/******************************************************************************
* ASAP2 file: CnvSet_Trq2Q.a2l
* Code generation for model "CnvSet_Trq2Q".
* Model version : 1.56
* Simulink Coder version : 8.11 (R2016b) 25-Aug-2016
* C source code generated on : Thu Jul 09 16:14:00 2020
* Target selection: ert.tlc
* Embedded hardware selection: Freescale->32-bit PowerPC
* Code generation objective: Execution efficiency
* Validation result: Not run
* (add additional file header information here)
******************************************************************************/ ASAP2_VERSION 1 51
/* Version 1.51 */
/begin PROJECT DCRS_Wolffu_NoRoadT4 "Design by Zhejiang University"
/begin HEADER "" /***********Version of ECU "DCRS ECU5-4YA"***********/ /*****Copyright of "Zhejiang University"*****/ /end HEADER
/begin MODULE CCP "Module Comment Goes Here"
/begin MOD_COMMON "Mod Common Comment Here" BYTE_ORDER MSB_FIRST ALIGNMENT_BYTE 1 ALIGNMENT_WORD 2 ALIGNMENT_LONG 4 ALIGNMENT_FLOAT32_IEEE 4 /end MOD_COMMON
/begin IF_DATA ASAP1B_CCP
 /begin SOURCE "segment synchronous" 0x67 0x1
  /begin QP_BLOB 0x0 LENGTH 0x10 CAN_ID_FIXED 0x330 RASTER 0x0 FIRST_PID 0x0 /end QP_BLOB
 /end SOURCE
 /begin SOURCE "10ms time synchronous" 0x4 0x1
  /begin QP_BLOB 0x1 LENGTH 0x1E CAN_ID_FIXED 0x340 RASTER 0x1 FIRST_PID 0x10 /end QP_BLOB
 /end SOURCE
 /begin SOURCE "100ms time synchronous" 0x4 0xA
  /begin QP_BLOB 0x2 LENGTH 0x28 CAN_ID_FIXED 0x350 RASTER 0x2 FIRST_PID 0x2E /end QP_BLOB
 /end SOURCE
 /begin RASTER "segment synchronous" "seg_sync" 0x0 0x67 0x1 /end RASTER
 /begin RASTER "10ms time synchronous" "10_ms" 0x1 0x4 0x1 /end RASTER
 /begin RASTER "100ms time synchronous" "100_ms" 0x2 0x4 0xA /end RASTER
 /begin SEED_KEY "" "" "" /end SEED_KEY
 /begin TP_BLOB 0x201 0x204 0x311 0x321 0xFFFFAD01 0x2 BAUDRATE 0x7A120 SAMPLE_POINT 0x53 SAMPLE_RATE 0x3 BTL_CYCLES 0xA SJW 0x1 SYNC_EDGE SINGLE DAQ_MODE BURST CONSISTENCY DAQ /begin CHECKSUM_PARAM 0xFFFFC001 0xFFFFFFFF CHECKSUM_CALCULATION ACTIVE_PAGE /end CHECKSUM_PARAM /begin DEFINED_PAGES 0x1 "reference page" 0x0 0x80240000 0x31000 ROM /end DEFINED_PAGES
  /begin DEFINED_PAGES 0x2 "working page" 0x0 0x240000 0x31000 RAM RAM_INIT_BY_ECU /end DEFINED_PAGES
  OPTIONAL_CMD 0x5 OPTIONAL_CMD 0x8 OPTIONAL_CMD 0x9 OPTIONAL_CMD 0xC OPTIONAL_CMD 0xD OPTIONAL_CMD 0xE OPTIONAL_CMD 0xF OPTIONAL_CMD 0x10 OPTIONAL_CMD 0x11 OPTIONAL_CMD 0x12 OPTIONAL_CMD 0x13 OPTIONAL_CMD 0x18 OPTIONAL_CMD 0x19 OPTIONAL_CMD 0x21 OPTIONAL_CMD 0x22 OPTIONAL_CMD 0x23 /end TP_BLOB
/end IF_DATA
/begin MOD_PAR "MOD PAR Comment Goes Here"
 /begin MEMORY_SEGMENT Pst80000000 "" RESERVED FLASH INTERN 0x80000000 0xC000 -1 -1 -1 -1 -1 /end MEMORY_SEGMENT
 /begin MEMORY_SEGMENT Pst8000C000 "" CODE FLASH INTERN 0x8000C000 0x234000 -1 -1 -1 -1 -1 /end MEMORY_SEGMENT
 /begin MEMORY_SEGMENT Dst80240000 "" DATA FLASH INTERN 0x80240000 0x31000 -1 -1 -1 -1 -1 /end MEMORY_SEGMENT
 /begin MEMORY_SEGMENT RamAFF00000 "" VARIABLES RAM INTERN 0xAFF00000 0x2000 -1 -1 -1 -1 -1 /end MEMORY_SEGMENT
 /begin MEMORY_SEGMENT RamAFF02000 "" CALIBRATION_VARIABLES RAM INTERN 0xAFF02000 0x2000 -1 -1 -1 -1 -1 /end MEMORY_SEGMENT
 /begin MEMORY_SEGMENT RamAFE70000 "" VARIABLES RAM INTERN 0xAFE70000 0x8000 -1 -1 -1 -1 -1 /end MEMORY_SEGMENT
 /begin MEMORY_SEGMENT RamAFE80000 "" VARIABLES RAM INTERN 0xAFE80000 0x2000 -1 -1 -1 -1 -1 /end MEMORY_SEGMENT
 /begin MEMORY_SEGMENT RamC0000000 "" VARIABLES RAM INTERN 0xC0000000 0x6000 -1 -1 -1 -1 -1 /end MEMORY_SEGMENT
 /begin MEMORY_SEGMENT RamD0000000 "" VARIABLES RAM INTERN 0xD0000000 0x20000 -1 -1 -1 -1 -1 /end MEMORY_SEGMENT
/end MOD_PAR
/begin RECORD_LAYOUT Scalar_BOOLEAN FNC_VALUES 1 UBYTE COLUMN_DIR DIRECT /end RECORD_LAYOUT
/begin RECORD_LAYOUT Scalar_UBYTE FNC_VALUES 1 UBYTE COLUMN_DIR DIRECT /end RECORD_LAYOUT
/begin RECORD_LAYOUT Scalar_BYTE FNC_VALUES 1 SBYTE COLUMN_DIR DIRECT /end RECORD_LAYOUT
/begin RECORD_LAYOUT Scalar_UWORD FNC_VALUES 1 UWORD COLUMN_DIR DIRECT /end RECORD_LAYOUT
/begin RECORD_LAYOUT Scalar_SWORD FNC_VALUES 1 SWORD COLUMN_DIR DIRECT /end RECORD_LAYOUT
/begin RECORD_LAYOUT Scalar_ULONG FNC_VALUES 1 ULONG COLUMN_DIR DIRECT /end RECORD_LAYOUT
/begin RECORD_LAYOUT Scalar_LONG FNC_VALUES 1 SLONG COLUMN_DIR DIRECT /end RECORD_LAYOUT
/begin RECORD_LAYOUT Scalar_FLOAT32_IEEE FNC_VALUES 1 FLOAT32_IEEE COLUMN_DIR DIRECT /end RECORD_LAYOUT
/begin RECORD_LAYOUT Scalar_FLOAT64_IEEE FNC_VALUES 1 FLOAT64_IEEE COLUMN_DIR DIRECT /end RECORD_LAYOUT
/begin RECORD_LAYOUT Lookup1D_BOOLEAN FNC_VALUES 1 UBYTE COLUMN_DIR DIRECT /end RECORD_LAYOUT
/begin RECORD_LAYOUT Lookup1D_X_BOOLEAN AXIS_PTS_X 1 UBYTE INDEX_INCR DIRECT /end RECORD_LAYOUT
/begin RECORD_LAYOUT Lookup1D_BYTE FNC_VALUES 1 SBYTE COLUMN_DIR DIRECT /end RECORD_LAYOUT
/begin RECORD_LAYOUT Lookup1D_X_BYTE AXIS_PTS_X 1 SBYTE INDEX_INCR DIRECT /end RECORD_LAYOUT
/begin RECORD_LAYOUT Lookup1D_UBYTE FNC_VALUES 1 UBYTE COLUMN_DIR DIRECT /end RECORD_LAYOUT
/begin RECORD_LAYOUT Lookup1D_X_UBYTE AXIS_PTS_X 1 UBYTE INDEX_INCR DIRECT /end RECORD_LAYOUT
/begin RECORD_LAYOUT Lookup1D_UWORD FNC_VALUES 1 UWORD COLUMN_DIR DIRECT /end RECORD_LAYOUT
/begin RECORD_LAYOUT Lookup1D_X_UWORD AXIS_PTS_X 1 UWORD INDEX_INCR DIRECT /end RECORD_LAYOUT
/begin RECORD_LAYOUT Lookup1D_WORD FNC_VALUES 1 SWORD COLUMN_DIR DIRECT /end RECORD_LAYOUT
/begin RECORD_LAYOUT Lookup1D_X_WORD AXIS_PTS_X 1 SWORD INDEX_INCR DIRECT /end RECORD_LAYOUT
/begin RECORD_LAYOUT Lookup1D_ULONG FNC_VALUES 1 ULONG COLUMN_DIR DIRECT /end RECORD_LAYOUT
/begin RECORD_LAYOUT Lookup1D_X_ULONG AXIS_PTS_X 1 ULONG INDEX_INCR DIRECT /end RECORD_LAYOUT
/begin RECORD_LAYOUT Lookup1D_SLONG FNC_VALUES 1 SLONG COLUMN_DIR DIRECT /end RECORD_LAYOUT
/begin RECORD_LAYOUT Lookup1D_X_LONG AXIS_PTS_X 1 SLONG INDEX_INCR DIRECT /end RECORD_LAYOUT
/begin RECORD_LAYOUT Lookup1D_FLOAT32_IEEE FNC_VALUES 1 FLOAT32_IEEE COLUMN_DIR DIRECT /end RECORD_LAYOUT
/begin RECORD_LAYOUT Lookup1D_X_FLOAT32_IEEE AXIS_PTS_X 1 FLOAT32_IEEE INDEX_INCR DIRECT /end RECORD_LAYOUT
/begin RECORD_LAYOUT Lookup1D_FLOAT64_IEEE FNC_VALUES 1 FLOAT64_IEEE COLUMN_DIR DIRECT /end RECORD_LAYOUT
/begin RECORD_LAYOUT Lookup1D_X_FLOAT64_IEEE AXIS_PTS_X 1 FLOAT64_IEEE INDEX_INCR DIRECT /end RECORD_LAYOUT
/begin RECORD_LAYOUT Lookup2D_BOOLEAN FNC_VALUES 1 UBYTE COLUMN_DIR DIRECT /end RECORD_LAYOUT
/begin RECORD_LAYOUT Lookup2D_X_BOOLEAN AXIS_PTS_X 1 UBYTE INDEX_INCR DIRECT /end RECORD_LAYOUT
/begin RECORD_LAYOUT Lookup2D_UBYTE FNC_VALUES 1 UBYTE COLUMN_DIR DIRECT /end RECORD_LAYOUT
/begin RECORD_LAYOUT Lookup2D_X_UBYTE AXIS_PTS_X 1 UBYTE INDEX_INCR DIRECT /end RECORD_LAYOUT
/begin RECORD_LAYOUT Lookup2D_BYTE FNC_VALUES 1 SBYTE COLUMN_DIR DIRECT /end RECORD_LAYOUT
/begin RECORD_LAYOUT Lookup2D_X_BYTE AXIS_PTS_X 1 SBYTE INDEX_INCR DIRECT /end RECORD_LAYOUT
/begin RECORD_LAYOUT Lookup2D_UWORD FNC_VALUES 1 UWORD COLUMN_DIR DIRECT /end RECORD_LAYOUT
/begin RECORD_LAYOUT Lookup2D_X_UWORD AXIS_PTS_X 1 UWORD INDEX_INCR DIRECT /end RECORD_LAYOUT
/begin RECORD_LAYOUT Lookup2D_WORD FNC_VALUES 1 SWORD COLUMN_DIR DIRECT /end RECORD_LAYOUT
/begin RECORD_LAYOUT Lookup2D_X_WORD AXIS_PTS_X 1 SWORD INDEX_INCR DIRECT /end RECORD_LAYOUT
/begin RECORD_LAYOUT Lookup2D_ULONG FNC_VALUES 1 ULONG COLUMN_DIR DIRECT /end RECORD_LAYOUT
/begin RECORD_LAYOUT Lookup2D_X_ULONG AXIS_PTS_X 1 ULONG INDEX_INCR DIRECT /end RECORD_LAYOUT
/begin RECORD_LAYOUT Lookup2D_LONG FNC_VALUES 1 SLONG COLUMN_DIR DIRECT /end RECORD_LAYOUT
/begin RECORD_LAYOUT Lookup2D_X_LONG AXIS_PTS_X 1 SLONG INDEX_INCR DIRECT /end RECORD_LAYOUT
/begin RECORD_LAYOUT Lookup2D_FLOAT32_IEEE FNC_VALUES 1 FLOAT32_IEEE COLUMN_DIR DIRECT /end RECORD_LAYOUT
/begin RECORD_LAYOUT Lookup2D_X_FLOAT32_IEEE AXIS_PTS_X 1 FLOAT32_IEEE INDEX_INCR DIRECT /end RECORD_LAYOUT
/begin RECORD_LAYOUT Lookup2D_FLOAT64_IEEE FNC_VALUES 1 FLOAT64_IEEE COLUMN_DIR DIRECT /end RECORD_LAYOUT
/begin RECORD_LAYOUT Lookup2D_X_FLOAT64_IEEE AXIS_PTS_X 1 FLOAT64_IEEE INDEX_INCR DIRECT /end RECORD_LAYOUT
/begin CHARACTERISTIC CnvSet_facRmpVal_CUR "Curve of ramp-factor for switch over ramp" /* Characteristic Type */ CURVE 0x0000 /* @ECU_Address@CnvSet_facRmpVal_CUR@ */ Lookup1D_WORD /* Maxdiff */ 0 Factor -31.0 31.0
 /begin AXIS_DESCR /* Description of X-Axis Points */ COM_AXIS NO_INPUT_QUANTITY Factor 11 -31.0 31.0 AXIS_PTS_REF CnvSet_facRmpVal_CURX /end AXIS_DESCR
/end CHARACTERISTIC
/begin AXIS_PTS CnvSet_facRmpVal_CURX "AxisX of the Curve" 0x0000 /* @ECU_Address@CnvSet_facRmpVal_CURX@ */ NO_INPUT_QUANTITY Lookup1D_X_WORD 0 Factor 11 -31.0 31.0 /end AXIS_PTS
/begin CHARACTERISTIC PhyMod_trq2qBas_MAP "Engine basic map for conversion of torque/quantity" /* Characteristic Type */ MAP 0x0000 /* @ECU_Address@PhyMod_trq2qBas_MAP@ */ Lookup2D_WORD /* Maxdiff */ 0 FuelMass_mg_hub -319.0 319.0
 /begin AXIS_DESCR /* Description of Y-Axis Points */ COM_AXIS NO_INPUT_QUANTITY EngSpeed_rpm 16 -12000.0 12000.0 AXIS_PTS_REF PhyMod_trq2qBas_MAPX /end AXIS_DESCR
 /begin AXIS_DESCR /* Description of X-Axis Points */ COM_AXIS NO_INPUT_QUANTITY Trq_Nm 16 -3276.8 3276.7 AXIS_PTS_REF PhyMod_trq2qBas_MAPY /end AXIS_DESCR
/end CHARACTERISTIC
/begin AXIS_PTS PhyMod_trq2qBas_MAPY "AxisY of the MAP" 0x0000 /* @ECU_Address@PhyMod_trq2qBas_MAPY@ */ NO_INPUT_QUANTITY Lookup2D_X_WORD 0 Trq_Nm 16 -3276.8 3276.7 /end AXIS_PTS
/begin AXIS_PTS PhyMod_trq2qBas_MAPX "AxisX of the MAP" 0x0000 /* @ECU_Address@PhyMod_trq2qBas_MAPX@ */ NO_INPUT_QUANTITY Lookup2D_X_WORD 0 EngSpeed_rpm 16 -12000.0 12000.0 /end AXIS_PTS
/begin CHARACTERISTIC CnvSet_eta0_C "Conversion efficiency during start" VALUE 0x0000 /* @ECU_Address@CnvSet_eta0_C@ */ Scalar_SWORD 0 TrqEta_Nm_mg_hub -255.0 255.0 /end CHARACTERISTIC
/begin CHARACTERISTIC CnvSet_etaMax_C "Current conversion efficiency min limation" VALUE 0x0000 /* @ECU_Address@CnvSet_etaMax_C@ */ Scalar_SWORD 0 TrqEta_Nm_mg_hub -255.0 255.0 /end CHARACTERISTIC
/begin CHARACTERISTIC CnvSet_etaMin_C "Current conversion efficiency max limation" VALUE 0x0000 /* @ECU_Address@CnvSet_etaMin_C@ */ Scalar_SWORD 0 TrqEta_Nm_mg_hub -255.0 255.0 /end CHARACTERISTIC
/begin MEASUREMENT PthSet_trqInrSetAct "Current inner engine torque" SWORD Trq_Nm 0 0 -3276.8 3276.7 ECU_ADDRESS 0x0000 /* @ECU_Address@PthSet_trqInrSetAct@ */ /end MEASUREMENT
/begin MEASUREMENT CnvSet_facRmpVal "ramp value for operation mode switchover" SWORD Factor 0 0 -31.0 31.0 ECU_ADDRESS 0x0000 /* @ECU_Address@CnvSet_facRmpVal@ */ /end MEASUREMENT
/begin MEASUREMENT CnvSet_qSetOpt_mp "Setpoint injection quantity without corrections" SWORD FuelMass_mg_hub 0 0 -319.0 319.0 ECU_ADDRESS 0x0000 /* @ECU_Address@CnvSet_qSetOpt_mp@ */ /end MEASUREMENT
/begin MEASUREMENT CnvSet_qSetPrs "Setpoint injection quantity current operation mode" SWORD FuelMass_mg_hub 0 0 -319.0 319.0 ECU_ADDRESS 0x0000 /* @ECU_Address@CnvSet_qSetPrs@ */ /end MEASUREMENT
/begin MEASUREMENT CnvSet_qSetOptNxt_mp "Setpoint injection quantity without corrections next operation mode" SWORD FuelMass_mg_hub 0 0 -319.0 319.0 ECU_ADDRESS 0x0000 /* @ECU_Address@CnvSet_qSetOptNxt_mp@ */ /end MEASUREMENT
/begin MEASUREMENT CnvSet_qSet "Set point injection quantity" SWORD FuelMass_mg_hub 0 0 -319.0 319.0 ECU_ADDRESS 0x0000 /* @ECU_Address@CnvSet_qSet@ */ /end MEASUREMENT
/begin MEASUREMENT CnvSet_qSetNxt "Setpoint injection quantity next opration mode" SWORD FuelMass_mg_hub 0 0 -319.0 319.0 ECU_ADDRESS 0x0000 /* @ECU_Address@CnvSet_qSetNxt@ */ /end MEASUREMENT
/begin MEASUREMENT CnvSet_qStrt "Injection start quantity" SWORD FuelMass_mg_hub 0 0 -319.0 319.0 ECU_ADDRESS 0x0000 /* @ECU_Address@CnvSet_qStrt@ */ /end MEASUREMENT
/begin MEASUREMENT CnvSet_etaCurrRmp "Conversion efficiency corresponding to CnvSet_qSet" SWORD TrqEta_Nm_mg_hub 0 0 -255.0 255.0 ECU_ADDRESS 0x0000 /* @ECU_Address@CnvSet_etaCurrRmp@ */ /end MEASUREMENT
/begin MEASUREMENT CnvSet_etaCurr "Current conversion efficiency" SWORD TrqEta_Nm_mg_hub 0 0 -255.0 255.0 ECU_ADDRESS 0x0000 /* @ECU_Address@CnvSet_etaCurr@ */ /end MEASUREMENT
/begin MEASUREMENT CnvSet_etaCurrNxt "conversion efficiency for next operation mode" SWORD TrqEta_Nm_mg_hub 0 0 -255.0 255.0 ECU_ADDRESS 0x0000 /* @ECU_Address@CnvSet_etaCurrNxt@ */ /end MEASUREMENT
/begin COMPU_METHOD Factor "f(x)=(c1*X*X+c2*X+c3)/(c4*X*X+c5*X+c6)" RAT_FUNC "%12.6" "" COEFFS 0 1024.000 0.000 0 0 1.000 /end COMPU_METHOD
/begin COMPU_METHOD FuelMass_mg_hub "f(x)=(c1*X*X+c2*X+c3)/(c4*X*X+c5*X+c6)" RAT_FUNC "%0.3" "mg/hub" COEFFS 0 102.400 0.000 0 0 1.000 /end COMPU_METHOD
/begin COMPU_METHOD EngSpeed_rpm "f(x)=(c1*X*X+c2*X+c3)/(c4*X*X+c5*X+c6)" RAT_FUNC "%6.1" "rpm" COEFFS 0 2.000 0.000 0 0 1.000 /end COMPU_METHOD
/begin COMPU_METHOD Trq_Nm "f(x)=(c1*X*X+c2*X+c3)/(c4*X*X+c5*X+c6)" RAT_FUNC "%0.3" "Nm" COEFFS 0 10.000 0.000 0 0 1.000 /end COMPU_METHOD
/begin COMPU_METHOD TrqEta_Nm_mg_hub "f(x)=(c1*X*X+c2*X+c3)/(c4*X*X+c5*X+c6)" RAT_FUNC "%10.6" "Nm/(mg/hub)" COEFFS 0 128.000 0.000 0 0 1.000 /end COMPU_METHOD
/begin GROUP CnvSet_Trq2Q "CnvSet_Trq2Q" /* Root */ ROOT
 /begin SUB_GROUP Root_etaCurrRmp Root_facRmpVal Root_qSet Root_qSetNxtRaw Root_qSetPrsRaw Root_qStrt /end SUB_GROUP
 /begin REF_MEASUREMENT PthSet_trqInrSetAct /end REF_MEASUREMENT
/end GROUP
/begin GROUP Root_etaCurrRmp "CnvSet_Trq2Q/etaCurrRmp" /begin REF_CHARACTERISTIC CnvSet_etaMax_C CnvSet_etaMin_C /end REF_CHARACTERISTIC /begin REF_MEASUREMENT CnvSet_etaCurrRmp /end REF_MEASUREMENT /end GROUP
/begin GROUP Root_facRmpVal "CnvSet_Trq2Q/facRmpVal" /begin REF_CHARACTERISTIC CnvSet_facRmpVal_CUR /end REF_CHARACTERISTIC /begin REF_MEASUREMENT CnvSet_facRmpVal /end REF_MEASUREMENT /end GROUP
/begin GROUP Root_qSet "CnvSet_Trq2Q/qSet" /begin REF_MEASUREMENT CnvSet_qSet CnvSet_qSetNxt CnvSet_qSetPrs /end REF_MEASUREMENT /end GROUP
/begin GROUP Root_qSetNxtRaw "CnvSet_Trq2Q/qSetNxtRaw" /begin REF_CHARACTERISTIC CnvSet_etaMax_C CnvSet_etaMin_C PhyMod_trq2qBas_MAP /end REF_CHARACTERISTIC /begin REF_MEASUREMENT CnvSet_etaCurrNxt CnvSet_qSetOptNxt_mp /end REF_MEASUREMENT /end GROUP
/begin GROUP Root_qSetPrsRaw "CnvSet_Trq2Q/qSetPrsRaw" /begin REF_CHARACTERISTIC CnvSet_etaMax_C CnvSet_etaMin_C PhyMod_trq2qBas_MAP /end REF_CHARACTERISTIC /begin REF_MEASUREMENT CnvSet_etaCurr CnvSet_qSetOpt_mp /end REF_MEASUREMENT /end GROUP
/begin GROUP Root_qStrt "CnvSet_Trq2Q/qStrt" /begin REF_CHARACTERISTIC CnvSet_eta0_C /end REF_CHARACTERISTIC /begin REF_MEASUREMENT CnvSet_qStrt /end REF_MEASUREMENT /end GROUP
/end MODULE
/end PROJECT
/* (add any file trailer comments here) */
/* EOF CnvSet_Trq2Q.a2l */
