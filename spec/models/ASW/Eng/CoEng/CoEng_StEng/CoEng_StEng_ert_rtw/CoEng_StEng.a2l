/******************************************************************************
* ASAP2 file: CoEng_StEng.a2l
* Code generation for model "CoEng_StEng".
* Model version : 1.61
* Simulink Coder version : 8.11 (R2016b) 25-Aug-2016
* C source code generated on : Wed Jul 01 14:46:16 2020
* Target selection: ert.tlc
* Embedded hardware selection: Freescale->32-bit PowerPC
* Code generation objective: Execution efficiency
* Validation result: Not run
* (add additional file header information here)
******************************************************************************/ ASAP2_VERSION 1 51
/* Version 1.51 */
/begin PROJECT DCRS_Wolffu_NoRoadT4 "Design by Zhejiang University"
/begin HEADER "" /***********Version of ECU "DCRS ECU5-4YA"***********/ /*****Copyright of "Zhejiang University"*****/ /end HEADER
/begin MODULE CCP "Module Comment Goes Here"
/begin MOD_COMMON "Mod Common Comment Here" BYTE_ORDER MSB_FIRST ALIGNMENT_BYTE 1 ALIGNMENT_WORD 2 ALIGNMENT_LONG 4 ALIGNMENT_FLOAT32_IEEE 4 /end MOD_COMMON
/begin IF_DATA ASAP1B_CCP
 /begin SOURCE "segment synchronous" 0x67 0x1
  /begin QP_BLOB 0x0 LENGTH 0x10 CAN_ID_FIXED 0x330 RASTER 0x0 FIRST_PID 0x0 /end QP_BLOB
 /end SOURCE
 /begin SOURCE "10ms time synchronous" 0x4 0x1
  /begin QP_BLOB 0x1 LENGTH 0x1E CAN_ID_FIXED 0x340 RASTER 0x1 FIRST_PID 0x10 /end QP_BLOB
 /end SOURCE
 /begin SOURCE "100ms time synchronous" 0x4 0xA
  /begin QP_BLOB 0x2 LENGTH 0x28 CAN_ID_FIXED 0x350 RASTER 0x2 FIRST_PID 0x2E /end QP_BLOB
 /end SOURCE
 /begin RASTER "segment synchronous" "seg_sync" 0x0 0x67 0x1 /end RASTER
 /begin RASTER "10ms time synchronous" "10_ms" 0x1 0x4 0x1 /end RASTER
 /begin RASTER "100ms time synchronous" "100_ms" 0x2 0x4 0xA /end RASTER
 /begin SEED_KEY "" "" "" /end SEED_KEY
 /begin TP_BLOB 0x201 0x204 0x311 0x321 0xFFFFAD01 0x2 BAUDRATE 0x7A120 SAMPLE_POINT 0x53 SAMPLE_RATE 0x3 BTL_CYCLES 0xA SJW 0x1 SYNC_EDGE SINGLE DAQ_MODE BURST CONSISTENCY DAQ /begin CHECKSUM_PARAM 0xFFFFC001 0xFFFFFFFF CHECKSUM_CALCULATION ACTIVE_PAGE /end CHECKSUM_PARAM /begin DEFINED_PAGES 0x1 "reference page" 0x0 0x80240000 0x31000 ROM /end DEFINED_PAGES
  /begin DEFINED_PAGES 0x2 "working page" 0x0 0x240000 0x31000 RAM RAM_INIT_BY_ECU /end DEFINED_PAGES
  OPTIONAL_CMD 0x5 OPTIONAL_CMD 0x8 OPTIONAL_CMD 0x9 OPTIONAL_CMD 0xC OPTIONAL_CMD 0xD OPTIONAL_CMD 0xE OPTIONAL_CMD 0xF OPTIONAL_CMD 0x10 OPTIONAL_CMD 0x11 OPTIONAL_CMD 0x12 OPTIONAL_CMD 0x13 OPTIONAL_CMD 0x18 OPTIONAL_CMD 0x19 OPTIONAL_CMD 0x21 OPTIONAL_CMD 0x22 OPTIONAL_CMD 0x23 /end TP_BLOB
/end IF_DATA
/begin MOD_PAR "MOD PAR Comment Goes Here"
 /begin MEMORY_SEGMENT Pst80000000 "" RESERVED FLASH INTERN 0x80000000 0xC000 -1 -1 -1 -1 -1 /end MEMORY_SEGMENT
 /begin MEMORY_SEGMENT Pst8000C000 "" CODE FLASH INTERN 0x8000C000 0x234000 -1 -1 -1 -1 -1 /end MEMORY_SEGMENT
 /begin MEMORY_SEGMENT Dst80240000 "" DATA FLASH INTERN 0x80240000 0x31000 -1 -1 -1 -1 -1 /end MEMORY_SEGMENT
 /begin MEMORY_SEGMENT RamAFF00000 "" VARIABLES RAM INTERN 0xAFF00000 0x2000 -1 -1 -1 -1 -1 /end MEMORY_SEGMENT
 /begin MEMORY_SEGMENT RamAFF02000 "" CALIBRATION_VARIABLES RAM INTERN 0xAFF02000 0x2000 -1 -1 -1 -1 -1 /end MEMORY_SEGMENT
 /begin MEMORY_SEGMENT RamAFE70000 "" VARIABLES RAM INTERN 0xAFE70000 0x8000 -1 -1 -1 -1 -1 /end MEMORY_SEGMENT
 /begin MEMORY_SEGMENT RamAFE80000 "" VARIABLES RAM INTERN 0xAFE80000 0x2000 -1 -1 -1 -1 -1 /end MEMORY_SEGMENT
 /begin MEMORY_SEGMENT RamC0000000 "" VARIABLES RAM INTERN 0xC0000000 0x6000 -1 -1 -1 -1 -1 /end MEMORY_SEGMENT
 /begin MEMORY_SEGMENT RamD0000000 "" VARIABLES RAM INTERN 0xD0000000 0x20000 -1 -1 -1 -1 -1 /end MEMORY_SEGMENT
/end MOD_PAR
/begin RECORD_LAYOUT Scalar_BOOLEAN FNC_VALUES 1 UBYTE COLUMN_DIR DIRECT /end RECORD_LAYOUT
/begin RECORD_LAYOUT Scalar_UBYTE FNC_VALUES 1 UBYTE COLUMN_DIR DIRECT /end RECORD_LAYOUT
/begin RECORD_LAYOUT Scalar_BYTE FNC_VALUES 1 SBYTE COLUMN_DIR DIRECT /end RECORD_LAYOUT
/begin RECORD_LAYOUT Scalar_UWORD FNC_VALUES 1 UWORD COLUMN_DIR DIRECT /end RECORD_LAYOUT
/begin RECORD_LAYOUT Scalar_SWORD FNC_VALUES 1 SWORD COLUMN_DIR DIRECT /end RECORD_LAYOUT
/begin RECORD_LAYOUT Scalar_ULONG FNC_VALUES 1 ULONG COLUMN_DIR DIRECT /end RECORD_LAYOUT
/begin RECORD_LAYOUT Scalar_LONG FNC_VALUES 1 SLONG COLUMN_DIR DIRECT /end RECORD_LAYOUT
/begin RECORD_LAYOUT Scalar_FLOAT32_IEEE FNC_VALUES 1 FLOAT32_IEEE COLUMN_DIR DIRECT /end RECORD_LAYOUT
/begin RECORD_LAYOUT Scalar_FLOAT64_IEEE FNC_VALUES 1 FLOAT64_IEEE COLUMN_DIR DIRECT /end RECORD_LAYOUT
/begin RECORD_LAYOUT Lookup1D_BOOLEAN FNC_VALUES 1 UBYTE COLUMN_DIR DIRECT /end RECORD_LAYOUT
/begin RECORD_LAYOUT Lookup1D_X_BOOLEAN AXIS_PTS_X 1 UBYTE INDEX_INCR DIRECT /end RECORD_LAYOUT
/begin RECORD_LAYOUT Lookup1D_BYTE FNC_VALUES 1 SBYTE COLUMN_DIR DIRECT /end RECORD_LAYOUT
/begin RECORD_LAYOUT Lookup1D_X_BYTE AXIS_PTS_X 1 SBYTE INDEX_INCR DIRECT /end RECORD_LAYOUT
/begin RECORD_LAYOUT Lookup1D_UBYTE FNC_VALUES 1 UBYTE COLUMN_DIR DIRECT /end RECORD_LAYOUT
/begin RECORD_LAYOUT Lookup1D_X_UBYTE AXIS_PTS_X 1 UBYTE INDEX_INCR DIRECT /end RECORD_LAYOUT
/begin RECORD_LAYOUT Lookup1D_UWORD FNC_VALUES 1 UWORD COLUMN_DIR DIRECT /end RECORD_LAYOUT
/begin RECORD_LAYOUT Lookup1D_X_UWORD AXIS_PTS_X 1 UWORD INDEX_INCR DIRECT /end RECORD_LAYOUT
/begin RECORD_LAYOUT Lookup1D_WORD FNC_VALUES 1 SWORD COLUMN_DIR DIRECT /end RECORD_LAYOUT
/begin RECORD_LAYOUT Lookup1D_X_WORD AXIS_PTS_X 1 SWORD INDEX_INCR DIRECT /end RECORD_LAYOUT
/begin RECORD_LAYOUT Lookup1D_ULONG FNC_VALUES 1 ULONG COLUMN_DIR DIRECT /end RECORD_LAYOUT
/begin RECORD_LAYOUT Lookup1D_X_ULONG AXIS_PTS_X 1 ULONG INDEX_INCR DIRECT /end RECORD_LAYOUT
/begin RECORD_LAYOUT Lookup1D_SLONG FNC_VALUES 1 SLONG COLUMN_DIR DIRECT /end RECORD_LAYOUT
/begin RECORD_LAYOUT Lookup1D_X_LONG AXIS_PTS_X 1 SLONG INDEX_INCR DIRECT /end RECORD_LAYOUT
/begin RECORD_LAYOUT Lookup1D_FLOAT32_IEEE FNC_VALUES 1 FLOAT32_IEEE COLUMN_DIR DIRECT /end RECORD_LAYOUT
/begin RECORD_LAYOUT Lookup1D_X_FLOAT32_IEEE AXIS_PTS_X 1 FLOAT32_IEEE INDEX_INCR DIRECT /end RECORD_LAYOUT
/begin RECORD_LAYOUT Lookup1D_FLOAT64_IEEE FNC_VALUES 1 FLOAT64_IEEE COLUMN_DIR DIRECT /end RECORD_LAYOUT
/begin RECORD_LAYOUT Lookup1D_X_FLOAT64_IEEE AXIS_PTS_X 1 FLOAT64_IEEE INDEX_INCR DIRECT /end RECORD_LAYOUT
/begin RECORD_LAYOUT Lookup2D_BOOLEAN FNC_VALUES 1 UBYTE COLUMN_DIR DIRECT /end RECORD_LAYOUT
/begin RECORD_LAYOUT Lookup2D_X_BOOLEAN AXIS_PTS_X 1 UBYTE INDEX_INCR DIRECT /end RECORD_LAYOUT
/begin RECORD_LAYOUT Lookup2D_UBYTE FNC_VALUES 1 UBYTE COLUMN_DIR DIRECT /end RECORD_LAYOUT
/begin RECORD_LAYOUT Lookup2D_X_UBYTE AXIS_PTS_X 1 UBYTE INDEX_INCR DIRECT /end RECORD_LAYOUT
/begin RECORD_LAYOUT Lookup2D_BYTE FNC_VALUES 1 SBYTE COLUMN_DIR DIRECT /end RECORD_LAYOUT
/begin RECORD_LAYOUT Lookup2D_X_BYTE AXIS_PTS_X 1 SBYTE INDEX_INCR DIRECT /end RECORD_LAYOUT
/begin RECORD_LAYOUT Lookup2D_UWORD FNC_VALUES 1 UWORD COLUMN_DIR DIRECT /end RECORD_LAYOUT
/begin RECORD_LAYOUT Lookup2D_X_UWORD AXIS_PTS_X 1 UWORD INDEX_INCR DIRECT /end RECORD_LAYOUT
/begin RECORD_LAYOUT Lookup2D_WORD FNC_VALUES 1 SWORD COLUMN_DIR DIRECT /end RECORD_LAYOUT
/begin RECORD_LAYOUT Lookup2D_X_WORD AXIS_PTS_X 1 SWORD INDEX_INCR DIRECT /end RECORD_LAYOUT
/begin RECORD_LAYOUT Lookup2D_ULONG FNC_VALUES 1 ULONG COLUMN_DIR DIRECT /end RECORD_LAYOUT
/begin RECORD_LAYOUT Lookup2D_X_ULONG AXIS_PTS_X 1 ULONG INDEX_INCR DIRECT /end RECORD_LAYOUT
/begin RECORD_LAYOUT Lookup2D_LONG FNC_VALUES 1 SLONG COLUMN_DIR DIRECT /end RECORD_LAYOUT
/begin RECORD_LAYOUT Lookup2D_X_LONG AXIS_PTS_X 1 SLONG INDEX_INCR DIRECT /end RECORD_LAYOUT
/begin RECORD_LAYOUT Lookup2D_FLOAT32_IEEE FNC_VALUES 1 FLOAT32_IEEE COLUMN_DIR DIRECT /end RECORD_LAYOUT
/begin RECORD_LAYOUT Lookup2D_X_FLOAT32_IEEE AXIS_PTS_X 1 FLOAT32_IEEE INDEX_INCR DIRECT /end RECORD_LAYOUT
/begin RECORD_LAYOUT Lookup2D_FLOAT64_IEEE FNC_VALUES 1 FLOAT64_IEEE COLUMN_DIR DIRECT /end RECORD_LAYOUT
/begin RECORD_LAYOUT Lookup2D_X_FLOAT64_IEEE AXIS_PTS_X 1 FLOAT64_IEEE INDEX_INCR DIRECT /end RECORD_LAYOUT
/begin CHARACTERISTIC CoEng_tiNrml2Strt_C "Debounce time of engine state transition from NORMAL to START" VALUE 0x0000 /* @ECU_Address@CoEng_tiNrml2Strt_C@ */ Scalar_ULONG 0 EngTime_ms 0.0 65535.0 /end CHARACTERISTIC
/begin CHARACTERISTIC CoEng_nThresCranking_C "Threshold of engine speed for transition from COENG_REAND to COENG_CRANKING" VALUE 0x0000 /* @ECU_Address@CoEng_nThresCranking_C@ */ Scalar_SWORD 0 EngSpeed_rpm 0.0 12799.0 /end CHARACTERISTIC
/begin CHARACTERISTIC CoEng_nThresNrml2Strt_C "Threshold of engine speed for transition from COENG_NORMAL to START" VALUE 0x0000 /* @ECU_Address@CoEng_nThresNrml2Strt_C@ */ Scalar_SWORD 0 EngSpeed_rpm 0.0 12799.0 /end CHARACTERISTIC
/begin MEASUREMENT CoEng_tiNormal "Time since state\"CONENG_RUNNING\"was reached" ULONG EngTime_ms 0 0 0.0 4.294967295E+10 ECU_ADDRESS 0x0000 /* @ECU_Address@CoEng_tiNormal@ */ /end MEASUREMENT
/begin MEASUREMENT CoEng_tiStandby "Time since engine state COENG_STANDBY was reached" ULONG EngTime_ms 0 0 0.0 4.294967295E+10 ECU_ADDRESS 0x0000 /* @ECU_Address@CoEng_tiStandby@ */ /end MEASUREMENT
/begin MEASUREMENT CoEng_tiStart "Time since state(COENG_READY&COENG_CRANKING) was reached" ULONG EngTime_ms 0 0 0.0 4.294967295E+10 ECU_ADDRESS 0x0000 /* @ECU_Address@CoEng_tiStart@ */ /end MEASUREMENT
/begin MEASUREMENT CoEng_tiAfterrun "Time since reaching engine state afterrun (COENG-_STOPPING & COENG_FINISH)" ULONG EngTime_ms 0 0 0.0 4.294967295E+10 ECU_ADDRESS 0x0000 /* @ECU_Address@CoEng_tiAfterrun@ */ /end MEASUREMENT
/begin MEASUREMENT CoEng_tiNrml2Strt_mp "Devounce time for engine state transition from NORMAL to START" ULONG EngTime_ms 0 0 0.0 65535.0 ECU_ADDRESS 0x0000 /* @ECU_Address@CoEng_tiNrml2Strt_mp@ */ /end MEASUREMENT
/begin MEASUREMENT CoEng_st "Engine coordinator state" UBYTE EngState_conv 0 0 0 5 ECU_ADDRESS 0x0000 /* @ECU_Address@CoEng_st@ */ /end MEASUREMENT
/begin MEASUREMENT CoEng_stOld "Engine state before current state was reached" UBYTE EngState_conv 0 0 0 5 ECU_ADDRESS 0x0000 /* @ECU_Address@CoEng_stOld@ */ /end MEASUREMENT
/begin COMPU_METHOD EngTime_ms "f(x)=(c1*X*X+c2*X+c3)/(c4*X*X+c5*X+c6)" RAT_FUNC "%0.3" "ms" /* Coefficients */ COEFFS 0 1.000 0.000 0 0 10.000 /end COMPU_METHOD
/begin COMPU_METHOD EngSpeed_rpm "f(x)=(c1*X*X+c2*X+c3)/(c4*X*X+c5*X+c6)" RAT_FUNC "%6.1" "rpm" /* Coefficients */ COEFFS 0 2.000 0.000 0 0 1.000 /end COMPU_METHOD
/begin COMPU_METHOD EngState_conv "Enumerated data type: EngState_conv" TAB_VERB "%0.3" "" /* Conversion Table */ COMPU_TAB_REF VTAB_FOR_EngState_conv /end COMPU_METHOD
/begin COMPU_VTAB /* Name of Table */ VTAB_FOR_EngState_conv "Enumerated data type: EngState_conv" TAB_VERB /* Number of Elements */ 6 0 "COENG_STANDBY" 1 "COENG_READY" 2 "COENG_CRANKING" 3 "COENG_RUNNING" 4 "COENG_STOPPING" 5 "COENG_FINISH" /end COMPU_VTAB
/begin GROUP CoEng_StEng "CoEng_StEng" /* Root */ ROOT
 /begin REF_CHARACTERISTIC CoEng_nThresCranking_C CoEng_nThresNrml2Strt_C CoEng_tiNrml2Strt_C /end REF_CHARACTERISTIC
 /begin REF_MEASUREMENT CoEng_st CoEng_stOld CoEng_tiAfterrun CoEng_tiNormal CoEng_tiNrml2Strt_mp CoEng_tiStandby CoEng_tiStart /end REF_MEASUREMENT
/end GROUP
/end MODULE
/end PROJECT
/* (add any file trailer comments here) */
/* EOF CoEng_StEng.a2l */
