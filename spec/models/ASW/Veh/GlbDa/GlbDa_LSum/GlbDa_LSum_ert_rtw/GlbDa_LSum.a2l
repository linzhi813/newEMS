/******************************************************************************
* ASAP2 file: GlbDa_LSum.a2l
* Code generation for model "GlbDa_LSum".
* Model version : 1.22
* Simulink Coder version : 8.11 (R2016b) 25-Aug-2016
* C source code generated on : Wed Jul 15 08:56:07 2020
* Target selection: ert.tlc
* Embedded hardware selection: Freescale->32-bit PowerPC
* Code generation objective: Execution efficiency
* Validation result: Not run
* (add additional file header information here)
******************************************************************************/ ASAP2_VERSION 1 51
/* Version 1.51 */
/begin PROJECT DCRS_Wolffu_NoRoadT4 "Design by Zhejiang University"
/begin HEADER "" /***********Version of ECU "DCRS ECU5-4YA"***********/ /*****Copyright of "Zhejiang University"*****/ /end HEADER
/begin MODULE CCP "Module Comment Goes Here"
/begin MOD_COMMON "Mod Common Comment Here" BYTE_ORDER MSB_FIRST ALIGNMENT_BYTE 1 ALIGNMENT_WORD 2 ALIGNMENT_LONG 4 ALIGNMENT_FLOAT32_IEEE 4 /end MOD_COMMON
/begin IF_DATA ASAP1B_CCP
 /begin SOURCE "segment synchronous" 0x67 0x1
  /begin QP_BLOB 0x0 LENGTH 0x10 CAN_ID_FIXED 0x330 RASTER 0x0 FIRST_PID 0x0 /end QP_BLOB
 /end SOURCE
 /begin SOURCE "10ms time synchronous" 0x4 0x1
  /begin QP_BLOB 0x1 LENGTH 0x1E CAN_ID_FIXED 0x340 RASTER 0x1 FIRST_PID 0x10 /end QP_BLOB
 /end SOURCE
 /begin SOURCE "100ms time synchronous" 0x4 0xA
  /begin QP_BLOB 0x2 LENGTH 0x28 CAN_ID_FIXED 0x350 RASTER 0x2 FIRST_PID 0x2E /end QP_BLOB
 /end SOURCE
 /begin RASTER "segment synchronous" "seg_sync" 0x0 0x67 0x1 /end RASTER
 /begin RASTER "10ms time synchronous" "10_ms" 0x1 0x4 0x1 /end RASTER
 /begin RASTER "100ms time synchronous" "100_ms" 0x2 0x4 0xA /end RASTER
 /begin SEED_KEY "" "" "" /end SEED_KEY
 /begin TP_BLOB 0x201 0x204 0x311 0x321 0xFFFFAD01 0x2 BAUDRATE 0x7A120 SAMPLE_POINT 0x53 SAMPLE_RATE 0x3 BTL_CYCLES 0xA SJW 0x1 SYNC_EDGE SINGLE DAQ_MODE BURST CONSISTENCY DAQ /begin CHECKSUM_PARAM 0xFFFFC001 0xFFFFFFFF CHECKSUM_CALCULATION ACTIVE_PAGE /end CHECKSUM_PARAM /begin DEFINED_PAGES 0x1 "reference page" 0x0 0x80240000 0x31000 ROM /end DEFINED_PAGES
  /begin DEFINED_PAGES 0x2 "working page" 0x0 0x240000 0x31000 RAM RAM_INIT_BY_ECU /end DEFINED_PAGES
  OPTIONAL_CMD 0x5 OPTIONAL_CMD 0x8 OPTIONAL_CMD 0x9 OPTIONAL_CMD 0xC OPTIONAL_CMD 0xD OPTIONAL_CMD 0xE OPTIONAL_CMD 0xF OPTIONAL_CMD 0x10 OPTIONAL_CMD 0x11 OPTIONAL_CMD 0x12 OPTIONAL_CMD 0x13 OPTIONAL_CMD 0x18 OPTIONAL_CMD 0x19 OPTIONAL_CMD 0x21 OPTIONAL_CMD 0x22 OPTIONAL_CMD 0x23 /end TP_BLOB
/end IF_DATA
/begin MOD_PAR "MOD PAR Comment Goes Here"
 /begin MEMORY_SEGMENT Pst80000000 "" RESERVED FLASH INTERN 0x80000000 0xC000 -1 -1 -1 -1 -1 /end MEMORY_SEGMENT
 /begin MEMORY_SEGMENT Pst8000C000 "" CODE FLASH INTERN 0x8000C000 0x234000 -1 -1 -1 -1 -1 /end MEMORY_SEGMENT
 /begin MEMORY_SEGMENT Dst80240000 "" DATA FLASH INTERN 0x80240000 0x31000 -1 -1 -1 -1 -1 /end MEMORY_SEGMENT
 /begin MEMORY_SEGMENT RamAFF00000 "" VARIABLES RAM INTERN 0xAFF00000 0x2000 -1 -1 -1 -1 -1 /end MEMORY_SEGMENT
 /begin MEMORY_SEGMENT RamAFF02000 "" CALIBRATION_VARIABLES RAM INTERN 0xAFF02000 0x2000 -1 -1 -1 -1 -1 /end MEMORY_SEGMENT
 /begin MEMORY_SEGMENT RamAFE70000 "" VARIABLES RAM INTERN 0xAFE70000 0x8000 -1 -1 -1 -1 -1 /end MEMORY_SEGMENT
 /begin MEMORY_SEGMENT RamAFE80000 "" VARIABLES RAM INTERN 0xAFE80000 0x2000 -1 -1 -1 -1 -1 /end MEMORY_SEGMENT
 /begin MEMORY_SEGMENT RamC0000000 "" VARIABLES RAM INTERN 0xC0000000 0x6000 -1 -1 -1 -1 -1 /end MEMORY_SEGMENT
 /begin MEMORY_SEGMENT RamD0000000 "" VARIABLES RAM INTERN 0xD0000000 0x20000 -1 -1 -1 -1 -1 /end MEMORY_SEGMENT
/end MOD_PAR
/begin RECORD_LAYOUT Scalar_BOOLEAN FNC_VALUES 1 UBYTE COLUMN_DIR DIRECT /end RECORD_LAYOUT
/begin RECORD_LAYOUT Scalar_UBYTE FNC_VALUES 1 UBYTE COLUMN_DIR DIRECT /end RECORD_LAYOUT
/begin RECORD_LAYOUT Scalar_BYTE FNC_VALUES 1 SBYTE COLUMN_DIR DIRECT /end RECORD_LAYOUT
/begin RECORD_LAYOUT Scalar_UWORD FNC_VALUES 1 UWORD COLUMN_DIR DIRECT /end RECORD_LAYOUT
/begin RECORD_LAYOUT Scalar_SWORD FNC_VALUES 1 SWORD COLUMN_DIR DIRECT /end RECORD_LAYOUT
/begin RECORD_LAYOUT Scalar_ULONG FNC_VALUES 1 ULONG COLUMN_DIR DIRECT /end RECORD_LAYOUT
/begin RECORD_LAYOUT Scalar_LONG FNC_VALUES 1 SLONG COLUMN_DIR DIRECT /end RECORD_LAYOUT
/begin RECORD_LAYOUT Scalar_FLOAT32_IEEE FNC_VALUES 1 FLOAT32_IEEE COLUMN_DIR DIRECT /end RECORD_LAYOUT
/begin RECORD_LAYOUT Scalar_FLOAT64_IEEE FNC_VALUES 1 FLOAT64_IEEE COLUMN_DIR DIRECT /end RECORD_LAYOUT
/begin RECORD_LAYOUT Lookup1D_BOOLEAN FNC_VALUES 1 UBYTE COLUMN_DIR DIRECT /end RECORD_LAYOUT
/begin RECORD_LAYOUT Lookup1D_X_BOOLEAN AXIS_PTS_X 1 UBYTE INDEX_INCR DIRECT /end RECORD_LAYOUT
/begin RECORD_LAYOUT Lookup1D_BYTE FNC_VALUES 1 SBYTE COLUMN_DIR DIRECT /end RECORD_LAYOUT
/begin RECORD_LAYOUT Lookup1D_X_BYTE AXIS_PTS_X 1 SBYTE INDEX_INCR DIRECT /end RECORD_LAYOUT
/begin RECORD_LAYOUT Lookup1D_UBYTE FNC_VALUES 1 UBYTE COLUMN_DIR DIRECT /end RECORD_LAYOUT
/begin RECORD_LAYOUT Lookup1D_X_UBYTE AXIS_PTS_X 1 UBYTE INDEX_INCR DIRECT /end RECORD_LAYOUT
/begin RECORD_LAYOUT Lookup1D_UWORD FNC_VALUES 1 UWORD COLUMN_DIR DIRECT /end RECORD_LAYOUT
/begin RECORD_LAYOUT Lookup1D_X_UWORD AXIS_PTS_X 1 UWORD INDEX_INCR DIRECT /end RECORD_LAYOUT
/begin RECORD_LAYOUT Lookup1D_WORD FNC_VALUES 1 SWORD COLUMN_DIR DIRECT /end RECORD_LAYOUT
/begin RECORD_LAYOUT Lookup1D_X_WORD AXIS_PTS_X 1 SWORD INDEX_INCR DIRECT /end RECORD_LAYOUT
/begin RECORD_LAYOUT Lookup1D_ULONG FNC_VALUES 1 ULONG COLUMN_DIR DIRECT /end RECORD_LAYOUT
/begin RECORD_LAYOUT Lookup1D_X_ULONG AXIS_PTS_X 1 ULONG INDEX_INCR DIRECT /end RECORD_LAYOUT
/begin RECORD_LAYOUT Lookup1D_SLONG FNC_VALUES 1 SLONG COLUMN_DIR DIRECT /end RECORD_LAYOUT
/begin RECORD_LAYOUT Lookup1D_X_LONG AXIS_PTS_X 1 SLONG INDEX_INCR DIRECT /end RECORD_LAYOUT
/begin RECORD_LAYOUT Lookup1D_FLOAT32_IEEE FNC_VALUES 1 FLOAT32_IEEE COLUMN_DIR DIRECT /end RECORD_LAYOUT
/begin RECORD_LAYOUT Lookup1D_X_FLOAT32_IEEE AXIS_PTS_X 1 FLOAT32_IEEE INDEX_INCR DIRECT /end RECORD_LAYOUT
/begin RECORD_LAYOUT Lookup1D_FLOAT64_IEEE FNC_VALUES 1 FLOAT64_IEEE COLUMN_DIR DIRECT /end RECORD_LAYOUT
/begin RECORD_LAYOUT Lookup1D_X_FLOAT64_IEEE AXIS_PTS_X 1 FLOAT64_IEEE INDEX_INCR DIRECT /end RECORD_LAYOUT
/begin RECORD_LAYOUT Lookup2D_BOOLEAN FNC_VALUES 1 UBYTE COLUMN_DIR DIRECT /end RECORD_LAYOUT
/begin RECORD_LAYOUT Lookup2D_X_BOOLEAN AXIS_PTS_X 1 UBYTE INDEX_INCR DIRECT /end RECORD_LAYOUT
/begin RECORD_LAYOUT Lookup2D_UBYTE FNC_VALUES 1 UBYTE COLUMN_DIR DIRECT /end RECORD_LAYOUT
/begin RECORD_LAYOUT Lookup2D_X_UBYTE AXIS_PTS_X 1 UBYTE INDEX_INCR DIRECT /end RECORD_LAYOUT
/begin RECORD_LAYOUT Lookup2D_BYTE FNC_VALUES 1 SBYTE COLUMN_DIR DIRECT /end RECORD_LAYOUT
/begin RECORD_LAYOUT Lookup2D_X_BYTE AXIS_PTS_X 1 SBYTE INDEX_INCR DIRECT /end RECORD_LAYOUT
/begin RECORD_LAYOUT Lookup2D_UWORD FNC_VALUES 1 UWORD COLUMN_DIR DIRECT /end RECORD_LAYOUT
/begin RECORD_LAYOUT Lookup2D_X_UWORD AXIS_PTS_X 1 UWORD INDEX_INCR DIRECT /end RECORD_LAYOUT
/begin RECORD_LAYOUT Lookup2D_WORD FNC_VALUES 1 SWORD COLUMN_DIR DIRECT /end RECORD_LAYOUT
/begin RECORD_LAYOUT Lookup2D_X_WORD AXIS_PTS_X 1 SWORD INDEX_INCR DIRECT /end RECORD_LAYOUT
/begin RECORD_LAYOUT Lookup2D_ULONG FNC_VALUES 1 ULONG COLUMN_DIR DIRECT /end RECORD_LAYOUT
/begin RECORD_LAYOUT Lookup2D_X_ULONG AXIS_PTS_X 1 ULONG INDEX_INCR DIRECT /end RECORD_LAYOUT
/begin RECORD_LAYOUT Lookup2D_LONG FNC_VALUES 1 SLONG COLUMN_DIR DIRECT /end RECORD_LAYOUT
/begin RECORD_LAYOUT Lookup2D_X_LONG AXIS_PTS_X 1 SLONG INDEX_INCR DIRECT /end RECORD_LAYOUT
/begin RECORD_LAYOUT Lookup2D_FLOAT32_IEEE FNC_VALUES 1 FLOAT32_IEEE COLUMN_DIR DIRECT /end RECORD_LAYOUT
/begin RECORD_LAYOUT Lookup2D_X_FLOAT32_IEEE AXIS_PTS_X 1 FLOAT32_IEEE INDEX_INCR DIRECT /end RECORD_LAYOUT
/begin RECORD_LAYOUT Lookup2D_FLOAT64_IEEE FNC_VALUES 1 FLOAT64_IEEE COLUMN_DIR DIRECT /end RECORD_LAYOUT
/begin RECORD_LAYOUT Lookup2D_X_FLOAT64_IEEE AXIS_PTS_X 1 FLOAT64_IEEE INDEX_INCR DIRECT /end RECORD_LAYOUT
/begin CHARACTERISTIC GlbDa_LSum_lVehCHGECU_C /* Long Identifier */ "Initial distance when ECU changed" /* Type */ VALUE /* ECU Address */ 0x0000 /* @ECU_Address@GlbDa_LSum_lVehCHGECU_C@ */ /* Record Layout */ Scalar_LONG /* Maximum Difference */ 0 /* Conversion Method */ Length_Km /* Lower Limit */ 0.0 /* Upper Limit */ 2.147483E+6 /end CHARACTERISTIC
/begin CHARACTERISTIC GlbDa_LSum_VehThreshold_C /* Long Identifier */ "Vehicle Speed Threshold to enable distance sum" /* Type */ VALUE /* ECU Address */ 0x0000 /* @ECU_Address@GlbDa_LSum_VehThreshold_C@ */ /* Record Layout */ Scalar_SWORD /* Maximum Difference */ 0 /* Conversion Method */ VehSpeed_km_h /* Lower Limit */ 0.0 /* Upper Limit */ 250.0 /end CHARACTERISTIC
/begin MEASUREMENT GlbDa_lDst "travelled distance in this drive cycle" SLONG Length_m 0 0 0.0 2.147483E+6 ECU_ADDRESS 0x0000 /* @ECU_Address@GlbDa_lDst@ */ /end MEASUREMENT
/begin MEASUREMENT GlbDa_lDstLstStored "last value of total distance in EEP" SLONG Length_Km 0 0 0.0 2.147483E+6 ECU_ADDRESS 0x0000 /* @ECU_Address@GlbDa_lDstLstStored@ */ /end MEASUREMENT
/begin MEASUREMENT GlbDa_lTotDst "total distance since first start" SLONG Length_Km 0 0 0.0 2.147483E+6 ECU_ADDRESS 0x0000 /* @ECU_Address@GlbDa_lTotDst@ */ /end MEASUREMENT
/begin MEASUREMENT GlbDa_lTotDstVeh "total travelled distance of vehicle" SLONG Length_Km 0 0 0.0 2.147483E+6 ECU_ADDRESS 0x0000 /* @ECU_Address@GlbDa_lTotDstVeh@ */ /end MEASUREMENT
/begin MEASUREMENT GlbDa_lTotDstVeh_EEP "" SLONG sfix32_Sp001 0 0 -2.147483648E+6 2.147483647E+6 ECU_ADDRESS 0x0000 /* @ECU_Address@GlbDa_lTotDstVeh_EEP@ */ /end MEASUREMENT
/begin MEASUREMENT GlbDa_lTotDst_EEP "" SLONG sfix32_Sp001 0 0 -2.147483648E+6 2.147483647E+6 ECU_ADDRESS 0x0000 /* @ECU_Address@GlbDa_lTotDst_EEP@ */ /end MEASUREMENT
/begin COMPU_METHOD Length_Km "f(x)=(c1*X*X+c2*X+c3)/(c4*X*X+c5*X+c6)" RAT_FUNC "%0.3" "Km" COEFFS 0 1000.000 0.000 0 0 1.000 /end COMPU_METHOD
/begin COMPU_METHOD VehSpeed_km_h "f(x)=(c1*X*X+c2*X+c3)/(c4*X*X+c5*X+c6)" RAT_FUNC "%0.3" "km/h" COEFFS 0 100.000 0.000 0 0 1.000 /end COMPU_METHOD
/begin COMPU_METHOD Length_m "f(x)=(c1*X*X+c2*X+c3)/(c4*X*X+c5*X+c6)" RAT_FUNC "%10.0" "m" COEFFS 0 1 0 0 0 1 /end COMPU_METHOD
/begin COMPU_METHOD sfix32_Sp001 "f(x)=(c1*X*X+c2*X+c3)/(c4*X*X+c5*X+c6)" RAT_FUNC "%0.3" "" COEFFS 0 1000.000 0.000 0 0 1.000 /end COMPU_METHOD
/begin GROUP GlbDa_LSum "GlbDa_LSum" /* Root */ ROOT /begin SUB_GROUP Root_GlbDa_LSum /end SUB_GROUP /end GROUP
/begin GROUP Root_GlbDa_LSum "GlbDa_LSum/GlbDa_LSum" /begin SUB_GROUP S1_VehDisSum /end SUB_GROUP /begin REF_CHARACTERISTIC GlbDa_LSum_VehThreshold_C /end REF_CHARACTERISTIC /begin REF_MEASUREMENT GlbDa_lTotDstVeh_EEP GlbDa_lTotDst_EEP /end REF_MEASUREMENT /end GROUP
/begin GROUP S1_VehDisSum "GlbDa_LSum/GlbDa_LSum/VehDisSum" /begin REF_CHARACTERISTIC GlbDa_LSum_lVehCHGECU_C /end REF_CHARACTERISTIC
 /begin REF_MEASUREMENT GlbDa_lDst GlbDa_lDstLstStored GlbDa_lTotDst GlbDa_lTotDstVeh /end REF_MEASUREMENT
/end GROUP
/end MODULE
/end PROJECT
/* (add any file trailer comments here) */
/* EOF GlbDa_LSum.a2l */
