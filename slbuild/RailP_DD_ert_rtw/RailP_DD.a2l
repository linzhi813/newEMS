/******************************************************************************
* ASAP2 file: RailP_DD.a2l
* Code generation for model "RailP_DD".
* Model version : 1.55
* Simulink Coder version : 9.4 (R2020b) 29-Jul-2020
* C source code generated on : Thu Feb 4 09:40:43 2021
* Target selection: ert.tlc
* Embedded hardware selection: ARM Compatible->ARM Cortex
* Code generation objectives: Unspecified
* Validation result: Not run
* (add additional file header information here)
******************************************************************************/ ASAP2_VERSION 1 31
/* Version 1.31 */
/begin PROJECT ProjectName "Project Comment Goes Here"
/begin HEADER "Header Comments go here" /end HEADER
/begin MODULE ModuleName "Module Comment Goes Here"
/begin MOD_PAR "MOD PAR Comment Goes Here" /end MOD_PAR
/begin MOD_COMMON "Mod Common Comment Here" BYTE_ORDER MSB_LAST /end MOD_COMMON
/begin RECORD_LAYOUT Scalar_BOOLEAN FNC_VALUES 1 UBYTE COLUMN_DIR DIRECT /end RECORD_LAYOUT
/begin RECORD_LAYOUT Scalar_UBYTE FNC_VALUES 1 UBYTE COLUMN_DIR DIRECT /end RECORD_LAYOUT
/begin RECORD_LAYOUT Scalar_BYTE FNC_VALUES 1 SBYTE COLUMN_DIR DIRECT /end RECORD_LAYOUT
/begin RECORD_LAYOUT Scalar_UWORD FNC_VALUES 1 UWORD COLUMN_DIR DIRECT /end RECORD_LAYOUT
/begin RECORD_LAYOUT Scalar_SWORD FNC_VALUES 1 SWORD COLUMN_DIR DIRECT /end RECORD_LAYOUT
/begin RECORD_LAYOUT Scalar_ULONG FNC_VALUES 1 ULONG COLUMN_DIR DIRECT /end RECORD_LAYOUT
/begin RECORD_LAYOUT Scalar_LONG FNC_VALUES 1 SLONG COLUMN_DIR DIRECT /end RECORD_LAYOUT
/begin RECORD_LAYOUT Scalar_FLOAT32_IEEE FNC_VALUES 1 FLOAT32_IEEE COLUMN_DIR DIRECT /end RECORD_LAYOUT
/begin RECORD_LAYOUT Scalar_FLOAT64_IEEE FNC_VALUES 1 FLOAT64_IEEE COLUMN_DIR DIRECT /end RECORD_LAYOUT
/begin RECORD_LAYOUT Lookup1D_BOOLEAN FNC_VALUES 1 UBYTE COLUMN_DIR DIRECT /end RECORD_LAYOUT
/begin RECORD_LAYOUT Lookup1D_X_BOOLEAN AXIS_PTS_X 1 UBYTE INDEX_INCR DIRECT /end RECORD_LAYOUT
/begin RECORD_LAYOUT Lookup1D_BYTE FNC_VALUES 1 SBYTE COLUMN_DIR DIRECT /end RECORD_LAYOUT
/begin RECORD_LAYOUT Lookup1D_X_BYTE AXIS_PTS_X 1 SBYTE INDEX_INCR DIRECT /end RECORD_LAYOUT
/begin RECORD_LAYOUT Lookup1D_UBYTE FNC_VALUES 1 UBYTE COLUMN_DIR DIRECT /end RECORD_LAYOUT
/begin RECORD_LAYOUT Lookup1D_X_UBYTE AXIS_PTS_X 1 UBYTE INDEX_INCR DIRECT /end RECORD_LAYOUT
/begin RECORD_LAYOUT Lookup1D_UWORD FNC_VALUES 1 UWORD COLUMN_DIR DIRECT /end RECORD_LAYOUT
/begin RECORD_LAYOUT Lookup1D_X_UWORD AXIS_PTS_X 1 UWORD INDEX_INCR DIRECT /end RECORD_LAYOUT
/begin RECORD_LAYOUT Lookup1D_WORD FNC_VALUES 1 SWORD COLUMN_DIR DIRECT /end RECORD_LAYOUT
/begin RECORD_LAYOUT Lookup1D_X_WORD AXIS_PTS_X 1 SWORD INDEX_INCR DIRECT /end RECORD_LAYOUT
/begin RECORD_LAYOUT Lookup1D_ULONG FNC_VALUES 1 ULONG COLUMN_DIR DIRECT /end RECORD_LAYOUT
/begin RECORD_LAYOUT Lookup1D_X_ULONG AXIS_PTS_X 1 ULONG INDEX_INCR DIRECT /end RECORD_LAYOUT
/begin RECORD_LAYOUT Lookup1D_SLONG FNC_VALUES 1 SLONG COLUMN_DIR DIRECT /end RECORD_LAYOUT
/begin RECORD_LAYOUT Lookup1D_X_LONG AXIS_PTS_X 1 SLONG INDEX_INCR DIRECT /end RECORD_LAYOUT
/begin RECORD_LAYOUT Lookup1D_FLOAT32_IEEE FNC_VALUES 1 FLOAT32_IEEE COLUMN_DIR DIRECT /end RECORD_LAYOUT
/begin RECORD_LAYOUT Lookup1D_X_FLOAT32_IEEE AXIS_PTS_X 1 FLOAT32_IEEE INDEX_INCR DIRECT /end RECORD_LAYOUT
/begin RECORD_LAYOUT Lookup1D_FLOAT64_IEEE FNC_VALUES 1 FLOAT64_IEEE COLUMN_DIR DIRECT /end RECORD_LAYOUT
/begin RECORD_LAYOUT Lookup1D_X_FLOAT64_IEEE AXIS_PTS_X 1 FLOAT64_IEEE INDEX_INCR DIRECT /end RECORD_LAYOUT
/begin RECORD_LAYOUT Lookup2D_BOOLEAN FNC_VALUES 1 UBYTE COLUMN_DIR DIRECT /end RECORD_LAYOUT
/begin RECORD_LAYOUT Lookup2D_X_BOOLEAN AXIS_PTS_X 1 UBYTE INDEX_INCR DIRECT /end RECORD_LAYOUT
/begin RECORD_LAYOUT Lookup2D_UBYTE FNC_VALUES 1 UBYTE COLUMN_DIR DIRECT /end RECORD_LAYOUT
/begin RECORD_LAYOUT Lookup2D_X_UBYTE AXIS_PTS_X 1 UBYTE INDEX_INCR DIRECT /end RECORD_LAYOUT
/begin RECORD_LAYOUT Lookup2D_BYTE FNC_VALUES 1 SBYTE COLUMN_DIR DIRECT /end RECORD_LAYOUT
/begin RECORD_LAYOUT Lookup2D_X_BYTE AXIS_PTS_X 1 SBYTE INDEX_INCR DIRECT /end RECORD_LAYOUT
/begin RECORD_LAYOUT Lookup2D_UWORD FNC_VALUES 1 UWORD COLUMN_DIR DIRECT /end RECORD_LAYOUT
/begin RECORD_LAYOUT Lookup2D_X_UWORD AXIS_PTS_X 1 UWORD INDEX_INCR DIRECT /end RECORD_LAYOUT
/begin RECORD_LAYOUT Lookup2D_WORD FNC_VALUES 1 SWORD COLUMN_DIR DIRECT /end RECORD_LAYOUT
/begin RECORD_LAYOUT Lookup2D_X_WORD AXIS_PTS_X 1 SWORD INDEX_INCR DIRECT /end RECORD_LAYOUT
/begin RECORD_LAYOUT Lookup2D_ULONG FNC_VALUES 1 ULONG COLUMN_DIR DIRECT /end RECORD_LAYOUT
/begin RECORD_LAYOUT Lookup2D_X_ULONG AXIS_PTS_X 1 ULONG INDEX_INCR DIRECT /end RECORD_LAYOUT
/begin RECORD_LAYOUT Lookup2D_LONG FNC_VALUES 1 SLONG COLUMN_DIR DIRECT /end RECORD_LAYOUT
/begin RECORD_LAYOUT Lookup2D_X_LONG AXIS_PTS_X 1 SLONG INDEX_INCR DIRECT /end RECORD_LAYOUT
/begin RECORD_LAYOUT Lookup2D_FLOAT32_IEEE FNC_VALUES 1 FLOAT32_IEEE COLUMN_DIR DIRECT /end RECORD_LAYOUT
/begin RECORD_LAYOUT Lookup2D_X_FLOAT32_IEEE AXIS_PTS_X 1 FLOAT32_IEEE INDEX_INCR DIRECT /end RECORD_LAYOUT
/begin RECORD_LAYOUT Lookup2D_FLOAT64_IEEE FNC_VALUES 1 FLOAT64_IEEE COLUMN_DIR DIRECT /end RECORD_LAYOUT
/begin RECORD_LAYOUT Lookup2D_X_FLOAT64_IEEE AXIS_PTS_X 1 FLOAT64_IEEE INDEX_INCR DIRECT /end RECORD_LAYOUT
/begin CHARACTERISTIC RailP_pLin_CUR "Linearisation curve for fuel pressure sensor" /* Characteristic Type */ CURVE 0x0000 /* @ECU_Address@RailP_pLin_CUR@ */ Lookup1D_WORD /* Maxdiff */ 0 RailP_DD_CM_Press_bar1_bar 0.0 2500.0
 /begin AXIS_DESCR /* Description of X-Axis Points */ /* Axis Type */ COM_AXIS /* Reference to Input */ RailP_uRaw RailP_DD_CM_Volt_mV_mv /* Number of Axis Pts */ 4 0.0 5000.0 AXIS_PTS_REF RailP_pLin_CURX /end AXIS_DESCR
/end CHARACTERISTIC
/begin AXIS_PTS RailP_pLin_CURX "RailP_uRaw" 0x0000 /* @ECU_Address@RailP_pLin_CURX@ */ /* Input Quantity */ RailP_uRaw Lookup1D_X_WORD 0 RailP_DD_CM_Volt_mV_mv /* Number of Axis Pts */ 4 0.0 5000.0 /end AXIS_PTS
/begin CHARACTERISTIC RailP_tiSRCMaxDefDeb_C "Debounce time for checking defect of RailP_bSRCMaxDeb" VALUE 0x0000 /* @ECU_Address@RailP_tiSRCMaxDefDeb_C@ */ Scalar_UWORD 0 RailP_DD_CM_Debncd_ms_ms 0.0 6000.0 /end CHARACTERISTIC
/begin CHARACTERISTIC RailP_tiSRCMaxOKDeb_C "Debounce time for checking heal of RailP_bSRCMaxDeb" VALUE 0x0000 /* @ECU_Address@RailP_tiSRCMaxOKDeb_C@ */ Scalar_UWORD 0 RailP_DD_CM_Debncd_ms_ms 0.0 6000.0 /end CHARACTERISTIC
/begin CHARACTERISTIC RailP_tiSRCMinDefDeb_C "Debounce time for checking defect of RailP_bSRCMinDeb" VALUE 0x0000 /* @ECU_Address@RailP_tiSRCMinDefDeb_C@ */ Scalar_UWORD 0 RailP_DD_CM_Debncd_ms_ms 0.0 6000.0 /end CHARACTERISTIC
/begin CHARACTERISTIC RailP_tiSRCMinOKDeb_C "Debounce time for checking heal of RailP_bSRCMinDeb" VALUE 0x0000 /* @ECU_Address@RailP_tiSRCMinOKDeb_C@ */ Scalar_UWORD 0 RailP_DD_CM_Debncd_ms_ms 0.0 6000.0 /end CHARACTERISTIC
/begin CHARACTERISTIC RailP_uSRCMax_C "Threshold for SRC -Max detection" VALUE 0x0000 /* @ECU_Address@RailP_uSRCMax_C@ */ Scalar_SWORD 0 RailP_DD_CM_Volt_mV_mv 0.0 5000.0 /end CHARACTERISTIC
/begin CHARACTERISTIC RailP_uSRCMin_C "Threshold for SRC -Min detection" VALUE 0x0000 /* @ECU_Address@RailP_uSRCMin_C@ */ Scalar_SWORD 0 RailP_DD_CM_Volt_mV_mv 0.0 5000.0 /end CHARACTERISTIC
/begin MEASUREMENT RailP_uRaw "" SWORD RailP_DD_CM_Volt_mV 0 0 0.0 5000.0 ECU_ADDRESS 0x0000 /* @ECU_Address@RailP_uRaw@ */ /end MEASUREMENT
/begin MEASUREMENT RailP_pLin_base "Fuel pressure from curve" SWORD RailP_DD_CM_Press_bar1_bar 0 0 0.0 2500.0 ECU_ADDRESS 0x0000 /* @ECU_Address@RailP_pLin_base@ */ /end MEASUREMENT
/begin MEASUREMENT RailP_pLin "Fuel pressure" SWORD RailP_DD_CM_Press_bar1_bar 0 0 0.0 2500.0 ECU_ADDRESS 0x0000 /* @ECU_Address@RailP_pLin@ */ /end MEASUREMENT
/begin MEASUREMENT RailP_bSRCMaxDeb_DSM "The debounce result of SRC" UBYTE RailP_DD_CM_boolean_NaN 0 0 0.0 1.0 ECU_ADDRESS 0x0000 /* @ECU_Address@RailP_bSRCMaxDeb_DSM@ */ /end MEASUREMENT
/begin MEASUREMENT RailP_bSRCMinDeb_DSM "The debounce result of SRC" UBYTE RailP_DD_CM_boolean_NaN 0 0 0.0 1.0 ECU_ADDRESS 0x0000 /* @ECU_Address@RailP_bSRCMinDeb_DSM@ */ /end MEASUREMENT
/begin MEASUREMENT RailP_bFinalDef "Status of final default" UBYTE RailP_DD_CM_boolean_NaN 0 0 0.0 1.0 ECU_ADDRESS 0x0000 /* @ECU_Address@RailP_bFinalDef@ */ /end MEASUREMENT
/begin MEASUREMENT RailP_bProvDef "Status of provisional default" UBYTE RailP_DD_CM_boolean_NaN 0 0 0.0 1.0 ECU_ADDRESS 0x0000 /* @ECU_Address@RailP_bProvDef@ */ /end MEASUREMENT
/begin COMPU_METHOD RailP_DD_CM_Press_bar1_bar "Q = V*10.000000" RAT_FUNC "%5.1" "bar" COEFFS 0 10.000000 0.000000 0 0 1.000000 /end COMPU_METHOD
/begin COMPU_METHOD RailP_DD_CM_Volt_mV_mv "Q = V" RAT_FUNC "%5.0" "mv" COEFFS 0 1 0 0 0 1 /end COMPU_METHOD
/begin COMPU_METHOD RailP_DD_CM_Debncd_ms_ms "Q = V*10.000000" RAT_FUNC "%5.1" "ms" COEFFS 0 10.000000 0.000000 0 0 1.000000 /end COMPU_METHOD
/begin COMPU_METHOD RailP_DD_CM_Volt_mV "Q = V" RAT_FUNC "%5.0" "" COEFFS 0 1 0 0 0 1 /end COMPU_METHOD
/begin COMPU_METHOD RailP_DD_CM_boolean_NaN "Q = V" RAT_FUNC "%1.0" "NaN" COEFFS 0 1 0 0 0 1 /end COMPU_METHOD
/begin GROUP RailP_DD "RailP_DD" /* Root */ ROOT /begin SUB_GROUP Root_Overview /end SUB_GROUP /begin REF_MEASUREMENT RailP_uRaw /end REF_MEASUREMENT /end GROUP
/begin GROUP Root_Overview "RailP_DD/Overview" /begin SUB_GROUP S1_RailP_DD /end SUB_GROUP /end GROUP
/begin GROUP S1_RailP_DD "RailP_DD/Overview/RailP_DD" /begin SUB_GROUP S2_Debounce /end SUB_GROUP /begin REF_CHARACTERISTIC RailP_pLin_CUR RailP_uSRCMax_C RailP_uSRCMin_C /end REF_CHARACTERISTIC /begin REF_MEASUREMENT RailP_bFinalDef RailP_bProvDef RailP_pLin RailP_pLin_base /end REF_MEASUREMENT /end GROUP
/begin GROUP S2_Debounce "RailP_DD/Overview/RailP_DD/Debounce" /begin SUB_GROUP S3_Debounce_DT S3_Debounce_DT1 /end SUB_GROUP
 /begin REF_CHARACTERISTIC RailP_tiSRCMaxDefDeb_C RailP_tiSRCMaxOKDeb_C RailP_tiSRCMinDefDeb_C RailP_tiSRCMinOKDeb_C /end REF_CHARACTERISTIC
/end GROUP
/begin GROUP S3_Debounce_DT "RailP_DD/Overview/RailP_DD/Debounce/Debounce_DT" /begin REF_MEASUREMENT RailP_bSRCMaxDeb_DSM /end REF_MEASUREMENT /end GROUP
/begin GROUP S3_Debounce_DT1 "RailP_DD/Overview/RailP_DD/Debounce/Debounce_DT1" /begin REF_MEASUREMENT RailP_bSRCMinDeb_DSM /end REF_MEASUREMENT /end GROUP
/end MODULE
/end PROJECT
/* (add any file trailer comments here) */
/* EOF RailP_DD.a2l */
