/******************************************************************************
* ASAP2 file: APP_DD2.a2l
* Code generation for model "APP_DD2".
* Model version : 1.53
* Simulink Coder version : 9.4 (R2020b) 29-Jul-2020
* C source code generated on : Thu Feb 4 09:42:58 2021
* Target selection: ert.tlc
* Embedded hardware selection: ARM Compatible->ARM Cortex
* Code generation objectives: Unspecified
* Validation result: Not run
* (add additional file header information here)
******************************************************************************/ ASAP2_VERSION 1 31
/* Version 1.31 */
/begin PROJECT ProjectName "Project Comment Goes Here"
/begin HEADER "Header Comments go here" /end HEADER
/begin MODULE ModuleName "Module Comment Goes Here"
/begin MOD_PAR "MOD PAR Comment Goes Here" /end MOD_PAR
/begin MOD_COMMON "Mod Common Comment Here" BYTE_ORDER MSB_LAST /end MOD_COMMON
/begin RECORD_LAYOUT Scalar_BOOLEAN FNC_VALUES 1 UBYTE COLUMN_DIR DIRECT /end RECORD_LAYOUT
/begin RECORD_LAYOUT Scalar_UBYTE FNC_VALUES 1 UBYTE COLUMN_DIR DIRECT /end RECORD_LAYOUT
/begin RECORD_LAYOUT Scalar_BYTE FNC_VALUES 1 SBYTE COLUMN_DIR DIRECT /end RECORD_LAYOUT
/begin RECORD_LAYOUT Scalar_UWORD FNC_VALUES 1 UWORD COLUMN_DIR DIRECT /end RECORD_LAYOUT
/begin RECORD_LAYOUT Scalar_SWORD FNC_VALUES 1 SWORD COLUMN_DIR DIRECT /end RECORD_LAYOUT
/begin RECORD_LAYOUT Scalar_ULONG FNC_VALUES 1 ULONG COLUMN_DIR DIRECT /end RECORD_LAYOUT
/begin RECORD_LAYOUT Scalar_LONG FNC_VALUES 1 SLONG COLUMN_DIR DIRECT /end RECORD_LAYOUT
/begin RECORD_LAYOUT Scalar_FLOAT32_IEEE FNC_VALUES 1 FLOAT32_IEEE COLUMN_DIR DIRECT /end RECORD_LAYOUT
/begin RECORD_LAYOUT Scalar_FLOAT64_IEEE FNC_VALUES 1 FLOAT64_IEEE COLUMN_DIR DIRECT /end RECORD_LAYOUT
/begin RECORD_LAYOUT Lookup1D_BOOLEAN FNC_VALUES 1 UBYTE COLUMN_DIR DIRECT /end RECORD_LAYOUT
/begin RECORD_LAYOUT Lookup1D_X_BOOLEAN AXIS_PTS_X 1 UBYTE INDEX_INCR DIRECT /end RECORD_LAYOUT
/begin RECORD_LAYOUT Lookup1D_BYTE FNC_VALUES 1 SBYTE COLUMN_DIR DIRECT /end RECORD_LAYOUT
/begin RECORD_LAYOUT Lookup1D_X_BYTE AXIS_PTS_X 1 SBYTE INDEX_INCR DIRECT /end RECORD_LAYOUT
/begin RECORD_LAYOUT Lookup1D_UBYTE FNC_VALUES 1 UBYTE COLUMN_DIR DIRECT /end RECORD_LAYOUT
/begin RECORD_LAYOUT Lookup1D_X_UBYTE AXIS_PTS_X 1 UBYTE INDEX_INCR DIRECT /end RECORD_LAYOUT
/begin RECORD_LAYOUT Lookup1D_UWORD FNC_VALUES 1 UWORD COLUMN_DIR DIRECT /end RECORD_LAYOUT
/begin RECORD_LAYOUT Lookup1D_X_UWORD AXIS_PTS_X 1 UWORD INDEX_INCR DIRECT /end RECORD_LAYOUT
/begin RECORD_LAYOUT Lookup1D_WORD FNC_VALUES 1 SWORD COLUMN_DIR DIRECT /end RECORD_LAYOUT
/begin RECORD_LAYOUT Lookup1D_X_WORD AXIS_PTS_X 1 SWORD INDEX_INCR DIRECT /end RECORD_LAYOUT
/begin RECORD_LAYOUT Lookup1D_ULONG FNC_VALUES 1 ULONG COLUMN_DIR DIRECT /end RECORD_LAYOUT
/begin RECORD_LAYOUT Lookup1D_X_ULONG AXIS_PTS_X 1 ULONG INDEX_INCR DIRECT /end RECORD_LAYOUT
/begin RECORD_LAYOUT Lookup1D_SLONG FNC_VALUES 1 SLONG COLUMN_DIR DIRECT /end RECORD_LAYOUT
/begin RECORD_LAYOUT Lookup1D_X_LONG AXIS_PTS_X 1 SLONG INDEX_INCR DIRECT /end RECORD_LAYOUT
/begin RECORD_LAYOUT Lookup1D_FLOAT32_IEEE FNC_VALUES 1 FLOAT32_IEEE COLUMN_DIR DIRECT /end RECORD_LAYOUT
/begin RECORD_LAYOUT Lookup1D_X_FLOAT32_IEEE AXIS_PTS_X 1 FLOAT32_IEEE INDEX_INCR DIRECT /end RECORD_LAYOUT
/begin RECORD_LAYOUT Lookup1D_FLOAT64_IEEE FNC_VALUES 1 FLOAT64_IEEE COLUMN_DIR DIRECT /end RECORD_LAYOUT
/begin RECORD_LAYOUT Lookup1D_X_FLOAT64_IEEE AXIS_PTS_X 1 FLOAT64_IEEE INDEX_INCR DIRECT /end RECORD_LAYOUT
/begin RECORD_LAYOUT Lookup2D_BOOLEAN FNC_VALUES 1 UBYTE COLUMN_DIR DIRECT /end RECORD_LAYOUT
/begin RECORD_LAYOUT Lookup2D_X_BOOLEAN AXIS_PTS_X 1 UBYTE INDEX_INCR DIRECT /end RECORD_LAYOUT
/begin RECORD_LAYOUT Lookup2D_UBYTE FNC_VALUES 1 UBYTE COLUMN_DIR DIRECT /end RECORD_LAYOUT
/begin RECORD_LAYOUT Lookup2D_X_UBYTE AXIS_PTS_X 1 UBYTE INDEX_INCR DIRECT /end RECORD_LAYOUT
/begin RECORD_LAYOUT Lookup2D_BYTE FNC_VALUES 1 SBYTE COLUMN_DIR DIRECT /end RECORD_LAYOUT
/begin RECORD_LAYOUT Lookup2D_X_BYTE AXIS_PTS_X 1 SBYTE INDEX_INCR DIRECT /end RECORD_LAYOUT
/begin RECORD_LAYOUT Lookup2D_UWORD FNC_VALUES 1 UWORD COLUMN_DIR DIRECT /end RECORD_LAYOUT
/begin RECORD_LAYOUT Lookup2D_X_UWORD AXIS_PTS_X 1 UWORD INDEX_INCR DIRECT /end RECORD_LAYOUT
/begin RECORD_LAYOUT Lookup2D_WORD FNC_VALUES 1 SWORD COLUMN_DIR DIRECT /end RECORD_LAYOUT
/begin RECORD_LAYOUT Lookup2D_X_WORD AXIS_PTS_X 1 SWORD INDEX_INCR DIRECT /end RECORD_LAYOUT
/begin RECORD_LAYOUT Lookup2D_ULONG FNC_VALUES 1 ULONG COLUMN_DIR DIRECT /end RECORD_LAYOUT
/begin RECORD_LAYOUT Lookup2D_X_ULONG AXIS_PTS_X 1 ULONG INDEX_INCR DIRECT /end RECORD_LAYOUT
/begin RECORD_LAYOUT Lookup2D_LONG FNC_VALUES 1 SLONG COLUMN_DIR DIRECT /end RECORD_LAYOUT
/begin RECORD_LAYOUT Lookup2D_X_LONG AXIS_PTS_X 1 SLONG INDEX_INCR DIRECT /end RECORD_LAYOUT
/begin RECORD_LAYOUT Lookup2D_FLOAT32_IEEE FNC_VALUES 1 FLOAT32_IEEE COLUMN_DIR DIRECT /end RECORD_LAYOUT
/begin RECORD_LAYOUT Lookup2D_X_FLOAT32_IEEE AXIS_PTS_X 1 FLOAT32_IEEE INDEX_INCR DIRECT /end RECORD_LAYOUT
/begin RECORD_LAYOUT Lookup2D_FLOAT64_IEEE FNC_VALUES 1 FLOAT64_IEEE COLUMN_DIR DIRECT /end RECORD_LAYOUT
/begin RECORD_LAYOUT Lookup2D_X_FLOAT64_IEEE AXIS_PTS_X 1 FLOAT64_IEEE INDEX_INCR DIRECT /end RECORD_LAYOUT
/begin CHARACTERISTIC APP_tiSRCHighDefDeb2_C "debounce time" VALUE 0x0000 /* @ECU_Address@APP_tiSRCHighDefDeb2_C@ */ Scalar_UWORD 0 APP_DD2_CM_Debncd_ms_ms 0.0 1000.0 /end CHARACTERISTIC
/begin CHARACTERISTIC APP_tiSRCHighOKDeb2_C "debounce time" VALUE 0x0000 /* @ECU_Address@APP_tiSRCHighOKDeb2_C@ */ Scalar_UWORD 0 APP_DD2_CM_Debncd_ms_ms 0.0 1000.0 /end CHARACTERISTIC
/begin CHARACTERISTIC APP_tiSRCLowDefDeb2_C "debounce time" VALUE 0x0000 /* @ECU_Address@APP_tiSRCLowDefDeb2_C@ */ Scalar_UWORD 0 APP_DD2_CM_Debncd_ms_ms 0.0 1000.0 /end CHARACTERISTIC
/begin CHARACTERISTIC APP_tiSRCLowOKDeb2_C "debounce time" VALUE 0x0000 /* @ECU_Address@APP_tiSRCLowOKDeb2_C@ */ Scalar_UWORD 0 APP_DD2_CM_Debncd_ms_ms 0.0 1000.0 /end CHARACTERISTIC
/begin CHARACTERISTIC APP_uRaw2Def_C "Substitute value for sensor 2 defect" VALUE 0x0000 /* @ECU_Address@APP_uRaw2Def_C@ */ Scalar_SWORD 0 APP_DD2_CM_Volt_mV_mv 0.0 5000.0 /end CHARACTERISTIC
/begin CHARACTERISTIC APP_uRaw2SRCHigh_C "voltage upper threshold of channel 2" VALUE 0x0000 /* @ECU_Address@APP_uRaw2SRCHigh_C@ */ Scalar_SWORD 0 APP_DD2_CM_Volt_mV_mv 0.0 5000.0 /end CHARACTERISTIC
/begin CHARACTERISTIC APP_uRaw2SRCLow_C "voltage lower threshold of channel 2" VALUE 0x0000 /* @ECU_Address@APP_uRaw2SRCLow_C@ */ Scalar_SWORD 0 APP_DD2_CM_Volt_mV_mv 0.0 5000.0 /end CHARACTERISTIC
/begin MEASUREMENT DSM_bAPP2SigPath "" UBYTE APP_DD2_CM_boolean 0 0 0.0 1.0 ECU_ADDRESS 0x0000 /* @ECU_Address@DSM_bAPP2SigPath@ */ /end MEASUREMENT
/begin MEASUREMENT APP_uRaw2unLim "" SWORD APP_DD2_CM_Volt_mV 0 0 0.0 5000.0 ECU_ADDRESS 0x0000 /* @ECU_Address@APP_uRaw2unLim@ */ /end MEASUREMENT
/begin MEASUREMENT APP_uRaw2 "Acceleration Pedal Position E" SWORD APP_DD2_CM_Volt_mV_mv 0 0 0.0 5000.0 ECU_ADDRESS 0x0000 /* @ECU_Address@APP_uRaw2@ */ /end MEASUREMENT
/begin MEASUREMENT APP_bSRCHigh2 "Status temporary SRC-High error Sensor 2" UBYTE APP_DD2_CM_boolean_NaN 0 0 0.0 1.0 ECU_ADDRESS 0x0000 /* @ECU_Address@APP_bSRCHigh2@ */ /end MEASUREMENT
/begin MEASUREMENT APP_bSRCHigh2Deb_DSM "Status debounced SRC-High error Sensor 2" UBYTE APP_DD2_CM_boolean_NaN 0 0 0.0 1.0 ECU_ADDRESS 0x0000 /* @ECU_Address@APP_bSRCHigh2Deb_DSM@ */ /end MEASUREMENT
/begin MEASUREMENT APP_bSRCLow2 "Status temporary SRC-Low error Sensor 2" UBYTE APP_DD2_CM_boolean_NaN 0 0 0.0 1.0 ECU_ADDRESS 0x0000 /* @ECU_Address@APP_bSRCLow2@ */ /end MEASUREMENT
/begin MEASUREMENT APP_bSRCLow2Deb_DSM "Status debounced SRC-Low error Sensor 2" UBYTE APP_DD2_CM_boolean_NaN 0 0 0.0 1.0 ECU_ADDRESS 0x0000 /* @ECU_Address@APP_bSRCLow2Deb_DSM@ */ /end MEASUREMENT
/begin MEASUREMENT APP_bAPP2FinalDef "Status Sensor 2 of the acceleration pedal finally defect" UBYTE APP_DD2_CM_boolean_NaN 0 0 0.0 1.0 ECU_ADDRESS 0x0000 /* @ECU_Address@APP_bAPP2FinalDef@ */ /end MEASUREMENT
/begin MEASUREMENT APP_bAPP2ProvDef "Status Sensor 2 of the acceleration pedal temporary defect" UBYTE APP_DD2_CM_boolean_NaN 0 0 0.0 1.0 ECU_ADDRESS 0x0000 /* @ECU_Address@APP_bAPP2ProvDef@ */ /end MEASUREMENT
/begin COMPU_METHOD APP_DD2_CM_Debncd_ms_ms "Q = V*10.000000" RAT_FUNC "%5.1" "ms" COEFFS 0 10.000000 0.000000 0 0 1.000000 /end COMPU_METHOD
/begin COMPU_METHOD APP_DD2_CM_Volt_mV_mv "Q = V" RAT_FUNC "%5.0" "mv" COEFFS 0 1 0 0 0 1 /end COMPU_METHOD
/begin COMPU_METHOD APP_DD2_CM_boolean "Q = V" RAT_FUNC "%1.0" "" COEFFS 0 1 0 0 0 1 /end COMPU_METHOD
/begin COMPU_METHOD APP_DD2_CM_Volt_mV "Q = V" RAT_FUNC "%5.0" "" COEFFS 0 1 0 0 0 1 /end COMPU_METHOD
/begin COMPU_METHOD APP_DD2_CM_boolean_NaN "Q = V" RAT_FUNC "%1.0" "NaN" COEFFS 0 1 0 0 0 1 /end COMPU_METHOD
/begin GROUP APP_DD2 "APP_DD2" /* Root */ ROOT /begin SUB_GROUP Root_Overview /end SUB_GROUP /begin REF_MEASUREMENT APP_uRaw2unLim DSM_bAPP2SigPath /end REF_MEASUREMENT /end GROUP
/begin GROUP Root_Overview "APP_DD2/Overview" /begin SUB_GROUP S1_APP_DD2 /end SUB_GROUP /end GROUP
/begin GROUP S1_APP_DD2 "APP_DD2/Overview/APP_DD2" /begin SUB_GROUP S2_DSM_Check S2_Error_Reaction /end SUB_GROUP /end GROUP
/begin GROUP S2_DSM_Check "APP_DD2/Overview/APP_DD2/DSM_Check"
 /begin REF_CHARACTERISTIC APP_tiSRCHighDefDeb2_C APP_tiSRCHighOKDeb2_C APP_tiSRCLowDefDeb2_C APP_tiSRCLowOKDeb2_C APP_uRaw2SRCHigh_C APP_uRaw2SRCLow_C /end REF_CHARACTERISTIC
 /begin REF_MEASUREMENT APP_bAPP2FinalDef APP_bSRCHigh2 APP_bSRCHigh2Deb_DSM APP_bSRCLow2 APP_bSRCLow2Deb_DSM /end REF_MEASUREMENT
/end GROUP
/begin GROUP S2_Error_Reaction "APP_DD2/Overview/APP_DD2/Error_Reaction" /begin REF_CHARACTERISTIC APP_uRaw2Def_C /end REF_CHARACTERISTIC /begin REF_MEASUREMENT APP_bAPP2ProvDef APP_uRaw2 /end REF_MEASUREMENT /end GROUP
/end MODULE
/end PROJECT
/* (add any file trailer comments here) */
/* EOF APP_DD2.a2l */
