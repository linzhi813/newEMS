ASAP2_VERSION 1 51
/begin PROJECT XCPDemo ""
/begin MODULE XCP ""
/begin MOD_COMMON "" BYTE_ORDER MSB_FIRST ALIGNMENT_BYTE 1 ALIGNMENT_WORD 1 ALIGNMENT_LONG 1 ALIGNMENT_FLOAT32_IEEE 1 ALIGNMENT_FLOAT64_IEEE 1 /end MOD_COMMON
/begin CHARACTERISTIC InjCrv_facPiI1APSSOECor1EOM0_CUR "Start of energizing correction curve for PiI1 in EOM0 based on air pressure" CURVE 0x38AA08 Lookup1D_WORD 0 Factor -10.0 10.0
 /begin AXIS_DESCR COM_AXIS EnvP_p AirPressure_kPa 16 0.0 1200.0 AXIS_PTS_REF InjCrv_facPiI1APSSOECor1EOM0_CURX /end AXIS_DESCR
/end CHARACTERISTIC
/begin CHARACTERISTIC InjCrv_facPiI1ATSSOECor1EOM0_CUR "Start of energizing correction curve for PiI1 in EOM0 based on air temperature" CURVE 0x38AA88 Lookup1D_WORD 0 Factor -10.0 10.0
 /begin AXIS_DESCR COM_AXIS InjCrv_tAir Temp_deg 16 -3000.0 3000.0 AXIS_PTS_REF InjCrv_facPiI1ATSSOECor1EOM0_CURX /end AXIS_DESCR
/end CHARACTERISTIC
/begin CHARACTERISTIC InjCrv_facPiI1ETSSOECor1EOM0_CUR "Start of energizing correction curve for PiI1 in EOM0 based on engine temperature" CURVE 0x38AB08 Lookup1D_WORD 0 Factor -10.0 10.0
 /begin AXIS_DESCR COM_AXIS InjSys_tEng Temp_deg 16 -3000.0 3000.0 AXIS_PTS_REF InjCrv_facPiI1ETSSOECor1EOM0_CURX /end AXIS_DESCR
/end CHARACTERISTIC
/begin AXIS_PTS InjCrv_facPiI1APSSOECor1EOM0_CURX "Start of energizing correction curve axis for PiI1 in EOM0 based on air pressure" 0x38AA28 EnvP_p Lookup1D_X_WORD 0 AirPressure_kPa 16 0.0 1200.0 /end AXIS_PTS
/begin AXIS_PTS InjCrv_facPiI1ATSSOECor1EOM0_CURX "Start of energizing correction curve axis for PiI1 in EOM0 based on air temperature" 0x38AAA8 InjCrv_tAir Lookup1D_X_WORD 0 Temp_deg 16 -3000.0 3000.0 /end AXIS_PTS
/begin AXIS_PTS InjCrv_facPiI1ETSSOECor1EOM0_CURX "Start of energizing correction curve axis for PiI1 in EOM0 based on engine temperature" 0x38AB28 InjSys_tEng Lookup1D_X_WORD 0 Temp_deg 16 -3000.0 3000.0 /end AXIS_PTS
/begin CHARACTERISTIC InjCrv_qPiI1Bas1EOM0_MAP "Base map for quantity of PiI1" MAP 0x38F60A Lookup2D_WORD 0 FuelMass_mg_hub -319.0 319.0
 /begin AXIS_DESCR COM_AXIS Epm_nEng EngSpeed_rpm 20 0.0 6000.0 AXIS_PTS_REF InjCrv_qPiI1Bas1EOM0_MAPX /end AXIS_DESCR
 /begin AXIS_DESCR COM_AXIS InjCtl_qSetUnBal FuelMass_mg_hub 20 -319.0 319.0 AXIS_PTS_REF InjCrv_qPiI1Bas1EOM0_MAPY /end AXIS_DESCR
/end CHARACTERISTIC
/begin CHARACTERISTIC InjCrv_phiPiI1Bas1EOM0_MAP "Map for base angular component of PiI1" MAP 0x38CE4C Lookup2D_WORD 0 Angle_CA -719.0 719.0
 /begin AXIS_DESCR COM_AXIS Epm_nEng EngSpeed_rpm 16 0.0 6000.0 AXIS_PTS_REF InjCrv_phiPiI1Bas1EOM0_MAPX /end AXIS_DESCR
 /begin AXIS_DESCR COM_AXIS InjCtl_qSetUnBal FuelMass_mg_hub 16 -319.0 319.0 AXIS_PTS_REF InjCrv_phiPiI1Bas1EOM0_MAPY /end AXIS_DESCR
/end CHARACTERISTIC
/begin CHARACTERISTIC InjCrv_tiPiI1Bas1EOM0_MAP "Map for base time component of PiI1" MAP 0x39213A Lookup2D_WORD 0 InjTime_us -13107.0 13106.0
 /begin AXIS_DESCR COM_AXIS Epm_nEng EngSpeed_rpm 16 0.0 6000.0 AXIS_PTS_REF InjCrv_tiPiI1Bas1EOM0_MAPX /end AXIS_DESCR
 /begin AXIS_DESCR COM_AXIS InjCtl_qSetUnBal FuelMass_mg_hub 16 -319.0 319.0 AXIS_PTS_REF InjCrv_tiPiI1Bas1EOM0_MAPY /end AXIS_DESCR
/end CHARACTERISTIC
/begin AXIS_PTS InjCrv_qPiI1Bas1EOM0_MAPY "Base map for quantity of PiI1(breakpoint1)" 0x38F952 InjCtl_qSetUnBal Lookup2D_X_WORD 0 FuelMass_mg_hub 20 -319.0 319.0 /end AXIS_PTS
/begin AXIS_PTS InjCrv_qPiI1Bas1EOM0_MAPX "Base map for quantity of PiI1(breakpoint2)" 0x38F92A Epm_nEng Lookup2D_X_WORD 0 EngSpeed_rpm 20 0.0 6000.0 /end AXIS_PTS
/begin AXIS_PTS InjCrv_phiPiI1Bas1EOM0_MAPY "Map for base angular component of PiI1(breakpoint1)" 0x38D06C InjCtl_qSetUnBal Lookup2D_X_WORD 0 FuelMass_mg_hub 16 -319.0 319.0 /end AXIS_PTS
/begin AXIS_PTS InjCrv_phiPiI1Bas1EOM0_MAPX "Map for base angular component of PiI1(breakpoint2)" 0x38D04C Epm_nEng Lookup2D_X_WORD 0 EngSpeed_rpm 16 0.0 6000.0 /end AXIS_PTS
/begin AXIS_PTS InjCrv_tiPiI1Bas1EOM0_MAPY "Map for base time component of PiI1(breakpoint1)" 0x39235A InjCtl_qSetUnBal Lookup2D_X_WORD 0 FuelMass_mg_hub 16 -319.0 319.0 /end AXIS_PTS
/begin AXIS_PTS InjCrv_tiPiI1Bas1EOM0_MAPX "Map for base time component of PiI1(breakpoint2)" 0x39233A Epm_nEng Lookup2D_X_WORD 0 EngSpeed_rpm 16 0.0 6000.0 /end AXIS_PTS
/begin CHARACTERISTIC InjCrv_qPiI2Max1_MAP "Maximum value map 1 for PiI2 injection quantity" MAP 0x390A6A Lookup2D_WORD 0 FuelMass_mg_hub -319.0 319.0
 /begin AXIS_DESCR COM_AXIS Epm_nEng EngSpeed_rpm 16 0.0 6000.0 AXIS_PTS_REF InjCrv_qPiI2Max1_MAPX /end AXIS_DESCR
 /begin AXIS_DESCR COM_AXIS InjCtl_qSetUnBal FuelMass_mg_hub 16 -319.0 319.0 AXIS_PTS_REF InjCrv_qPiI2Max1_MAPY /end AXIS_DESCR
/end CHARACTERISTIC
/begin CHARACTERISTIC SigTst_qPiI2_C "test value of the PiI2 injection quantity" VALUE 0x398050 Scalar_SWORD 0 FuelMass_mg_hub -319.0 319.0 /end CHARACTERISTIC
/begin CHARACTERISTIC SigTst_tiPiI2_C "test value of PiI2 start of energizing (time component)" VALUE 0x3980B0 Scalar_SWORD 0 InjTime_us -13107.0 13106.0 /end CHARACTERISTIC
/begin CHARACTERISTIC InjCrv_phiPiI2Max_C "Earliest absolute start of energizing of a PiI(phi)" VALUE 0x38DE0E Scalar_SWORD 0 Angle_CA -78.0 78.0 /end CHARACTERISTIC
/begin CHARACTERISTIC SigTst_phiPiI2_C "test value of PiI2 start of energizing (angular component)" VALUE 0x39804A Scalar_SWORD 0 Angle_CA -719.0 719.0 /end CHARACTERISTIC
/begin CHARACTERISTIC SigTst_swtPiI2Phi_C "Switch for the test value of the PiI2 start of energizing (time component)" VALUE 0x39808D Scalar_UBYTE 0 Switch_conv 0 1 /end CHARACTERISTIC
/begin CHARACTERISTIC SigTst_swtPiI2Q_C "Switch for the test value of the PiI2 injection quantity" VALUE 0x39808E Scalar_UBYTE 0 Switch_conv 0 1 /end CHARACTERISTIC
/begin CHARACTERISTIC SigTst_swtPiI2Ti_C "Switch for the test value of the PiI2 start of energizing (time component)" VALUE 0x39808F Scalar_UBYTE 0 Switch_conv 0 1 /end CHARACTERISTIC
/begin AXIS_PTS InjCrv_qPiI2Max1_MAPY "Maximum value map 1 for PiI2 injection quantity(breakpoint1)" 0x390C8A InjCtl_qSetUnBal Lookup2D_X_WORD 0 FuelMass_mg_hub 16 -319.0 319.0 /end AXIS_PTS
/begin AXIS_PTS InjCrv_qPiI2Max1_MAPX "Maximum value map 1 for PiI2 injection quantity(breakpoint2)" 0x390C6A Epm_nEng Lookup2D_X_WORD 0 EngSpeed_rpm 16 0.0 6000.0 /end AXIS_PTS
/begin CHARACTERISTIC InjCrv_qPiI2StrtBase_MAP "Base starting map for quantity of PiI2" MAP 0x390CAA Lookup2D_WORD 0 FuelMass_mg_hub -319.0 319.0
 /begin AXIS_DESCR COM_AXIS Epm_nEng EngSpeed_rpm 16 0.0 6000.0 AXIS_PTS_REF InjCrv_qPiI2StrtBase_MAPX /end AXIS_DESCR
 /begin AXIS_DESCR COM_AXIS InjCtl_qSetUnBal FuelMass_mg_hub 16 -319.0 319.0 AXIS_PTS_REF InjCrv_qPiI2StrtBase_MAPY /end AXIS_DESCR
/end CHARACTERISTIC
/begin CHARACTERISTIC InjCrv_phiPiI2StrtBase_MAP "Map for base angular component of PiI2 during start" MAP 0x38DE10 Lookup2D_WORD 0 Angle_CA -719.0 719.0
 /begin AXIS_DESCR COM_AXIS Epm_nEng EngSpeed_rpm 16 0.0 6000.0 AXIS_PTS_REF InjCrv_phiPiI2StrtBase_MAPX /end AXIS_DESCR
 /begin AXIS_DESCR COM_AXIS InjCtl_qSetUnBal FuelMass_mg_hub 16 -319.0 319.0 AXIS_PTS_REF InjCrv_phiPiI2StrtBase_MAPY /end AXIS_DESCR
/end CHARACTERISTIC
/begin CHARACTERISTIC InjCrv_tiPiI2StrtBase_MAP "Map for base time component of PiI2 during start" MAP 0x3930FA Lookup2D_WORD 0 InjTime_us -13107.0 13106.0
 /begin AXIS_DESCR COM_AXIS Epm_nEng EngSpeed_rpm 16 0.0 6000.0 AXIS_PTS_REF InjCrv_tiPiI2StrtBase_MAPX /end AXIS_DESCR
 /begin AXIS_DESCR COM_AXIS InjCtl_qSetUnBal FuelMass_mg_hub 16 -319.0 319.0 AXIS_PTS_REF InjCrv_tiPiI2StrtBase_MAPY /end AXIS_DESCR
/end CHARACTERISTIC
/begin AXIS_PTS InjCrv_qPiI2StrtBase_MAPY "Base starting map for quantity of PiI2(breakpoint1)" 0x390ECA InjCtl_qSetUnBal Lookup2D_X_WORD 0 FuelMass_mg_hub 16 -319.0 319.0 /end AXIS_PTS
/begin AXIS_PTS InjCrv_qPiI2StrtBase_MAPX "Base starting map for quantity of PiI2(breakpoint2)" 0x390EAA Epm_nEng Lookup2D_X_WORD 0 EngSpeed_rpm 16 0.0 6000.0 /end AXIS_PTS
/begin AXIS_PTS InjCrv_phiPiI2StrtBase_MAPY "Map for base angular component of PiI2 during start(breakpoint1)" 0x38E030 InjCtl_qSetUnBal Lookup2D_X_WORD 0 FuelMass_mg_hub 16 -319.0 319.0 /end AXIS_PTS
/begin AXIS_PTS InjCrv_phiPiI2StrtBase_MAPX "Map for base angular component of PiI2 during start(breakpoint2)" 0x38E010 Epm_nEng Lookup2D_X_WORD 0 EngSpeed_rpm 16 0.0 6000.0 /end AXIS_PTS
/begin AXIS_PTS InjCrv_tiPiI2StrtBase_MAPY "Map for base time component of PiI2 during start(breakpoint1)" 0x39331A InjCtl_qSetUnBal Lookup2D_X_WORD 0 FuelMass_mg_hub 16 -319.0 319.0 /end AXIS_PTS
/begin AXIS_PTS InjCrv_tiPiI2StrtBase_MAPX "Map for base time component of PiI2 during start(breakpoint2)" 0x3932FA Epm_nEng Lookup2D_X_WORD 0 EngSpeed_rpm 16 0.0 6000.0 /end AXIS_PTS
/begin CHARACTERISTIC InjCrv_qPiI2APSCor1EOM0_MAP "Map for correction based on ambient pressure" MAP 0x39003A Lookup2D_WORD 0 FuelMass_mg_hub -319.0 319.0
 /begin AXIS_DESCR COM_AXIS Epm_nEng EngSpeed_rpm 16 0.0 6000.0 AXIS_PTS_REF InjCrv_qPiI2APSCor1EOM0_MAPX /end AXIS_DESCR
 /begin AXIS_DESCR COM_AXIS InjCtl_qSetUnBal FuelMass_mg_hub 16 -319.0 319.0 AXIS_PTS_REF InjCrv_qPiI2APSCor1EOM0_MAPY /end AXIS_DESCR
/end CHARACTERISTIC
/begin CHARACTERISTIC InjCrv_qPiI2ATSCor1EOM0_MAP "Map for correction based on air temperature" MAP 0x39027A Lookup2D_WORD 0 FuelMass_mg_hub -319.0 319.0
 /begin AXIS_DESCR COM_AXIS Epm_nEng EngSpeed_rpm 16 0.0 6000.0 AXIS_PTS_REF InjCrv_qPiI2ATSCor1EOM0_MAPX /end AXIS_DESCR
 /begin AXIS_DESCR COM_AXIS InjCtl_qSetUnBal FuelMass_mg_hub 16 -319.0 319.0 AXIS_PTS_REF InjCrv_qPiI2ATSCor1EOM0_MAPY /end AXIS_DESCR
/end CHARACTERISTIC
/begin CHARACTERISTIC InjCrv_qPiI2ETSCor1EOM0_MAP "Map for correction based on engine temperature" MAP 0x39082A Lookup2D_WORD 0 FuelMass_mg_hub -319.0 319.0
 /begin AXIS_DESCR COM_AXIS Epm_nEng EngSpeed_rpm 16 0.0 6000.0 AXIS_PTS_REF InjCrv_qPiI2ETSCor1EOM0_MAPX /end AXIS_DESCR
 /begin AXIS_DESCR COM_AXIS InjCtl_qSetUnBal FuelMass_mg_hub 16 -319.0 319.0 AXIS_PTS_REF InjCrv_qPiI2ETSCor1EOM0_MAPY /end AXIS_DESCR
/end CHARACTERISTIC
/begin CHARACTERISTIC InjCrv_facPiI2APSQCor1EOM0_CUR "Start of fuel quantity correction curve for PiI2 in EOM0 based on air pressure" CURVE 0x38AB48 Lookup1D_WORD 0 Factor -10.0 10.0
 /begin AXIS_DESCR COM_AXIS EnvP_p AirPressure_kPa 16 0.0 1200.0 AXIS_PTS_REF InjCrv_facPiI2APSQCor1EOM0_CURX /end AXIS_DESCR
/end CHARACTERISTIC
/begin CHARACTERISTIC InjCrv_facPiI2ATSQCor1EOM0_CUR "Start of fuel quantity correction curve for PiI2 in EOM0 based on air temperature" CURVE 0x38ABC8 Lookup1D_WORD 0 Factor -10.0 10.0
 /begin AXIS_DESCR COM_AXIS InjCrv_tAir Temp_deg 16 -3000.0 3000.0 AXIS_PTS_REF InjCrv_facPiI2ATSQCor1EOM0_CURX /end AXIS_DESCR
/end CHARACTERISTIC
/begin CHARACTERISTIC InjCrv_facPiI2ETSQCor1EOM0_CUR "Start of fuel quantity correction curve for PiI2 in EOM0 based on engine temperature" CURVE 0x38AC48 Lookup1D_WORD 0 Factor -10.0 10.0
 /begin AXIS_DESCR COM_AXIS InjSys_tEng Temp_deg 16 -3000.0 3000.0 AXIS_PTS_REF InjCrv_facPiI2ETSQCor1EOM0_CURX /end AXIS_DESCR
/end CHARACTERISTIC
/begin CHARACTERISTIC InjCrv_phiPiI2APSCor1EOM0_MAP "Map for angular component correction based on ambient pressure" MAP 0x38D50E Lookup2D_WORD 0 Angle_CA -719.0 719.0
 /begin AXIS_DESCR COM_AXIS Epm_nEng EngSpeed_rpm 16 0.0 6000.0 AXIS_PTS_REF InjCrv_phiPiI2APSCor1EOM0_MAPX /end AXIS_DESCR
 /begin AXIS_DESCR COM_AXIS InjCtl_qSetUnBal FuelMass_mg_hub 16 -319.0 319.0 AXIS_PTS_REF InjCrv_phiPiI2APSCor1EOM0_MAPY /end AXIS_DESCR
/end CHARACTERISTIC
/begin CHARACTERISTIC InjCrv_phiPiI2ATSCor1EOM0_MAP "Map for angular component correction based on air temperature" MAP 0x38D74E Lookup2D_WORD 0 Angle_CA -719.0 719.0
 /begin AXIS_DESCR COM_AXIS Epm_nEng EngSpeed_rpm 16 0.0 6000.0 AXIS_PTS_REF InjCrv_phiPiI2ATSCor1EOM0_MAPX /end AXIS_DESCR
 /begin AXIS_DESCR COM_AXIS InjCtl_qSetUnBal FuelMass_mg_hub 16 -319.0 319.0 AXIS_PTS_REF InjCrv_phiPiI2ATSCor1EOM0_MAPY /end AXIS_DESCR
/end CHARACTERISTIC
/begin CHARACTERISTIC InjCrv_phiPiI2ETSCor1EOM0_MAP "Map for angular component correction based on engine temperature" MAP 0x38DBCE Lookup2D_WORD 0 Angle_CA -719.0 719.0
 /begin AXIS_DESCR COM_AXIS Epm_nEng EngSpeed_rpm 16 0.0 6000.0 AXIS_PTS_REF InjCrv_phiPiI2ETSCor1EOM0_MAPX /end AXIS_DESCR
 /begin AXIS_DESCR COM_AXIS InjCtl_qSetUnBal FuelMass_mg_hub 16 -319.0 319.0 AXIS_PTS_REF InjCrv_phiPiI2ETSCor1EOM0_MAPY /end AXIS_DESCR
/end CHARACTERISTIC
/begin CHARACTERISTIC InjCrv_tiPiI2APSCor1EOM0_MAP "Map for time component correction based on ambient pressure" MAP 0x3927FA Lookup2D_WORD 0 InjTime_us -13107.0 13106.0
 /begin AXIS_DESCR COM_AXIS Epm_nEng EngSpeed_rpm 16 0.0 6000.0 AXIS_PTS_REF InjCrv_tiPiI2APSCor1EOM0_MAPX /end AXIS_DESCR
 /begin AXIS_DESCR COM_AXIS InjCtl_qSetUnBal FuelMass_mg_hub 16 -319.0 319.0 AXIS_PTS_REF InjCrv_tiPiI2APSCor1EOM0_MAPY /end AXIS_DESCR
/end CHARACTERISTIC
/begin CHARACTERISTIC InjCrv_tiPiI2ATSCor1EOM0_MAP "Map for time component correction based on air temperature" MAP 0x392A3A Lookup2D_WORD 0 InjTime_us -13107.0 13106.0
 /begin AXIS_DESCR COM_AXIS Epm_nEng EngSpeed_rpm 16 0.0 6000.0 AXIS_PTS_REF InjCrv_tiPiI2ATSCor1EOM0_MAPX /end AXIS_DESCR
 /begin AXIS_DESCR COM_AXIS InjCtl_qSetUnBal FuelMass_mg_hub 16 -319.0 319.0 AXIS_PTS_REF InjCrv_tiPiI2ATSCor1EOM0_MAPY /end AXIS_DESCR
/end CHARACTERISTIC
/begin CHARACTERISTIC InjCrv_tiPiI2ETSCor1EOM0_MAP "Map for time component correction based on engine temperature" MAP 0x392EBA Lookup2D_WORD 0 InjTime_us -13107.0 13106.0
 /begin AXIS_DESCR COM_AXIS Epm_nEng EngSpeed_rpm 16 0.0 6000.0 AXIS_PTS_REF InjCrv_tiPiI2ETSCor1EOM0_MAPX /end AXIS_DESCR
 /begin AXIS_DESCR COM_AXIS InjCtl_qSetUnBal FuelMass_mg_hub 16 -319.0 319.0 AXIS_PTS_REF InjCrv_tiPiI2ETSCor1EOM0_MAPY /end AXIS_DESCR
/end CHARACTERISTIC
/begin CHARACTERISTIC InjCrv_facPiI2APSSOECor1EOM0_CUR "Start of energizing correction curve for PiI2 in EOM0 based on air pressure" CURVE 0x38AB88 Lookup1D_WORD 0 Factor -10.0 10.0
 /begin AXIS_DESCR COM_AXIS EnvP_p AirPressure_kPa 16 0.0 1200.0 AXIS_PTS_REF InjCrv_facPiI2APSSOECor1EOM0_CURX /end AXIS_DESCR
/end CHARACTERISTIC
/begin CHARACTERISTIC InjCrv_facPiI2ATSSOECor1EOM0_CUR "Start of energizing correction curve for PiI2 in EOM0 based on air temperature" CURVE 0x38AC08 Lookup1D_WORD 0 Factor -10.0 10.0
 /begin AXIS_DESCR COM_AXIS InjCrv_tAir Temp_deg 16 -3000.0 3000.0 AXIS_PTS_REF InjCrv_facPiI2ATSSOECor1EOM0_CURX /end AXIS_DESCR
/end CHARACTERISTIC
/begin CHARACTERISTIC InjCrv_facPiI2ETSSOECor1EOM0_CUR "Start of energizing correction curve for PiI2 in EOM0 based on engine temperature" CURVE 0x38AC88 Lookup1D_WORD 0 Factor -10.0 10.0
 /begin AXIS_DESCR COM_AXIS InjSys_tEng Temp_deg 16 -3000.0 3000.0 AXIS_PTS_REF InjCrv_facPiI2ETSSOECor1EOM0_CURX /end AXIS_DESCR
/end CHARACTERISTIC
/begin AXIS_PTS InjCrv_qPiI2APSCor1EOM0_MAPY "Map for correction based on ambient pressure(breakpoint1)" 0x39025A InjCtl_qSetUnBal Lookup2D_X_WORD 0 FuelMass_mg_hub 16 -319.0 319.0 /end AXIS_PTS
/begin AXIS_PTS InjCrv_qPiI2APSCor1EOM0_MAPX "Map for correction based on ambient pressure(breakpoint2)" 0x39023A Epm_nEng Lookup2D_X_WORD 0 EngSpeed_rpm 16 0.0 6000.0 /end AXIS_PTS
/begin AXIS_PTS InjCrv_qPiI2ATSCor1EOM0_MAPY "Map for correction based on air temperature(breakpoint1)" 0x39049A InjCtl_qSetUnBal Lookup2D_X_WORD 0 FuelMass_mg_hub 16 -319.0 319.0 /end AXIS_PTS
/begin AXIS_PTS InjCrv_qPiI2ATSCor1EOM0_MAPX "Map for correction based on air temperature(breakpoint2)" 0x39047A Epm_nEng Lookup2D_X_WORD 0 EngSpeed_rpm 16 0.0 6000.0 /end AXIS_PTS
/begin AXIS_PTS InjCrv_qPiI2ETSCor1EOM0_MAPY "Map for correction based on engine temperature(breakpoint1)" 0x390A4A InjCtl_qSetUnBal Lookup2D_X_WORD 0 FuelMass_mg_hub 16 -319.0 319.0 /end AXIS_PTS
/begin AXIS_PTS InjCrv_qPiI2ETSCor1EOM0_MAPX "Map for correction based on engine temperature(breakpoint2)" 0x390A2A Epm_nEng Lookup2D_X_WORD 0 EngSpeed_rpm 16 0.0 6000.0 /end AXIS_PTS
/begin AXIS_PTS InjCrv_facPiI2APSQCor1EOM0_CURX "Start of fuel quantity correction curve axis for PiI2 in EOM0 based on air pressure" 0x38AB68 EnvP_p Lookup1D_X_WORD 0 AirPressure_kPa 16 0.0 1200.0 /end AXIS_PTS
/begin AXIS_PTS InjCrv_facPiI2ATSQCor1EOM0_CURX "Start of fuel quantity correction curve axis for PiI2 in EOM0 based on air temperature" 0x38ABE8 InjCrv_tAir Lookup1D_X_WORD 0 Temp_deg 16 -3000.0 3000.0 /end AXIS_PTS
/begin AXIS_PTS InjCrv_facPiI2ETSQCor1EOM0_CURX "Start of fuel quantity correction curve axis for PiI2 in EOM0 based on engine temperature" 0x38AC68 InjSys_tEng Lookup1D_X_WORD 0 Temp_deg 16 -3000.0 3000.0 /end AXIS_PTS
/begin AXIS_PTS InjCrv_phiPiI2APSCor1EOM0_MAPY "Map for angular component correction based on ambient pressure(breakpoint1)" 0x38D72E InjCtl_qSetUnBal Lookup2D_X_WORD 0 FuelMass_mg_hub 16 -319.0 319.0 /end AXIS_PTS
/begin AXIS_PTS InjCrv_phiPiI2APSCor1EOM0_MAPX "Map for angular component  correction based on ambient pressure(breakpoint2)" 0x38D70E Epm_nEng Lookup2D_X_WORD 0 EngSpeed_rpm 16 0.0 6000.0 /end AXIS_PTS
/begin AXIS_PTS InjCrv_phiPiI2ATSCor1EOM0_MAPY "Map for angular component correction based on air temperature(breakpoint1)" 0x38D96E InjCtl_qSetUnBal Lookup2D_X_WORD 0 FuelMass_mg_hub 16 -319.0 319.0 /end AXIS_PTS
/begin AXIS_PTS InjCrv_phiPiI2ATSCor1EOM0_MAPX "Map for angular component correction based on air temperature(breakpoint2)" 0x38D94E Epm_nEng Lookup2D_X_WORD 0 EngSpeed_rpm 16 0.0 6000.0 /end AXIS_PTS
/begin AXIS_PTS InjCrv_phiPiI2ETSCor1EOM0_MAPY "Map for angular component correction based on engine temperature(breakpoint1)" 0x38DDEE InjCtl_qSetUnBal Lookup2D_X_WORD 0 FuelMass_mg_hub 16 -319.0 319.0 /end AXIS_PTS
/begin AXIS_PTS InjCrv_phiPiI2ETSCor1EOM0_MAPX "Map for angular component correction based on engine temperature(breakpoint2)" 0x38DDCE Epm_nEng Lookup2D_X_WORD 0 EngSpeed_rpm 16 0.0 6000.0 /end AXIS_PTS
/begin AXIS_PTS InjCrv_tiPiI2APSCor1EOM0_MAPY "Map for time component correction based on ambient pressure(breakpoint1)" 0x392A1A InjCtl_qSetUnBal Lookup2D_X_WORD 0 FuelMass_mg_hub 16 -319.0 319.0 /end AXIS_PTS
/begin AXIS_PTS InjCrv_tiPiI2APSCor1EOM0_MAPX "Map for time component  correction based on ambient pressure(breakpoint2)" 0x3929FA Epm_nEng Lookup2D_X_WORD 0 EngSpeed_rpm 16 0.0 6000.0 /end AXIS_PTS
/begin AXIS_PTS InjCrv_tiPiI2ATSCor1EOM0_MAPY "Map for time component correction based on air temperature(breakpoint1)" 0x392C5A InjCtl_qSetUnBal Lookup2D_X_WORD 0 FuelMass_mg_hub 16 -319.0 319.0 /end AXIS_PTS
/begin AXIS_PTS InjCrv_tiPiI2ATSCor1EOM0_MAPX "Map for time component correction based on air temperature(breakpoint2)" 0x392C3A Epm_nEng Lookup2D_X_WORD 0 EngSpeed_rpm 16 0.0 6000.0 /end AXIS_PTS
/begin AXIS_PTS InjCrv_tiPiI2ETSCor1EOM0_MAPY "Map for time component correction based on engine temperature(breakpoint1)" 0x3930DA InjCtl_qSetUnBal Lookup2D_X_WORD 0 FuelMass_mg_hub 16 -319.0 319.0 /end AXIS_PTS
/begin AXIS_PTS InjCrv_tiPiI2ETSCor1EOM0_MAPX "Map for time component correction based on engine temperature(breakpoint2)" 0x3930BA Epm_nEng Lookup2D_X_WORD 0 EngSpeed_rpm 16 0.0 6000.0 /end AXIS_PTS
/begin AXIS_PTS InjCrv_facPiI2APSSOECor1EOM0_CURX "Start of energizing correction curve axis for PiI2 in EOM0 based on air pressure" 0x38ABA8 EnvP_p Lookup1D_X_WORD 0 AirPressure_kPa 16 0.0 1200.0 /end AXIS_PTS
/begin AXIS_PTS InjCrv_facPiI2ATSSOECor1EOM0_CURX "Start of energizing correction curve axis for PiI2 in EOM0 based on air temperature" 0x38AC28 InjCrv_tAir Lookup1D_X_WORD 0 Temp_deg 16 -3000.0 3000.0 /end AXIS_PTS
/begin AXIS_PTS InjCrv_facPiI2ETSSOECor1EOM0_CURX "Start of energizing correction curve axis for PiI2 in EOM0 based on engine temperature" 0x38ACA8 InjSys_tEng Lookup1D_X_WORD 0 Temp_deg 16 -3000.0 3000.0 /end AXIS_PTS
/begin CHARACTERISTIC InjCrv_qPiI2Bas1EOM0_MAP "Base map for quantity of PiI2" MAP 0x3904BA Lookup2D_WORD 0 FuelMass_mg_hub -319.0 319.0
 /begin AXIS_DESCR COM_AXIS Epm_nEng EngSpeed_rpm 20 0.0 6000.0 AXIS_PTS_REF InjCrv_qPiI2Bas1EOM0_MAPX /end AXIS_DESCR
 /begin AXIS_DESCR COM_AXIS InjCtl_qSetUnBal FuelMass_mg_hub 20 -319.0 319.0 AXIS_PTS_REF InjCrv_qPiI2Bas1EOM0_MAPY /end AXIS_DESCR
/end CHARACTERISTIC
/begin CHARACTERISTIC InjCrv_phiPiI2Bas1EOM0_MAP "Map for base angular component of PiI2" MAP 0x38D98E Lookup2D_WORD 0 Angle_CA -719.0 719.0
 /begin AXIS_DESCR COM_AXIS Epm_nEng EngSpeed_rpm 16 0.0 6000.0 AXIS_PTS_REF InjCrv_phiPiI2Bas1EOM0_MAPX /end AXIS_DESCR
 /begin AXIS_DESCR COM_AXIS InjCtl_qSetUnBal FuelMass_mg_hub 16 -319.0 319.0 AXIS_PTS_REF InjCrv_phiPiI2Bas1EOM0_MAPY /end AXIS_DESCR
/end CHARACTERISTIC
/begin CHARACTERISTIC InjCrv_tiPiI2Bas1EOM0_MAP "Map for base time component of PiI2" MAP 0x392C7A Lookup2D_WORD 0 InjTime_us -13107.0 13106.0
 /begin AXIS_DESCR COM_AXIS Epm_nEng EngSpeed_rpm 16 0.0 6000.0 AXIS_PTS_REF InjCrv_tiPiI2Bas1EOM0_MAPX /end AXIS_DESCR
 /begin AXIS_DESCR COM_AXIS InjCtl_qSetUnBal FuelMass_mg_hub 16 -319.0 319.0 AXIS_PTS_REF InjCrv_tiPiI2Bas1EOM0_MAPY /end AXIS_DESCR
/end CHARACTERISTIC
/begin AXIS_PTS InjCrv_qPiI2Bas1EOM0_MAPY "Base map for quantity of PiI2(breakpoint1)" 0x390802 InjCtl_qSetUnBal Lookup2D_X_WORD 0 FuelMass_mg_hub 20 -319.0 319.0 /end AXIS_PTS
/begin AXIS_PTS InjCrv_qPiI2Bas1EOM0_MAPX "Base map for quantity of PiI2(breakpoint2)" 0x3907DA Epm_nEng Lookup2D_X_WORD 0 EngSpeed_rpm 20 0.0 6000.0 /end AXIS_PTS
/begin AXIS_PTS InjCrv_phiPiI2Bas1EOM0_MAPY "Map for base angular component of PiI2(breakpoint1)" 0x38DBAE InjCtl_qSetUnBal Lookup2D_X_WORD 0 FuelMass_mg_hub 16 -319.0 319.0 /end AXIS_PTS
/begin AXIS_PTS InjCrv_phiPiI2Bas1EOM0_MAPX "Map for base angular component of PiI2(breakpoint2)" 0x38DB8E Epm_nEng Lookup2D_X_WORD 0 EngSpeed_rpm 16 0.0 6000.0 /end AXIS_PTS
/begin AXIS_PTS InjCrv_tiPiI2Bas1EOM0_MAPY "Map for base time component of PiI2(breakpoint1)" 0x392E9A InjCtl_qSetUnBal Lookup2D_X_WORD 0 FuelMass_mg_hub 16 -319.0 319.0 /end AXIS_PTS
/begin AXIS_PTS InjCrv_tiPiI2Bas1EOM0_MAPX "Map for base time component of PiI2(breakpoint2)" 0x392E7A Epm_nEng Lookup2D_X_WORD 0 EngSpeed_rpm 16 0.0 6000.0 /end AXIS_PTS
/begin CHARACTERISTIC InjCrv_phiPoI2MaxEOMX_MAP "Maximum PoI2 start of energizing for EOM1-EOM7" MAP 0x38EE10 Lookup2D_WORD 0 Angle_CA -719.0 719.0
 /begin AXIS_DESCR COM_AXIS Epm_nEng EngSpeed_rpm 20 0.0 6000.0 AXIS_PTS_REF InjCrv_phiPoI2MaxEOMX_MAPX /end AXIS_DESCR
 /begin AXIS_DESCR COM_AXIS InjCtl_qSetUnBal FuelMass_mg_hub 20 -319.0 319.0 AXIS_PTS_REF InjCrv_phiPoI2MaxEOMX_MAPY /end AXIS_DESCR
/end CHARACTERISTIC
/begin CHARACTERISTIC InjCrv_phiPoIMin_C "Minimum PoIx start of energizing relative to the TDC" VALUE 0x38F182 Scalar_SWORD 0 Angle_CA -719.0 719.0 /end CHARACTERISTIC
/begin AXIS_PTS InjCrv_phiPoI2MaxEOMX_MAPY "Maximum PoI2 start of energizing for EOM1-EOM7" 0x38F158 InjCtl_qSetUnBal Lookup2D_X_WORD 0 FuelMass_mg_hub 20 -319.0 319.0 /end AXIS_PTS
/begin AXIS_PTS InjCrv_phiPoI2MaxEOMX_MAPX "Maximum PoI2 start of energizing for EOM1-EOM7" 0x38F130 Epm_nEng Lookup2D_X_WORD 0 EngSpeed_rpm 20 0.0 6000.0 /end AXIS_PTS
/begin CHARACTERISTIC ETCtl_qPoI2_C "The temperature governor intervention quantity" VALUE 0x38774C Scalar_SWORD 0 FuelMass_mg_hub -319.0 319.0 /end CHARACTERISTIC
/begin CHARACTERISTIC InjCrv_qPoI2Eff_C "Remote control value of the PoI2 torque forming fuel quantity" VALUE 0x391CAA Scalar_SWORD 0 FuelMass_mg_hub -319.0 319.0 /end CHARACTERISTIC
/begin CHARACTERISTIC InjCrv_qPoI2_C "Remote control value of the total PoI2 fuel quantity" VALUE 0x391CAC Scalar_SWORD 0 FuelMass_mg_hub -319.0 319.0 /end CHARACTERISTIC
/begin CHARACTERISTIC InjCrv_tiAddCorRmt_C "Time for Remote add correction angle" VALUE 0x391CB8 Scalar_SWORD 0 InjTime_us -13107.0 13106.0 /end CHARACTERISTIC
/begin CHARACTERISTIC InjCrv_tiPoI2_C "Remote control value of PoI2 start of energizing (time component)" VALUE 0x3940FA Scalar_SWORD 0 InjTime_us -13107.0 13106.0 /end CHARACTERISTIC
/begin CHARACTERISTIC InjCrv_phiAddCorRmt_C "Remote add correction angle" VALUE 0x38B21C Scalar_SWORD 0 Angle_CA -719.0 719.0 /end CHARACTERISTIC
/begin CHARACTERISTIC InjCrv_phiPoI2_C "Remote control value of PoI2 start of energizing (angular component)" VALUE 0x38F180 Scalar_SWORD 0 Angle_CA -719.0 719.0 /end CHARACTERISTIC
/begin CHARACTERISTIC InjCrv_swtPhiAddCorRmt_C "Switch for Remote add correction angle" VALUE 0x391CAF Scalar_UBYTE 0 Switch_conv 0 1 /end CHARACTERISTIC
/begin CHARACTERISTIC InjCrv_swtPoI2ETCtl_C "Switch for intervention point of temperature governor (PoI2 or PoI3)" VALUE 0x391CB0 Scalar_UBYTE 0 Switch_conv 0 1 /end CHARACTERISTIC
/begin CHARACTERISTIC InjCrv_swtPoI2FMTC_C "Switch for FMTC calibration containing PoI2 quantity" VALUE 0x391CB1 Scalar_UBYTE 0 Switch_conv 0 1 /end CHARACTERISTIC
/begin CHARACTERISTIC InjCrv_swtPoI2Phi_C "Switch for the remote control value of the PoI2 start of energizing (angular component)" VALUE 0x391CB2 Scalar_UBYTE 0 Switch_conv 0 1 /end CHARACTERISTIC
/begin CHARACTERISTIC InjCrv_swtPoI2QEff_C "Switch for the remote control value of the PoI2 torque forming fuel quantity" VALUE 0x391CB3 Scalar_UBYTE 0 Switch_conv 0 1 /end CHARACTERISTIC
/begin CHARACTERISTIC InjCrv_swtPoI2Q_C "Switch for the remote control value of the total PoI2 fuel quantity" VALUE 0x391CB4 Scalar_UBYTE 0 Switch_conv 0 1 /end CHARACTERISTIC
/begin CHARACTERISTIC InjCrv_swtPoI2Ti_C "Switch for the remote control value of the PoI2 start of energizing (time component)" VALUE 0x391CB5 Scalar_UBYTE 0 Switch_conv 0 1 /end CHARACTERISTIC
/begin CHARACTERISTIC InjCrv_swtTiAddCorRmt_C "Switch for Remote add correction time" VALUE 0x391CB6 Scalar_UBYTE 0 Switch_conv 0 1 /end CHARACTERISTIC
/begin CHARACTERISTIC InjCrv_phiPoI2APSCorEOM_MAP "Map for correction of angle of PoI2 due to atmospheric pressure in EOM0" MAP 0x38E050 Lookup2D_WORD 0 Angle_CA -719.0 719.0
 /begin AXIS_DESCR COM_AXIS Epm_nEng EngSpeed_rpm 20 0.0 6000.0 AXIS_PTS_REF InjCrv_phiPoI2APSCorEOM_MAPX /end AXIS_DESCR
 /begin AXIS_DESCR COM_AXIS InjCtl_qSetUnBal FuelMass_mg_hub 20 -319.0 319.0 AXIS_PTS_REF InjCrv_phiPoI2APSCorEOM_MAPY /end AXIS_DESCR
/end CHARACTERISTIC
/begin CHARACTERISTIC InjCrv_phiPoI2ATSCorEOM_MAP "Map for correction of angle of PoI2 due to air temperature in EOM0" MAP 0x38E3C0 Lookup2D_WORD 0 Angle_CA -719.0 719.0
 /begin AXIS_DESCR COM_AXIS Epm_nEng EngSpeed_rpm 20 0.0 6000.0 AXIS_PTS_REF InjCrv_phiPoI2ATSCorEOM_MAPX /end AXIS_DESCR
 /begin AXIS_DESCR COM_AXIS InjCtl_qSetUnBal FuelMass_mg_hub 20 -319.0 319.0 AXIS_PTS_REF InjCrv_phiPoI2ATSCorEOM_MAPY /end AXIS_DESCR
/end CHARACTERISTIC
/begin CHARACTERISTIC InjCrv_phiPoI2ETSCorEOM_MAP "Map for correction of angle of PoI2 due to engine temperature in EOM0" MAP 0x38EAA0 Lookup2D_WORD 0 Angle_CA -719.0 719.0
 /begin AXIS_DESCR COM_AXIS Epm_nEng EngSpeed_rpm 20 0.0 6000.0 AXIS_PTS_REF InjCrv_phiPoI2ETSCorEOM_MAPX /end AXIS_DESCR
 /begin AXIS_DESCR COM_AXIS InjCtl_qSetUnBal FuelMass_mg_hub 20 -319.0 319.0 AXIS_PTS_REF InjCrv_phiPoI2ETSCorEOM_MAPY /end AXIS_DESCR
/end CHARACTERISTIC
/begin CHARACTERISTIC InjCrv_tiPoI2APSCorEOM_MAP "Map for correction of time of PoI2 due to atmospheric pressure in EOM0" MAP 0x39333A Lookup2D_WORD 0 InjTime_us -13107.0 13106.0
 /begin AXIS_DESCR COM_AXIS Epm_nEng EngSpeed_rpm 20 0.0 6000.0 AXIS_PTS_REF InjCrv_tiPoI2APSCorEOM_MAPX /end AXIS_DESCR
 /begin AXIS_DESCR COM_AXIS InjCtl_qSetUnBal FuelMass_mg_hub 20 -319.0 319.0 AXIS_PTS_REF InjCrv_tiPoI2APSCorEOM_MAPY /end AXIS_DESCR
/end CHARACTERISTIC
/begin CHARACTERISTIC InjCrv_tiPoI2ATSCorEOM_MAP "Map for correction of time of PoI2 due to air temperature in EOM0" MAP 0x3936AA Lookup2D_WORD 0 InjTime_us -13107.0 13106.0
 /begin AXIS_DESCR COM_AXIS Epm_nEng EngSpeed_rpm 20 0.0 6000.0 AXIS_PTS_REF InjCrv_tiPoI2ATSCorEOM_MAPX /end AXIS_DESCR
 /begin AXIS_DESCR COM_AXIS InjCtl_qSetUnBal FuelMass_mg_hub 20 -319.0 319.0 AXIS_PTS_REF InjCrv_tiPoI2ATSCorEOM_MAPY /end AXIS_DESCR
/end CHARACTERISTIC
/begin CHARACTERISTIC InjCrv_tiPoI2ETSCorEOM_MAP "Map for correction of time of PoI2 due to engine temperature in EOM0" MAP 0x393D8A Lookup2D_WORD 0 InjTime_us -13107.0 13106.0
 /begin AXIS_DESCR COM_AXIS Epm_nEng EngSpeed_rpm 20 0.0 6000.0 AXIS_PTS_REF InjCrv_tiPoI2ETSCorEOM_MAPX /end AXIS_DESCR
 /begin AXIS_DESCR COM_AXIS InjCtl_qSetUnBal FuelMass_mg_hub 20 -319.0 319.0 AXIS_PTS_REF InjCrv_tiPoI2ETSCorEOM_MAPY /end AXIS_DESCR
/end CHARACTERISTIC
/begin CHARACTERISTIC InjCrv_qPoI2APSCorEOM_MAP "Map for correction of quantity of PoI2 due to atmospheric pressure in EOM0" MAP 0x390EEA Lookup2D_WORD 0 FuelMass_mg_hub -319.0 319.0
 /begin AXIS_DESCR COM_AXIS Epm_nEng EngSpeed_rpm 20 0.0 6000.0 AXIS_PTS_REF InjCrv_qPoI2APSCorEOM_MAPX /end AXIS_DESCR
 /begin AXIS_DESCR COM_AXIS InjCtl_qSetUnBal FuelMass_mg_hub 20 -319.0 319.0 AXIS_PTS_REF InjCrv_qPoI2APSCorEOM_MAPY /end AXIS_DESCR
/end CHARACTERISTIC
/begin CHARACTERISTIC InjCrv_qPoI2ATSCorEOM_MAP "Map for correction of quantity of PoI2 due to air temperature in EOM0" MAP 0x39125A Lookup2D_WORD 0 FuelMass_mg_hub -319.0 319.0
 /begin AXIS_DESCR COM_AXIS Epm_nEng EngSpeed_rpm 20 0.0 6000.0 AXIS_PTS_REF InjCrv_qPoI2ATSCorEOM_MAPX /end AXIS_DESCR
 /begin AXIS_DESCR COM_AXIS InjCtl_qSetUnBal FuelMass_mg_hub 20 -319.0 319.0 AXIS_PTS_REF InjCrv_qPoI2ATSCorEOM_MAPY /end AXIS_DESCR
/end CHARACTERISTIC
/begin CHARACTERISTIC InjCrv_qPoI2ETSCorEOM_MAP "Map for correction of quantity of PoI2 due to engine temperature in EOM0" MAP 0x39193A Lookup2D_WORD 0 FuelMass_mg_hub -319.0 319.0
 /begin AXIS_DESCR COM_AXIS Epm_nEng EngSpeed_rpm 20 0.0 6000.0 AXIS_PTS_REF InjCrv_qPoI2ETSCorEOM_MAPX /end AXIS_DESCR
 /begin AXIS_DESCR COM_AXIS InjCtl_qSetUnBal FuelMass_mg_hub 20 -319.0 319.0 AXIS_PTS_REF InjCrv_qPoI2ETSCorEOM_MAPY /end AXIS_DESCR
/end CHARACTERISTIC
/begin CHARACTERISTIC InjCrv_facPoI2APSSOECorEOM_CUR "Start of energizing correction curve for PoI2 in EOM0 based on atmospheric pressure" CURVE 0x38AD18 Lookup1D_WORD 0 Factor -4.0 4.0
 /begin AXIS_DESCR COM_AXIS EnvP_p AirPressure_kPa 20 0.0 1200.0 AXIS_PTS_REF InjCrv_facPoI2APSSOECorEOM_CURX /end AXIS_DESCR
/end CHARACTERISTIC
/begin CHARACTERISTIC InjCrv_facPoI2ATSSOECorEOM_CUR "Start of energizing correction curve for PoI2 in EOM0 based on air temperature" CURVE 0x38ADB8 Lookup1D_WORD 0 Factor -4.0 4.0
 /begin AXIS_DESCR COM_AXIS InjCrv_tAir Temp_deg 20 -50.0 1000.0 AXIS_PTS_REF InjCrv_facPoI2ATSSOECorEOM_CURX /end AXIS_DESCR
/end CHARACTERISTIC
/begin CHARACTERISTIC InjCrv_facPoI2ETSSOECorEOM_CUR "Start of energizing correction curve for PoI2 in EOM0 based on engine temperature" CURVE 0x38AE58 Lookup1D_WORD 0 Factor -4.0 4.0
 /begin AXIS_DESCR COM_AXIS InjSys_tEng Temp_deg 20 -50.0 1000.0 AXIS_PTS_REF InjCrv_facPoI2ETSSOECorEOM_CURX /end AXIS_DESCR
/end CHARACTERISTIC
/begin CHARACTERISTIC InjCrv_facPoI2APSQCorEOM_CUR "Fuel quantity correction curve for PoI2 in EOM0 based on atmospheric pressure" CURVE 0x38ACC8 Lookup1D_WORD 0 Factor -4.0 4.0
 /begin AXIS_DESCR COM_AXIS EnvP_p AirPressure_kPa 20 0.0 1200.0 AXIS_PTS_REF InjCrv_facPoI2APSQCorEOM_CURX /end AXIS_DESCR
/end CHARACTERISTIC
/begin CHARACTERISTIC InjCrv_facPoI2ATSQCorEOM_CUR "Fuel quantity correction curve for PoI2 in EOM0 based on air temperature" CURVE 0x38AD68 Lookup1D_WORD 0 Factor -4.0 4.0
 /begin AXIS_DESCR COM_AXIS InjCrv_tAir Temp_deg 20 -50.0 1000.0 AXIS_PTS_REF InjCrv_facPoI2ATSQCorEOM_CURX /end AXIS_DESCR
/end CHARACTERISTIC
/begin CHARACTERISTIC InjCrv_facPoI2ETSQCorEOM_CUR "Fuel quantity correction curve for PoI2 in EOM1 based on engine temperature" CURVE 0x38AE08 Lookup1D_WORD 0 Factor -4.0 4.0
 /begin AXIS_DESCR COM_AXIS InjSys_tEng Temp_deg 20 -50.0 1000.0 AXIS_PTS_REF InjCrv_facPoI2ETSQCorEOM_CURX /end AXIS_DESCR
/end CHARACTERISTIC
/begin AXIS_PTS InjCrv_phiPoI2APSCorEOM_MAPY "Map for correction of angle of PoI2 due to atmospheric pressure in EOM0" 0x38E398 InjCtl_qSetUnBal Lookup2D_X_WORD 0 FuelMass_mg_hub 20 -319.0 319.0 /end AXIS_PTS
/begin AXIS_PTS InjCrv_phiPoI2APSCorEOM_MAPX "Map for correction of angle of PoI2 due to atmospheric pressure in EOM0" 0x38E370 Epm_nEng Lookup2D_X_WORD 0 EngSpeed_rpm 20 0.0 6000.0 /end AXIS_PTS
/begin AXIS_PTS InjCrv_phiPoI2ATSCorEOM_MAPY "Map for correction of angle of PoI2 due to air temperature in EOM0" 0x38E708 InjCtl_qSetUnBal Lookup2D_X_WORD 0 FuelMass_mg_hub 20 -319.0 319.0 /end AXIS_PTS
/begin AXIS_PTS InjCrv_phiPoI2ATSCorEOM_MAPX "Map for correction of angle of PoI2 due to air temperature in EOM0" 0x38E6E0 Epm_nEng Lookup2D_X_WORD 0 EngSpeed_rpm 20 0.0 6000.0 /end AXIS_PTS
/begin AXIS_PTS InjCrv_phiPoI2ETSCorEOM_MAPY "Map for correction of angle of PoI2 due to engine temperature in EOM0" 0x38EDE8 InjCtl_qSetUnBal Lookup2D_X_WORD 0 FuelMass_mg_hub 20 -319.0 319.0 /end AXIS_PTS
/begin AXIS_PTS InjCrv_phiPoI2ETSCorEOM_MAPX "Map for correction of angle of PoI2 due to engine temperature in EOM0" 0x38EDC0 Epm_nEng Lookup2D_X_WORD 0 EngSpeed_rpm 20 0.0 6000.0 /end AXIS_PTS
/begin AXIS_PTS InjCrv_tiPoI2APSCorEOM_MAPY "Map for correction of time of PoI2 due to atmospheric pressure in EOM0" 0x393682 InjCtl_qSetUnBal Lookup2D_X_WORD 0 FuelMass_mg_hub 20 -319.0 319.0 /end AXIS_PTS
/begin AXIS_PTS InjCrv_tiPoI2APSCorEOM_MAPX "Map for correction of time of PoI2 due to atmospheric pressure in EOM0" 0x39365A Epm_nEng Lookup2D_X_WORD 0 EngSpeed_rpm 20 0.0 6000.0 /end AXIS_PTS
/begin AXIS_PTS InjCrv_tiPoI2ATSCorEOM_MAPY "Map for correction of time of PoI2 due to air temperature in EOM0" 0x3939F2 InjCtl_qSetUnBal Lookup2D_X_WORD 0 FuelMass_mg_hub 20 -319.0 319.0 /end AXIS_PTS
/begin AXIS_PTS InjCrv_tiPoI2ATSCorEOM_MAPX "Map for correction of time of PoI2 due to air temperature in EOM0" 0x3939CA Epm_nEng Lookup2D_X_WORD 0 EngSpeed_rpm 20 0.0 6000.0 /end AXIS_PTS
/begin AXIS_PTS InjCrv_tiPoI2ETSCorEOM_MAPY "Map for correction of time of PoI2 due to engine temperature in EOM0" 0x3940D2 InjCtl_qSetUnBal Lookup2D_X_WORD 0 FuelMass_mg_hub 20 -319.0 319.0 /end AXIS_PTS
/begin AXIS_PTS InjCrv_tiPoI2ETSCorEOM_MAPX "Map for correction of time of PoI2 due to engine temperature in EOM0" 0x3940AA Epm_nEng Lookup2D_X_WORD 0 EngSpeed_rpm 20 0.0 6000.0 /end AXIS_PTS
/begin AXIS_PTS InjCrv_qPoI2APSCorEOM_MAPY "Map for correction of quantity of PoI2 due to atmospheric pressure in EOM0" 0x391232 InjCtl_qSetUnBal Lookup2D_X_WORD 0 FuelMass_mg_hub 20 -319.0 319.0 /end AXIS_PTS
/begin AXIS_PTS InjCrv_qPoI2APSCorEOM_MAPX "Map for correction of quantity of PoI2 due to atmospheric pressure in EOM0" 0x39120A Epm_nEng Lookup2D_X_WORD 0 EngSpeed_rpm 20 0.0 6000.0 /end AXIS_PTS
/begin AXIS_PTS InjCrv_qPoI2ATSCorEOM_MAPY "Map for correction of quantity of PoI2 due to air temperature in EOM0" 0x3915A2 InjCtl_qSetUnBal Lookup2D_X_WORD 0 FuelMass_mg_hub 20 -319.0 319.0 /end AXIS_PTS
/begin AXIS_PTS InjCrv_qPoI2ATSCorEOM_MAPX "Map for correction of quantity of PoI2 due to air temperature in EOM0" 0x39157A Epm_nEng Lookup2D_X_WORD 0 EngSpeed_rpm 20 0.0 6000.0 /end AXIS_PTS
/begin AXIS_PTS InjCrv_qPoI2ETSCorEOM_MAPY "Map for correction of quantity of PoI2 due to engine temperature in EOM0" 0x391C82 InjCtl_qSetUnBal Lookup2D_X_WORD 0 FuelMass_mg_hub 20 -319.0 319.0 /end AXIS_PTS
/begin AXIS_PTS InjCrv_qPoI2ETSCorEOM_MAPX "Map for correction of quantity of PoI2 due to engine temperature in EOM0" 0x391C5A Epm_nEng Lookup2D_X_WORD 0 EngSpeed_rpm 20 0.0 6000.0 /end AXIS_PTS
/begin AXIS_PTS InjCrv_facPoI2APSSOECorEOM_CURX "Start of energizing correction curve for PoI2 in EOM0 based on atmospheric pressure" 0x38AD40 EnvP_p Lookup1D_X_WORD 0 AirPressure_kPa 20 0.0 1200.0 /end AXIS_PTS
/begin AXIS_PTS InjCrv_facPoI2ATSSOECorEOM_CURX "Start of energizing correction curve for PoI2 in EOM0 based on air temperature" 0x38ADE0 InjCrv_tAir Lookup1D_X_WORD 0 Temp_deg 20 -50.0 1000.0 /end AXIS_PTS
/begin AXIS_PTS InjCrv_facPoI2ETSSOECorEOM_CURX "Start of energizing correction curve for PoI2 in EOM0 based on engine temperature" 0x38AE80 InjSys_tEng Lookup1D_X_WORD 0 Temp_deg 20 -50.0 1000.0 /end AXIS_PTS
/begin AXIS_PTS InjCrv_facPoI2APSQCorEOM_CURX "Fuel quantity correction curve for PoI2 in EOM0 based on atmospheric pressure" 0x38ACF0 EnvP_p Lookup1D_X_WORD 0 AirPressure_kPa 20 0.0 1200.0 /end AXIS_PTS
/begin AXIS_PTS InjCrv_facPoI2ATSQCorEOM_CURX "Fuel quantity correction curve for PoI2 in EOM0 based on air temperature" 0x38AD90 InjCrv_tAir Lookup1D_X_WORD 0 Temp_deg 20 -50.0 1000.0 /end AXIS_PTS
/begin AXIS_PTS InjCrv_facPoI2ETSQCorEOM_CURX "Fuel quantity correction curve for PoI2 in EOM1 based on engine temperature" 0x38AE30 InjSys_tEng Lookup1D_X_WORD 0 Temp_deg 20 -50.0 1000.0 /end AXIS_PTS
/begin CHARACTERISTIC InjCrv_facPoI2EffEOM_MAP "Efficiency factor map of the PoI2 (EOM0)" MAP 0x38AEA8 Lookup2D_WORD 0 Factor -4.0 4.0
 /begin AXIS_DESCR COM_AXIS Epm_nEng EngSpeed_rpm 20 0.0 6000.0 AXIS_PTS_REF InjCrv_facPoI2EffEOM_MAPX /end AXIS_DESCR
 /begin AXIS_DESCR COM_AXIS InjCtl_qSetUnBal FuelMass_mg_hub 20 -319.0 319.0 AXIS_PTS_REF InjCrv_facPoI2EffEOM_MAPY /end AXIS_DESCR
/end CHARACTERISTIC
/begin CHARACTERISTIC InjCrv_phiPoI2BasEOM_MAP "Map for base value of angle of PoI2 in EOM0" MAP 0x38E730 Lookup2D_WORD 0 Angle_CA -719.0 719.0
 /begin AXIS_DESCR COM_AXIS Epm_nEng EngSpeed_rpm 20 0.0 6000.0 AXIS_PTS_REF InjCrv_phiPoI2BasEOM_MAPX /end AXIS_DESCR
 /begin AXIS_DESCR COM_AXIS InjCtl_qSetUnBal FuelMass_mg_hub 20 -319.0 319.0 AXIS_PTS_REF InjCrv_phiPoI2BasEOM_MAPY /end AXIS_DESCR
/end CHARACTERISTIC
/begin CHARACTERISTIC InjCrv_qPoI2BasEOM_MAP "Map for base value of quantity of PoI2 in EOM0" MAP 0x3915CA Lookup2D_WORD 0 FuelMass_mg_hub -319.0 319.0
 /begin AXIS_DESCR COM_AXIS Epm_nEng EngSpeed_rpm 20 0.0 6000.0 AXIS_PTS_REF InjCrv_qPoI2BasEOM_MAPX /end AXIS_DESCR
 /begin AXIS_DESCR COM_AXIS InjCtl_qSetUnBal FuelMass_mg_hub 20 -319.0 319.0 AXIS_PTS_REF InjCrv_qPoI2BasEOM_MAPY /end AXIS_DESCR
/end CHARACTERISTIC
/begin CHARACTERISTIC InjCrv_tiPoI2BasEOM_MAP "Map for base value of time of PoI2 in EOM0" MAP 0x393A1A Lookup2D_WORD 0 InjTime_us -13107.0 13106.0
 /begin AXIS_DESCR COM_AXIS Epm_nEng EngSpeed_rpm 20 0.0 6000.0 AXIS_PTS_REF InjCrv_tiPoI2BasEOM_MAPX /end AXIS_DESCR
 /begin AXIS_DESCR COM_AXIS InjCtl_qSetUnBal FuelMass_mg_hub 20 -319.0 319.0 AXIS_PTS_REF InjCrv_tiPoI2BasEOM_MAPY /end AXIS_DESCR
/end CHARACTERISTIC
/begin AXIS_PTS InjCrv_facPoI2EffEOM_MAPY "Efficiency factor map of the PoI2 (EOM0)" 0x38B1F0 InjCtl_qSetUnBal Lookup2D_X_WORD 0 FuelMass_mg_hub 20 -319.0 319.0 /end AXIS_PTS
/begin AXIS_PTS InjCrv_facPoI2EffEOM_MAPX "Efficiency factor map of the PoI2 (EOM0)" 0x38B1C8 Epm_nEng Lookup2D_X_WORD 0 EngSpeed_rpm 20 0.0 6000.0 /end AXIS_PTS
/begin AXIS_PTS InjCrv_phiPoI2BasEOM_MAPY "Map for base value of angle of PoI2 in EOM0" 0x38EA78 InjCtl_qSetUnBal Lookup2D_X_WORD 0 FuelMass_mg_hub 20 -319.0 319.0 /end AXIS_PTS
/begin AXIS_PTS InjCrv_phiPoI2BasEOM_MAPX "Map for base value of angle of PoI2 in EOM0" 0x38EA50 Epm_nEng Lookup2D_X_WORD 0 EngSpeed_rpm 20 0.0 6000.0 /end AXIS_PTS
/begin AXIS_PTS InjCrv_qPoI2BasEOM_MAPY "Map for base value of quantity of PoI2 in EOM0" 0x391912 InjCtl_qSetUnBal Lookup2D_X_WORD 0 FuelMass_mg_hub 20 -319.0 319.0 /end AXIS_PTS
/begin AXIS_PTS InjCrv_qPoI2BasEOM_MAPX "Map for base value of quantity of PoI2 in EOM0" 0x3918EA Epm_nEng Lookup2D_X_WORD 0 EngSpeed_rpm 20 0.0 6000.0 /end AXIS_PTS
/begin AXIS_PTS InjCrv_tiPoI2BasEOM_MAPY "Map for base value of time of PoI2 in EOM0" 0x393D62 InjCtl_qSetUnBal Lookup2D_X_WORD 0 FuelMass_mg_hub 20 -319.0 319.0 /end AXIS_PTS
/begin AXIS_PTS InjCrv_tiPoI2BasEOM_MAPX "Map for base value of time of PoI2 in EOM0" 0x393D3A Epm_nEng Lookup2D_X_WORD 0 EngSpeed_rpm 20 0.0 6000.0 /end AXIS_PTS
/begin CHARACTERISTIC FMA_qCor_C "Correction quantity of FMA (indirect control)" VALUE 0x389A40 Scalar_SWORD 0 FuelMass_mg_hub -319.0 319.0 /end CHARACTERISTIC
/begin CHARACTERISTIC FMO_qCor_C "Correction quantity of FMO" VALUE 0x389A42 Scalar_SWORD 0 FuelMass_mg_hub -319.0 319.0 /end CHARACTERISTIC
/begin CHARACTERISTIC InjCtl_swtDiffQntIn_C "Selection of input quantity" VALUE 0x3940FC Scalar_UBYTE 0 Switch_conv 0 1 /end CHARACTERISTIC
/begin CHARACTERISTIC InjSys_ctAirTempSel_C "Air_tCACDs=0,Air_tAFS=1,Air_tEnvT=2,Air_tIntkVUS=3" VALUE 0x3940FD Scalar_UBYTE 0 AirTempFldSel_conv 0 3 /end CHARACTERISTIC
/begin CHARACTERISTIC Rail_ctAirTempSel_C "Air_tCACDs=0,Air_tAFS=1,Air_tEnvT=2,Air_tIntkVUS=3" VALUE 0x395CBA Scalar_UBYTE 0 AirTempFldSel_conv 0 3 /end CHARACTERISTIC
/begin CHARACTERISTIC InjSys_ctEngTempSel_C "Coolant_Temperature(0),Oil_Temperature(1),Eng_Temperature(2)" VALUE 0x3940FE Scalar_UBYTE 0 EngTempFldSel_conv 0 2 /end CHARACTERISTIC
/begin CHARACTERISTIC HPUn_dvolPmpTolc_CUR "Curve for mechanical tolerance corrections of the high pressure" CURVE 0x38A638 Lookup1D_WORD 0 FuelVol_mm3_s 0.0 50000.0
 /begin AXIS_DESCR COM_AXIS HPUn_dvolPmpNom FuelVol_mm3_s 8 0.0 50000.0 AXIS_PTS_REF HPUn_dvolPmpTolc_CURX /end AXIS_DESCR
/end CHARACTERISTIC
/begin CHARACTERISTIC HPUn_etaPmpFlTemp_CUR "High pressure pump efficiency based on the fuel temperature" CURVE 0x38A658 Lookup1D_WORD 0 HPUnEta -256.0 1.0
 /begin AXIS_DESCR COM_AXIS FuelT_tFlSys Temp_deg 12 -50.0 150.0 AXIS_PTS_REF HPUn_etaPmpFlTemp_CURX /end AXIS_DESCR
/end CHARACTERISTIC
/begin CHARACTERISTIC HPUn_etaPmp_MAP "Map to obtain efficiency of high pressure pump" MAP 0x38A68A Lookup2D_WORD 0 HPUnEta -256.0 1.0
 /begin AXIS_DESCR COM_AXIS HPUn_nPmp_mp EngSpeed_rpm 16 0.0 6000.0 AXIS_PTS_REF HPUn_etaPmp_MAPX /end AXIS_DESCR
 /begin AXIS_DESCR COM_AXIS RailP_pFlt RailPressure_bar 16 0.0 2500.0 AXIS_PTS_REF HPUn_etaPmp_MAPY /end AXIS_DESCR
/end CHARACTERISTIC
/begin CHARACTERISTIC HPUn_nMin_C "Engine speed threshold for shutting off the calculation of the high pressure pump load torque" VALUE 0x38A8CC Scalar_SWORD 0 EngSpeed_rpm 0.0 6000.0 /end CHARACTERISTIC
/begin CHARACTERISTIC HPUn_dvolMeUnMax_C "Maximum supply volume through the metering unit" VALUE 0x38A636 Scalar_SWORD 0 FuelVol_mm3_s 0.0 50000.0 /end CHARACTERISTIC
/begin CHARACTERISTIC HPUn_etaPmpMech_C "Mechanical efficiency of the high pressure pump" VALUE 0x38A688 Scalar_SWORD 0 HPUnEta -256.0 1.0 /end CHARACTERISTIC
/begin CHARACTERISTIC HPUn_rTransCrS_C "High pressure pump to crankshaft ratio" VALUE 0x38A8D6 Scalar_SWORD 0 TransRatio 0.0 10.0 /end CHARACTERISTIC
/begin CHARACTERISTIC HPUn_volPmp_C "Geometric supply volume of the high pressure pump per revolution" VALUE 0x38A8DC Scalar_SWORD 0 PumpQnt_mm3_rev 0.0 3000.0 /end CHARACTERISTIC
/begin AXIS_PTS HPUn_dvolPmpTolc_CURX "Curve axis for mechanical tolerance corrections of the high pressure" 0x38A648 HPUn_dvolPmpNom Lookup1D_X_WORD 0 FuelVol_mm3_s 8 0.0 50000.0 /end AXIS_PTS
/begin AXIS_PTS HPUn_etaPmpFlTemp_CURX "Curve axis for High pressure pump efficiency based on the fuel temperature" 0x38A670 FuelT_tFlSys Lookup1D_X_WORD 0 Temp_deg 12 -50.0 150.0 /end AXIS_PTS
/begin AXIS_PTS HPUn_etaPmp_MAPY "Map to obtain efficiency of high pressure pump（breakpoint1）" 0x38A8AA RailP_pFlt Lookup2D_X_WORD 0 RailPressure_bar 16 0.0 2500.0 /end AXIS_PTS
/begin AXIS_PTS HPUn_etaPmp_MAPX "Map to obtain efficiency of high pressure pump（breakpoint2）" 0x38A88A HPUn_nPmp_mp Lookup2D_X_WORD 0 EngSpeed_rpm 16 0.0 6000.0 /end AXIS_PTS
/begin CHARACTERISTIC HPUn_numInjMin_C "Minimum number of injections permitted by the high pressure pump" VALUE 0x38A8D0 Scalar_ULONG 0 Counter_num 0.0 8.0 /end CHARACTERISTIC
/begin CHARACTERISTIC InjCrv_numInjMaxSys_C "Maximum number of injections allowed determined by the system" VALUE 0x38B218 Scalar_ULONG 0 Counter_num 0.0 8.0 /end CHARACTERISTIC
/begin CHARACTERISTIC HPUn_tiQntBalDel_C "Delay time for calculating the fuel quantity balance of the high pressure pump" VALUE 0x38A8D8 Scalar_ULONG 0 EngTime_ms 0.0 4.294967296E+6 /end CHARACTERISTIC
/begin CHARACTERISTIC HPUn_pRailDvtOk_C "Maximum rail pressure governor deviation for the fuel quantity balance check" VALUE 0x38A8D4 Scalar_SWORD 0 RailPressure_bar 0.0 2500.0 /end CHARACTERISTIC
/begin CHARACTERISTIC HPUn_facPresDvtFlt_C "PT1 time constant for filtering the rail pressure governor deviation" VALUE 0x38A8CA Scalar_UWORD 0 PT_fac 0.0 99.9985 /end CHARACTERISTIC
/begin CHARACTERISTIC Rail_dfrqBlkShtCntUp_CUR "Curve to determine the blankshot incrementation step size" CURVE 0x395CBE Lookup1D_UWORD 0 Freq_q1p0 0.0 65535.0
 /begin AXIS_DESCR COM_AXIS Rail_pDvt RailPressure_bar 3 -2500.0 2500.0 AXIS_PTS_REF Rail_dfrqBlkShtCntUp_CURX /end AXIS_DESCR
/end CHARACTERISTIC
/begin CHARACTERISTIC Rail_frqBlkShtMax_MAP "Map for the maximum blankshot frequency (input variables: vehicle speed and engine speed; goal: noise reduction)" MAP 0x396536 Lookup2D_UWORD 0 Freq_q1p0 0.0 65535.0
 /begin AXIS_DESCR COM_AXIS VehV_v VehSpeed_km_h 4 0.0 250.0 AXIS_PTS_REF Rail_frqBlkShtMax_MAPX /end AXIS_DESCR
 /begin AXIS_DESCR COM_AXIS Epm_nEng EngSpeed_rpm 4 0.0 6000.0 AXIS_PTS_REF Rail_frqBlkShtMax_MAPY /end AXIS_DESCR
/end CHARACTERISTIC
/begin CHARACTERISTIC Rail_frqBlkShtPreCtl_MAP "Map for determination of blankshot frequency depending on pressure deviation and engine temperature" MAP 0x396566 Lookup2D_UWORD 0 Freq_q1p0 0.0 65535.0
 /begin AXIS_DESCR COM_AXIS Rail_pDvt RailPressure_bar 8 -2500.0 2500.0 AXIS_PTS_REF Rail_frqBlkShtPreCtl_MAPX /end AXIS_DESCR
 /begin AXIS_DESCR COM_AXIS EngDa_tEng Temp_deg 2 -1000.0 1000.0 AXIS_PTS_REF Rail_frqBlkShtPreCtl_MAPY /end AXIS_DESCR
/end CHARACTERISTIC
/begin CHARACTERISTIC Rail_tiBlkShtCntDn_C "Time interval between blank shot frequency reductions" VALUE 0x39777C Scalar_LONG 0 Time_s -327.68 327.67 /end CHARACTERISTIC
/begin CHARACTERISTIC Rail_tiBlkShtCntUp_C "Time interval between blank shot frequency increases" VALUE 0x397780 Scalar_LONG 0 Time_s -327.68 327.67 /end CHARACTERISTIC
/begin CHARACTERISTIC Rail_tiBlkShtDeflate_C "Time for deflation phase" VALUE 0x397784 Scalar_LONG 0 Time_s -327.68 327.67 /end CHARACTERISTIC
/begin CHARACTERISTIC Rail_dfrqBlkShtCntDn_C "Step size for blankshot decrementation" VALUE 0x395CBC Scalar_UWORD 0 Freq_q1p0 0.0 65535.0 /end CHARACTERISTIC
/begin CHARACTERISTIC Rail_frqBlkShtDeflate_C "Blankshot frequency in deflation phase" VALUE 0x396534 Scalar_UWORD 0 Freq_q1p0 0.0 65535.0 /end CHARACTERISTIC
/begin CHARACTERISTIC Rail_frqBlkShtThres_C "Target blankshot frequency to be reached for transition to pressure stabilization phase" VALUE 0x39659A Scalar_UWORD 0 Freq_q1p0 0.0 65535.0 /end CHARACTERISTIC
/begin CHARACTERISTIC Rail_pBlkShtDeflateHi_C "Rail pressure high therod in deflation phase" VALUE 0x3965B0 Scalar_SWORD 0 RailPressure_bar -2500.0 2500.0 /end CHARACTERISTIC
/begin CHARACTERISTIC Rail_pBlkShtDeflateLo_C "Rail pressure low therod in deflation phase" VALUE 0x3965B2 Scalar_SWORD 0 RailPressure_bar -2500.0 2500.0 /end CHARACTERISTIC
/begin CHARACTERISTIC Rail_pBlkShtMax_C "Maximum rail pressure allowed when programming blank shots" VALUE 0x3965B4 Scalar_SWORD 0 RailPressure_bar -2500.0 2500.0 /end CHARACTERISTIC
/begin CHARACTERISTIC Rail_pDvtBlkShtCntDn_C "Rail pressure deviation for the transition from fast to slow pressure reduction" VALUE 0x3965BA Scalar_SWORD 0 RailPressure_bar -2500.0 2500.0 /end CHARACTERISTIC
/begin CHARACTERISTIC Rail_pDvtBlkShtCntUpHiLim_C "Rail pressure deviation threshold for the transition to fast pressure reduction" VALUE 0x3965BC Scalar_SWORD 0 RailPressure_bar -2500.0 2500.0 /end CHARACTERISTIC
/begin CHARACTERISTIC Rail_pDvtBlkShtCntUpLoLim_C "Rail pressure deviation threshold for blank shot frequency increase" VALUE 0x3965BE Scalar_SWORD 0 RailPressure_bar -2500.0 2500.0 /end CHARACTERISTIC
/begin CHARACTERISTIC Rail_qBlkShtStart_C "Maximum injection quantity for blank shot release in phase 1" VALUE 0x39773E Scalar_SWORD 0 FuelMass_mg_hub -319.0 319.0 /end CHARACTERISTIC
/begin CHARACTERISTIC Rail_swtPh1Byp_C "Switch for the release of blank shots in phase 1" VALUE 0x397774 Scalar_UBYTE 0 State_uint8 0.0 1.0 /end CHARACTERISTIC
/begin CHARACTERISTIC Rail_stCtlBlkShtDeflate_C "Switch selection for Rail Deflation using blank shots" VALUE 0x39776A Scalar_BOOLEAN 0 boolean 0.0 1.0 /end CHARACTERISTIC
/begin CHARACTERISTIC Rail_stCtlBlkShtOvr_C "Switch selection for Blank shot in overrun" VALUE 0x39776B Scalar_BOOLEAN 0 boolean 0.0 1.0 /end CHARACTERISTIC
/begin AXIS_PTS Rail_dfrqBlkShtCntUp_CURX "Governor deviation of the rail pressure governor" 0x395CC4 Rail_pDvt Lookup1D_X_WORD 0 RailPressure_bar 3 -2500.0 2500.0 /end AXIS_PTS
/begin AXIS_PTS Rail_frqBlkShtMax_MAPY "Engine speed" 0x39655E Epm_nEng Lookup2D_X_WORD 0 EngSpeed_rpm 4 0.0 6000.0 /end AXIS_PTS
/begin AXIS_PTS Rail_frqBlkShtMax_MAPX "Vehicle speed" 0x396556 VehV_v Lookup2D_X_WORD 0 VehSpeed_km_h 4 0.0 250.0 /end AXIS_PTS
/begin AXIS_PTS Rail_frqBlkShtPreCtl_MAPY "Engine temperature" 0x396596 EngDa_tEng Lookup2D_X_WORD 0 Temp_deg 2 -1000.0 1000.0 /end AXIS_PTS
/begin AXIS_PTS Rail_frqBlkShtPreCtl_MAPX "Governor deviation of the rail pressure governor" 0x396586 Rail_pDvt Lookup2D_X_WORD 0 RailPressure_bar 8 -2500.0 2500.0 /end AXIS_PTS
/begin CHARACTERISTIC Rail_dvolMeUnCtlInitI_CUR "Offset flowrate when PRV is active" CURVE 0x395FBC Lookup1D_WORD 0 FuelVol_mm3_s -327670.0 327670.0
 /begin AXIS_DESCR COM_AXIS InjSys_tEng Temp_deg 6 -150.0 150.0 AXIS_PTS_REF Rail_dvolMeUnCtlInitI_CURX /end AXIS_DESCR
/end CHARACTERISTIC
/begin CHARACTERISTIC Rail_dvolStrt_MAP "Flow quantity through the metering unit at start" MAP 0x396068 Lookup2D_WORD 0 FuelVol_mm3_s -327670.0 327670.0
 /begin AXIS_DESCR COM_AXIS Epm_nEng EngSpeed_rpm 8 0.0 6000.0 AXIS_PTS_REF Rail_dvolStrt_MAPX /end AXIS_DESCR
 /begin AXIS_DESCR COM_AXIS InjSys_tEng Temp_deg 8 -150.0 150.0 AXIS_PTS_REF Rail_dvolStrt_MAPY /end AXIS_DESCR
/end CHARACTERISTIC
/begin CHARACTERISTIC Rail_numRevPlaus_C "Number of camshaft rotations required to change from precontrol to control" VALUE 0x3965AC Scalar_ULONG 0 Counter_num 0.0 65535.0 /end CHARACTERISTIC
/begin CHARACTERISTIC Rail_tiFrzIDel_C "Delay time for freezing the I component for the pressure governor by the metering " VALUE 0x397788 Scalar_ULONG 0 Debounce_ms 0.0 65535.0 /end CHARACTERISTIC
/begin CHARACTERISTIC Rail_pCloseCtl_C "Absolute pressure threshold from switching over to closed loop control" VALUE 0x3965B6 Scalar_SWORD 0 RailPressure_bar -2500.0 2500.0 /end CHARACTERISTIC
/begin CHARACTERISTIC Rail_pDiffCloseCtl_C "Differential pressure threshold for switching to closed loop control" VALUE 0x3965B8 Scalar_SWORD 0 RailPressure_bar -2500.0 2500.0 /end CHARACTERISTIC
/begin CHARACTERISTIC Rail_pDvtFltMin_C "Minimum absolute governor deviation as input signal of DT1 element" VALUE 0x3965C0 Scalar_SWORD 0 RailPressure_bar -2500.0 2500.0 /end CHARACTERISTIC
/begin CHARACTERISTIC Rail_pMeUnCtlIWinNeg_C "Lower small signal limit for P component of pressure control by metering unit" VALUE 0x3965C6 Scalar_SWORD 0 RailPressure_bar -2500.0 2500.0 /end CHARACTERISTIC
/begin CHARACTERISTIC Rail_pMeUnCtlIWinPos_C "Upper small signal limit for I component of pressure control by metering unit" VALUE 0x3965C8 Scalar_SWORD 0 RailPressure_bar -2500.0 2500.0 /end CHARACTERISTIC
/begin CHARACTERISTIC Rail_pMeUnCtlPWinNeg_C "Lower small signal limit for P component of pressure control by metering unit" VALUE 0x3965CA Scalar_SWORD 0 RailPressure_bar -2500.0 2500.0 /end CHARACTERISTIC
/begin CHARACTERISTIC Rail_pMeUnCtlPWinPos_C "Upper small signal limit for P component of pressure control by metering unit" VALUE 0x3965CC Scalar_SWORD 0 RailPressure_bar -2500.0 2500.0 /end CHARACTERISTIC
/begin CHARACTERISTIC Rail_pOpnCtl_C "Absolute pressure threshold from switching over to open loop control" VALUE 0x3966D4 Scalar_SWORD 0 RailPressure_bar -2500.0 2500.0 /end CHARACTERISTIC
/begin CHARACTERISTIC Rail_nCloseCtl_C "Engine speed threshold for transition between open loop and closed loop control" VALUE 0x39659C Scalar_SWORD 0 EngSpeed_rpm 0.0 5000.0 /end CHARACTERISTIC
/begin CHARACTERISTIC Rail_nMeUnFrzI_C "Engine speed threshold for freezing the I component for the pressure governor by the metering unit" VALUE 0x39659E Scalar_SWORD 0 EngSpeed_rpm 0.0 6000.0 /end CHARACTERISTIC
/begin CHARACTERISTIC Rail_nOpnCtl_C "Engine speed threshold for exiting the startup state of state control" VALUE 0x3965A2 Scalar_SWORD 0 EngSpeed_rpm 0.0 6000.0 /end CHARACTERISTIC
/begin CHARACTERISTIC Rail_nStrtLoPress_C "Engine speed threshold for leaving the starting state at low pressure" VALUE 0x3965A4 Scalar_SWORD 0 EngSpeed_rpm 0.0 6000.0 /end CHARACTERISTIC
/begin CHARACTERISTIC Rail_dvolMeUnCtlLoLim_C "Lower set value limitation in case of error" VALUE 0x395FD4 Scalar_SWORD 0 FuelVol_mm3_s -327670.0 327670.0 /end CHARACTERISTIC
/begin CHARACTERISTIC Rail_dvolOff_C "Volume flow at system shut-off (zero delivery)" VALUE 0x396064 Scalar_SWORD 0 FuelVol_mm3_s -327670.0 327670.0 /end CHARACTERISTIC
/begin CHARACTERISTIC Rail_dvolPRVCtlOfs_C "Offset flowrate when PRV is active" VALUE 0x396066 Scalar_SWORD 0 FuelVol_mm3_s 0.0 327670.0 /end CHARACTERISTIC
/begin CHARACTERISTIC FlSys_stDeflate_C "Activation of the low pressure deflation" VALUE 0x389D06 Scalar_UBYTE 0 State_uint8 0.0 255.0 /end CHARACTERISTIC
/begin CHARACTERISTIC Rail_stCtlLoopSel_C "Switch selection for rail pressure control" VALUE 0x39776C Scalar_BOOLEAN 0 boolean 0.0 1.0 /end CHARACTERISTIC
/begin CHARACTERISTIC Rail_swtPress_C "Switchover between open loop and closed loop control using the absolute(0)/differential(1) value of the rail pressure" VALUE 0x397775 Scalar_BOOLEAN 0 boolean 0.0 1.0 /end CHARACTERISTIC
/begin AXIS_PTS Rail_dvolMeUnCtlInitI_CURX "Transformation axis X to convert engine temperature to flow quantity through the metering unit at start" 0x395FC8 InjSys_tEng Lookup1D_X_WORD 0 Temp_deg 6 -150.0 150.0 /end AXIS_PTS
/begin AXIS_PTS Rail_dvolStrt_MAPY "Transformation axis Y to convert engine temperature to flow quantity through the metering unit at start" 0x3960F8 InjSys_tEng Lookup2D_X_WORD 0 Temp_deg 8 -150.0 150.0 /end AXIS_PTS
/begin AXIS_PTS Rail_dvolStrt_MAPX "Transformation axis X to convert engine speed to flow quantity through the metering unit at start" 0x3960E8 Epm_nEng Lookup2D_X_WORD 0 EngSpeed_rpm 8 0.0 6000.0 /end AXIS_PTS
/begin CHARACTERISTIC Rail_dvolMeUnCtlUpLim_CUR "Transformation curve to convert engine speed to the maximum delivery quantity of the high pressure pump" CURVE 0x395FD8 Lookup1D_WORD 0 FuelVol_mm3_s 0.0 327670.0
 /begin AXIS_DESCR COM_AXIS Epm_nEng EngSpeed_rpm 16 0.0 6000.0 AXIS_PTS_REF Rail_dvolMeUnCtlUpLim_CURX /end AXIS_DESCR
/end CHARACTERISTIC
/begin CHARACTERISTIC Rail_dvolMeUnCtlUpLim_C "Upper set value limitation in case of error" VALUE 0x395FD6 Scalar_SWORD 0 FuelVol_mm3_s 0.0 327670.0 /end CHARACTERISTIC
/begin AXIS_PTS Rail_dvolMeUnCtlUpLim_CURX "engine speed" 0x395FF8 Epm_nEng Lookup1D_X_WORD 0 EngSpeed_rpm 16 0.0 6000.0 /end AXIS_PTS
/begin CHARACTERISTIC Rail_MeUnCtlDKd_CUR "Transformation curve to convert engine speed to D amplification " CURVE 0x395AF8 Lookup1D_UWORD 0 Pid_Kp_Kd 0.0 15.0
 /begin AXIS_DESCR COM_AXIS Epm_nEng EngSpeed_rpm 16 0.0 6000.0 AXIS_PTS_REF Rail_MeUnCtlDKd_CURX /end AXIS_DESCR
/end CHARACTERISTIC
/begin CHARACTERISTIC Rail_MeUnCtlIKiNeg_CUR "Transformation curve to convert engine speed to I amplification below lower window border" CURVE 0x395B38 Lookup1D_UWORD 0 Pid_Ki 0.0 65.0
 /begin AXIS_DESCR COM_AXIS Epm_nEng EngSpeed_rpm 16 0.0 6000.0 AXIS_PTS_REF Rail_MeUnCtlIKiNeg_CURX /end AXIS_DESCR
/end CHARACTERISTIC
/begin CHARACTERISTIC Rail_MeUnCtlIKiPos_CUR "Transformation curve to convert engine speed to I amplification above upper window border" CURVE 0x395B78 Lookup1D_UWORD 0 Pid_Ki 0.0 65.0
 /begin AXIS_DESCR COM_AXIS Epm_nEng EngSpeed_rpm 16 0.0 6000.0 AXIS_PTS_REF Rail_MeUnCtlIKiPos_CURX /end AXIS_DESCR
/end CHARACTERISTIC
/begin CHARACTERISTIC Rail_MeUnCtlIKi_CUR "Transformation curve to convert engine speed to I amplification within the window" CURVE 0x395BB8 Lookup1D_UWORD 0 Pid_Ki 0.0 65.0
 /begin AXIS_DESCR COM_AXIS Epm_nEng EngSpeed_rpm 16 0.0 6000.0 AXIS_PTS_REF Rail_MeUnCtlIKi_CURX /end AXIS_DESCR
/end CHARACTERISTIC
/begin CHARACTERISTIC Rail_MeUnCtlPKpNeg_CUR "Transformation curve to convert engine speed to P amplification below lower window border" CURVE 0x395BF8 Lookup1D_UWORD 0 Pid_Kp_Kd 0.0 65.0
 /begin AXIS_DESCR COM_AXIS Epm_nEng EngSpeed_rpm 16 0.0 6000.0 AXIS_PTS_REF Rail_MeUnCtlPKpNeg_CURX /end AXIS_DESCR
/end CHARACTERISTIC
/begin CHARACTERISTIC Rail_MeUnCtlPKpPos_CUR "Transformation curve to convert engine speed to P amplification above upper window border" CURVE 0x395C38 Lookup1D_UWORD 0 Pid_Kp_Kd 0.0 65.0
 /begin AXIS_DESCR COM_AXIS Epm_nEng EngSpeed_rpm 16 0.0 6000.0 AXIS_PTS_REF Rail_MeUnCtlPKpPos_CURX /end AXIS_DESCR
/end CHARACTERISTIC
/begin CHARACTERISTIC Rail_MeUnCtlPKp_CUR "Transformation curve to convert engine speed to P amplification within the window" CURVE 0x395C78 Lookup1D_UWORD 0 Pid_Kp_Kd 0.0 65.0
 /begin AXIS_DESCR COM_AXIS Epm_nEng EngSpeed_rpm 16 0.0 6000.0 AXIS_PTS_REF Rail_MeUnCtlPKp_CURX /end AXIS_DESCR
/end CHARACTERISTIC
/begin CHARACTERISTIC Rail_facMeUnCtlDCor_CUR "Transformation curve to convert fuel system temperature to correction factor for D parameter" CURVE 0x39615E Lookup1D_WORD 0 Factor -10.0 10.0
 /begin AXIS_DESCR COM_AXIS FuelT_tFlSys Temp_deg 4 -50.0 150.0 AXIS_PTS_REF Rail_facMeUnCtlDCor_CURX /end AXIS_DESCR
/end CHARACTERISTIC
/begin CHARACTERISTIC Rail_facMeUnCtlICor_CUR "Transformation curve to convert fuel system temperature to correction factor for I parameter" CURVE 0x39616E Lookup1D_WORD 0 Factor -10.0 10.0
 /begin AXIS_DESCR COM_AXIS FuelT_tFlSys Temp_deg 4 -50.0 150.0 AXIS_PTS_REF Rail_facMeUnCtlICor_CURX /end AXIS_DESCR
/end CHARACTERISTIC
/begin CHARACTERISTIC Rail_facMeUnCtlPCor_CUR "Transformation curve to convert fuel system temperature to correction factor for P parameter" CURVE 0x39617E Lookup1D_WORD 0 Factor -10.0 10.0
 /begin AXIS_DESCR COM_AXIS FuelT_tFlSys Temp_deg 4 -50.0 150.0 AXIS_PTS_REF Rail_facMeUnCtlPCor_CURX /end AXIS_DESCR
/end CHARACTERISTIC
/begin CHARACTERISTIC Rail_facMeUnCtlPT1_CUR "Transformation curve to convert engine speed to PT1 component" CURVE 0x39618E Lookup1D_UWORD 0 PT_fac 0.0 99.9985
 /begin AXIS_DESCR COM_AXIS Epm_nEng EngSpeed_rpm 16 0.0 6000.0 AXIS_PTS_REF Rail_facMeUnCtlPT1_CURX /end AXIS_DESCR
/end CHARACTERISTIC
/begin CHARACTERISTIC Rail_tiMeUnCtlDT1_CUR "Transformation curve to convert engine speed to DT1 component" CURVE 0x3977B0 Lookup1D_UWORD 0 RailDT1_ms 0.0 65535.0
 /begin AXIS_DESCR COM_AXIS Epm_nEng EngSpeed_rpm 16 0.0 6000.0 AXIS_PTS_REF Rail_tiMeUnCtlDT1_CURX /end AXIS_DESCR
/end CHARACTERISTIC
/begin CHARACTERISTIC Rail_pOvrMeUnThresHigh_C "Upper hysteresis threshold for MeUn overpressure detection" VALUE 0x3966D6 Scalar_SWORD 0 RailPressure_bar 0.0 2500.0 /end CHARACTERISTIC
/begin CHARACTERISTIC Rail_pOvrMeUnThresLow_C "Lower hysteresis threshold for MeUn overpressure detection" VALUE 0x3966D8 Scalar_SWORD 0 RailPressure_bar 0.0 2500.0 /end CHARACTERISTIC
/begin CHARACTERISTIC Rail_facOvrMeUnNegIncr_C "Multiplication factor for increasing I amplification for negative large signals when there is overpressure (pressure control by metering unit)" VALUE 0x3961CE Scalar_SWORD 0 Factor -10.0 10.0 /end CHARACTERISTIC
/begin AXIS_PTS Rail_MeUnCtlDKd_CURX "Transformation axis to convert engine speed to D amplification " 0x395B18 Epm_nEng Lookup1D_X_WORD 0 EngSpeed_rpm 16 0.0 6000.0 /end AXIS_PTS
/begin AXIS_PTS Rail_MeUnCtlIKiNeg_CURX "Transformation axis to convert engine speed to I amplification below lower window border" 0x395B58 Epm_nEng Lookup1D_X_WORD 0 EngSpeed_rpm 16 0.0 6000.0 /end AXIS_PTS
/begin AXIS_PTS Rail_MeUnCtlIKiPos_CURX "Transformation axis to convert engine speed to I amplification above upper window border" 0x395B98 Epm_nEng Lookup1D_X_WORD 0 EngSpeed_rpm 16 0.0 6000.0 /end AXIS_PTS
/begin AXIS_PTS Rail_MeUnCtlIKi_CURX "Transformation axis to convert engine speed to I amplification within the window" 0x395BD8 Epm_nEng Lookup1D_X_WORD 0 EngSpeed_rpm 16 0.0 6000.0 /end AXIS_PTS
/begin AXIS_PTS Rail_MeUnCtlPKpNeg_CURX "Transformation axis to convert engine speed to P amplification below lower window border" 0x395C18 Epm_nEng Lookup1D_X_WORD 0 EngSpeed_rpm 16 0.0 6000.0 /end AXIS_PTS
/begin AXIS_PTS Rail_MeUnCtlPKpPos_CURX "Transformation axis to convert engine speed to P amplification above upper window border" 0x395C58 Epm_nEng Lookup1D_X_WORD 0 EngSpeed_rpm 16 0.0 6000.0 /end AXIS_PTS
/begin AXIS_PTS Rail_MeUnCtlPKp_CURX "Transformation axis to convert engine speed to P amplification within the window" 0x395C98 Epm_nEng Lookup1D_X_WORD 0 EngSpeed_rpm 16 0.0 6000.0 /end AXIS_PTS
/begin AXIS_PTS Rail_facMeUnCtlDCor_CURX "Transformation axis to convert fuel system temperature to correction factor for D parameter" 0x396166 FuelT_tFlSys Lookup1D_X_WORD 0 Temp_deg 4 -50.0 150.0 /end AXIS_PTS
/begin AXIS_PTS Rail_facMeUnCtlICor_CURX "Transformation axis to convert fuel system temperature to correction factor for I parameter" 0x396176 FuelT_tFlSys Lookup1D_X_WORD 0 Temp_deg 4 -50.0 150.0 /end AXIS_PTS
/begin AXIS_PTS Rail_facMeUnCtlPCor_CURX "Transformation axis to convert fuel system temperature to correction factor for P parameter" 0x396186 FuelT_tFlSys Lookup1D_X_WORD 0 Temp_deg 4 -50.0 150.0 /end AXIS_PTS
/begin AXIS_PTS Rail_facMeUnCtlPT1_CURX "Transformation axis to convert engine speed to PT1 component" 0x3961AE Epm_nEng Lookup1D_X_WORD 0 EngSpeed_rpm 16 0.0 6000.0 /end AXIS_PTS
/begin AXIS_PTS Rail_tiMeUnCtlDT1_CURX "Transformation axis to convert engine speed to DT1 component" 0x3977D0 Epm_nEng Lookup1D_X_WORD 0 EngSpeed_rpm 16 0.0 6000.0 /end AXIS_PTS
/begin CHARACTERISTIC Rail_pMeUnDvtMax_CUR "Maximum governor deviation allowed for rail pressure monitoring as a function of engine speed" CURVE 0x3965CE Lookup1D_WORD 0 RailPressure_bar -2500.0 2500.0
 /begin AXIS_DESCR COM_AXIS Epm_nEng EngSpeed_rpm 16 0.0 6000.0 AXIS_PTS_REF Rail_pMeUnDvtMax_CURX /end AXIS_DESCR
/end CHARACTERISTIC
/begin CHARACTERISTIC Rail_dvolMonHPUnTolc_CUR "Tolerance of high pressure pump" CURVE 0x39603A Lookup1D_WORD 0 FuelVol_mm3_s -327680.0 327670.0
 /begin AXIS_DESCR COM_AXIS Rail_dvolDemSysMax FuelVol_mm3_s 4 -327680.0 327670.0 AXIS_PTS_REF Rail_dvolMonHPUnTolc_CURX /end AXIS_DESCR
/end CHARACTERISTIC
/begin CHARACTERISTIC Rail_dvolMonLeakTolc_CUR "Tolerances based on the setpoint pressure" CURVE 0x39604C Lookup1D_WORD 0 FuelVol_mm3_s -327680.0 327670.0
 /begin AXIS_DESCR COM_AXIS Rail_pSetPoint RailPressure_bar 6 -2500.0 2500.0 AXIS_PTS_REF Rail_dvolMonLeakTolc_CURX /end AXIS_DESCR
/end CHARACTERISTIC
/begin CHARACTERISTIC Rail_pMeUnDvtMin_CUR "Minimum governor deviation allowed for rail pressure monitoring as a function of engine speed" CURVE 0x39664E Lookup1D_WORD 0 RailPressure_bar -2500.0 2500.0
 /begin AXIS_DESCR COM_AXIS Epm_nEng EngSpeed_rpm 16 0.0 6000.0 AXIS_PTS_REF Rail_pMeUnDvtMin_CURX /end AXIS_DESCR
/end CHARACTERISTIC
/begin CHARACTERISTIC Rail_pMeUnDvtMin2_CUR "Minimum governor deviation allowed for rail pressure monitoring as a function of engine speed for second monitoring stage" CURVE 0x39660E Lookup1D_WORD 0 RailPressure_bar -2500.0 2500.0
 /begin AXIS_DESCR COM_AXIS Epm_nEng EngSpeed_rpm 16 0.0 6000.0 AXIS_PTS_REF Rail_pMeUnDvtMin2_CURX /end AXIS_DESCR
/end CHARACTERISTIC
/begin CHARACTERISTIC Rail_pMeUnFltMin_CUR "Minimum rail pressure allowed as a function of the engine speed" CURVE 0x39668E Lookup1D_WORD 0 RailPressure_bar -2500.0 2500.0
 /begin AXIS_DESCR COM_AXIS Epm_nEng EngSpeed_rpm 16 0.0 6000.0 AXIS_PTS_REF Rail_pMeUnFltMin_CURX /end AXIS_DESCR
/end CHARACTERISTIC
/begin CHARACTERISTIC Rail_dvolMeUnOvrRun_CUR "Maximum admissible fuel delivery rate for monitoring of set value in overrun" CURVE 0x39601A Lookup1D_WORD 0 FuelVol_mm3_s -327680.0 327670.0
 /begin AXIS_DESCR COM_AXIS RailP_pFlt RailPressure_bar 8 -2500.0 2500.0 AXIS_PTS_REF Rail_dvolMeUnOvrRun_CURX /end AXIS_DESCR
/end CHARACTERISTIC
/begin CHARACTERISTIC Rail_tiMeUn0Deb_C "Duration of defect or healing debouncing for check DFC_RailMeUn0" VALUE 0x39778C Scalar_ULONG 0 Debounce_ms 0.0 65535.0 /end CHARACTERISTIC
/begin CHARACTERISTIC Rail_tiMeUn10Deb_C "Duration of defect or healing debouncing for check DFC_RailMeUn10" VALUE 0x397790 Scalar_ULONG 0 Debounce_ms 0.0 65535.0 /end CHARACTERISTIC
/begin CHARACTERISTIC Rail_tiMeUn22Deb_C "Duration of defect or healing debouncing for check DFC_RailMeUn22" VALUE 0x397794 Scalar_ULONG 0 Debounce_ms 0.0 65535.0 /end CHARACTERISTIC
/begin CHARACTERISTIC Rail_tiMeUn2Deb_C "Duration of defect or healing debouncing for check DFC_RailMeUn2" VALUE 0x397798 Scalar_ULONG 0 Debounce_ms 0.0 65535.0 /end CHARACTERISTIC
/begin CHARACTERISTIC Rail_tiMeUn3Deb_C "Duration of defect or healing debouncing for check DFC_RailMeUn3" VALUE 0x39779C Scalar_ULONG 0 Debounce_ms 0.0 65535.0 /end CHARACTERISTIC
/begin CHARACTERISTIC Rail_tiMeUn42Deb_C "Duration of defect or healing debouncing for check DFC_RailMeUn42" VALUE 0x3977A0 Scalar_ULONG 0 Debounce_ms 0.0 65535.0 /end CHARACTERISTIC
/begin CHARACTERISTIC Rail_tiMeUn4Deb_C "Duration of defect or healing debouncing for check DFC_RailMeUn4" VALUE 0x3977A4 Scalar_ULONG 0 Debounce_ms 0.0 65535.0 /end CHARACTERISTIC
/begin CHARACTERISTIC Rail_tiMeUn7Deb_C "Duration of defect or healing debouncing for check DFC_RailMeUn7" VALUE 0x3977A8 Scalar_ULONG 0 Debounce_ms 0.0 65535.0 /end CHARACTERISTIC
/begin CHARACTERISTIC Rail_tiMeUn8Deb_C "Duration of defect or healing debouncing for check DFC_RailMeUn8" VALUE 0x3977AC Scalar_ULONG 0 Debounce_ms 0.0 65535.0 /end CHARACTERISTIC
/begin CHARACTERISTIC Rail_stMeUnMonRls_C "Class for MeUn monitoring threshold value / general release mask for monitoring pressure governing via metering unit" VALUE 0x39776E Scalar_UWORD 0 State_uint16 0.0 65535.0 /end CHARACTERISTIC
/begin CHARACTERISTIC Rail_pMeUnMonFltMax2_C "Class for MeUn monitoring threshold value / maximum admissbile rail pressure for the second monitoring stage" VALUE 0x3966CE Scalar_SWORD 0 RailPressure_bar -2500.0 2500.0 /end CHARACTERISTIC
/begin CHARACTERISTIC Rail_pMeUnMonFltMax_C "Class for MeUn monitoring threshold value / maximum admissbile rail pressure" VALUE 0x3966D0 Scalar_SWORD 0 RailPressure_bar -2500.0 2500.0 /end CHARACTERISTIC
/begin CHARACTERISTIC Rail_pMonDvtMax_C "Maximum rail pressure governor deviation for metering unit monitoring" VALUE 0x3966D2 Scalar_SWORD 0 RailPressure_bar -2500.0 2500.0 /end CHARACTERISTIC
/begin CHARACTERISTIC Rail_nMonIdlMax_C "Maximum engine speed level for low idle state" VALUE 0x3965A0 Scalar_SWORD 0 EngSpeed_rpm 0.0 6000.0 /end CHARACTERISTIC
/begin CHARACTERISTIC Rail_dvolMeUnMonSetMin_C "Class for MeUn monitoring threshold value / minimum admissible flow of fuel through metering unit for rail pressure monitoring" VALUE 0x396018 Scalar_SWORD 0 FuelVol_mm3_s -327670.0 327670.0 /end CHARACTERISTIC
/begin CHARACTERISTIC Rail_dvolMonIdlMax_C "Maximum metering unit flow at low idle" VALUE 0x39604A Scalar_SWORD 0 FuelVol_mm3_s -327680.0 327670.0 /end CHARACTERISTIC
/begin CHARACTERISTIC Rail_qMeUnMonLoIdl_C "Class for MeUn monitoring threshold value / quantity threshold for rail pressure monitoring to recognize the overrun condition" VALUE 0x397764 Scalar_SWORD 0 FuelMass_mg_hub 0.0 300.0 /end CHARACTERISTIC
/begin CHARACTERISTIC Rail_qMonUnBalMax_C "Maximum injection quantity for metering unit monitoring" VALUE 0x397766 Scalar_SWORD 0 FuelMass_mg_hub 0.0 30.0 /end CHARACTERISTIC
/begin CHARACTERISTIC Rail_tMeUnMonLoIdl_C "Class for MeUn monitoring threshold value / system temperature threshold of rail pressure monitoring" VALUE 0x397778 Scalar_SWORD 0 Temp_deg -50.0 150.0 /end CHARACTERISTIC
/begin AXIS_PTS Rail_pMeUnDvtMax_CURX "Epm_nEng" 0x3965EE Epm_nEng Lookup1D_X_WORD 0 EngSpeed_rpm 16 0.0 6000.0 /end AXIS_PTS
/begin AXIS_PTS Rail_dvolMonHPUnTolc_CURX "Rail_dvolDemSysMax" 0x396042 Rail_dvolDemSysMax Lookup1D_X_WORD 0 FuelVol_mm3_s 4 -327680.0 327670.0 /end AXIS_PTS
/begin AXIS_PTS Rail_dvolMonLeakTolc_CURX "Rail_pSetPoint" 0x396058 Rail_pSetPoint Lookup1D_X_WORD 0 RailPressure_bar 6 -2500.0 2500.0 /end AXIS_PTS
/begin AXIS_PTS Rail_pMeUnDvtMin_CURX "Epm_nEng" 0x39666E Epm_nEng Lookup1D_X_WORD 0 EngSpeed_rpm 16 0.0 6000.0 /end AXIS_PTS
/begin AXIS_PTS Rail_pMeUnDvtMin2_CURX "Epm_nEng" 0x39662E Epm_nEng Lookup1D_X_WORD 0 EngSpeed_rpm 16 0.0 6000.0 /end AXIS_PTS
/begin AXIS_PTS Rail_pMeUnFltMin_CURX "Epm_nEng" 0x3966AE Epm_nEng Lookup1D_X_WORD 0 EngSpeed_rpm 16 0.0 6000.0 /end AXIS_PTS
/begin AXIS_PTS Rail_dvolMeUnOvrRun_CURX "RailP_pFlt" 0x39602A RailP_pFlt Lookup1D_X_WORD 0 RailPressure_bar 8 -2500.0 2500.0 /end AXIS_PTS
/begin CHARACTERISTIC Rail_facPreCtlMeUnCor_MAP "Operating point dependent factor map to scale the PreCtl in relation to the estimated system requirement" MAP 0x3961D0 Lookup2D_WORD 0 Factor 0.0 3.0
 /begin AXIS_DESCR COM_AXIS Rail_qDemInj_mp FuelMass_mg_hub 16 0.0 300.0 AXIS_PTS_REF Rail_facPreCtlMeUnCor_MAPX /end AXIS_DESCR
 /begin AXIS_DESCR COM_AXIS Epm_nEng EngSpeed_rpm 16 0.0 6000.0 AXIS_PTS_REF Rail_facPreCtlMeUnCor_MAPY /end AXIS_DESCR
/end CHARACTERISTIC
/begin CHARACTERISTIC Rail_qDemInjCtl_CUR "Estimated injection control quantity for a single injection based on the requested injection quantity" CURVE 0x397744 Lookup1D_WORD 0 FuelMass_mg_hub 0.0 300.0
 /begin AXIS_DESCR COM_AXIS InjCrv_qPiI1Des FuelMass_mg_hub 8 0.0 300.0 AXIS_PTS_REF Rail_qDemInjCtl_CURX /end AXIS_DESCR
/end CHARACTERISTIC
/begin CHARACTERISTIC Rail_dvolLeak_CUR "Rail pressure setpoint dependant base leakage curve for one cylinder" CURVE 0x395F9C Lookup1D_WORD 0 FuelVol_mm3_s -327680.0 327670.0
 /begin AXIS_DESCR COM_AXIS NO_INPUT_QUANTITY RailPressure_bar 8 0.0 2500.0 AXIS_PTS_REF Rail_dvolLeak_CURX /end AXIS_DESCR
/end CHARACTERISTIC
/begin CHARACTERISTIC Rail_facLeakEngOn_CUR "Leakage factor curve based on the lifetime wear" CURVE 0x39612A Lookup1D_WORD 0 Factor 0.0 3.0
 /begin AXIS_DESCR COM_AXIS Rail_tiLeakEngOn_mp RailHrsEngOn_h 3 -3.2768E+6 3.2767E+6 AXIS_PTS_REF Rail_facLeakEngOn_CURX /end AXIS_DESCR
/end CHARACTERISTIC
/begin CHARACTERISTIC Rail_facLeakTempCor_CUR "Fuel temperature dependent leakage correction factor curve" CURVE 0x396136 Lookup1D_WORD 0 Factor 0.0 3.0
 /begin AXIS_DESCR COM_AXIS FuelT_t Temp_deg 10 -50.0 150.0 AXIS_PTS_REF Rail_facLeakTempCor_CURX /end AXIS_DESCR
/end CHARACTERISTIC
/begin CHARACTERISTIC Rail_numInjSum_C "Maximum Number of injections in the injection cycle in the current cylinder" VALUE 0x3965A8 Scalar_ULONG 0 Counter_num 0.0 8.0 /end CHARACTERISTIC
/begin CHARACTERISTIC Rail_tiPreCtlDynT1_C "Parameter structure of dynamic component for boosting the PreCtl during sudden changes / Reciprocal of time delay T1 " VALUE 0x3977F0 Scalar_UWORD 0 RailDT1_ms 0.0 65535.0 /end CHARACTERISTIC
/begin CHARACTERISTIC Rail_qDemInjCtlMaxOfs_C "Injection control quantity offset for a single injection between a nominal and a maximum tolerated injector" VALUE 0x397742 Scalar_SWORD 0 FuelMass_mg_hub 0.0 300.0 /end CHARACTERISTIC
/begin CHARACTERISTIC Rail_qPreCtlDynDiffMin_C "Limitation for the dynamic DT1 component (Rail_dvolPreCtlDyn_mp) in the MeUn precontrol" VALUE 0x397768 Scalar_SWORD 0 FuelMass_mg_hub 0.0 300.0 /end CHARACTERISTIC
/begin CHARACTERISTIC PCV_dvolLeak_C "Leakage in the pressure control valve" VALUE 0x395714 Scalar_SWORD 0 FuelVol_mm3_s -327680.0 327670.0 /end CHARACTERISTIC
/begin CHARACTERISTIC Rail_PreCtlDynKd_C "Parameter structure of dynamic component for boosting the PreCtl during sudden changes / Differential factor" VALUE 0x395CB8 Scalar_UWORD 0 Pid_Kp_Kd 0.0 15.0 /end CHARACTERISTIC
/begin CHARACTERISTIC Rail_facDemInjCtlMax_C "Factor by that the injection control quantity for a single injection is increased between a nominal and a max. tolerated injector" VALUE 0x396108 Scalar_SWORD 0 Factor 0.0 3.0 /end CHARACTERISTIC
/begin CHARACTERISTIC Rail_swtDemInjSel_C "Switch to select the torque relevant injection quantity information for the PreCtl of the MeUn based on the application strategy" VALUE 0x397770 Scalar_UBYTE 0 State_uint8 0.0 255.0 /end CHARACTERISTIC
/begin AXIS_PTS Rail_facPreCtlMeUnCor_MAPY "Epm_nEng" 0x3963F0 Epm_nEng Lookup2D_X_WORD 0 EngSpeed_rpm 16 0.0 6000.0 /end AXIS_PTS
/begin AXIS_PTS Rail_facPreCtlMeUnCor_MAPX "Rail_qDemInj_mp" 0x3963D0 Rail_qDemInj_mp Lookup2D_X_WORD 0 FuelMass_mg_hub 16 0.0 300.0 /end AXIS_PTS
/begin AXIS_PTS Rail_qDemInjCtl_CURX "InjCrv_qPilDes" 0x397754 InjCrv_qPiI1Des Lookup1D_X_WORD 0 FuelMass_mg_hub 8 0.0 300.0 /end AXIS_PTS
/begin AXIS_PTS Rail_dvolLeak_CURX "Rail_pSetPoint" 0x395FAC NO_INPUT_QUANTITY Lookup1D_X_WORD 0 RailPressure_bar 8 0.0 2500.0 /end AXIS_PTS
/begin AXIS_PTS Rail_facLeakEngOn_CURX "Rail_tiLeakEngOn_mp" 0x396130 Rail_tiLeakEngOn_mp Lookup1D_X_WORD 0 RailHrsEngOn_h 3 -3.2768E+6 3.2767E+6 /end AXIS_PTS
/begin AXIS_PTS Rail_facLeakTempCor_CURX "FuelT_tFlSys" 0x39614A FuelT_t Lookup1D_X_WORD 0 Temp_deg 10 -50.0 150.0 /end AXIS_PTS
/begin CHARACTERISTIC Rail_qCorPresPeakLim_C "Quantity correction for limiting pressure peaks (pos. and neg.) mg/cyc" VALUE 0x397740 Scalar_SWORD 0 FuelMass_mg_hub -300.0 300.0 /end CHARACTERISTIC
/begin CHARACTERISTIC Rail_pSetPointErrLoLim_CUR " the minimum rail pressure level dependent on the fuel flow through PCV" CURVE 0x396FDA Lookup1D_WORD 0 RailPressure_bar -2500.0 2500.0
 /begin AXIS_DESCR COM_AXIS Rail_dvolPCVFlw_mp FuelVol_mm3_s 16 -327670.0 327670.0 AXIS_PTS_REF Rail_pSetPointErrLoLim_CURX /end AXIS_DESCR
/end CHARACTERISTIC
/begin CHARACTERISTIC Rail_pSetPointBasEOM0_MAP "The map of the basic setpoint value" MAP 0x396B5A Lookup2D_WORD 0 RailPressure_bar -2500.0 2500.0
 /begin AXIS_DESCR COM_AXIS Epm_nEng EngSpeed_rpm 16 0.0 6000.0 AXIS_PTS_REF Rail_pSetPointBasEOM0_MAPX /end AXIS_DESCR
 /begin AXIS_DESCR COM_AXIS InjCtl_qCurr FuelMass_mg_hub 16 0.0 300.0 AXIS_PTS_REF Rail_pSetPointBasEOM0_MAPY /end AXIS_DESCR
/end CHARACTERISTIC
/begin CHARACTERISTIC Rail_pSetPointLimNFlTemp_MAP "Minimum value of the correction map of the rail pressure setpoint correction based on the engine speed and the fuel temperature" MAP 0x39725A Lookup2D_WORD 0 RailPressure_bar -2500.0 2500.0
 /begin AXIS_DESCR COM_AXIS Epm_nEng EngSpeed_rpm 8 0.0 6000.0 AXIS_PTS_REF Rail_pSetPointLimNFlTemp_MAPX /end AXIS_DESCR
 /begin AXIS_DESCR COM_AXIS FuelT_t Temp_deg 8 -50.0 150.0 AXIS_PTS_REF Rail_pSetPointLimNFlTemp_MAPY /end AXIS_DESCR
/end CHARACTERISTIC
/begin CHARACTERISTIC Rail_dpSetPointIncLim_MAP "Map for Rail set point Increment Limitation" MAP 0x395DD2 Lookup2D_WORD 0 RailPressure_bar_s -2500.0 2500.0
 /begin AXIS_DESCR COM_AXIS NO_INPUT_QUANTITY RailPressure_bar 12 -2500.0 2500.0 AXIS_PTS_REF Rail_dpSetPointIncLim_MAPX /end AXIS_DESCR
 /begin AXIS_DESCR COM_AXIS Tra_numGear Tra_num 8 -128.0 127.0 AXIS_PTS_REF Rail_dpSetPointIncLim_MAPY /end AXIS_DESCR
/end CHARACTERISTIC
/begin CHARACTERISTIC Rail_dpSetPointInc_MAP "Maximum rail pressure setpoint increase per second based upon the engine speed and injected fuel quantity" MAP 0x395EB4 Lookup2D_WORD 0 RailPressure_bar_s -2500.0 2500.0
 /begin AXIS_DESCR COM_AXIS Epm_nEng EngSpeed_rpm 12 0.0 6000.0 AXIS_PTS_REF Rail_dpSetPointInc_MAPX /end AXIS_DESCR
 /begin AXIS_DESCR COM_AXIS NO_INPUT_QUANTITY FuelMass_mg_hub 8 0.0 300.0 AXIS_PTS_REF Rail_dpSetPointInc_MAPY /end AXIS_DESCR
/end CHARACTERISTIC
/begin CHARACTERISTIC Rail_dpSetPointDec_CUR "Curve for maximum rail pressure setpoint decrease per second" CURVE 0x395CCA Lookup1D_WORD 0 RailPressure_bar_s -2500.0 2500.0
 /begin AXIS_DESCR COM_AXIS NO_INPUT_QUANTITY RailPressure_bar 8 -2500.0 2500.0 AXIS_PTS_REF Rail_dpSetPointDec_CURX /end AXIS_DESCR
/end CHARACTERISTIC
/begin CHARACTERISTIC Rail_dpSetPointDec_MAP "map for Maximum rail pressure setpoint decrease per second" MAP 0x395CEA Lookup2D_WORD 0 RailPressure_bar_s -2500.0 2500.0
 /begin AXIS_DESCR COM_AXIS Epm_nEng EngSpeed_rpm 12 0.0 6000.0 AXIS_PTS_REF Rail_dpSetPointDec_MAPX /end AXIS_DESCR
 /begin AXIS_DESCR COM_AXIS InjCtl_qCurr FuelMass_mg_hub 8 0.0 300.0 AXIS_PTS_REF Rail_dpSetPointDec_MAPY /end AXIS_DESCR
/end CHARACTERISTIC
/begin CHARACTERISTIC Rail_pSetPointRed_C "Offset for reduction of rail pressure setpoint in the event of system error" VALUE 0x39773A Scalar_SWORD 0 RailPressure_bar -2500.0 2500.0 /end CHARACTERISTIC
/begin CHARACTERISTIC SigTst_pSetPoint_C "Set setpoint by hand" VALUE 0x398044 Scalar_SWORD 0 RailPressure_bar -2500.0 2500.0 /end CHARACTERISTIC
/begin CHARACTERISTIC Rail_pEnvpSetPointIncHi_C "Upper threshold for the switchover of the gear based setpoint limitation" VALUE 0x3965C2 Scalar_SWORD 0 AirPressure_kPa 0.0 350.0 /end CHARACTERISTIC
/begin CHARACTERISTIC Rail_pEnvpSetPointIncLo_C "Lower threshold for the switchover of the gear based setpoint limitation" VALUE 0x3965C4 Scalar_SWORD 0 AirPressure_kPa 0.0 350.0 /end CHARACTERISTIC
/begin CHARACTERISTIC Rail_swtDynLim_C "switch to select rail pressure dynamic limitation" VALUE 0x397771 Scalar_BOOLEAN 0 boolean 0.0 1.0 /end CHARACTERISTIC
/begin CHARACTERISTIC Rail_swtPSetPointSrc_C "switch to select rail pressure signal source" VALUE 0x397773 Scalar_BOOLEAN 0 boolean 0.0 1.0 /end CHARACTERISTIC
/begin CHARACTERISTIC Rail_swtStatLim_C "switch to select rail pressure static limitation" VALUE 0x397776 Scalar_BOOLEAN 0 boolean 0.0 1.0 /end CHARACTERISTIC
/begin CHARACTERISTIC Rail_swtIncLim_C "Switch for selecting the input dependancy for the gradient limitation of increasing railpressure setpoints" VALUE 0x397772 Scalar_UBYTE 0 Switch_conv 0 1 /end CHARACTERISTIC
/begin CHARACTERISTIC Rail_swtqIncSel_C "Switch for quantity that has to be used for rail pressure increment limitation" VALUE 0x397777 Scalar_UBYTE 0 Switch_conv 0 1 /end CHARACTERISTIC
/begin CHARACTERISTIC SigTst_swtSetPoint_C "Switch for setpoint by hand" VALUE 0x398094 Scalar_UBYTE 0 Switch_conv 0 1 /end CHARACTERISTIC
/begin AXIS_PTS Rail_pSetPointErrLoLim_CURX "Rail_dvolPCVFlw_mp" 0x396FFA Rail_dvolPCVFlw_mp Lookup1D_X_WORD 0 FuelVol_mm3_s 16 -327670.0 327670.0 /end AXIS_PTS
/begin AXIS_PTS Rail_pSetPointBasEOM0_MAPY "InjCtl_qCurr" 0x396D7A InjCtl_qCurr Lookup2D_X_WORD 0 FuelMass_mg_hub 16 0.0 300.0 /end AXIS_PTS
/begin AXIS_PTS Rail_pSetPointBasEOM0_MAPX "Epm_nEng" 0x396D5A Epm_nEng Lookup2D_X_WORD 0 EngSpeed_rpm 16 0.0 6000.0 /end AXIS_PTS
/begin AXIS_PTS Rail_pSetPointLimNFlTemp_MAPY "FuelT_t" 0x3972EA FuelT_t Lookup2D_X_WORD 0 Temp_deg 8 -50.0 150.0 /end AXIS_PTS
/begin AXIS_PTS Rail_pSetPointLimNFlTemp_MAPX "Epm_nEng" 0x3972DA Epm_nEng Lookup2D_X_WORD 0 EngSpeed_rpm 8 0.0 6000.0 /end AXIS_PTS
/begin AXIS_PTS Rail_dpSetPointIncLim_MAPY "Tra_numGear" 0x395EAC Tra_numGear Lookup2D_X_BYTE 0 Tra_num 8 -128.0 127.0 /end AXIS_PTS
/begin AXIS_PTS Rail_dpSetPointIncLim_MAPX "Rail_pFlt or Rail_pSetPoint" 0x395E92 NO_INPUT_QUANTITY Lookup2D_X_WORD 0 RailPressure_bar 12 -2500.0 2500.0 /end AXIS_PTS
/begin AXIS_PTS Rail_dpSetPointInc_MAPY "InjSys_qTol or InjCtl_qSetUnBal" 0x395F8C NO_INPUT_QUANTITY Lookup2D_X_WORD 0 FuelMass_mg_hub 8 0.0 300.0 /end AXIS_PTS
/begin AXIS_PTS Rail_dpSetPointInc_MAPX "Epm_nEng" 0x395F74 Epm_nEng Lookup2D_X_WORD 0 EngSpeed_rpm 12 0.0 6000.0 /end AXIS_PTS
/begin AXIS_PTS Rail_dpSetPointDec_CURX "Rail_pSetPoint" 0x395CDA NO_INPUT_QUANTITY Lookup1D_X_WORD 0 RailPressure_bar 8 -2500.0 2500.0 /end AXIS_PTS
/begin AXIS_PTS Rail_dpSetPointDec_MAPY "InjCtl_qCurr" 0x395DC2 InjCtl_qCurr Lookup2D_X_WORD 0 FuelMass_mg_hub 8 0.0 300.0 /end AXIS_PTS
/begin AXIS_PTS Rail_dpSetPointDec_MAPX "Epm_nEng" 0x395DAA Epm_nEng Lookup2D_X_WORD 0 EngSpeed_rpm 12 0.0 6000.0 /end AXIS_PTS
/begin CHARACTERISTIC Rail_facSetPointFTSCor_CUR "the weighting fator of fuel temperature" CURVE 0x3964D0 Lookup1D_WORD 0 Factor 0.0 1.0
 /begin AXIS_DESCR COM_AXIS FuelT_t Temp_deg 25 -50.0 150.0 AXIS_PTS_REF Rail_facSetPointFTSCor_CURX /end AXIS_DESCR
/end CHARACTERISTIC
/begin CHARACTERISTIC Rail_pSetPointFTSCor_MAP "correction value based on fuel temperature" MAP 0x39701A Lookup2D_WORD 0 RailPressure_bar 0.0 2500.0
 /begin AXIS_DESCR COM_AXIS Epm_nEng EngSpeed_rpm 16 0.0 6000.0 AXIS_PTS_REF Rail_pSetPointFTSCor_MAPX /end AXIS_DESCR
 /begin AXIS_DESCR COM_AXIS InjCtl_qCurr FuelMass_mg_hub 16 0.0 300.0 AXIS_PTS_REF Rail_pSetPointFTSCor_MAPY /end AXIS_DESCR
/end CHARACTERISTIC
/begin CHARACTERISTIC Rail_pSetPointMax_MAP "maximum setpoint values based on the operating point" MAP 0x3972FC Lookup2D_WORD 0 RailPressure_bar 0.0 2500.0
 /begin AXIS_DESCR COM_AXIS Epm_nEng EngSpeed_rpm 15 0.0 6000.0 AXIS_PTS_REF Rail_pSetPointMax_MAPX /end AXIS_DESCR
 /begin AXIS_DESCR COM_AXIS InjSys_qTot FuelMass_mg_hub 16 0.0 300.0 AXIS_PTS_REF Rail_pSetPointMax_MAPY /end AXIS_DESCR
/end CHARACTERISTIC
/begin CHARACTERISTIC Rail_pSetPointMin_MAP "Minimum setpoint values based on the operating point" MAP 0x39751C Lookup2D_WORD 0 RailPressure_bar 0.0 2500.0
 /begin AXIS_DESCR COM_AXIS Epm_nEng EngSpeed_rpm 15 0.0 6000.0 AXIS_PTS_REF Rail_pSetPointMin_MAPX /end AXIS_DESCR
 /begin AXIS_DESCR COM_AXIS InjSys_qTot FuelMass_mg_hub 16 0.0 300.0 AXIS_PTS_REF Rail_pSetPointMin_MAPY /end AXIS_DESCR
/end CHARACTERISTIC
/begin CHARACTERISTIC Rail_pSetPointMaxDef_C "Maximum rail pressure setpoint in the event of an error" VALUE 0x3972FA Scalar_SWORD 0 RailPressure_bar 0.0 2500.0 /end CHARACTERISTIC
/begin CHARACTERISTIC Rail_pSetPointMinDef_C "Minimum rail pressure setpoint in the event of an error" VALUE 0x39751A Scalar_SWORD 0 RailPressure_bar 0.0 2500.0 /end CHARACTERISTIC
/begin CHARACTERISTIC Rail_pSetPointTolcMin_C "Setpoint pressure for minimum tolerance" VALUE 0x39773C Scalar_SWORD 0 RailPressure_bar 0.0 2500.0 /end CHARACTERISTIC
/begin AXIS_PTS Rail_facSetPointFTSCor_CURX "Curve axis X to convert fuel temperature to weighting factor" 0x396502 FuelT_t Lookup1D_X_WORD 0 Temp_deg 25 -50.0 150.0 /end AXIS_PTS
/begin AXIS_PTS Rail_pSetPointFTSCor_MAPY "Table axis Y to convert injection quantity to correction value" 0x39723A InjCtl_qCurr Lookup2D_X_WORD 0 FuelMass_mg_hub 16 0.0 300.0 /end AXIS_PTS
/begin AXIS_PTS Rail_pSetPointFTSCor_MAPX "Table axis X to convert engine speed to correction value" 0x39721A Epm_nEng Lookup2D_X_WORD 0 EngSpeed_rpm 16 0.0 6000.0 /end AXIS_PTS
/begin AXIS_PTS Rail_pSetPointMax_MAPY "Table axis Y" 0x3974FA InjSys_qTot Lookup2D_X_WORD 0 FuelMass_mg_hub 16 0.0 300.0 /end AXIS_PTS
/begin AXIS_PTS Rail_pSetPointMax_MAPX "Table axis X " 0x3974DC Epm_nEng Lookup2D_X_WORD 0 EngSpeed_rpm 15 0.0 6000.0 /end AXIS_PTS
/begin AXIS_PTS Rail_pSetPointMin_MAPY "Table axis Y" 0x39771A InjSys_qTot Lookup2D_X_WORD 0 FuelMass_mg_hub 16 0.0 300.0 /end AXIS_PTS
/begin AXIS_PTS Rail_pSetPointMin_MAPX "Table axis X " 0x3976FC Epm_nEng Lookup2D_X_WORD 0 EngSpeed_rpm 15 0.0 6000.0 /end AXIS_PTS
/begin CHARACTERISTIC Rail_pSetPointAPSCor_MAP "rail pressure corrections  for atmospheric pressure based on the engine speed and the fuel injection quantity" MAP 0x3966DA Lookup2D_WORD 0 RailPressure_bar -2500.0 2500.0
 /begin AXIS_DESCR COM_AXIS Epm_nEng EngSpeed_rpm 16 0.0 6000.0 AXIS_PTS_REF Rail_pSetPointAPSCor_MAPX /end AXIS_DESCR
 /begin AXIS_DESCR COM_AXIS InjCtl_qCurr FuelMass_mg_hub 16 0.0 300.0 AXIS_PTS_REF Rail_pSetPointAPSCor_MAPY /end AXIS_DESCR
/end CHARACTERISTIC
/begin CHARACTERISTIC Rail_pSetPointATSCor_MAP "rail pressure corrections  for intake air temperature based on the engine speed and the fuel injection quantity" MAP 0x39691A Lookup2D_WORD 0 RailPressure_bar -2500.0 2500.0
 /begin AXIS_DESCR COM_AXIS Epm_nEng EngSpeed_rpm 16 0.0 6000.0 AXIS_PTS_REF Rail_pSetPointATSCor_MAPX /end AXIS_DESCR
 /begin AXIS_DESCR COM_AXIS InjCtl_qCurr FuelMass_mg_hub 16 0.0 300.0 AXIS_PTS_REF Rail_pSetPointATSCor_MAPY /end AXIS_DESCR
/end CHARACTERISTIC
/begin CHARACTERISTIC Rail_pSetPointETSCor_MAP "rail pressure corrections  for engine temperature based on the engine speed and the fuel injection quantity" MAP 0x396D9A Lookup2D_WORD 0 RailPressure_bar -2500.0 2500.0
 /begin AXIS_DESCR COM_AXIS Epm_nEng EngSpeed_rpm 16 0.0 6000.0 AXIS_PTS_REF Rail_pSetPointETSCor_MAPX /end AXIS_DESCR
 /begin AXIS_DESCR COM_AXIS InjCtl_qCurr FuelMass_mg_hub 16 0.0 300.0 AXIS_PTS_REF Rail_pSetPointETSCor_MAPY /end AXIS_DESCR
/end CHARACTERISTIC
/begin CHARACTERISTIC Rail_facSetPointAPSCor_CUR "weighting factor base on the atmospheric pressure" CURVE 0x396410 Lookup1D_WORD 0 Factor -3.0 3.0
 /begin AXIS_DESCR COM_AXIS EnvP_p AirPressure_kPa 16 0.0 300.0 AXIS_PTS_REF Rail_facSetPointAPSCor_CURX /end AXIS_DESCR
/end CHARACTERISTIC
/begin CHARACTERISTIC Rail_facSetPointATSCor_CUR "weighting factor base on the intake air temperature selected" CURVE 0x396450 Lookup1D_WORD 0 Factor -3.0 3.0
 /begin AXIS_DESCR COM_AXIS Rail_tAir Temp_deg 16 -50.0 200.0 AXIS_PTS_REF Rail_facSetPointATSCor_CURX /end AXIS_DESCR
/end CHARACTERISTIC
/begin CHARACTERISTIC Rail_facSetPointETSCor_CUR "weighting factor base on the engine temperature selected" CURVE 0x396490 Lookup1D_WORD 0 Factor -3.0 3.0
 /begin AXIS_DESCR COM_AXIS InjSys_tEng Temp_deg 16 -50.0 200.0 AXIS_PTS_REF Rail_facSetPointETSCor_CURX /end AXIS_DESCR
/end CHARACTERISTIC
/begin AXIS_PTS Rail_pSetPointAPSCor_MAPY "Torque generating engine fuel injection quantity" 0x3968FA InjCtl_qCurr Lookup2D_X_WORD 0 FuelMass_mg_hub 16 0.0 300.0 /end AXIS_PTS
/begin AXIS_PTS Rail_pSetPointAPSCor_MAPX "Engine speed" 0x3968DA Epm_nEng Lookup2D_X_WORD 0 EngSpeed_rpm 16 0.0 6000.0 /end AXIS_PTS
/begin AXIS_PTS Rail_pSetPointATSCor_MAPY "Torque generating engine fuel injection quantity" 0x396B3A InjCtl_qCurr Lookup2D_X_WORD 0 FuelMass_mg_hub 16 0.0 300.0 /end AXIS_PTS
/begin AXIS_PTS Rail_pSetPointATSCor_MAPX "Engine speed" 0x396B1A Epm_nEng Lookup2D_X_WORD 0 EngSpeed_rpm 16 0.0 6000.0 /end AXIS_PTS
/begin AXIS_PTS Rail_pSetPointETSCor_MAPY "Torque generating engine fuel injection quantity" 0x396FBA InjCtl_qCurr Lookup2D_X_WORD 0 FuelMass_mg_hub 16 0.0 300.0 /end AXIS_PTS
/begin AXIS_PTS Rail_pSetPointETSCor_MAPX "Engine speed" 0x396F9A Epm_nEng Lookup2D_X_WORD 0 EngSpeed_rpm 16 0.0 6000.0 /end AXIS_PTS
/begin AXIS_PTS Rail_facSetPointAPSCor_CURX "Barometric pressure" 0x396430 EnvP_p Lookup1D_X_WORD 0 AirPressure_kPa 16 0.0 300.0 /end AXIS_PTS
/begin AXIS_PTS Rail_facSetPointATSCor_CURX "Intake air temperature for the Rail subsystem" 0x396470 Rail_tAir Lookup1D_X_WORD 0 Temp_deg 16 -50.0 200.0 /end AXIS_PTS
/begin AXIS_PTS Rail_facSetPointETSCor_CURX "Engine temperature selected for the injection system" 0x3964B0 InjSys_tEng Lookup1D_X_WORD 0 Temp_deg 16 -50.0 200.0 /end AXIS_PTS
/begin CHARACTERISTIC Rail_facFlPLimFTSCor_CUR "Transformation curve to convert fuel temperature to correction Factor for limitation in case of low input pressure in high altitude" CURVE 0x39610A Lookup1D_WORD 0 Factor -10.0 10.0
 /begin AXIS_DESCR COM_AXIS FuelT_t Temp_deg 8 -50.0 150.0 AXIS_PTS_REF Rail_facFlPLimFTSCor_CURX /end AXIS_DESCR
/end CHARACTERISTIC
/begin CHARACTERISTIC Rail_trqFlPLim_MAP "moment limitation in case of low input pressure in high altitude dependent on fuelpressure  and engine speed" MAP 0x3977F2 Lookup2D_WORD 0 Trq_Nm 0.0 3000.0
 /begin AXIS_DESCR COM_AXIS Epm_nEng EngSpeed_rpm 16 0.0 6000.0 AXIS_PTS_REF Rail_trqFlPLim_MAPX /end AXIS_DESCR
 /begin AXIS_DESCR COM_AXIS FlSys_p AirPressure_kPa 16 0.0 3000.0 AXIS_PTS_REF Rail_trqFlPLim_MAPY /end AXIS_DESCR
/end CHARACTERISTIC
/begin CHARACTERISTIC Rail_trqFlTempLimMeUn_MAP "a limitation torque based on the engine speed and the fuel temperature" MAP 0x397A32 Lookup2D_WORD 0 Trq_Nm 0.0 3000.0
 /begin AXIS_DESCR COM_AXIS Epm_nEng EngSpeed_rpm 16 0.0 6000.0 AXIS_PTS_REF Rail_trqFlTempLimMeUn_MAPX /end AXIS_DESCR
 /begin AXIS_DESCR COM_AXIS FuelT_t Temp_deg 16 -50.0 150.0 AXIS_PTS_REF Rail_trqFlTempLimMeUn_MAPY /end AXIS_DESCR
/end CHARACTERISTIC
/begin AXIS_PTS Rail_facFlPLimFTSCor_CURX "Transformation axis to convert fuel temperature to correction Factor for limitation in case of low input pressure in high altitude" 0x39611A FuelT_t Lookup1D_X_WORD 0 Temp_deg 8 -50.0 150.0 /end AXIS_PTS
/begin AXIS_PTS Rail_trqFlPLim_MAPY "Fuelpressure on highpressurepump" 0x397A12 FlSys_p Lookup2D_X_WORD 0 AirPressure_kPa 16 0.0 3000.0 /end AXIS_PTS
/begin AXIS_PTS Rail_trqFlPLim_MAPX "engine speed" 0x3979F2 Epm_nEng Lookup2D_X_WORD 0 EngSpeed_rpm 16 0.0 6000.0 /end AXIS_PTS
/begin AXIS_PTS Rail_trqFlTempLimMeUn_MAPY "Fuel temperature" 0x397C52 FuelT_t Lookup2D_X_WORD 0 Temp_deg 16 -50.0 150.0 /end AXIS_PTS
/begin AXIS_PTS Rail_trqFlTempLimMeUn_MAPX "engine speed" 0x397C32 Epm_nEng Lookup2D_X_WORD 0 EngSpeed_rpm 16 0.0 6000.0 /end AXIS_PTS
/begin CHARACTERISTIC StSys_facStrtAPS_CUR "Transformation curve to convert Barometric pressure to factor" CURVE 0x39A408 Lookup1D_WORD 0 Factor -10.0 10.0
 /begin AXIS_DESCR COM_AXIS EnvP_p AirPressure_kPa 8 0.0 200.0 AXIS_PTS_REF StSys_facStrtAPS_CURX /end AXIS_DESCR
/end CHARACTERISTIC
/begin CHARACTERISTIC StSys_trqStrtAPS_MAP "Additional starting torque map" MAP 0x39A5C8 Lookup2D_WORD 0 Trq_Nm -100.0 100.0
 /begin AXIS_DESCR COM_AXIS Epm_nEng EngSpeed_rpm 16 0.0 5000.0 AXIS_PTS_REF StSys_trqStrtAPS_MAPX /end AXIS_DESCR
 /begin AXIS_DESCR COM_AXIS StSys_tStrt_mp Temp_deg 18 -50.0 150.0 AXIS_PTS_REF StSys_trqStrtAPS_MAPY /end AXIS_DESCR
/end CHARACTERISTIC
/begin AXIS_PTS StSys_facStrtAPS_CURX "Transformation aixs to convert Barometric pressure to factor" 0x39A418 EnvP_p Lookup1D_X_WORD 0 AirPressure_kPa 8 0.0 200.0 /end AXIS_PTS
/begin AXIS_PTS StSys_trqStrtAPS_MAPY "Transformation aixs Y of the table" 0x39A828 StSys_tStrt_mp Lookup2D_X_WORD 0 Temp_deg 18 -50.0 150.0 /end AXIS_PTS
/begin AXIS_PTS StSys_trqStrtAPS_MAPX "Transformation aixs X of the table" 0x39A808 Epm_nEng Lookup2D_X_WORD 0 EngSpeed_rpm 16 0.0 5000.0 /end AXIS_PTS
/begin CHARACTERISTIC StSys_nStrtCutOut_MAP "engine speed threshold for starting cut out" MAP 0x39A42C Lookup2D_WORD 0 EngSpeed_rpm 0.0 5000.0
 /begin AXIS_DESCR COM_AXIS StSys_tStrt_mp Temp_deg 18 -50.0 150.0 AXIS_PTS_REF StSys_nStrtCutOut_MAPX /end AXIS_DESCR
 /begin AXIS_DESCR COM_AXIS EnvP_p AirPressure_kPa 8 0.0 300.0 AXIS_PTS_REF StSys_nStrtCutOut_MAPY /end AXIS_DESCR
/end CHARACTERISTIC
/begin CHARACTERISTIC StSys_tiStrtCutOut_C "locking time for starting cut out" VALUE 0x39A5BC Scalar_ULONG 0 EngTime_ms 0.0 4.294967295E+10 /end CHARACTERISTIC
/begin AXIS_PTS StSys_nStrtCutOut_MAPY "Barometric pressure" 0x39A570 EnvP_p Lookup2D_X_WORD 0 AirPressure_kPa 8 0.0 300.0 /end AXIS_PTS
/begin AXIS_PTS StSys_nStrtCutOut_MAPX "engine temperature for starting system" 0x39A54C StSys_tStrt_mp Lookup2D_X_WORD 0 Temp_deg 18 -50.0 150.0 /end AXIS_PTS
/begin CHARACTERISTIC StSys_trqStrtBas_MAP "basic map for torque start demand" MAP 0x39A84C Lookup2D_WORD 0 Trq_Nm 0.0 1000.0
 /begin AXIS_DESCR COM_AXIS Epm_nEng EngSpeed_rpm 16 0.0 6000.0 AXIS_PTS_REF StSys_trqStrtBas_MAPX /end AXIS_DESCR
 /begin AXIS_DESCR COM_AXIS StSys_tStrt_mp Temp_deg 16 -50.0 150.0 AXIS_PTS_REF StSys_trqStrtBas_MAPY /end AXIS_DESCR
/end CHARACTERISTIC
/begin CHARACTERISTIC StSys_trqAdjMax_C "maximum value of starting torque compensation" VALUE 0x39A5C4 Scalar_SWORD 0 Trq_Nm -50.0 150.0 /end CHARACTERISTIC
/begin CHARACTERISTIC StSys_nAdjMax_C "maximum engine speed for starting torque compensation" VALUE 0x39A428 Scalar_SWORD 0 EngSpeed_rpm 0.0 1000.0 /end CHARACTERISTIC
/begin AXIS_PTS StSys_trqStrtBas_MAPY "Transformation aixs Y of the table" 0x39AA6C StSys_tStrt_mp Lookup2D_X_WORD 0 Temp_deg 16 -50.0 150.0 /end AXIS_PTS
/begin AXIS_PTS StSys_trqStrtBas_MAPX "Transformation aixs X of the table" 0x39AA4C Epm_nEng Lookup2D_X_WORD 0 EngSpeed_rpm 16 0.0 6000.0 /end AXIS_PTS
/begin CHARACTERISTIC StSys_nThresCalc_CUR "threshold engine speed base on Coolant engine down stream temperature" CURVE 0x39A580 Lookup1D_WORD 0 EngSpeed_rpm 0.0 6000.0
 /begin AXIS_DESCR COM_AXIS CEngDsT_t Temp_deg 10 -200.0 200.0 AXIS_PTS_REF StSys_nThresCalc_CURX /end AXIS_DESCR
/end CHARACTERISTIC
/begin CHARACTERISTIC StSys_tiBlnd_C "Blind meshing detection time" VALUE 0x39A5B8 Scalar_ULONG 0 EngTime_ms 0.0 65535.0 /end CHARACTERISTIC
/begin CHARACTERISTIC StSys_tiStrtON_C "Maximum cranking duration" VALUE 0x39A5C0 Scalar_ULONG 0 EngTime_ms 0.0 65535.0 /end CHARACTERISTIC
/begin CHARACTERISTIC StSys_stCondActv_C "Crank control features selection" VALUE 0x39A5AA Scalar_UWORD 0 State_uint16 0.0 65535.0 /end CHARACTERISTIC
/begin CHARACTERISTIC StSys_stSelectT50CAN_C "Array used for selection of enable/disable conditions for T50CAN" VALUE 0x39A5AE Scalar_UWORD 0 State_uint16 0.0 65535.0 /end CHARACTERISTIC
/begin CHARACTERISTIC StSys_stSelectT50EMGCY_C "Array used for selection of enable/disable conditions for T50EMGCY" VALUE 0x39A5B0 Scalar_UWORD 0 State_uint16 0.0 65535.0 /end CHARACTERISTIC
/begin CHARACTERISTIC StSys_stSelectT50NRM_C "Array used for selection of enable/disable conditions for T50NRM" VALUE 0x39A5B2 Scalar_UWORD 0 State_uint16 0.0 65535.0 /end CHARACTERISTIC
/begin CHARACTERISTIC Strt_uThresIniMinStrt_C "The minimum voltage, above which no active starteris detected" VALUE 0x39AAC6 Scalar_UWORD 0 Battery_mv 0.0 50000.0 /end CHARACTERISTIC
/begin CHARACTERISTIC StSys_nBlnd_C "Threshold used to detect blind meshing" VALUE 0x39A42A Scalar_SWORD 0 EngSpeed_rpm 0.0 6000.0 /end CHARACTERISTIC
/begin CHARACTERISTIC StSys_nThres_C "application parameter for setting threshold forengine speed" VALUE 0x39A5A8 Scalar_SWORD 0 EngSpeed_rpm 0.0 6000.0 /end CHARACTERISTIC
/begin CHARACTERISTIC StSys_vEngCompStrt_C "Threshold vehicle speed after a sucessfull crankingfrom engine compartment start button" VALUE 0x39AABC Scalar_SWORD 0 VehSpeed_km_h 0.0 200.0 /end CHARACTERISTIC
/begin CHARACTERISTIC StSys_vThresT50CAN_C "vehicle speed threshold for CAN Cranking fuel shut off" VALUE 0x39AABE Scalar_SWORD 0 VehSpeed_km_h 0.0 200.0 /end CHARACTERISTIC
/begin CHARACTERISTIC StSys_vThresT50EMGCY_C "vehicle speed threshold for EMGCY Cranking fuel shut off" VALUE 0x39AAC0 Scalar_SWORD 0 VehSpeed_km_h 0.0 200.0 /end CHARACTERISTIC
/begin CHARACTERISTIC StSys_vThresT50NRM_C "vehicle speed threshold for NRM Cranking fuel shut off" VALUE 0x39AAC2 Scalar_SWORD 0 VehSpeed_km_h 0.0 200.0 /end CHARACTERISTIC
/begin CHARACTERISTIC StSys_stCondDeactv_C "End/abort conditions selection" VALUE 0x39A5AC Scalar_UBYTE 0 State_uint8 0.0 255.0 /end CHARACTERISTIC
/begin AXIS_PTS StSys_nThresCalc_CURX "Coolant engine down stream temperature" 0x39A594 CEngDsT_t Lookup1D_X_WORD 0 Temp_deg 10 -200.0 200.0 /end AXIS_PTS
/begin CHARACTERISTIC StSys_trqStrtMax_CUR "Maximum torque permitted during start" CURVE 0x39AA8C Lookup1D_WORD 0 Trq_Nm 0.0 1000.0
 /begin AXIS_DESCR COM_AXIS StSys_tStrt_mp Temp_deg 12 -50.0 150.0 AXIS_PTS_REF StSys_trqStrtMax_CURX /end AXIS_DESCR
/end CHARACTERISTIC
/begin AXIS_PTS StSys_trqStrtMax_CURX "Axis X of the Curve" 0x39AAA4 StSys_tStrt_mp Lookup1D_X_WORD 0 Temp_deg 12 -50.0 150.0 /end AXIS_PTS
/begin CHARACTERISTIC StSys_trqSetAdjVal_C "EPPROM adjustment value for start torque correction" VALUE 0x39A5C6 Scalar_SWORD 0 Trq_Nm 0.0 1000.0 /end CHARACTERISTIC
/begin CHARACTERISTIC StSys_stTrqShutOff_C "the status of the starting torque shuto-off input" VALUE 0x39A5B4 Scalar_BOOLEAN 0 boolean 0.0 1.0 /end CHARACTERISTIC
/begin CHARACTERISTIC CoME_stNReqESS_C "Status of the speed demand ESS_nMin" VALUE 0x386745 Scalar_UBYTE 0 State_uint8 0.0 255.0 /end CHARACTERISTIC
/begin CHARACTERISTIC CoME_stNReqTSAC_C "Status of the speed demand TS_nMinAC" VALUE 0x386746 Scalar_UBYTE 0 State_uint8 0.0 255.0 /end CHARACTERISTIC
/begin CHARACTERISTIC CoME_stNReqTS_C "Status of the speed demand TS_nMin" VALUE 0x386747 Scalar_UBYTE 0 State_uint8 0.0 255.0 /end CHARACTERISTIC
/begin CHARACTERISTIC CoME_stNReqVehMot_C "Status of the speed demand VehMot_nMinAcs" VALUE 0x386748 Scalar_UBYTE 0 State_uint8 0.0 255.0 /end CHARACTERISTIC
/begin CHARACTERISTIC CoME_tiMaxOffAcc_CUR "curve of Maximal shutoff time by ACC" CURVE 0x38675C Lookup1D_ULONG 0 EngTime_ms 0.0 4.294967295E+10
 /begin AXIS_DESCR COM_AXIS Epm_nEng EngSpeed_rpm 4 -12000.0 12000.0 AXIS_PTS_REF CoME_tiMaxOffAcc_CURX /end AXIS_DESCR
/end CHARACTERISTIC
/begin CHARACTERISTIC CoME_tiMinOffAcc_CUR "curve of Minimal shutoff time by ACC" CURVE 0x38678C Lookup1D_ULONG 0 EngTime_ms 0.0 4.294967295E+10
 /begin AXIS_DESCR COM_AXIS Epm_nEng EngSpeed_rpm 4 -12000.0 12000.0 AXIS_PTS_REF CoME_tiMinOffAcc_CURX /end AXIS_DESCR
/end CHARACTERISTIC
/begin CHARACTERISTIC CoME_tiMaxOffDrvOff_CUR "Curve of Maximal shutoff time by Drive off" CURVE 0x386774 Lookup1D_ULONG 0 EngTime_ms 0.0 4.294967295E+10
 /begin AXIS_DESCR COM_AXIS Epm_nEng EngSpeed_rpm 4 -12000.0 12000.0 AXIS_PTS_REF CoME_tiMaxOffDrvOff_CURX /end AXIS_DESCR
/end CHARACTERISTIC
/begin CHARACTERISTIC CoME_tiMinOffDrvOff_CUR "Curve of Minimal shutoff time by Drive Off" CURVE 0x3867A4 Lookup1D_ULONG 0 EngTime_ms 0.0 4.294967295E+10
 /begin AXIS_DESCR COM_AXIS Epm_nEng EngSpeed_rpm 4 -12000.0 12000.0 AXIS_PTS_REF CoME_tiMinOffDrvOff_CURX /end AXIS_DESCR
/end CHARACTERISTIC
/begin CHARACTERISTIC CoME_drPedHi_C "Gradient of maximum accelerator pedal value (lower hysteresis value)" VALUE 0x386724 Scalar_LONG 0 Accpedal_rate_s -400.0 399.0 /end CHARACTERISTIC
/begin CHARACTERISTIC CoME_drPedLo_C "Gradient of maximum accelerator pedal value (lower hysteresis value)" VALUE 0x386728 Scalar_LONG 0 Accpedal_rate_s -400.0 399.0 /end CHARACTERISTIC
/begin CHARACTERISTIC CoME_tiBattVltgOff_C "Minimum switch-off time because of low battery voltage" VALUE 0x386754 Scalar_LONG 0 Time_s -2.1474836E+7 2.1474836E+7 /end CHARACTERISTIC
/begin CHARACTERISTIC CoME_tiDrvOn_C "Minimum switch-on time after switch-off because of driveaway or acceleration" VALUE 0x386758 Scalar_LONG 0 Time_s -2.1474836E+7 2.1474836E+7 /end CHARACTERISTIC
/begin CHARACTERISTIC CoME_tiOffStrtAC_C "Debouncing time after engine start" VALUE 0x3867BC Scalar_LONG 0 Time_s -2.1474836E+7 2.1474836E+7 /end CHARACTERISTIC
/begin CHARACTERISTIC CoME_tiOffStrtAlt_C "Debouncing time after engine start" VALUE 0x3867C0 Scalar_LONG 0 Time_s -2.1474836E+7 2.1474836E+7 /end CHARACTERISTIC
/begin CHARACTERISTIC CoME_uBattMinHi_C "Minimum battery voltage (upper hysteresis value)" VALUE 0x3867CE Scalar_UWORD 0 Battery_mv 0.0 65535.0 /end CHARACTERISTIC
/begin CHARACTERISTIC CoME_uBattMinLo_C "Minimum battery voltage (lower hysteresis value)" VALUE 0x3867D0 Scalar_UWORD 0 Battery_mv 0.0 65535.0 /end CHARACTERISTIC
/begin CHARACTERISTIC CoME_nEng1Hi_C "Minimum engine speed (upper hysteresis value - 1)" VALUE 0x38672C Scalar_SWORD 0 EngSpeed_rpm -12000.0 12000.0 /end CHARACTERISTIC
/begin CHARACTERISTIC CoME_nEng1Lo_C "Minimum engine speed (lower hysteresis value - 1)" VALUE 0x38672E Scalar_SWORD 0 EngSpeed_rpm -12000.0 12000.0 /end CHARACTERISTIC
/begin CHARACTERISTIC CoME_nEng2Hi_C "Minimum engine speed (lower hysteresis value - 2)" VALUE 0x386730 Scalar_SWORD 0 EngSpeed_rpm -12000.0 12000.0 /end CHARACTERISTIC
/begin CHARACTERISTIC CoME_nEng2Lo_C "Minimum engine speed (lower hysteresis value - 2)" VALUE 0x386732 Scalar_SWORD 0 EngSpeed_rpm -12000.0 12000.0 /end CHARACTERISTIC
/begin CHARACTERISTIC CoME_rPedHi_C "Maximum accelerator pedal value (upper hysteresis value)" VALUE 0x38673E Scalar_SWORD 0 Accpedal_rate -400.0 399.0 /end CHARACTERISTIC
/begin CHARACTERISTIC CoME_rPedLo_C "Maximum accelerator pedal value (lower hysteresis value)" VALUE 0x386740 Scalar_SWORD 0 Accpedal_rate -400.0 399.0 /end CHARACTERISTIC
/begin CHARACTERISTIC CoME_vX1Hi_C "Minimum vehicle speed (upper hysteresis value - 1)" VALUE 0x3867D2 Scalar_SWORD 0 VehSpeed_km_h 0.0 250.0 /end CHARACTERISTIC
/begin CHARACTERISTIC CoME_vX1Lo_C "Minimum vehicle speed (lower hysteresis value - 1)" VALUE 0x3867D4 Scalar_SWORD 0 VehSpeed_km_h 0.0 250.0 /end CHARACTERISTIC
/begin CHARACTERISTIC CoME_vX2Hi_C "Minimum vehicle speed (upper hysteresis value - 2)" VALUE 0x3867D6 Scalar_SWORD 0 VehSpeed_km_h 0.0 250.0 /end CHARACTERISTIC
/begin CHARACTERISTIC CoME_vX2Lo_C "Minimum vehicle speed (lower hysteresis value - 2)" VALUE 0x3867D8 Scalar_SWORD 0 VehSpeed_km_h 0.0 250.0 /end CHARACTERISTIC
/begin CHARACTERISTIC CoME_tEnvAir1Hi_C "Minimum environmental air temperature (upper hysteresis value - 1)" VALUE 0x38674A Scalar_SWORD 0 Temp_deg -3000.0 3000.0 /end CHARACTERISTIC
/begin CHARACTERISTIC CoME_tEnvAir1Lo_C "Maximum environmental air temperature (lower hysteresis value - 1)" VALUE 0x38674C Scalar_SWORD 0 Temp_deg -3000.0 3000.0 /end CHARACTERISTIC
/begin CHARACTERISTIC CoME_tEnvAir2Hi_C "Maximum environmental air temperature (upper hysteresis value - 2)" VALUE 0x38674E Scalar_SWORD 0 Temp_deg -3000.0 3000.0 /end CHARACTERISTIC
/begin CHARACTERISTIC CoME_tEnvAir2Lo_C "Maximum environmental air temperature (lower hysteresis value - 2)" VALUE 0x386750 Scalar_SWORD 0 Temp_deg -3000.0 3000.0 /end CHARACTERISTIC
/begin CHARACTERISTIC CoME_pEnv1Hi_C "Minimum environmental pressure (upper hysteresis value - 1)" VALUE 0x386736 Scalar_SWORD 0 AirPressure_kPa -3000.0 3000.0 /end CHARACTERISTIC
/begin CHARACTERISTIC CoME_pEnv1Lo_C "Minimum environmental pressure (lower hysteresis value - 1)" VALUE 0x386738 Scalar_SWORD 0 AirPressure_kPa -3000.0 3000.0 /end CHARACTERISTIC
/begin CHARACTERISTIC CoME_pEnv2Hi_C "Minimum environmental pressure (upper hysteresis value - 2)" VALUE 0x38673A Scalar_SWORD 0 AirPressure_kPa -3000.0 3000.0 /end CHARACTERISTIC
/begin CHARACTERISTIC CoME_pEnv2Lo_C "Minimum environmental pressure (lower hysteresis value - 2)" VALUE 0x38673C Scalar_SWORD 0 AirPressure_kPa -3000.0 3000.0 /end CHARACTERISTIC
/begin CHARACTERISTIC CoME_trqACMax_C "maximum torque of AC compressor" VALUE 0x3867C4 Scalar_SWORD 0 Trq_Nm -3000.0 3276.7 /end CHARACTERISTIC
/begin CHARACTERISTIC CoME_trqAcc_C "Permissible torque consumption for AC during acceleration" VALUE 0x3867C6 Scalar_SWORD 0 Trq_Nm -3000.0 3276.7 /end CHARACTERISTIC
/begin CHARACTERISTIC CoME_trqBattVltg_C "Permissible torque consumption for AC during low battery voltage" VALUE 0x3867C8 Scalar_SWORD 0 Trq_Nm -3000.0 3276.7 /end CHARACTERISTIC
/begin CHARACTERISTIC CoME_trqDrvOff_C "Maximum allowed A/C torque during drive-off" VALUE 0x3867CA Scalar_SWORD 0 Trq_Nm -3000.0 3276.7 /end CHARACTERISTIC
/begin CHARACTERISTIC CoME_trqStrt_C "Maximum allowed A/C torque during engine start" VALUE 0x3867CC Scalar_SWORD 0 Trq_Nm -3000.0 3276.7 /end CHARACTERISTIC
/begin CHARACTERISTIC CoME_numTraGearMax_C "Minimum gear number" VALUE 0x386734 Scalar_BYTE 0 Tra_num -128.0 127.0 /end CHARACTERISTIC
/begin CHARACTERISTIC CoME_stAlt_CW "Status: Alternator shut-off conditions" VALUE 0x386742 Scalar_UBYTE 0 State_uint8 0.0 255.0 /end CHARACTERISTIC
/begin CHARACTERISTIC CoME_stFan_CW "Status: Fan switch-off conditions" VALUE 0x386744 Scalar_UBYTE 0 State_uint8 0.0 255.0 /end CHARACTERISTIC
/begin CHARACTERISTIC CoME_stEEM_C "Status Electrical energy management" VALUE 0x386743 Scalar_BOOLEAN 0 boolean 0.0 1.0 /end CHARACTERISTIC
/begin AXIS_PTS CoME_tiMaxOffAcc_CURX "axis of Maximal shutoff time by ACC" 0x38676C Epm_nEng Lookup1D_X_WORD 0 EngSpeed_rpm 4 -12000.0 12000.0 /end AXIS_PTS
/begin AXIS_PTS CoME_tiMinOffAcc_CURX "axis of Minimal shutoff time by ACC" 0x38679C Epm_nEng Lookup1D_X_WORD 0 EngSpeed_rpm 4 -12000.0 12000.0 /end AXIS_PTS
/begin AXIS_PTS CoME_tiMaxOffDrvOff_CURX "axis of Maximal shutoff time by Drive off" 0x386784 Epm_nEng Lookup1D_X_WORD 0 EngSpeed_rpm 4 -12000.0 12000.0 /end AXIS_PTS
/begin AXIS_PTS CoME_tiMinOffDrvOff_CURX "axis of Minimal shutoff time by Drive Off" 0x3867B4 Epm_nEng Lookup1D_X_WORD 0 EngSpeed_rpm 4 -12000.0 12000.0 /end AXIS_PTS
/begin MEASUREMENT InjCrv_facPiI1SOEETSCor1 "PiI1 start of energizing correction factor due to engine temperature" SWORD Factor 0 0 -4.0 4.0 ECU_ADDRESS 0x40022EB4 /end MEASUREMENT
/begin MEASUREMENT InjCrv_facPiI1SOEATSCor1 "PiI1 start of energizing correction factor due to air temperature" SWORD Factor 0 0 -4.0 4.0 ECU_ADDRESS 0x40022EB6 /end MEASUREMENT
/begin MEASUREMENT InjCrv_facPiI1SOEAPSCor1 "PiI1 start of energizing correction factor due to atmospheric pressure" SWORD Factor 0 0 -4.0 4.0 ECU_ADDRESS 0x40022EB8 /end MEASUREMENT
/begin MEASUREMENT InjCrv_qPiI2Max_mp "Maximum injection quantity for PiI2" SWORD FuelMass_mg_hub 0 0 -319.0 319.0 ECU_ADDRESS 0x40022EC8 /end MEASUREMENT
/begin MEASUREMENT InjCrv_qPiI2SetLim_mp "PiI2 quantity during with unlimitation" SWORD FuelMass_mg_hub 0 0 -319.0 319.0 ECU_ADDRESS 0x40022ECA /end MEASUREMENT
/begin MEASUREMENT InjCrv_tiPiI2Min_mp "Minimum time component for PiI2 start of energizing" SWORD InjTime_us 0 0 -13107.0 13106.0 ECU_ADDRESS 0x40022ECC /end MEASUREMENT
/begin MEASUREMENT InjCrv_tiPiI1 "Time component of PiI1 start of energizing" SWORD InjTime_us 0 0 -13107.0 13106.0 ECU_ADDRESS 0x40022ECE /end MEASUREMENT
/begin MEASUREMENT InjCrv_tiPiI2SetUnLim_mp "unlinited time component for PiI2 start of energizing" SWORD InjTime_us 0 0 -13107.0 13106.0 ECU_ADDRESS 0x40022ED0 /end MEASUREMENT
/begin MEASUREMENT InjCrv_tiPiI2Abs_mp "absolute time component for PiI2 start of energizing" SWORD InjTime_us 0 0 -13107.0 13106.0 ECU_ADDRESS 0x40022ED2 /end MEASUREMENT
/begin MEASUREMENT InjCrv_phiPiI2Min_mp "Minimum angular component for PiI2 start of energizing" SWORD Angle_CA 0 0 -719.0 719.0 ECU_ADDRESS 0x40022ED4 /end MEASUREMENT
/begin MEASUREMENT InjCrv_phiPiI2SetUnLim_mp "unlimited angular component for PiI2 start of energizing" SWORD Angle_CA 0 0 -719.0 719.0 ECU_ADDRESS 0x40022ED6 /end MEASUREMENT
/begin MEASUREMENT InjCrv_phiPiI2Abs_mp "absolute angular component for PiI2 start of energizing" SWORD Angle_CA 0 0 -719.0 719.0 ECU_ADDRESS 0x40022ED8 /end MEASUREMENT
/begin MEASUREMENT InjCrv_qPiI2StrtBase_mp "Basic PiI2 quantity during starting time" SWORD FuelMass_mg_hub 0 0 -319.0 319.0 ECU_ADDRESS 0x40022EE4 /end MEASUREMENT
/begin MEASUREMENT InjCrv_qPiI2Strt_mp "PiI2 quantity during starting time" SWORD FuelMass_mg_hub 0 0 -319.0 319.0 ECU_ADDRESS 0x40022EE6 /end MEASUREMENT
/begin MEASUREMENT InjCrv_phiPiI2StrtBase_mp "Basic PiI2 start of energizing during starting time(phi)" SWORD Angle_CA 0 0 -719.0 719.0 ECU_ADDRESS 0x40022EE8 /end MEASUREMENT
/begin MEASUREMENT InjCrv_phiPiI2Strt_mp "PiI2 start of energizing during starting time(phi)" SWORD Angle_CA 0 0 -719.0 719.0 ECU_ADDRESS 0x40022EEA /end MEASUREMENT
/begin MEASUREMENT InjCrv_tiPiI2StrtBase_mp "Basic PiI2 start of energizing during starting time(ti)" SWORD InjTime_us 0 0 -13107.0 13106.0 ECU_ADDRESS 0x40022EEC /end MEASUREMENT
/begin MEASUREMENT InjCrv_tiPiI2Strt_mp "PiI2 start of energizing during starting time(ti)" SWORD InjTime_us 0 0 -13107.0 13106.0 ECU_ADDRESS 0x40022EEE /end MEASUREMENT
/begin MEASUREMENT InjCrv_qPiI2ETSCor1_mp "PiI2 quantity correction due to engine temperature" SWORD FuelMass_mg_hub 0 0 -319.0 319.0 ECU_ADDRESS 0x40022EF0 /end MEASUREMENT
/begin MEASUREMENT InjCrv_qPiI2ATSCor1_mp "PiI2 quantity correction due to air temperature" SWORD FuelMass_mg_hub 0 0 -319.0 319.0 ECU_ADDRESS 0x40022EF2 /end MEASUREMENT
/begin MEASUREMENT InjCrv_qPiI2APSCor1_mp "PiI2 quantity correction due to atmospheric pressure" SWORD FuelMass_mg_hub 0 0 -319.0 319.0 ECU_ADDRESS 0x40022EF4 /end MEASUREMENT
/begin MEASUREMENT InjCrv_facPiI2QETSCor1 "PiI2 quantity correction factor due to engine temperature" SWORD Factor 0 0 -4.0 4.0 ECU_ADDRESS 0x40022EF6 /end MEASUREMENT
/begin MEASUREMENT InjCrv_facPiI2QATSCor1 "PiI2 quantity correction factor due to air temperature" SWORD Factor 0 0 -4.0 4.0 ECU_ADDRESS 0x40022EF8 /end MEASUREMENT
/begin MEASUREMENT InjCrv_facPiI2QAPSCor1 "PiI2 quantity correction factor due to atmospheric pressure" SWORD Factor 0 0 -4.0 4.0 ECU_ADDRESS 0x40022EFA /end MEASUREMENT
/begin MEASUREMENT InjCrv_facPiI2SOEETSCor1 "PiI2 start of energizing correction factor due to engine temperature" SWORD Factor 0 0 -4.0 4.0 ECU_ADDRESS 0x40022EFC /end MEASUREMENT
/begin MEASUREMENT InjCrv_facPiI2SOEATSCor1 "PiI2 start of energizing correction factor due to air temperature" SWORD Factor 0 0 -4.0 4.0 ECU_ADDRESS 0x40022EFE /end MEASUREMENT
/begin MEASUREMENT InjCrv_facPiI2SOEAPSCor1 "PiI2 start of energizing correction factor due to atmospheric pressure" SWORD Factor 0 0 -4.0 4.0 ECU_ADDRESS 0x40022F00 /end MEASUREMENT
/begin MEASUREMENT InjCrv_phiPiI2ETSCor1_mp "PiI2 start of energizing correction due to engine temperature(phi)" SWORD Angle_CA 0 0 -719.0 719.0 ECU_ADDRESS 0x40022F02 /end MEASUREMENT
/begin MEASUREMENT InjCrv_phiPiI2ATSCor1_mp "PiI2 start of energizing correction due to air temperature(phi)" SWORD Angle_CA 0 0 -719.0 719.0 ECU_ADDRESS 0x40022F04 /end MEASUREMENT
/begin MEASUREMENT InjCrv_phiPiI2APSCor1_mp "PiI2 start of energizing correction due to atmospheric pressure(phi)" SWORD Angle_CA 0 0 -719.0 719.0 ECU_ADDRESS 0x40022F06 /end MEASUREMENT
/begin MEASUREMENT InjCrv_tiPiI2ETSCor1_mp "PiI2 start of energizing correction due to engine temperature(ti)" SWORD InjTime_us 0 0 -13107.0 13106.0 ECU_ADDRESS 0x40022F08 /end MEASUREMENT
/begin MEASUREMENT InjCrv_tiPiI2ATSCor1_mp "PiI2 start of energizing correction due to air temperature(ti)" SWORD InjTime_us 0 0 -13107.0 13106.0 ECU_ADDRESS 0x40022F0A /end MEASUREMENT
/begin MEASUREMENT InjCrv_tiPiI2APSCor1_mp "PiI2 start of energizing correction due to atmospheric pressure(ti)" SWORD InjTime_us 0 0 -13107.0 13106.0 ECU_ADDRESS 0x40022F0C /end MEASUREMENT
/begin MEASUREMENT InjCrv_phiPoI2AbsMax_mp "Maximum angular component of PoI2 start of energizing relative to the TDC" SWORD Angle_CA 0 0 -719.0 719.0 ECU_ADDRESS 0x40022F0E /end MEASUREMENT
/begin MEASUREMENT InjCrv_phiPoI2Lim_mp "limited start of energizing Agngle for PoI2" SWORD Angle_CA 0 0 -719.0 719.0 ECU_ADDRESS 0x40022F10 /end MEASUREMENT
/begin MEASUREMENT InjCrv_tiPoI2Max_mp "Maximum time compoent of PoI2 start of energizing relative to the TDC" SWORD InjTime_us 0 0 -13107.0 13106.0 ECU_ADDRESS 0x40022F12 /end MEASUREMENT
/begin MEASUREMENT InjCrv_tiPoI2Min_mp "Minimum time compoent of PoI2 start of energizing relative to the TDC" SWORD InjTime_us 0 0 -13107.0 13106.0 ECU_ADDRESS 0x40022F14 /end MEASUREMENT
/begin MEASUREMENT InjCrv_tiPoI2Lim_mp "limited start of energizing time for PoI2" SWORD InjTime_us 0 0 -13107.0 13106.0 ECU_ADDRESS 0x40022F16 /end MEASUREMENT
/begin MEASUREMENT InjCrv_stPoI2 "Base injection release for present operation mode" UBYTE State_uint8 0 0 0.0 255.0 ECU_ADDRESS 0x40022F18 /end MEASUREMENT
/begin MEASUREMENT InjCrv_qPoI2Set "Static setpoint value of PoI2 quantity" SWORD FuelMass_mg_hub 0 0 -319.0 319.0 ECU_ADDRESS 0x40022F1A /end MEASUREMENT
/begin MEASUREMENT InjCrv_qPoI2EffSet "Efficient part of static PoI2 injection quantity" SWORD FuelMass_mg_hub 0 0 -319.0 319.0 ECU_ADDRESS 0x40022F1C /end MEASUREMENT
/begin MEASUREMENT InjCrv_qPoI2EffDes "desired Efficient part of static PoI2 injection quantity" SWORD FuelMass_mg_hub 0 0 -319.0 319.0 ECU_ADDRESS 0x40022F1E /end MEASUREMENT
/begin MEASUREMENT InjCrv_qPoI2ATSCor_mp "PoI2 base quantity correction due to air temperature" SWORD FuelMass_mg_hub 0 0 -319.0 319.0 ECU_ADDRESS 0x40022F20 /end MEASUREMENT
/begin MEASUREMENT InjCrv_qPoI2ETSCor_mp "PoI2 base quantity correction due to engine temperature" SWORD FuelMass_mg_hub 0 0 -319.0 319.0 ECU_ADDRESS 0x40022F22 /end MEASUREMENT
/begin MEASUREMENT InjCrv_qPoI2APSCor_mp "PoI2 base quantity correction  due to atmospheric pressure" SWORD FuelMass_mg_hub 0 0 -319.0 319.0 ECU_ADDRESS 0x40022F24 /end MEASUREMENT
/begin MEASUREMENT InjCrv_tiPoI2ATSCor_mp "PoI2 start of energizing correction by  air temperature" SWORD InjTime_us 0 0 -13107.0 13106.0 ECU_ADDRESS 0x40022F26 /end MEASUREMENT
/begin MEASUREMENT InjCrv_tiPoI2ETSCor_mp "PoI2 start of energizing correction by engine temperature" SWORD InjTime_us 0 0 -13107.0 13106.0 ECU_ADDRESS 0x40022F28 /end MEASUREMENT
/begin MEASUREMENT InjCrv_tiPoI2APSCor_mp "PoI2 start of energizing correction by atmospheric pressure" SWORD InjTime_us 0 0 -13107.0 13106.0 ECU_ADDRESS 0x40022F2A /end MEASUREMENT
/begin MEASUREMENT InjCrv_phiPoI2APSCor_mp "PoI2 start of energizing correction by atmospheric pressure" SWORD Angle_CA 0 0 -719.0 719.0 ECU_ADDRESS 0x40022F2C /end MEASUREMENT
/begin MEASUREMENT InjCrv_phiPoI2ATSCor_mp "PoI2 start of energizing correction by  air temperature" SWORD Angle_CA 0 0 -719.0 719.0 ECU_ADDRESS 0x40022F2E /end MEASUREMENT
/begin MEASUREMENT InjCrv_phiPoI2ETSCor_mp "PoI2 start of energizing correction by engine temperature" SWORD Angle_CA 0 0 -719.0 719.0 ECU_ADDRESS 0x40022F30 /end MEASUREMENT
/begin MEASUREMENT InjCrv_facPoI2SOEAPSCor "PoI2 start of energizing correction factor due to atmospheric pressure" SWORD Factor 0 0 -10.0 10.0 ECU_ADDRESS 0x40022F32 /end MEASUREMENT
/begin MEASUREMENT InjCrv_facPoI2SOEATSCor "PoI2 start of energizing correction factor due to air temperature" SWORD Factor 0 0 -10.0 10.0 ECU_ADDRESS 0x40022F34 /end MEASUREMENT
/begin MEASUREMENT InjCrv_facPoI2SOEETSCor "PoI2 start of energizing correction factor due to engine temperature" SWORD Factor 0 0 -10.0 10.0 ECU_ADDRESS 0x40022F36 /end MEASUREMENT
/begin MEASUREMENT InjCrv_facPoI2QATSCor "PoI2 quantity correction factor due to air temperature" SWORD Factor 0 0 -10.0 10.0 ECU_ADDRESS 0x40022F38 /end MEASUREMENT
/begin MEASUREMENT InjCrv_facPoI2QETSCor "PoI2 quantity correction factor due to engine temperature" SWORD Factor 0 0 -10.0 10.0 ECU_ADDRESS 0x40022F3A /end MEASUREMENT
/begin MEASUREMENT InjCrv_facPoI2QAPSCor "PoI2 quantity correction factor due to atmospheric pressure" SWORD Factor 0 0 -10.0 10.0 ECU_ADDRESS 0x40022F3C /end MEASUREMENT
/begin MEASUREMENT HPUn_nPmp_mp "Pump speed" SWORD EngSpeed_rpm 0 0 0.0 6000.0 ECU_ADDRESS 0x40022E34 /end MEASUREMENT
/begin MEASUREMENT HPUn_dvolPmp_mp "Geometric supply volume of the high pressure based on engine speed" SWORD FuelVol_mm3_s 0 0 0.0 50000.0 ECU_ADDRESS 0x40022E36 /end MEASUREMENT
/begin MEASUREMENT HPUn_dvolPmpMax_mp "Physical maximum of the volume flow of a high pressure pump" SWORD FuelVol_mm3_s 0 0 0.0 50000.0 ECU_ADDRESS 0x40022E38 /end MEASUREMENT
/begin MEASUREMENT HPUn_dvolPmpTolc_mp "Supply volume corrections of the high pressure based on mechanical tolerance" SWORD FuelVol_mm3_s 0 0 0.0 50000.0 ECU_ADDRESS 0x40022E3A /end MEASUREMENT
/begin MEASUREMENT HPUn_trqPmp_mp "High pressure pump torque demand without loss" SWORD Trq_Nm 0 0 0.0 1000.0 ECU_ADDRESS 0x40022E3C /end MEASUREMENT
/begin MEASUREMENT HPUn_etaPmp_mp "Efficiency of high pressure pump" SWORD HPUnEta 0 0 -256.0 255.0 ECU_ADDRESS 0x40022E3E /end MEASUREMENT
/begin MEASUREMENT HPUn_etaPmpFlTemp_mp "High pressure pump efficiency based on the fuel temperature" SWORD HPUnEta 0 0 -256.0 255.0 ECU_ADDRESS 0x40022E40 /end MEASUREMENT
/begin MEASUREMENT HPUn_pRailDvtFlt_mp "Filtered rail pressure governor deviation" SWORD RailPressure_bar 0 0 -2500.0 2500.0 ECU_ADDRESS 0x40022E44 /end MEASUREMENT
/begin MEASUREMENT HPUn_stQntBal_mp "Status of the fuel quantity balance of the high pressure pump" UBYTE State_uint8 0 0 0.0 255.0 ECU_ADDRESS 0x40022E46 /end MEASUREMENT
/begin MEASUREMENT HPUn_tiQntBalDel_mp "Delay time for calculating the fuel quantity balance of the high pressure pump" ULONG EngTime_ms 0 0 0.0 4.294967296E+6 ECU_ADDRESS 0x40022E48 /end MEASUREMENT
/begin MEASUREMENT Rail_numRevPlaus_mp "Number of camshaft rotations" ULONG Counter_num 0 0 0.0 65535.0 ECU_ADDRESS 0x4002315C /end MEASUREMENT
/begin MEASUREMENT Rail_numRevFrzl_mp "Freeze number of crankshaft rotations" ULONG Counter_num 0 0 0.0 65535.0 ECU_ADDRESS 0x40023160 /end MEASUREMENT
/begin MEASUREMENT Rail_pPT1Flt_mp "PT1 filtered rail pressure for pressure control by metering unit" SWORD RailPressure_bar 0 0 -2500.0 2500.0 ECU_ADDRESS 0x40023164 /end MEASUREMENT
/begin MEASUREMENT Rail_pDvtFltLim_mp "Filtered governor deviation of rail pressure" SWORD RailPressure_bar 0 0 -2500.0 2500.0 ECU_ADDRESS 0x40023166 /end MEASUREMENT
/begin MEASUREMENT Rail_dvolMeUnCtlI_mp "I component of pressure governor by metering unit" SWORD FuelVol_mm3_s 0 0 -327670.0 327670.0 ECU_ADDRESS 0x40023168 /end MEASUREMENT
/begin MEASUREMENT Rail_dvolMeUnCtlP_mp "P component of pressure governor by metering unit" SWORD FuelVol_mm3_s 0 0 -327670.0 327670.0 ECU_ADDRESS 0x4002316A /end MEASUREMENT
/begin MEASUREMENT Rail_dvolMeUnCtlPID_mp "PID component of pressure governor by metering unit" SWORD FuelVol_mm3_s 0 0 -327670.0 327670.0 ECU_ADDRESS 0x4002316C /end MEASUREMENT
/begin MEASUREMENT Rail_dvolMeUnCtl_mp "PID component of pressure governor by metering unit before limit" SWORD FuelVol_mm3_s 0 0 -327670.0 327670.0 ECU_ADDRESS 0x4002316E /end MEASUREMENT
/begin MEASUREMENT Rail_dvolPRVCtlSet_mp "Setpoint flow rate when PRV is active" SWORD FuelVol_mm3_s 0 0 -327670.0 327670.0 ECU_ADDRESS 0x40023170 /end MEASUREMENT
/begin MEASUREMENT Rail_dvolMeUnCtlLim_mp "PID component of pressure governor by metering unit after limit" SWORD FuelVol_mm3_s 0 0 -327670.0 327670.0 ECU_ADDRESS 0x40023172 /end MEASUREMENT
/begin MEASUREMENT Rail_dvolMeUnCtlDT1_mp "DT1 component of pressure governor by metering unit" SWORD FuelVol_mm3_s 0 0 -327670.0 327670.0 ECU_ADDRESS 0x40023174 /end MEASUREMENT
/begin MEASUREMENT Rail_facMeUnCtlPCor_mp "Fuel system temperature dependent correction factor for P parameter" SWORD Factor 0 0 -10.0 10.0 ECU_ADDRESS 0x40023180 /end MEASUREMENT
/begin MEASUREMENT Rail_facMeUnCtlICor_mp "Fuel system temperature dependent correction factor for I parameter" SWORD Factor 0 0 -10.0 10.0 ECU_ADDRESS 0x40023182 /end MEASUREMENT
/begin MEASUREMENT Rail_facMeUnCtlDCor_mp "Fuel system temperature dependent correction factor for D parameter" SWORD Factor 0 0 -10.0 10.0 ECU_ADDRESS 0x40023184 /end MEASUREMENT
/begin MEASUREMENT Rail_pMeUnDvtMax_mp "Output of the curve Rail_pMeUnDvtMax_CUR" SWORD RailPressure_bar 0 0 -2500.0 2500.0 ECU_ADDRESS 0x40023186 /end MEASUREMENT
/begin MEASUREMENT Rail_pMeUnDvtMin_mp "Output of the curve Rail_pMeUnDvtMin_CUR" SWORD RailPressure_bar 0 0 -2500.0 2500.0 ECU_ADDRESS 0x40023188 /end MEASUREMENT
/begin MEASUREMENT Rail_pMeUnDvtMin2_mp "Minimum governor deviation allowed for rail pressure monitoring as a function of engine speed for second monitoring stage" SWORD RailPressure_bar 0 0 -2500.0 2500.0 ECU_ADDRESS 0x4002318A /end MEASUREMENT
/begin MEASUREMENT Rail_pMeUnFltMin_mp "Output of the curve Rail_pMeUnFltMin_CUR" SWORD RailPressure_bar 0 0 -2500.0 2500.0 ECU_ADDRESS 0x4002318C /end MEASUREMENT
/begin MEASUREMENT Rail_dvolMonHPUnTolc_mp "tolerance of high pressure pump" SWORD FuelVol_mm3_s 0 0 -327680.0 327670.0 ECU_ADDRESS 0x4002318E /end MEASUREMENT
/begin MEASUREMENT Rail_dvolMonLeakTolc_mp "Tolerances based on the setpoint pressure" SWORD FuelVol_mm3_s 0 0 -327680.0 327670.0 ECU_ADDRESS 0x40023190 /end MEASUREMENT
/begin MEASUREMENT Rail_dvolMonMax_mp "Upper limit of the volume flow allowed" SWORD FuelVol_mm3_s 0 0 -327680.0 327670.0 ECU_ADDRESS 0x40023192 /end MEASUREMENT
/begin MEASUREMENT Rail_dvolMeUnOvrRun_mp "Measurement point for displaying the MeUn set value from the curve in case of overrun" SWORD FuelVol_mm3_s 0 0 -327680.0 327670.0 ECU_ADDRESS 0x40023194 /end MEASUREMENT
/begin MEASUREMENT Rail_stMeUnMon0_mp "State bits for monitoring for a positive governor deviation" UBYTE boolean 0 0 0.0 1.0 ECU_ADDRESS 0x40023196 /end MEASUREMENT
/begin MEASUREMENT Rail_stMeUnMon10_mp "State bits of leckage detection of MeUn" UBYTE boolean 0 0 0.0 1.0 ECU_ADDRESS 0x40023197 /end MEASUREMENT
/begin MEASUREMENT Rail_stMeUnMon2_mp "State bits for monitoring for a negative governor deviation at zero delivery" UBYTE boolean 0 0 0.0 1.0 ECU_ADDRESS 0x40023198 /end MEASUREMENT
/begin MEASUREMENT Rail_stMeUnMon22_mp "State bits for monitoring for a negative governor deviation at zero delivery for second monitoring stage" UBYTE boolean 0 0 0.0 1.0 ECU_ADDRESS 0x40023199 /end MEASUREMENT
/begin MEASUREMENT Rail_stMeUnMon3_mp "State bits for monitoring for minimum rail pressure" UBYTE boolean 0 0 0.0 1.0 ECU_ADDRESS 0x4002319A /end MEASUREMENT
/begin MEASUREMENT Rail_stMeUnMon4_mp "State bits for monitoring for maximum rail pressure" UBYTE boolean 0 0 0.0 1.0 ECU_ADDRESS 0x4002319B /end MEASUREMENT
/begin MEASUREMENT Rail_stMeUnMon42_mp "State bits for monitoring for maximum rail pressure for second monitoring stage" UBYTE boolean 0 0 0.0 1.0 ECU_ADDRESS 0x4002319C /end MEASUREMENT
/begin MEASUREMENT Rail_stMeUnMon7_mp "State bits for monitoring metering unit set value in overrun" UBYTE boolean 0 0 0.0 1.0 ECU_ADDRESS 0x4002319D /end MEASUREMENT
/begin MEASUREMENT Rail_stMeUnMon8_mp "Status of the error detection by a plausibility check of the volume flow of the metering unit at low idle" UBYTE boolean 0 0 0.0 1.0 ECU_ADDRESS 0x4002319E /end MEASUREMENT
/begin MEASUREMENT Rail_qDemInj_mp "Sum of the requested injection quantity per cylinder (might be distributed to various injections)" SWORD FuelMass_mg_hub 0 0 0.0 300.0 ECU_ADDRESS 0x400231A0 /end MEASUREMENT
/begin MEASUREMENT Rail_qDemInjCtlPiI1_mp "Sum of the requested injection quantity per cylinder (might be distributed to various injections)" SWORD FuelMass_mg_hub 0 0 0.0 300.0 ECU_ADDRESS 0x400231A2 /end MEASUREMENT
/begin MEASUREMENT Rail_qDemInjCtlPiI2_mp "Sum of the requested injection quantity per cylinder (might be distributed to various injections)" SWORD FuelMass_mg_hub 0 0 0.0 300.0 ECU_ADDRESS 0x400231A4 /end MEASUREMENT
/begin MEASUREMENT Rail_qDemInjCtlMI1_mp "Sum of all estimated injection control quantities of all requested injections per cylinder (for a nominal injection system)" SWORD FuelMass_mg_hub 0 0 0.0 300.0 ECU_ADDRESS 0x400231A6 /end MEASUREMENT
/begin MEASUREMENT Rail_qDemInjCtlPoI2_mp "Sum of all estimated injection control quantities of all requested injections per cylinder (for a maximum tolerated injection system)" SWORD FuelMass_mg_hub 0 0 0.0 300.0 ECU_ADDRESS 0x400231A8 /end MEASUREMENT
/begin MEASUREMENT Rail_qDemInjCtlNom_mp "Sum of all estimated injection control quantities of all requested injections per cylinder (for a nominal injection system)" SWORD FuelMass_mg_hub 0 0 0.0 300.0 ECU_ADDRESS 0x400231AA /end MEASUREMENT
/begin MEASUREMENT Rail_qPreCtlDynLim_mp "Output of the dynamic DT1 component for the MeUn precontrol" SWORD FuelMass_mg_hub 0 0 -300.0 300.0 ECU_ADDRESS 0x400231AC /end MEASUREMENT
/begin MEASUREMENT Rail_qDemInjCtlMax_mp "Sum of all estimated injection control quantities of all requested injections per cylinder (for a maximum tolerated injection system)" SWORD FuelMass_mg_hub 0 0 0.0 300.0 ECU_ADDRESS 0x400231AE /end MEASUREMENT
/begin MEASUREMENT Rail_qPreCtlDyn_mp "Virtual additional injection quantity for boosting the PreCtl during sudden changes" SWORD FuelMass_mg_hub 0 0 -300.0 300.0 ECU_ADDRESS 0x400231B0 /end MEASUREMENT
/begin MEASUREMENT Rail_dvolDemInjNom "Volume flow requested for all injections (including control quantities) by a nominal injection system" SWORD FuelVol_mm3_s 0 0 -327680.0 327670.0 ECU_ADDRESS 0x400231B2 /end MEASUREMENT
/begin MEASUREMENT Rail_dvolLeakCyl_mp "Leakage per cylinder" SWORD FuelVol_mm3_s 0 0 -327680.0 327670.0 ECU_ADDRESS 0x400231B4 /end MEASUREMENT
/begin MEASUREMENT Rail_dvolLeak "Leakage of the high pressure system" SWORD FuelVol_mm3_s 0 0 -327680.0 327670.0 ECU_ADDRESS 0x400231B6 /end MEASUREMENT
/begin MEASUREMENT Rail_dvolPreCtlDyn_mp "Additional pump flow requested by the dynamic component for boosting the PreCtl during sudden changes" SWORD FuelVol_mm3_s 0 0 -327680.0 327670.0 ECU_ADDRESS 0x400231B8 /end MEASUREMENT
/begin MEASUREMENT Rail_dvolDemInjMax "Volume flow requested for all injections (including control quantities) by a maximum tolerated injection system" SWORD FuelVol_mm3_s 0 0 -327680.0 327670.0 ECU_ADDRESS 0x400231BA /end MEASUREMENT
/begin MEASUREMENT Rail_facPreCtlMeUnCor_mp "Operating point dependent factor to scale the PreCtl in relation to the estimated system requirement" SWORD Factor 0 0 0.0 3.0 ECU_ADDRESS 0x400231BC /end MEASUREMENT
/begin MEASUREMENT Rail_facLeakTempCor_mp "Fuel temperature dependent leakage correction factor" SWORD Factor 0 0 0.0 3.0 ECU_ADDRESS 0x400231BE /end MEASUREMENT
/begin MEASUREMENT Rail_facLeakAged_mp "Leakage factor based on the lifetime wear" SWORD Factor 0 0 0.0 3.0 ECU_ADDRESS 0x400231C0 /end MEASUREMENT
/begin MEASUREMENT Rail_tiLeakEngOn_mp "Time input to calculate the ageing factor for the leakage of the injection system based on the ageing of the engine" SWORD RailHrsEngOn_h 0 0 -3.2768E+6 3.2767E+6 ECU_ADDRESS 0x400231C2 /end MEASUREMENT
/begin MEASUREMENT Rail_pSetPointBase_mp "The basic setpoint value" SWORD RailPressure_bar 0 0 -2500.0 2500.0 ECU_ADDRESS 0x400231CC /end MEASUREMENT
/begin MEASUREMENT Rail_pSetPointCor_mp "Corrected rail pressure setpoint value" SWORD RailPressure_bar 0 0 -2500.0 2500.0 ECU_ADDRESS 0x400231CE /end MEASUREMENT
/begin MEASUREMENT Rail_pSetPointOut_mp "Rail pressure setpoint after regeneration intervention" SWORD RailPressure_bar 0 0 -2500.0 2500.0 ECU_ADDRESS 0x400231D0 /end MEASUREMENT
/begin MEASUREMENT Rail_pSetPointLimNFlTemp_mp "maximum rail pressure setpoint, depending on the fuel temperature and engine speed" SWORD RailPressure_bar 0 0 -2500.0 2500.0 ECU_ADDRESS 0x400231D2 /end MEASUREMENT
/begin MEASUREMENT Rail_pSetPointFlTempLim_mp "Limited rail pressure setpoint including fuel temperature correction" SWORD RailPressure_bar 0 0 -2500.0 2500.0 ECU_ADDRESS 0x400231D4 /end MEASUREMENT
/begin MEASUREMENT Rail_pSetPointFlTempRedLim "Limited rail pressure setpoint considering the fuel temperature correction less the reduced reduced setpoint" SWORD RailPressure_bar 0 0 -2500.0 2500.0 ECU_ADDRESS 0x400231D6 /end MEASUREMENT
/begin MEASUREMENT Rail_pSetPointLim_mp "Rail pressure setpoint after range limitation in normal operation" SWORD RailPressure_bar 0 0 -2500.0 2500.0 ECU_ADDRESS 0x400231D8 /end MEASUREMENT
/begin MEASUREMENT Rail_pSetPointSubsLim_mp "Limited rail pressure setpoint substitution value by other functions" SWORD RailPressure_bar 0 0 -2500.0 2500.0 ECU_ADDRESS 0x400231DA /end MEASUREMENT
/begin MEASUREMENT Rail_pSetPointErrLim_mp "Low limitation of rail pressure for proper PCV operation at max pump flow error " SWORD RailPressure_bar 0 0 -2500.0 2500.0 ECU_ADDRESS 0x400231DC /end MEASUREMENT
/begin MEASUREMENT Rail_pSetPointDynMin_mp "Low limitation of rail pressure for Dynamic" SWORD RailPressure_bar 0 0 -2500.0 2500.0 ECU_ADDRESS 0x400231DE /end MEASUREMENT
/begin MEASUREMENT Rail_pSetPointInc_mp "Maximum rail pressure setpoint increase per schedule sequence" SWORD RailPressure_bar 0 0 -2500.0 2500.0 ECU_ADDRESS 0x400231E0 /end MEASUREMENT
/begin MEASUREMENT Rail_pSetPointDynMax_mp "High limitation of rail pressure for Dynamic" SWORD RailPressure_bar 0 0 -2500.0 2500.0 ECU_ADDRESS 0x400231E2 /end MEASUREMENT
/begin MEASUREMENT Rail_dvolPCVFlw_mp "Fuel flow through PCV" SWORD FuelVol_mm3_s 0 0 -327680.0 327670.0 ECU_ADDRESS 0x400231E4 /end MEASUREMENT
/begin MEASUREMENT Rail_dpSetPointDec "Maximum rail pressure setpoint decrease per second" SWORD RailPressure_bar_s 0 0 -2500.0 2500.0 ECU_ADDRESS 0x400231E6 /end MEASUREMENT
/begin MEASUREMENT Rail_dpSetPointIncLim_mp "Rail set point Increment Limitation" SWORD RailPressure_bar_s 0 0 -2500.0 2500.0 ECU_ADDRESS 0x400231E8 /end MEASUREMENT
/begin MEASUREMENT Rail_dpSetPointInc_mp "Maximum rail pressure setpoint increase per second based upon the engine speed and injected fuel quantity" SWORD RailPressure_bar_s 0 0 -2500.0 2500.0 ECU_ADDRESS 0x400231EA /end MEASUREMENT
/begin MEASUREMENT Rail_dpSetPointInc "Maximum rail pressure setpoint increase per second" SWORD RailPressure_bar_s 0 0 -2500.0 2500.0 ECU_ADDRESS 0x400231EC /end MEASUREMENT
/begin MEASUREMENT Rail_pSetPointAPSCor_mp "rail pressure corrections multiplied by the factors based on atmospheric pressure" SWORD RailPressure_bar 0 0 -2500.0 2500.0 ECU_ADDRESS 0x400231F2 /end MEASUREMENT
/begin MEASUREMENT Rail_pSetPointETSCor_mp "rail pressure corrections multiplied by the factors based on engine temperature" SWORD RailPressure_bar 0 0 -2500.0 2500.0 ECU_ADDRESS 0x400231F4 /end MEASUREMENT
/begin MEASUREMENT Rail_pSetPointATSCor_mp "rail pressure corrections multiplied by the factors based on intake air temperature" SWORD RailPressure_bar 0 0 -2500.0 2500.0 ECU_ADDRESS 0x400231F6 /end MEASUREMENT
/begin MEASUREMENT Rail_facSetPointAPSCor "weighting factor base on the atmospheric pressure" SWORD Factor 0 0 0.0 1.0 ECU_ADDRESS 0x400231F8 /end MEASUREMENT
/begin MEASUREMENT Rail_facSetPointETSCor "weighting factor base on the engine temperature selected" SWORD Factor 0 0 0.0 1.0 ECU_ADDRESS 0x400231FA /end MEASUREMENT
/begin MEASUREMENT Rail_facSetPointATSCor "weighting factor base on the intake air temperature selected" SWORD Factor 0 0 0.0 1.0 ECU_ADDRESS 0x400231FC /end MEASUREMENT
/begin MEASUREMENT Rail_trqFlPLim_mp "moment limitation in case of low input pressure in high altitude" SWORD Trq_Nm 0 0 0.0 3000.0 ECU_ADDRESS 0x400231FE /end MEASUREMENT
/begin MEASUREMENT Rail_trqFlPLimCor_mp "rated moment limitation in case of low input pressure in high altitude" SWORD Trq_Nm 0 0 0.0 3000.0 ECU_ADDRESS 0x40023200 /end MEASUREMENT
/begin MEASUREMENT Rail_trqFlTempLim_mp "moment limitation dependent on temperature and engine speed" SWORD Trq_Nm 0 0 0.0 3000.0 ECU_ADDRESS 0x40023202 /end MEASUREMENT
/begin MEASUREMENT Rail_facFlPLimFTSCor_mp "Factor for limitation in case of low input pressure in high altitude" SWORD Factor 0 0 -10.0 10.0 ECU_ADDRESS 0x40023204 /end MEASUREMENT
/begin MEASUREMENT StSys_nThresStrtCutOut_mp "Engine Speed to cut off from start" SWORD EngSpeed_rpm 0 0 0.0 6000.0 ECU_ADDRESS 0x40023296 /end MEASUREMENT
/begin MEASUREMENT StSys_trqStrtBas_mp "basic starting torque from map" SWORD Trq_Nm 0 0 0.0 1000.0 ECU_ADDRESS 0x40023298 /end MEASUREMENT
/begin MEASUREMENT StSys_trqAdj_mp "starting torque correction" SWORD Trq_Nm 0 0 0.0 1000.0 ECU_ADDRESS 0x4002329A /end MEASUREMENT
/begin MEASUREMENT StSys_stAbort_mp "status of abort condition for cranking" UWORD State_uint16 0 0 0.0 65535.0 ECU_ADDRESS 0x400232A4 /end MEASUREMENT
/begin MEASUREMENT StSys_stCondT50NRM_mp "enable/disable condition for crank control" UWORD State_uint16 0 0 0.0 65535.0 ECU_ADDRESS 0x400232A6 /end MEASUREMENT
/begin MEASUREMENT StSys_stCondT50EMGCY_mp "enable/disable condition for crank control" UWORD State_uint16 0 0 0.0 65535.0 ECU_ADDRESS 0x400232A8 /end MEASUREMENT
/begin MEASUREMENT StSys_stCondT50CAN_mp "enable/disable condition for crank control" UWORD State_uint16 0 0 0.0 65535.0 ECU_ADDRESS 0x400232AA /end MEASUREMENT
/begin MEASUREMENT StSys_stGlobCheck_mp "global condition check for crank control" UBYTE State_uint8 0 0 0.0 255.0 ECU_ADDRESS 0x400232AC /end MEASUREMENT
/begin MEASUREMENT StSys_stStrtReq_mp "status of the starting requests" UBYTE State_uint8 0 0 0.0 255.0 ECU_ADDRESS 0x400232AD /end MEASUREMENT
/begin MEASUREMENT StSys_stValidReq_mp "validation of the cranking request source" UBYTE State_uint8 0 0 0.0 255.0 ECU_ADDRESS 0x400232AE /end MEASUREMENT
/begin MEASUREMENT StSys_stSrcReq_mp "status of cranking request source" UBYTE State_uint8 0 0 0.0 255.0 ECU_ADDRESS 0x400232AF /end MEASUREMENT
/begin MEASUREMENT StSys_trqStrtMax "Maximum torque permitted during start" SWORD Trq_Nm 0 0 0.0 1000.0 ECU_ADDRESS 0x400232B0 /end MEASUREMENT
/begin MEASUREMENT CoME_nMinTipin_mp "Measurement point for the current minimal speed demand via Tipin" SWORD EngSpeed_rpm 0 0 -12000.0 12000.0 ECU_ADDRESS 0x4002221A /end MEASUREMENT
/begin MEASUREMENT CoME_nMinUnFlt_mp "Measurement point for the current minimal speed demand via UnFlt" SWORD EngSpeed_rpm 0 0 -12000.0 12000.0 ECU_ADDRESS 0x4002221C /end MEASUREMENT
/begin MEASUREMENT CoME_tiMaxOffDrvOff_mp "Maximal shutoff time by Drive off" ULONG EngTime_ms 0 0 0.0 4.294967295E+10 ECU_ADDRESS 0x40022224 /end MEASUREMENT
/begin MEASUREMENT CoME_tiMinOffDrvOff_mp "Minimal shutoff time by Drive Off" ULONG EngTime_ms 0 0 0.0 4.294967295E+10 ECU_ADDRESS 0x40022228 /end MEASUREMENT
/begin MEASUREMENT CoME_tiMaxOffAcc_mp "Maximal shutoff time by ACC" ULONG EngTime_ms 0 0 0.0 4.294967295E+10 ECU_ADDRESS 0x4002222C /end MEASUREMENT
/begin MEASUREMENT CoME_tiMinOffAcc_mp "Minimal shutoff time by ACC" ULONG EngTime_ms 0 0 0.0 4.294967295E+10 ECU_ADDRESS 0x40022230 /end MEASUREMENT
/begin MEASUREMENT CoME_stAcc_mp "Status: acceleration" UBYTE boolean 0 0 0.0 1.0 ECU_ADDRESS 0x40022234 /end MEASUREMENT
/begin MEASUREMENT CoME_stDrvTmr_mp "Drive timer" UBYTE boolean 0 0 0.0 1.0 ECU_ADDRESS 0x40022235 /end MEASUREMENT
/begin MEASUREMENT CoME_stAccMin_mp "AC status: minimal time off in case of acceleration" UBYTE boolean 0 0 0.0 1.0 ECU_ADDRESS 0x40022236 /end MEASUREMENT
/begin MEASUREMENT CoME_stAccMax_mp "AC status: maximum time off in case of acceleration" UBYTE boolean 0 0 0.0 1.0 ECU_ADDRESS 0x40022237 /end MEASUREMENT
/begin MEASUREMENT CoME_stOffAcc_mp "Reset: Acc" UBYTE boolean 0 0 0.0 1.0 ECU_ADDRESS 0x40022238 /end MEASUREMENT
/begin MEASUREMENT CoME_stAccTmr_mp "status: acceleration after timer" UBYTE boolean 0 0 0.0 1.0 ECU_ADDRESS 0x40022239 /end MEASUREMENT
/begin MEASUREMENT CoME_stDrvOff_mp "status: drive off" UBYTE boolean 0 0 0.0 1.0 ECU_ADDRESS 0x4002223A /end MEASUREMENT
/begin MEASUREMENT CoME_stDrvOffMin_mp "AC status: minimal time off in case of drive off" UBYTE boolean 0 0 0.0 1.0 ECU_ADDRESS 0x4002223B /end MEASUREMENT
/begin MEASUREMENT CoME_stDrvOffMax_mp "AC status: maximal time off in case of drive off" UBYTE boolean 0 0 0.0 1.0 ECU_ADDRESS 0x4002223C /end MEASUREMENT
/begin MEASUREMENT CoME_stOffDrvOff_mp "Reset: Drive Off" UBYTE boolean 0 0 0.0 1.0 ECU_ADDRESS 0x4002223D /end MEASUREMENT
/begin MEASUREMENT CoME_stDrvOffTmr_mp "status: drive off after timer" UBYTE boolean 0 0 0.0 1.0 ECU_ADDRESS 0x4002223E /end MEASUREMENT
/begin MEASUREMENT CoME_stStrt_mp "status: start" UBYTE boolean 0 0 0.0 1.0 ECU_ADDRESS 0x4002223F /end MEASUREMENT
/begin MEASUREMENT CoME_stStrtTmrAC_mp "status: engine start after timer" UBYTE boolean 0 0 0.0 1.0 ECU_ADDRESS 0x40022240 /end MEASUREMENT
/begin MEASUREMENT CoME_stBattVltg_mp "status: low battery voltage" UBYTE boolean 0 0 0.0 1.0 ECU_ADDRESS 0x40022241 /end MEASUREMENT
/begin MEASUREMENT CoME_stBattVltgTmr_mp "status: low battery voltage after timer" UBYTE boolean 0 0 0.0 1.0 ECU_ADDRESS 0x40022242 /end MEASUREMENT
/begin COMPU_METHOD EngSpeed_rpm "f(x)=(c1*X*X+c2*X+c3)/(c4*X*X+c5*X+c6)" RAT_FUNC "%6.1" "rpm" COEFFS 0 2.000 0.000 0 0 1.000 /end COMPU_METHOD
/begin COMPU_METHOD State_uint8 "f(x)=(c1*X*X+c2*X+c3)/(c4*X*X+c5*X+c6)" RAT_FUNC "%3.0" "" COEFFS 0 1 0 0 0 1 /end COMPU_METHOD
/begin COMPU_METHOD State_uint16 "f(x)=(c1*X*X+c2*X+c3)/(c4*X*X+c5*X+c6)" RAT_FUNC "%5.0" "" COEFFS 0 1 0 0 0 1 /end COMPU_METHOD
/begin COMPU_METHOD Trq_Nm "f(x)=(c1*X*X+c2*X+c3)/(c4*X*X+c5*X+c6)" RAT_FUNC "%0.3" "Nm" COEFFS 0 10.000 0.000 0 0 1.000 /end COMPU_METHOD
/begin COMPU_METHOD FuelMass_mg_hub "f(x)=(c1*X*X+c2*X+c3)/(c4*X*X+c5*X+c6)" RAT_FUNC "%0.3" "mg/hub" COEFFS 0 102.400 0.000 0 0 1.000 /end COMPU_METHOD
/begin COMPU_METHOD AirPressure_kPa "f(x)=(c1*X*X+c2*X+c3)/(c4*X*X+c5*X+c6)" RAT_FUNC "%0.3" "kPa" COEFFS 0 10.000 0.000 0 0 1.000 /end COMPU_METHOD
/begin COMPU_METHOD boolean "f(x)=(c1*X*X+c2*X+c3)/(c4*X*X+c5*X+c6)" RAT_FUNC "%1.0" "" COEFFS 0 1 0 0 0 1 /end COMPU_METHOD
/begin COMPU_METHOD Counter_num "f(x)=(c1*X*X+c2*X+c3)/(c4*X*X+c5*X+c6)" RAT_FUNC "%10.0" "" COEFFS 0 1 0 0 0 1 /end COMPU_METHOD
/begin COMPU_METHOD EngTime_ms "f(x)=(c1*X*X+c2*X+c3)/(c4*X*X+c5*X+c6)" RAT_FUNC "%0.3" "ms" COEFFS 0 1.000 0.000 0 0 10.000 /end COMPU_METHOD
/begin COMPU_METHOD InjTime_us "f(x)=(c1*X*X+c2*X+c3)/(c4*X*X+c5*X+c6)" RAT_FUNC "%0.3" "us" COEFFS 0 2.500 0.000 0 0 1.000 /end COMPU_METHOD
/begin COMPU_METHOD Debounce_ms "f(x)=(c1*X*X+c2*X+c3)/(c4*X*X+c5*X+c6)" RAT_FUNC "%10.0" "ms" COEFFS 0 1 0 0 0 1 /end COMPU_METHOD
/begin COMPU_METHOD Accpedal_rate_s "f(x)=(c1*X*X+c2*X+c3)/(c4*X*X+c5*X+c6)" RAT_FUNC "%0.3" "%/s" COEFFS 0 81.920 0.000 0 0 1.000 /end COMPU_METHOD
/begin COMPU_METHOD Time_s "f(x)=(c1*X*X+c2*X+c3)/(c4*X*X+c5*X+c6)" RAT_FUNC "%0.3" "s" COEFFS 0 100.000 0.000 0 0 1.000 /end COMPU_METHOD
/begin COMPU_METHOD Battery_mv "f(x)=(c1*X*X+c2*X+c3)/(c4*X*X+c5*X+c6)" RAT_FUNC "%5.0" "mv" COEFFS 0 1 0 0 0 1 /end COMPU_METHOD
/begin COMPU_METHOD Freq_q1p0 "f(x)=(c1*X*X+c2*X+c3)/(c4*X*X+c5*X+c6)" RAT_FUNC "%5.0" "Hz" COEFFS 0 1 0 0 0 1 /end COMPU_METHOD
/begin COMPU_METHOD RailDT1_ms "f(x)=(c1*X*X+c2*X+c3)/(c4*X*X+c5*X+c6)" RAT_FUNC "%5.0" "ms" COEFFS 0 1 0 0 0 1 /end COMPU_METHOD
/begin COMPU_METHOD VehSpeed_km_h "f(x)=(c1*X*X+c2*X+c3)/(c4*X*X+c5*X+c6)" RAT_FUNC "%0.3" "km/h" COEFFS 0 100.000 0.000 0 0 1.000 /end COMPU_METHOD
/begin COMPU_METHOD TransRatio "f(x)=(c1*X*X+c2*X+c3)/(c4*X*X+c5*X+c6)" RAT_FUNC "%0.3" "" COEFFS 0 100.000 0.000 0 0 1.000 /end COMPU_METHOD
/begin COMPU_METHOD Temp_deg "f(x)=(c1*X*X+c2*X+c3)/(c4*X*X+c5*X+c6)" RAT_FUNC "%0.3" "deg" COEFFS 0 10.000 2731.400 0 0 1.000 /end COMPU_METHOD
/begin COMPU_METHOD PT_fac "f(x)=(c1*X*X+c2*X+c3)/(c4*X*X+c5*X+c6)" RAT_FUNC "%0.3" "" COEFFS 0 655.360 0.000 0 0 1.000 /end COMPU_METHOD
/begin COMPU_METHOD Accpedal_rate "f(x)=(c1*X*X+c2*X+c3)/(c4*X*X+c5*X+c6)" RAT_FUNC "%0.3" "%" COEFFS 0 81.920 0.000 0 0 1.000 /end COMPU_METHOD
/begin COMPU_METHOD Factor "f(x)=(c1*X*X+c2*X+c3)/(c4*X*X+c5*X+c6)" RAT_FUNC "%12.6" "" COEFFS 0 1024.000 0.000 0 0 1.000 /end COMPU_METHOD
/begin COMPU_METHOD Pid_Kp_Kd "f(x)=(c1*X*X+c2*X+c3)/(c4*X*X+c5*X+c6)" RAT_FUNC "%0.3" "" COEFFS 0 1000.000 0.000 0 0 1.000 /end COMPU_METHOD
/begin COMPU_METHOD Pid_Ki "f(x)=(c1*X*X+c2*X+c3)/(c4*X*X+c5*X+c6)" RAT_FUNC "%0.3" "" COEFFS 0 1000.000 0.000 0 0 1.000 /end COMPU_METHOD
/begin COMPU_METHOD FuelVol_mm3_s "f(x)=(c1*X*X+c2*X+c3)/(c4*X*X+c5*X+c6)" RAT_FUNC "%0.3" "mm^3/s" COEFFS 0 1.000 0.000 0 0 10.000 /end COMPU_METHOD
/begin COMPU_METHOD RailPressure_bar "f(x)=(c1*X*X+c2*X+c3)/(c4*X*X+c5*X+c6)" RAT_FUNC "%0.3" "bar" COEFFS 0 12.800 0.000 0 0 1.000 /end COMPU_METHOD
/begin COMPU_METHOD Angle_CA "f(x)=(c1*X*X+c2*X+c3)/(c4*X*X+c5*X+c6)" RAT_FUNC "%0.3" "CA" COEFFS 0 45.511 0.000 0 0 1.000 /end COMPU_METHOD
/begin COMPU_METHOD Tra_num "f(x)=(c1*X*X+c2*X+c3)/(c4*X*X+c5*X+c6)" RAT_FUNC "%3.0" "" COEFFS 0 1 0 0 0 1 /end COMPU_METHOD
/begin COMPU_METHOD Switch_conv "Enumerated data type: Switch_conv" TAB_VERB "%0.3" "" COMPU_TAB_REF VTAB_FOR_Switch_conv /end COMPU_METHOD
/begin COMPU_METHOD EngTempFldSel_conv "Enumerated data type: EngTempFldSel_conv" TAB_VERB "%0.3" "" COMPU_TAB_REF VTAB_FOR_EngTempFldSel_conv /end COMPU_METHOD
/begin COMPU_METHOD AirTempFldSel_conv "Enumerated data type: AirTempFldSel_conv" TAB_VERB "%0.3" "" COMPU_TAB_REF VTAB_FOR_AirTempFldSel_conv /end COMPU_METHOD
/begin COMPU_METHOD HPUnEta "f(x)=(c1*X*X+c2*X+c3)/(c4*X*X+c5*X+c6)" RAT_FUNC "%10.6" "" COEFFS 0 128.000 0.000 0 0 1.000 /end COMPU_METHOD
/begin COMPU_METHOD PumpQnt_mm3_rev "f(x)=(c1*X*X+c2*X+c3)/(c4*X*X+c5*X+c6)" RAT_FUNC "%0.3" "mm^3/rev" COEFFS 0 5.000 0.000 0 0 1.000 /end COMPU_METHOD
/begin COMPU_METHOD RailHrsEngOn_h "f(x)=(c1*X*X+c2*X+c3)/(c4*X*X+c5*X+c6)" RAT_FUNC "%0.3" "h" COEFFS 0 1.000 0.000 0 0 100.000 /end COMPU_METHOD
/begin COMPU_METHOD RailPressure_bar_s "f(x)=(c1*X*X+c2*X+c3)/(c4*X*X+c5*X+c6)" RAT_FUNC "%0.3" "bar/s" COEFFS 0 10.000 0.000 0 0 1.000 /end COMPU_METHOD
/begin COMPU_VTAB VTAB_FOR_Switch_conv "Enumerated data type: Switch_conv" TAB_VERB 2 0 "OFF" 1 "ON" /end COMPU_VTAB
/begin COMPU_VTAB VTAB_FOR_EngTempFldSel_conv "Enumerated data type: EngTempFldSel_conv" TAB_VERB 3 0 "Coolant_Temperature" 1 "Oil_Temperature" 2 "Eng_Temperature" /end COMPU_VTAB
/begin COMPU_VTAB VTAB_FOR_AirTempFldSel_conv "Enumerated data type: AirTempFldSel_conv" TAB_VERB 4 0 "Air_tCACDs" 1 "Air_tAFS" 2 "Air_tEnvT" 3 "Air_tIntkVUS" /end COMPU_VTAB
/begin GROUP S2_Weight_Factor "InjCrv_PiI1Cor/InjCrv_PiISOECor/Weight Factor"
 /begin REF_CHARACTERISTIC InjCrv_facPiI1APSSOECor1EOM0_CUR InjCrv_facPiI1ATSSOECor1EOM0_CUR InjCrv_facPiI1ETSSOECor1EOM0_CUR /end REF_CHARACTERISTIC
 /begin REF_MEASUREMENT InjCrv_facPiI1SOEAPSCor1 InjCrv_facPiI1SOEATSCor1 InjCrv_facPiI1SOEETSCor1 /end REF_MEASUREMENT
/end GROUP
/begin GROUP InjCrv_PiI1Set "InjCrv_PiI1Set" /begin SUB_GROUP Root_InjCrv_PiIQntBase Root_InjCrv_PiISOEBase /end SUB_GROUP /end GROUP
/begin GROUP Root_InjCrv_PiIQntBase "InjCrv_PiI1Set/InjCrv_PiIQntBase" /begin REF_CHARACTERISTIC InjCrv_qPiI1Bas1EOM0_MAP /end REF_CHARACTERISTIC /end GROUP
/begin GROUP Root_InjCrv_PiISOEBase "InjCrv_PiI1Set/InjCrv_PiISOEBase" /begin REF_CHARACTERISTIC InjCrv_phiPiI1Bas1EOM0_MAP InjCrv_tiPiI1Bas1EOM0_MAP /end REF_CHARACTERISTIC /end GROUP
/begin GROUP InjCrv_PiI2 "InjCrv_PiI2" /begin SUB_GROUP Root_InjCrv_PiI2QntLim Root_InjCrv_PiI2SOELim /end SUB_GROUP /end GROUP
/begin GROUP Root_InjCrv_PiI2QntLim "InjCrv_PiI2/InjCrv_PiI2QntLim" /begin REF_CHARACTERISTIC InjCrv_qPiI2Max1_MAP SigTst_qPiI2_C SigTst_swtPiI2Q_C /end REF_CHARACTERISTIC /begin REF_MEASUREMENT InjCrv_qPiI2Max_mp InjCrv_qPiI2SetLim_mp /end REF_MEASUREMENT /end GROUP
/begin GROUP Root_InjCrv_PiI2SOELim "InjCrv_PiI2/InjCrv_PiI2SOELim" /begin SUB_GROUP S2_Angle2Time1 S2_Time2Angle1 /end SUB_GROUP
 /begin REF_CHARACTERISTIC InjCrv_phiPiI2Max_C SigTst_phiPiI2_C SigTst_swtPiI2Phi_C SigTst_swtPiI2Ti_C SigTst_tiPiI2_C /end REF_CHARACTERISTIC
 /begin REF_MEASUREMENT InjCrv_phiPiI2Abs_mp InjCrv_phiPiI2SetUnLim_mp InjCrv_tiPiI2Abs_mp InjCrv_tiPiI2Min_mp InjCrv_tiPiI2SetUnLim_mp /end REF_MEASUREMENT
/end GROUP
/begin GROUP S2_Angle2Time1 "InjCrv_PiI2/InjCrv_PiI2SOELim/Angle2Time" /begin REF_MEASUREMENT InjCrv_tiPiI1 /end REF_MEASUREMENT /end GROUP
/begin GROUP S2_Time2Angle1 "InjCrv_PiI2/InjCrv_PiI2SOELim/Time2Angle" /begin REF_MEASUREMENT InjCrv_phiPiI2Min_mp /end REF_MEASUREMENT /end GROUP
/begin GROUP InjCrv_PiI2AddCor "InjCrv_PiI2AddCor" /begin SUB_GROUP Root_InjCrv_PiIQntAddCorEOM1 Root_InjCrv_PiISOEAddCorEOM1 /end SUB_GROUP /end GROUP
/begin GROUP Root_InjCrv_PiIQntAddCorEOM1 "InjCrv_PiI2AddCor/InjCrv_PiIQntAddCorEOM" /begin SUB_GROUP S1_InjCrv_qPiI1Strt1 /end SUB_GROUP /end GROUP
/begin GROUP Root_InjCrv_PiISOEAddCorEOM1 "InjCrv_PiI2AddCor/InjCrv_PiISOEAddCorEOM" /begin SUB_GROUP S2_InjCrv_phiPiI1Strt1 S2_InjCrv_tiPiI1Strt1 /end SUB_GROUP /end GROUP
/begin GROUP S1_InjCrv_qPiI1Strt1 "InjCrv_PiI2AddCor/InjCrv_PiIQntAddCorEOM/InjCrv_qPiI1Strt" /begin REF_CHARACTERISTIC InjCrv_qPiI2StrtBase_MAP /end REF_CHARACTERISTIC /begin REF_MEASUREMENT InjCrv_qPiI2StrtBase_mp InjCrv_qPiI2Strt_mp /end REF_MEASUREMENT /end GROUP
/begin GROUP S2_InjCrv_phiPiI1Strt1 "InjCrv_PiI2AddCor/InjCrv_PiISOEAddCorEOM/InjCrv_phiPiI1Strt" /begin REF_CHARACTERISTIC InjCrv_phiPiI2StrtBase_MAP /end REF_CHARACTERISTIC /begin REF_MEASUREMENT InjCrv_phiPiI2StrtBase_mp InjCrv_phiPiI2Strt_mp /end REF_MEASUREMENT /end GROUP
/begin GROUP S2_InjCrv_tiPiI1Strt1 "InjCrv_PiI2AddCor/InjCrv_PiISOEAddCorEOM/InjCrv_tiPiI1Strt" /begin REF_CHARACTERISTIC InjCrv_tiPiI2StrtBase_MAP /end REF_CHARACTERISTIC /begin REF_MEASUREMENT InjCrv_tiPiI2StrtBase_mp InjCrv_tiPiI2Strt_mp /end REF_MEASUREMENT /end GROUP
/begin GROUP InjCrv_PiI2Cor "InjCrv_PiI2Cor" /begin SUB_GROUP Root_InjCrv_PiIQntCor1 Root_InjCrv_PiISOECor1 /end SUB_GROUP /end GROUP
/begin GROUP Root_InjCrv_PiIQntCor1 "InjCrv_PiI2Cor/InjCrv_PiIQntCor" /begin SUB_GROUP S1_Correction_Calculation1 S1_Weight_Factor1 /end SUB_GROUP /end GROUP
/begin GROUP Root_InjCrv_PiISOECor1 "InjCrv_PiI2Cor/InjCrv_PiISOECor" /begin SUB_GROUP S2_Correction_Calculation1 S2_Weight_Factor1 /end SUB_GROUP /end GROUP
/begin GROUP S1_Correction_Calculation1 "InjCrv_PiI2Cor/InjCrv_PiIQntCor/Correction Calculation"
 /begin REF_CHARACTERISTIC InjCrv_qPiI2APSCor1EOM0_MAP InjCrv_qPiI2ATSCor1EOM0_MAP InjCrv_qPiI2ETSCor1EOM0_MAP /end REF_CHARACTERISTIC
 /begin REF_MEASUREMENT InjCrv_qPiI2APSCor1_mp InjCrv_qPiI2ATSCor1_mp InjCrv_qPiI2ETSCor1_mp /end REF_MEASUREMENT
/end GROUP
/begin GROUP S1_Weight_Factor1 "InjCrv_PiI2Cor/InjCrv_PiIQntCor/Weight Factor"
 /begin REF_CHARACTERISTIC InjCrv_facPiI2APSQCor1EOM0_CUR InjCrv_facPiI2ATSQCor1EOM0_CUR InjCrv_facPiI2ETSQCor1EOM0_CUR /end REF_CHARACTERISTIC
 /begin REF_MEASUREMENT InjCrv_facPiI2QAPSCor1 InjCrv_facPiI2QATSCor1 InjCrv_facPiI2QETSCor1 /end REF_MEASUREMENT
/end GROUP
/begin GROUP S2_Correction_Calculation1 "InjCrv_PiI2Cor/InjCrv_PiISOECor/Correction Calculation"
 /begin REF_CHARACTERISTIC InjCrv_phiPiI2APSCor1EOM0_MAP InjCrv_phiPiI2ATSCor1EOM0_MAP InjCrv_phiPiI2ETSCor1EOM0_MAP InjCrv_tiPiI2APSCor1EOM0_MAP InjCrv_tiPiI2ATSCor1EOM0_MAP InjCrv_tiPiI2ETSCor1EOM0_MAP /end REF_CHARACTERISTIC
 /begin REF_MEASUREMENT InjCrv_phiPiI2APSCor1_mp InjCrv_phiPiI2ATSCor1_mp InjCrv_phiPiI2ETSCor1_mp InjCrv_tiPiI2APSCor1_mp InjCrv_tiPiI2ATSCor1_mp InjCrv_tiPiI2ETSCor1_mp /end REF_MEASUREMENT
/end GROUP
/begin GROUP S2_Weight_Factor1 "InjCrv_PiI2Cor/InjCrv_PiISOECor/Weight Factor"
 /begin REF_CHARACTERISTIC InjCrv_facPiI2APSSOECor1EOM0_CUR InjCrv_facPiI2ATSSOECor1EOM0_CUR InjCrv_facPiI2ETSSOECor1EOM0_CUR /end REF_CHARACTERISTIC
 /begin REF_MEASUREMENT InjCrv_facPiI2SOEAPSCor1 InjCrv_facPiI2SOEATSCor1 InjCrv_facPiI2SOEETSCor1 /end REF_MEASUREMENT
/end GROUP
/begin GROUP InjCrv_PiI2Set "InjCrv_PiI2Set" /begin SUB_GROUP Root_InjCrv_PiIQntBase1 Root_InjCrv_PiISOEBase1 /end SUB_GROUP /end GROUP
/begin GROUP Root_InjCrv_PiIQntBase1 "InjCrv_PiI2Set/InjCrv_PiIQntBase" /begin REF_CHARACTERISTIC InjCrv_qPiI2Bas1EOM0_MAP /end REF_CHARACTERISTIC /end GROUP
/begin GROUP Root_InjCrv_PiISOEBase1 "InjCrv_PiI2Set/InjCrv_PiISOEBase" /begin REF_CHARACTERISTIC InjCrv_phiPiI2Bas1EOM0_MAP InjCrv_tiPiI2Bas1EOM0_MAP /end REF_CHARACTERISTIC /end GROUP
/begin GROUP InjCrv_PoI2 "InjCrv_PoI2" /begin SUB_GROUP Root_InjCrv_PoI2SOELim /end SUB_GROUP /begin REF_CHARACTERISTIC InjCrv_phiPoI2MaxEOMX_MAP /end REF_CHARACTERISTIC /end GROUP
/begin GROUP Root_InjCrv_PoI2SOELim "InjCrv_PoI2/InjCrv_PoI2SOELim" /begin SUB_GROUP S1_Angle2Time S1_Angle2Time1 /end SUB_GROUP /begin REF_CHARACTERISTIC InjCrv_phiPoIMin_C /end REF_CHARACTERISTIC
 /begin REF_MEASUREMENT InjCrv_phiPoI2AbsMax_mp InjCrv_phiPoI2Lim_mp InjCrv_stPoI2 InjCrv_tiPoI2Lim_mp /end REF_MEASUREMENT
/end GROUP
/begin GROUP S1_Angle2Time "InjCrv_PoI2/InjCrv_PoI2SOELim/Angle2Time" /begin REF_MEASUREMENT InjCrv_tiPoI2Max_mp /end REF_MEASUREMENT /end GROUP
/begin GROUP S1_Angle2Time1 "InjCrv_PoI2/InjCrv_PoI2SOELim/Angle2Time1" /begin REF_MEASUREMENT InjCrv_tiPoI2Min_mp /end REF_MEASUREMENT /end GROUP
/begin GROUP InjCrv_PoI2AddCor "InjCrv_PoI2AddCor" /begin SUB_GROUP Root_InjCrv_PoI2AddCor Root_InjCrv_PoI2QntFMTC /end SUB_GROUP
 /begin REF_CHARACTERISTIC InjCrv_phiPoI2_C InjCrv_qPoI2Eff_C InjCrv_qPoI2_C InjCrv_swtPoI2Phi_C InjCrv_swtPoI2QEff_C InjCrv_swtPoI2Q_C InjCrv_swtPoI2Ti_C InjCrv_tiPoI2_C /end REF_CHARACTERISTIC
 /begin REF_MEASUREMENT InjCrv_qPoI2EffDes InjCrv_qPoI2EffSet InjCrv_qPoI2Set /end REF_MEASUREMENT
/end GROUP
/begin GROUP Root_InjCrv_PoI2AddCor "InjCrv_PoI2AddCor/InjCrv_PoI2AddCor" /begin SUB_GROUP S2_InjCrv_PoI2QntAddCorEOM S2_InjCrv_PoI2SOESetEOM /end SUB_GROUP /end GROUP
/begin GROUP Root_InjCrv_PoI2QntFMTC "InjCrv_PoI2AddCor/InjCrv_PoI2QntFMTC" /begin REF_CHARACTERISTIC InjCrv_swtPoI2FMTC_C /end REF_CHARACTERISTIC /end GROUP
/begin GROUP S2_InjCrv_PoI2QntAddCorEOM "InjCrv_PoI2AddCor/InjCrv_PoI2AddCor/InjCrv_PoI2QntAddCorEOM" /begin REF_CHARACTERISTIC ETCtl_qPoI2_C InjCrv_swtPoI2ETCtl_C /end REF_CHARACTERISTIC /end GROUP
/begin GROUP S2_InjCrv_PoI2SOESetEOM "InjCrv_PoI2AddCor/InjCrv_PoI2AddCor/InjCrv_PoI2SOESetEOM" /begin SUB_GROUP S6_InjCrv_PoI2AgAddCorEOM S6_InjCrv_PoI2TiAddCorEOM /end SUB_GROUP /end GROUP
/begin GROUP S6_InjCrv_PoI2AgAddCorEOM "InjCrv_PoI2AddCor/InjCrv_PoI2AddCor/InjCrv_PoI2SOESetEOM/InjCrv_PoI2AgAddCorEOM" /begin REF_CHARACTERISTIC InjCrv_phiAddCorRmt_C InjCrv_swtPhiAddCorRmt_C /end REF_CHARACTERISTIC /end GROUP
/begin GROUP S6_InjCrv_PoI2TiAddCorEOM "InjCrv_PoI2AddCor/InjCrv_PoI2AddCor/InjCrv_PoI2SOESetEOM/InjCrv_PoI2TiAddCorEOM" /begin REF_CHARACTERISTIC InjCrv_swtTiAddCorRmt_C InjCrv_tiAddCorRmt_C /end REF_CHARACTERISTIC /end GROUP
/begin GROUP InjCrv_PoI2Cor "InjCrv_PoI2Cor"
 /begin SUB_GROUP Root_Angle_corrections_and_Time_corrections Root_Quantity_corrections Root_Weight_Factor_for_angle_and_time Root_Weight_Factor_for_quantity /end SUB_GROUP
/end GROUP
/begin GROUP Root_Angle_corrections_and_Time_corrections "InjCrv_PoI2Cor/Angle corrections and Time corrections"
 /begin REF_CHARACTERISTIC InjCrv_phiPoI2APSCorEOM_MAP InjCrv_phiPoI2ATSCorEOM_MAP InjCrv_phiPoI2ETSCorEOM_MAP InjCrv_tiPoI2APSCorEOM_MAP InjCrv_tiPoI2ATSCorEOM_MAP InjCrv_tiPoI2ETSCorEOM_MAP /end REF_CHARACTERISTIC
 /begin REF_MEASUREMENT InjCrv_phiPoI2APSCor_mp InjCrv_phiPoI2ATSCor_mp InjCrv_phiPoI2ETSCor_mp InjCrv_tiPoI2APSCor_mp InjCrv_tiPoI2ATSCor_mp InjCrv_tiPoI2ETSCor_mp /end REF_MEASUREMENT
/end GROUP
/begin GROUP Root_Quantity_corrections "InjCrv_PoI2Cor/Quantity corrections"
 /begin REF_CHARACTERISTIC InjCrv_qPoI2APSCorEOM_MAP InjCrv_qPoI2ATSCorEOM_MAP InjCrv_qPoI2ETSCorEOM_MAP /end REF_CHARACTERISTIC
 /begin REF_MEASUREMENT InjCrv_qPoI2APSCor_mp InjCrv_qPoI2ATSCor_mp InjCrv_qPoI2ETSCor_mp /end REF_MEASUREMENT
/end GROUP
/begin GROUP Root_Weight_Factor_for_angle_and_time "InjCrv_PoI2Cor/Weight Factor for angle and time"
 /begin REF_CHARACTERISTIC InjCrv_facPoI2APSSOECorEOM_CUR InjCrv_facPoI2ATSSOECorEOM_CUR InjCrv_facPoI2ETSSOECorEOM_CUR /end REF_CHARACTERISTIC
 /begin REF_MEASUREMENT InjCrv_facPoI2SOEAPSCor InjCrv_facPoI2SOEATSCor InjCrv_facPoI2SOEETSCor /end REF_MEASUREMENT
/end GROUP
/begin GROUP Root_Weight_Factor_for_quantity "InjCrv_PoI2Cor/Weight Factor for quantity"
 /begin REF_CHARACTERISTIC InjCrv_facPoI2APSQCorEOM_CUR InjCrv_facPoI2ATSQCorEOM_CUR InjCrv_facPoI2ETSQCorEOM_CUR /end REF_CHARACTERISTIC
 /begin REF_MEASUREMENT InjCrv_facPoI2QAPSCor InjCrv_facPoI2QATSCor InjCrv_facPoI2QETSCor /end REF_MEASUREMENT
/end GROUP
/begin GROUP InjCrv_PoI2Set "InjCrv_PoI2Set"
 /begin REF_CHARACTERISTIC InjCrv_facPoI2EffEOM_MAP InjCrv_phiPoI2BasEOM_MAP InjCrv_qPoI2BasEOM_MAP InjCrv_tiPoI2BasEOM_MAP /end REF_CHARACTERISTIC
/end GROUP
/begin GROUP InjCtl_qCo "InjCtl_qCo" /begin SUB_GROUP Root_time_synchronous /end SUB_GROUP /end GROUP
/begin GROUP Root_time_synchronous "InjCtl_qCo/time_synchronous" /begin REF_CHARACTERISTIC FMA_qCor_C FMO_qCor_C InjCtl_swtDiffQntIn_C /end REF_CHARACTERISTIC /end GROUP
/begin GROUP InjSys_Co "InjSys_Co"
 /begin REF_CHARACTERISTIC InjSys_ctAirTempSel_C InjSys_ctEngTempSel_C Rail_ctAirTempSel_C /end REF_CHARACTERISTIC
/end GROUP
/begin GROUP HPUn_Co "HPUn_Co" /begin SUB_GROUP Root_Pump_Torque_Loss Root_Pump_Volume_Flow_ /end SUB_GROUP /end GROUP
/begin GROUP Root_Pump_Torque_Loss "HPUn_Co/Pump_Torque_Loss" /begin REF_CHARACTERISTIC HPUn_dvolMeUnMax_C HPUn_etaPmpMech_C HPUn_nMin_C /end REF_CHARACTERISTIC /begin REF_MEASUREMENT HPUn_dvolPmpMax_mp HPUn_trqPmp_mp /end REF_MEASUREMENT /end GROUP
/begin GROUP Root_Pump_Volume_Flow_ "HPUn_Co/Pump_Volume_Flow "
 /begin REF_CHARACTERISTIC HPUn_dvolPmpTolc_CUR HPUn_etaPmpFlTemp_CUR HPUn_etaPmp_MAP HPUn_rTransCrS_C HPUn_volPmp_C /end REF_CHARACTERISTIC
 /begin REF_MEASUREMENT HPUn_dvolPmpTolc_mp HPUn_dvolPmp_mp HPUn_etaPmpFlTemp_mp HPUn_etaPmp_mp HPUn_nPmp_mp /end REF_MEASUREMENT
/end GROUP
/begin GROUP HPUn_QntBalInjLim "HPUn_QntBalInjLim"
 /begin REF_CHARACTERISTIC HPUn_facPresDvtFlt_C HPUn_numInjMin_C HPUn_pRailDvtOk_C HPUn_tiQntBalDel_C InjCrv_numInjMaxSys_C /end REF_CHARACTERISTIC
 /begin REF_MEASUREMENT HPUn_pRailDvtFlt_mp HPUn_stQntBal_mp HPUn_tiQntBalDel_mp /end REF_MEASUREMENT
/end GROUP
/begin GROUP Rail_BlkShtCtl "Rail_BlkShtCtl" /begin SUB_GROUP Root_Rail_pressure_reduction_by_Blankshots /end SUB_GROUP /end GROUP
/begin GROUP Root_Rail_pressure_reduction_by_Blankshots "Rail_BlkShtCtl/Rail pressure reduction by Blankshots"
 /begin REF_CHARACTERISTIC Rail_dfrqBlkShtCntDn_C Rail_dfrqBlkShtCntUp_CUR Rail_frqBlkShtDeflate_C Rail_frqBlkShtMax_MAP Rail_frqBlkShtPreCtl_MAP Rail_frqBlkShtThres_C Rail_pBlkShtDeflateHi_C Rail_pBlkShtDeflateLo_C Rail_pBlkShtMax_C Rail_pDvtBlkShtCntDn_C Rail_pDvtBlkShtCntUpHiLim_C Rail_pDvtBlkShtCntUpLoLim_C Rail_qBlkShtStart_C Rail_stCtlBlkShtDeflate_C Rail_stCtlBlkShtOvr_C Rail_swtPh1Byp_C Rail_tiBlkShtCntDn_C Rail_tiBlkShtCntUp_C Rail_tiBlkShtDeflate_C /end REF_CHARACTERISTIC
/end GROUP
/begin GROUP Rail_CtlLoop "Rail_CtlLoop" /begin SUB_GROUP Root_Control_Loop_Calculation Root_Governor_Calculation /end SUB_GROUP /end GROUP
/begin GROUP Root_Control_Loop_Calculation "Rail_CtlLoop/Control_Loop_Calculation" /begin SUB_GROUP S2_Get_Rotation_Number /end SUB_GROUP
 /begin REF_CHARACTERISTIC FlSys_stDeflate_C Rail_nCloseCtl_C Rail_nOpnCtl_C Rail_nStrtLoPress_C Rail_numRevPlaus_C Rail_pCloseCtl_C Rail_pDiffCloseCtl_C Rail_pOpnCtl_C Rail_swtPress_C /end REF_CHARACTERISTIC
/end GROUP
/begin GROUP Root_Governor_Calculation "Rail_CtlLoop/Governor_Calculation" /begin SUB_GROUP S4_DT1_S16 /end SUB_GROUP
 /begin REF_CHARACTERISTIC Rail_dvolMeUnCtlInitI_CUR Rail_dvolMeUnCtlLoLim_C Rail_dvolOff_C Rail_dvolPRVCtlOfs_C Rail_dvolStrt_MAP Rail_nMeUnFrzI_C Rail_pDvtFltMin_C Rail_pMeUnCtlIWinNeg_C Rail_pMeUnCtlIWinPos_C Rail_pMeUnCtlPWinNeg_C Rail_pMeUnCtlPWinPos_C Rail_stCtlLoopSel_C Rail_tiFrzIDel_C /end REF_CHARACTERISTIC
 /begin REF_MEASUREMENT Rail_dvolMeUnCtlI_mp Rail_dvolMeUnCtlLim_mp Rail_dvolMeUnCtlPID_mp Rail_dvolMeUnCtlP_mp Rail_dvolMeUnCtl_mp Rail_dvolPRVCtlSet_mp Rail_pDvtFltLim_mp Rail_pPT1Flt_mp /end REF_MEASUREMENT
/end GROUP
/begin GROUP S2_Get_Rotation_Number "Rail_CtlLoop/Control_Loop_Calculation/Get Rotation Number" /begin SUB_GROUP S6_If_Action_Subsystem /end SUB_GROUP /begin REF_MEASUREMENT Rail_numRevPlaus_mp /end REF_MEASUREMENT /end GROUP
/begin GROUP S4_DT1_S16 "Rail_CtlLoop/Governor_Calculation/DT1_S16" /begin SUB_GROUP S8_Function_Call_Subsystem1 /end SUB_GROUP /end GROUP
/begin GROUP S6_If_Action_Subsystem "Rail_CtlLoop/Control_Loop_Calculation/Get Rotation Number/If Action Subsystem" /begin REF_MEASUREMENT Rail_numRevFrzl_mp /end REF_MEASUREMENT /end GROUP
/begin GROUP S8_Function_Call_Subsystem1 "Rail_CtlLoop/Governor_Calculation/DT1_S16/Function-Call Subsystem1" /begin REF_MEASUREMENT Rail_dvolMeUnCtlDT1_mp /end REF_MEASUREMENT /end GROUP
/begin GROUP Rail_CtlLoopLimMeUn "Rail_CtlLoopLimMeUn" /begin REF_CHARACTERISTIC Rail_dvolMeUnCtlUpLim_C Rail_dvolMeUnCtlUpLim_CUR /end REF_CHARACTERISTIC /end GROUP
/begin GROUP Rail_CtlLoopParaMeUn "Rail_CtlLoopParaMeUn"
 /begin REF_CHARACTERISTIC Rail_MeUnCtlDKd_CUR Rail_MeUnCtlIKiNeg_CUR Rail_MeUnCtlIKiPos_CUR Rail_MeUnCtlIKi_CUR Rail_MeUnCtlPKpNeg_CUR Rail_MeUnCtlPKpPos_CUR Rail_MeUnCtlPKp_CUR Rail_facMeUnCtlDCor_CUR Rail_facMeUnCtlICor_CUR Rail_facMeUnCtlPCor_CUR Rail_facMeUnCtlPT1_CUR Rail_facOvrMeUnNegIncr_C Rail_pOvrMeUnThresHigh_C Rail_pOvrMeUnThresLow_C Rail_tiMeUnCtlDT1_CUR /end REF_CHARACTERISTIC
 /begin REF_MEASUREMENT Rail_facMeUnCtlDCor_mp Rail_facMeUnCtlICor_mp Rail_facMeUnCtlPCor_mp /end REF_MEASUREMENT
/end GROUP
/begin GROUP Rail_MonMeUn "Rail_MonMeUn"
 /begin SUB_GROUP Root_RailMeUn0 Root_RailMeUn10 Root_RailMeUn2 Root_RailMeUn22 Root_RailMeUn3 Root_RailMeUn4 Root_RailMeUn42 Root_RailMeUn7 Root_RailMeUn8 /end SUB_GROUP
/end GROUP
/begin GROUP Root_RailMeUn0 "Rail_MonMeUn/RailMeUn0" /begin REF_CHARACTERISTIC Rail_pMeUnDvtMax_CUR Rail_stMeUnMonRls_C Rail_tiMeUn0Deb_C /end REF_CHARACTERISTIC /begin REF_MEASUREMENT Rail_pMeUnDvtMax_mp Rail_stMeUnMon0_mp /end REF_MEASUREMENT /end GROUP
/begin GROUP Root_RailMeUn10 "Rail_MonMeUn/RailMeUn10"
 /begin REF_CHARACTERISTIC Rail_dvolMonHPUnTolc_CUR Rail_dvolMonLeakTolc_CUR Rail_pMonDvtMax_C Rail_stMeUnMonRls_C Rail_tiMeUn10Deb_C /end REF_CHARACTERISTIC
 /begin REF_MEASUREMENT Rail_dvolMonHPUnTolc_mp Rail_dvolMonLeakTolc_mp Rail_dvolMonMax_mp Rail_stMeUnMon10_mp /end REF_MEASUREMENT
/end GROUP
/begin GROUP Root_RailMeUn2 "Rail_MonMeUn/RailMeUn2"
 /begin REF_CHARACTERISTIC Rail_dvolMeUnMonSetMin_C Rail_pMeUnDvtMin_CUR Rail_qMeUnMonLoIdl_C Rail_stMeUnMonRls_C Rail_tMeUnMonLoIdl_C Rail_tiMeUn2Deb_C /end REF_CHARACTERISTIC
 /begin REF_MEASUREMENT Rail_pMeUnDvtMin_mp Rail_stMeUnMon2_mp /end REF_MEASUREMENT
/end GROUP
/begin GROUP Root_RailMeUn22 "Rail_MonMeUn/RailMeUn22"
 /begin REF_CHARACTERISTIC Rail_dvolMeUnMonSetMin_C Rail_pMeUnDvtMin2_CUR Rail_qMeUnMonLoIdl_C Rail_stMeUnMonRls_C Rail_tMeUnMonLoIdl_C Rail_tiMeUn22Deb_C /end REF_CHARACTERISTIC
 /begin REF_MEASUREMENT Rail_pMeUnDvtMin2_mp Rail_stMeUnMon22_mp /end REF_MEASUREMENT
/end GROUP
/begin GROUP Root_RailMeUn3 "Rail_MonMeUn/RailMeUn3" /begin REF_CHARACTERISTIC Rail_pMeUnFltMin_CUR Rail_stMeUnMonRls_C Rail_tiMeUn3Deb_C /end REF_CHARACTERISTIC /begin REF_MEASUREMENT Rail_pMeUnFltMin_mp Rail_stMeUnMon3_mp /end REF_MEASUREMENT /end GROUP
/begin GROUP Root_RailMeUn4 "Rail_MonMeUn/RailMeUn4"
 /begin REF_CHARACTERISTIC Rail_pMeUnMonFltMax_C Rail_stMeUnMonRls_C Rail_tiMeUn4Deb_C /end REF_CHARACTERISTIC
 /begin REF_MEASUREMENT Rail_stMeUnMon4_mp /end REF_MEASUREMENT
/end GROUP
/begin GROUP Root_RailMeUn42 "Rail_MonMeUn/RailMeUn42"
 /begin REF_CHARACTERISTIC Rail_pMeUnMonFltMax2_C Rail_stMeUnMonRls_C Rail_tiMeUn42Deb_C /end REF_CHARACTERISTIC
 /begin REF_MEASUREMENT Rail_stMeUnMon42_mp /end REF_MEASUREMENT
/end GROUP
/begin GROUP Root_RailMeUn7 "Rail_MonMeUn/RailMeUn7"
 /begin REF_CHARACTERISTIC Rail_dvolMeUnOvrRun_CUR Rail_stMeUnMonRls_C Rail_tiMeUn7Deb_C /end REF_CHARACTERISTIC
 /begin REF_MEASUREMENT Rail_dvolMeUnOvrRun_mp Rail_stMeUnMon7_mp /end REF_MEASUREMENT
/end GROUP
/begin GROUP Root_RailMeUn8 "Rail_MonMeUn/RailMeUn8"
 /begin REF_CHARACTERISTIC Rail_dvolMonIdlMax_C Rail_nMonIdlMax_C Rail_qMonUnBalMax_C Rail_stMeUnMonRls_C Rail_tiMeUn8Deb_C /end REF_CHARACTERISTIC
 /begin REF_MEASUREMENT Rail_stMeUnMon8_mp /end REF_MEASUREMENT
/end GROUP
/begin GROUP Rail_PreCtlMeUn "Rail_PreCtlMeUn"
 /begin SUB_GROUP Root_Governor_Precontrol Root_Injection_And_Control_Quantity Root_Leakage /end SUB_GROUP
/end GROUP
/begin GROUP Root_Governor_Precontrol "Rail_PreCtlMeUn/Governor_Precontrol" /begin SUB_GROUP S1_DT1_S161 S1_q2dvol /end SUB_GROUP
 /begin REF_CHARACTERISTIC Rail_PreCtlDynKd_C Rail_facPreCtlMeUnCor_MAP Rail_qPreCtlDynDiffMin_C Rail_tiPreCtlDynT1_C /end REF_CHARACTERISTIC
 /begin REF_MEASUREMENT Rail_facPreCtlMeUnCor_mp Rail_qPreCtlDynLim_mp /end REF_MEASUREMENT
/end GROUP
/begin GROUP Root_Injection_And_Control_Quantity "Rail_PreCtlMeUn/Injection_And_Control_Quantity" /begin SUB_GROUP S2_q2dvol S2_q2dvol1 /end SUB_GROUP
 /begin REF_CHARACTERISTIC Rail_facDemInjCtlMax_C Rail_numInjSum_C Rail_qDemInjCtlMaxOfs_C Rail_qDemInjCtl_CUR Rail_swtDemInjSel_C /end REF_CHARACTERISTIC
 /begin REF_MEASUREMENT Rail_dvolDemInjMax Rail_dvolDemInjNom Rail_qDemInjCtlMI1_mp Rail_qDemInjCtlMax_mp Rail_qDemInjCtlNom_mp Rail_qDemInjCtlPiI1_mp Rail_qDemInjCtlPiI2_mp Rail_qDemInjCtlPoI2_mp Rail_qDemInj_mp /end REF_MEASUREMENT
/end GROUP
/begin GROUP Root_Leakage "Rail_PreCtlMeUn/Leakage"
 /begin REF_CHARACTERISTIC PCV_dvolLeak_C Rail_dvolLeak_CUR Rail_facLeakEngOn_CUR Rail_facLeakTempCor_CUR /end REF_CHARACTERISTIC
 /begin REF_MEASUREMENT Rail_dvolLeak Rail_dvolLeakCyl_mp Rail_facLeakAged_mp Rail_facLeakTempCor_mp Rail_tiLeakEngOn_mp /end REF_MEASUREMENT
/end GROUP
/begin GROUP S1_DT1_S161 "Rail_PreCtlMeUn/Governor_Precontrol/DT1_S16" /begin SUB_GROUP S4_Function_Call_Subsystem1 /end SUB_GROUP /end GROUP
/begin GROUP S1_q2dvol "Rail_PreCtlMeUn/Governor_Precontrol/q2dvol" /begin REF_MEASUREMENT Rail_dvolPreCtlDyn_mp /end REF_MEASUREMENT /end GROUP
/begin GROUP S4_Function_Call_Subsystem1 "Rail_PreCtlMeUn/Governor_Precontrol/DT1_S16/Function-Call Subsystem1" /begin REF_MEASUREMENT Rail_qPreCtlDyn_mp /end REF_MEASUREMENT /end GROUP
/begin GROUP Rail_PresPeakLim "Rail_PresPeakLim" /begin REF_CHARACTERISTIC Rail_qCorPresPeakLim_C /end REF_CHARACTERISTIC /end GROUP
/begin GROUP Rail_SetPoint "Rail_SetPoint"
 /begin SUB_GROUP Root_Rail_PresSetPErrLoLim Root_Rail_PresSetPSubs Root_Rail_PresSetPSubsLim Root_Rail_SetPointBase_WithCor Root_Rail_SetPoint_FlTempLim Root_Rail_pSetPointLim Root_pMaxLim Root_pMinLim /end SUB_GROUP
 /begin REF_CHARACTERISTIC Rail_swtDynLim_C /end REF_CHARACTERISTIC
/end GROUP
/begin GROUP Root_Rail_PresSetPErrLoLim "Rail_SetPoint/Rail_PresSetPErrLoLim" /begin REF_CHARACTERISTIC Rail_pSetPointErrLoLim_CUR /end REF_CHARACTERISTIC /begin REF_MEASUREMENT Rail_dvolPCVFlw_mp Rail_pSetPointErrLim_mp /end REF_MEASUREMENT /end GROUP
/begin GROUP Root_Rail_PresSetPSubs "Rail_SetPoint/Rail_PresSetPSubs" /begin REF_CHARACTERISTIC SigTst_pSetPoint_C SigTst_swtSetPoint_C /end REF_CHARACTERISTIC /begin REF_MEASUREMENT Rail_pSetPointOut_mp /end REF_MEASUREMENT /end GROUP
/begin GROUP Root_Rail_PresSetPSubsLim "Rail_SetPoint/Rail_PresSetPSubsLim" /begin REF_MEASUREMENT Rail_pSetPointSubsLim_mp /end REF_MEASUREMENT /end GROUP
/begin GROUP Root_Rail_SetPointBase_WithCor "Rail_SetPoint/Rail_SetPointBase_WithCor" /begin REF_CHARACTERISTIC Rail_pSetPointBasEOM0_MAP /end REF_CHARACTERISTIC /begin REF_MEASUREMENT Rail_pSetPointBase_mp Rail_pSetPointCor_mp /end REF_MEASUREMENT /end GROUP
/begin GROUP Root_Rail_SetPoint_FlTempLim "Rail_SetPoint/Rail_SetPoint_FlTempLim" /begin REF_CHARACTERISTIC Rail_pSetPointLimNFlTemp_MAP Rail_pSetPointRed_C /end REF_CHARACTERISTIC
 /begin REF_MEASUREMENT Rail_pSetPointFlTempLim_mp Rail_pSetPointFlTempRedLim Rail_pSetPointLimNFlTemp_mp /end REF_MEASUREMENT
/end GROUP
/begin GROUP Root_Rail_pSetPointLim "Rail_SetPoint/Rail_pSetPointLim" /begin REF_CHARACTERISTIC Rail_swtStatLim_C /end REF_CHARACTERISTIC /begin REF_MEASUREMENT Rail_pSetPointLim_mp /end REF_MEASUREMENT /end GROUP
/begin GROUP Root_pMaxLim "Rail_SetPoint/pMaxLim"
 /begin REF_CHARACTERISTIC Rail_dpSetPointIncLim_MAP Rail_dpSetPointInc_MAP Rail_pEnvpSetPointIncHi_C Rail_pEnvpSetPointIncLo_C Rail_swtIncLim_C Rail_swtqIncSel_C /end REF_CHARACTERISTIC
 /begin REF_MEASUREMENT Rail_dpSetPointInc Rail_dpSetPointIncLim_mp Rail_dpSetPointInc_mp Rail_pSetPointDynMax_mp Rail_pSetPointInc_mp /end REF_MEASUREMENT
/end GROUP
/begin GROUP Root_pMinLim "Rail_SetPoint/pMinLim"
 /begin REF_CHARACTERISTIC Rail_dpSetPointDec_CUR Rail_dpSetPointDec_MAP Rail_swtPSetPointSrc_C /end REF_CHARACTERISTIC
 /begin REF_MEASUREMENT Rail_dpSetPointDec Rail_pSetPointDynMin_mp /end REF_MEASUREMENT
/end GROUP
/begin GROUP Rail_SetPointAddCor "Rail_SetPointAddCor"
 /begin REF_CHARACTERISTIC Rail_facSetPointFTSCor_CUR Rail_pSetPointFTSCor_MAP Rail_pSetPointMaxDef_C Rail_pSetPointMax_MAP Rail_pSetPointMinDef_C Rail_pSetPointMin_MAP Rail_pSetPointTolcMin_C /end REF_CHARACTERISTIC
/end GROUP
/begin GROUP Rail_SetPointCor "Rail_SetPointCor" /begin SUB_GROUP Root_Correction_Calculation1 Root_Weight_Factor1 /end SUB_GROUP /end GROUP
/begin GROUP Root_Correction_Calculation1 "Rail_SetPointCor/Correction Calculation"
 /begin REF_CHARACTERISTIC Rail_pSetPointAPSCor_MAP Rail_pSetPointATSCor_MAP Rail_pSetPointETSCor_MAP /end REF_CHARACTERISTIC
 /begin REF_MEASUREMENT Rail_pSetPointAPSCor_mp Rail_pSetPointATSCor_mp Rail_pSetPointETSCor_mp /end REF_MEASUREMENT
/end GROUP
/begin GROUP Root_Weight_Factor1 "Rail_SetPointCor/Weight Factor"
 /begin REF_CHARACTERISTIC Rail_facSetPointAPSCor_CUR Rail_facSetPointATSCor_CUR Rail_facSetPointETSCor_CUR /end REF_CHARACTERISTIC
 /begin REF_MEASUREMENT Rail_facSetPointAPSCor Rail_facSetPointATSCor Rail_facSetPointETSCor /end REF_MEASUREMENT
/end GROUP
/begin GROUP Rail_TempLim "Rail_TempLim"
 /begin REF_CHARACTERISTIC Rail_facFlPLimFTSCor_CUR Rail_trqFlPLim_MAP Rail_trqFlTempLimMeUn_MAP /end REF_CHARACTERISTIC
 /begin REF_MEASUREMENT Rail_facFlPLimFTSCor_mp Rail_trqFlPLimCor_mp Rail_trqFlPLim_mp Rail_trqFlTempLim_mp /end REF_MEASUREMENT
/end GROUP
/begin GROUP StSys_AddCor "StSys_AddCor" /begin SUB_GROUP Root_StSys_AddCor /end SUB_GROUP /end GROUP
/begin GROUP Root_StSys_AddCor "StSys_AddCor/StSys_AddCor" /begin REF_CHARACTERISTIC StSys_facStrtAPS_CUR StSys_trqStrtAPS_MAP /end REF_CHARACTERISTIC /end GROUP
/begin GROUP StSys_Strt "StSys_Strt" /begin REF_CHARACTERISTIC StSys_nStrtCutOut_MAP StSys_tiStrtCutOut_C /end REF_CHARACTERISTIC /begin REF_MEASUREMENT StSys_nThresStrtCutOut_mp /end REF_MEASUREMENT /end GROUP
/begin GROUP StSys_StrtBas "StSys_StrtBas" /begin REF_CHARACTERISTIC StSys_nAdjMax_C StSys_trqAdjMax_C StSys_trqStrtBas_MAP /end REF_CHARACTERISTIC /begin REF_MEASUREMENT StSys_trqAdj_mp StSys_trqStrtBas_mp /end REF_MEASUREMENT /end GROUP
/begin GROUP StSys_StrtCtl "StSys_StrtCtl" /begin SUB_GROUP Root_StSys_StrtCtl /end SUB_GROUP /end GROUP
/begin GROUP Root_StSys_StrtCtl "StSys_StrtCtl/StSys_StrtCtl"
 /begin SUB_GROUP S1_Processing_of_End_or_Abort_Conditions S1_Processing_of_StSys_stGlobCheck S1_Processing_of_StSys_stStrtReq S1_Processing_of_StSys_stValidReq S1_activate_or_deactivate_the_Starter S1_various_enable_or_disable_conditions /end SUB_GROUP
/end GROUP
/begin GROUP S1_Processing_of_End_or_Abort_Conditions "StSys_StrtCtl/StSys_StrtCtl/Processing of End or Abort Conditions"
 /begin REF_CHARACTERISTIC StSys_nBlnd_C StSys_nThresCalc_CUR StSys_stCondActv_C StSys_stCondDeactv_C StSys_tiBlnd_C StSys_tiStrtON_C StSys_vEngCompStrt_C /end REF_CHARACTERISTIC
 /begin REF_MEASUREMENT StSys_stAbort_mp /end REF_MEASUREMENT
/end GROUP
/begin GROUP S1_Processing_of_StSys_stGlobCheck "StSys_StrtCtl/StSys_StrtCtl/Processing of StSys_stGlobCheck" /begin REF_CHARACTERISTIC StSys_stCondActv_C StSys_stCondDeactv_C /end REF_CHARACTERISTIC /begin REF_MEASUREMENT StSys_stGlobCheck_mp /end REF_MEASUREMENT /end GROUP
/begin GROUP S1_Processing_of_StSys_stStrtReq "StSys_StrtCtl/StSys_StrtCtl/Processing of StSys_stStrtReq" /begin REF_MEASUREMENT StSys_stStrtReq_mp /end REF_MEASUREMENT /end GROUP
/begin GROUP S1_Processing_of_StSys_stValidReq "StSys_StrtCtl/StSys_StrtCtl/Processing of StSys_stValidReq" /begin REF_CHARACTERISTIC StSys_stCondActv_C /end REF_CHARACTERISTIC /begin REF_MEASUREMENT StSys_stValidReq_mp /end REF_MEASUREMENT /end GROUP
/begin GROUP S1_activate_or_deactivate_the_Starter "StSys_StrtCtl/StSys_StrtCtl/activate or deactivate the Starter" /begin REF_MEASUREMENT StSys_stSrcReq_mp /end REF_MEASUREMENT /end GROUP
/begin GROUP S1_various_enable_or_disable_conditions "StSys_StrtCtl/StSys_StrtCtl/various enable or disable conditions"
 /begin SUB_GROUP S7_Processing_of_Enable_or_disable_conditions_for_T50CAN S7_Processing_of_Enable_or_disable_conditions_for_T50EMGCY S7_Processing_of_Enable_or_disable_conditions_for_T50NRM /end SUB_GROUP
 /begin REF_CHARACTERISTIC StSys_stSelectT50CAN_C StSys_stSelectT50EMGCY_C StSys_stSelectT50NRM_C /end REF_CHARACTERISTIC
/end GROUP
/begin GROUP S7_Processing_of_Enable_or_disable_conditions_for_T50CAN "StSys_StrtCtl/StSys_StrtCtl/various enable or disable conditions/Processing of Enable or disable conditions for T50CAN"
 /begin REF_CHARACTERISTIC StSys_nThres_C StSys_vThresT50CAN_C Strt_uThresIniMinStrt_C /end REF_CHARACTERISTIC
 /begin REF_MEASUREMENT StSys_stCondT50CAN_mp /end REF_MEASUREMENT
/end GROUP
/begin GROUP S7_Processing_of_Enable_or_disable_conditions_for_T50EMGCY "StSys_StrtCtl/StSys_StrtCtl/various enable or disable conditions/Processing of Enable or disable conditions for T50EMGCY"
 /begin REF_CHARACTERISTIC StSys_nThres_C StSys_vThresT50EMGCY_C Strt_uThresIniMinStrt_C /end REF_CHARACTERISTIC
 /begin REF_MEASUREMENT StSys_stCondT50EMGCY_mp /end REF_MEASUREMENT
/end GROUP
/begin GROUP S7_Processing_of_Enable_or_disable_conditions_for_T50NRM "StSys_StrtCtl/StSys_StrtCtl/various enable or disable conditions/Processing of Enable or disable conditions for T50NRM"
 /begin REF_CHARACTERISTIC StSys_nThres_C StSys_vThresT50NRM_C Strt_uThresIniMinStrt_C /end REF_CHARACTERISTIC
 /begin REF_MEASUREMENT StSys_stCondT50NRM_mp /end REF_MEASUREMENT
/end GROUP
/begin GROUP StSys_StrtRmp "StSys_StrtRmp" /begin SUB_GROUP Root_StSys_StrtRmp /end SUB_GROUP /end GROUP
/begin GROUP Root_StSys_StrtRmp "StSys_StrtRmp/StSys_StrtRmp" /begin REF_CHARACTERISTIC StSys_trqStrtMax_CUR /end REF_CHARACTERISTIC /begin REF_MEASUREMENT StSys_trqStrtMax /end REF_MEASUREMENT /end GROUP
/begin GROUP StSys_TrqShutOff "StSys_TrqShutOff" /begin REF_CHARACTERISTIC StSys_stTrqShutOff_C StSys_trqSetAdjVal_C /end REF_CHARACTERISTIC /end GROUP
/begin GROUP CoME_DemCoord "CoME_DemCoord" /begin SUB_GROUP Root_CoME_DemCoord /end SUB_GROUP /end GROUP
/begin GROUP Root_CoME_DemCoord "CoME_DemCoord/CoME_DemCoord" /begin SUB_GROUP S1_Idle_Speed_Increase_ /end SUB_GROUP /end GROUP
/begin GROUP S1_Idle_Speed_Increase_ "CoME_DemCoord/CoME_DemCoord/Idle_Speed_Increase " /begin SUB_GROUP S2_TipIn S2_Unfiltered /end SUB_GROUP /end GROUP
/begin GROUP S2_TipIn "CoME_DemCoord/CoME_DemCoord/Idle_Speed_Increase /TipIn"
 /begin REF_CHARACTERISTIC CoME_stNReqESS_C CoME_stNReqTSAC_C CoME_stNReqTS_C CoME_stNReqVehMot_C /end REF_CHARACTERISTIC
 /begin REF_MEASUREMENT CoME_nMinTipin_mp /end REF_MEASUREMENT
/end GROUP
/begin GROUP S2_Unfiltered "CoME_DemCoord/CoME_DemCoord/Idle_Speed_Increase /Unfiltered"
 /begin REF_CHARACTERISTIC CoME_stNReqESS_C CoME_stNReqTSAC_C CoME_stNReqTS_C CoME_stNReqVehMot_C /end REF_CHARACTERISTIC
 /begin REF_MEASUREMENT CoME_nMinUnFlt_mp /end REF_MEASUREMENT
/end GROUP
/begin GROUP CoME_ShutOff "CoME_ShutOff" /begin SUB_GROUP Root_CoME_ShutOff /end SUB_GROUP /end GROUP
/begin GROUP Root_CoME_ShutOff "CoME_ShutOff/CoME_ShutOff"
 /begin SUB_GROUP S1_Acceleration S1_AirCondition S1_Alternator S1_Drive_Off_and_Full_Throttle S1_Fan S1_Low_Battery_Voltage S1_Standby_and_Start /end SUB_GROUP
/end GROUP
/begin GROUP S1_Acceleration "CoME_ShutOff/CoME_ShutOff/Acceleration"
 /begin REF_CHARACTERISTIC CoME_drPedHi_C CoME_drPedLo_C CoME_nEng2Hi_C CoME_nEng2Lo_C CoME_pEnv2Hi_C CoME_pEnv2Lo_C CoME_tEnvAir2Hi_C CoME_tEnvAir2Lo_C CoME_vX2Hi_C CoME_vX2Lo_C /end REF_CHARACTERISTIC
 /begin REF_MEASUREMENT CoME_stAcc_mp /end REF_MEASUREMENT
/end GROUP
/begin GROUP S1_AirCondition "CoME_ShutOff/CoME_ShutOff/AirCondition" /begin SUB_GROUP S4_Air_Condition_Timer /end SUB_GROUP
 /begin REF_CHARACTERISTIC CoME_trqACMax_C CoME_trqAcc_C CoME_trqBattVltg_C CoME_trqDrvOff_C CoME_trqStrt_C /end REF_CHARACTERISTIC
/end GROUP
/begin GROUP S1_Alternator "CoME_ShutOff/CoME_ShutOff/Alternator" /begin SUB_GROUP S5_Alternator_Timer /end SUB_GROUP /begin REF_CHARACTERISTIC CoME_stAlt_CW /end REF_CHARACTERISTIC /end GROUP
/begin GROUP S1_Drive_Off_and_Full_Throttle "CoME_ShutOff/CoME_ShutOff/Drive_Off_and_Full_Throttle"
 /begin REF_CHARACTERISTIC CoME_nEng1Hi_C CoME_nEng1Lo_C CoME_numTraGearMax_C CoME_pEnv1Hi_C CoME_pEnv1Lo_C CoME_rPedHi_C CoME_rPedLo_C CoME_tEnvAir1Hi_C CoME_tEnvAir1Lo_C CoME_vX1Hi_C CoME_vX1Lo_C /end REF_CHARACTERISTIC
 /begin REF_MEASUREMENT CoME_stDrvOff_mp /end REF_MEASUREMENT
/end GROUP
/begin GROUP S1_Fan "CoME_ShutOff/CoME_ShutOff/Fan" /begin REF_CHARACTERISTIC CoME_stFan_CW /end REF_CHARACTERISTIC /end GROUP
/begin GROUP S1_Low_Battery_Voltage "CoME_ShutOff/CoME_ShutOff/Low_Battery_Voltage" /begin SUB_GROUP S8_Electrical_Energy /end SUB_GROUP /begin REF_CHARACTERISTIC CoME_uBattMinHi_C CoME_uBattMinLo_C /end REF_CHARACTERISTIC /end GROUP
/begin GROUP S1_Standby_and_Start "CoME_ShutOff/CoME_ShutOff/Standby_and_Start" /begin REF_MEASUREMENT CoME_stStrt_mp /end REF_MEASUREMENT /end GROUP
/begin GROUP S4_Air_Condition_Timer "CoME_ShutOff/CoME_ShutOff/AirCondition/Air_Condition_Timer"
 /begin SUB_GROUP S15_AC_Minimum_Time_On S15_Acceleration_Timer S15_Battery_Voltage_Timer S15_Drive_Off_Timer S15_Start_Timer /end SUB_GROUP
/end GROUP
/begin GROUP S5_Alternator_Timer "CoME_ShutOff/CoME_ShutOff/Alternator/Alternator_Timer" /begin REF_CHARACTERISTIC CoME_tiOffStrtAlt_C /end REF_CHARACTERISTIC /end GROUP
/begin GROUP S8_Electrical_Energy "CoME_ShutOff/CoME_ShutOff/Low_Battery_Voltage/Electrical_Energy" /begin REF_CHARACTERISTIC CoME_stEEM_C /end REF_CHARACTERISTIC /begin REF_MEASUREMENT CoME_stBattVltg_mp /end REF_MEASUREMENT /end GROUP
/begin GROUP S15_AC_Minimum_Time_On "CoME_ShutOff/CoME_ShutOff/AirCondition/Air_Condition_Timer/AC_Minimum_Time_On" /begin REF_CHARACTERISTIC CoME_tiDrvOn_C /end REF_CHARACTERISTIC /begin REF_MEASUREMENT CoME_stDrvTmr_mp /end REF_MEASUREMENT /end GROUP
/begin GROUP S15_Acceleration_Timer "CoME_ShutOff/CoME_ShutOff/AirCondition/Air_Condition_Timer/Acceleration_Timer" /begin SUB_GROUP S17_Acc_Min_Max_Timer /end SUB_GROUP /begin REF_MEASUREMENT CoME_stAccTmr_mp CoME_stOffAcc_mp /end REF_MEASUREMENT /end GROUP
/begin GROUP S15_Battery_Voltage_Timer "CoME_ShutOff/CoME_ShutOff/AirCondition/Air_Condition_Timer/Battery_Voltage_Timer" /begin REF_CHARACTERISTIC CoME_tiBattVltgOff_C /end REF_CHARACTERISTIC /begin REF_MEASUREMENT CoME_stBattVltgTmr_mp /end REF_MEASUREMENT /end GROUP
/begin GROUP S15_Drive_Off_Timer "CoME_ShutOff/CoME_ShutOff/AirCondition/Air_Condition_Timer/Drive_Off_Timer" /begin SUB_GROUP S19_DrvOff_Min_Max_Time /end SUB_GROUP /begin REF_MEASUREMENT CoME_stDrvOffTmr_mp CoME_stOffDrvOff_mp /end REF_MEASUREMENT /end GROUP
/begin GROUP S15_Start_Timer "CoME_ShutOff/CoME_ShutOff/AirCondition/Air_Condition_Timer/Start_Timer" /begin REF_CHARACTERISTIC CoME_tiOffStrtAC_C /end REF_CHARACTERISTIC /begin REF_MEASUREMENT CoME_stStrtTmrAC_mp /end REF_MEASUREMENT /end GROUP
/begin GROUP S17_Acc_Min_Max_Timer "CoME_ShutOff/CoME_ShutOff/AirCondition/Air_Condition_Timer/Acceleration_Timer/Acc_Min_Max_Timer" /begin SUB_GROUP S24_If_Action_Subsystem /end SUB_GROUP /begin REF_MEASUREMENT CoME_stAccMax_mp CoME_stAccMin_mp /end REF_MEASUREMENT /end GROUP
/begin GROUP S19_DrvOff_Min_Max_Time "CoME_ShutOff/CoME_ShutOff/AirCondition/Air_Condition_Timer/Drive_Off_Timer/DrvOff_Min_Max_Time" /begin SUB_GROUP S35_If_Action_Subsystem /end SUB_GROUP /begin REF_MEASUREMENT CoME_stDrvOffMax_mp CoME_stDrvOffMin_mp /end REF_MEASUREMENT /end GROUP
/begin GROUP S24_If_Action_Subsystem "CoME_ShutOff/CoME_ShutOff/AirCondition/Air_Condition_Timer/Acceleration_Timer/Acc_Min_Max_Timer/If Action Subsystem" /begin REF_CHARACTERISTIC CoME_tiMaxOffAcc_CUR CoME_tiMinOffAcc_CUR /end REF_CHARACTERISTIC /begin REF_MEASUREMENT CoME_tiMaxOffAcc_mp CoME_tiMinOffAcc_mp /end REF_MEASUREMENT /end GROUP
/begin GROUP S35_If_Action_Subsystem "CoME_ShutOff/CoME_ShutOff/AirCondition/Air_Condition_Timer/Drive_Off_Timer/DrvOff_Min_Max_Time/If Action Subsystem" /begin REF_CHARACTERISTIC CoME_tiMaxOffDrvOff_CUR CoME_tiMinOffDrvOff_CUR /end REF_CHARACTERISTIC /begin REF_MEASUREMENT CoME_tiMaxOffDrvOff_mp CoME_tiMinOffDrvOff_mp /end REF_MEASUREMENT /end GROUP
/begin GROUP CoVeh_CalcTrqPrpLimErr "CoVeh_CalcTrqPrpLimErr" /begin SUB_GROUP Root_CoVeh_CalcTrqPrpLimErr /end SUB_GROUP /end GROUP
/begin RECORD_LAYOUT Scalar_BOOLEAN FNC_VALUES 1 UBYTE COLUMN_DIR DIRECT /end RECORD_LAYOUT
/begin RECORD_LAYOUT Scalar_UBYTE FNC_VALUES 1 UBYTE COLUMN_DIR DIRECT /end RECORD_LAYOUT
/begin RECORD_LAYOUT Scalar_BYTE FNC_VALUES 1 SBYTE COLUMN_DIR DIRECT /end RECORD_LAYOUT
/begin RECORD_LAYOUT Scalar_UWORD FNC_VALUES 1 UWORD COLUMN_DIR DIRECT /end RECORD_LAYOUT
/begin RECORD_LAYOUT Scalar_SWORD FNC_VALUES 1 SWORD COLUMN_DIR DIRECT /end RECORD_LAYOUT
/begin RECORD_LAYOUT Scalar_ULONG FNC_VALUES 1 ULONG COLUMN_DIR DIRECT /end RECORD_LAYOUT
/begin RECORD_LAYOUT Scalar_LONG FNC_VALUES 1 SLONG COLUMN_DIR DIRECT /end RECORD_LAYOUT
/begin RECORD_LAYOUT Lookup1D_X_UBYTE AXIS_PTS_X 1 UBYTE INDEX_INCR DIRECT /end RECORD_LAYOUT
/begin RECORD_LAYOUT Lookup1D_UWORD FNC_VALUES 1 UWORD COLUMN_DIR DIRECT /end RECORD_LAYOUT
/begin RECORD_LAYOUT Lookup1D_WORD FNC_VALUES 1 SWORD COLUMN_DIR DIRECT /end RECORD_LAYOUT
/begin RECORD_LAYOUT Lookup1D_X_WORD AXIS_PTS_X 1 SWORD INDEX_INCR DIRECT /end RECORD_LAYOUT
/begin RECORD_LAYOUT Lookup1D_ULONG FNC_VALUES 1 ULONG COLUMN_DIR DIRECT /end RECORD_LAYOUT
/begin RECORD_LAYOUT Lookup1D_X_ULONG AXIS_PTS_X 1 ULONG INDEX_INCR DIRECT /end RECORD_LAYOUT
/begin RECORD_LAYOUT Lookup2D_X_BYTE AXIS_PTS_X 1 SBYTE INDEX_INCR DIRECT /end RECORD_LAYOUT
/begin RECORD_LAYOUT Lookup2D_UWORD FNC_VALUES 1 UWORD COLUMN_DIR DIRECT /end RECORD_LAYOUT
/begin RECORD_LAYOUT Lookup2D_WORD FNC_VALUES 1 SWORD COLUMN_DIR DIRECT /end RECORD_LAYOUT
/begin RECORD_LAYOUT Lookup2D_X_WORD AXIS_PTS_X 1 SWORD INDEX_INCR DIRECT /end RECORD_LAYOUT
/end MODULE
/end PROJECT
