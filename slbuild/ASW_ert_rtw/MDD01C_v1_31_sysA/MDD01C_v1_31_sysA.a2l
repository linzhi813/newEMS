/* @@@@ File written by CANAPE_VERSION 13 0 30 @@@@ */
ASAP2_VERSION 1 51
/begin PROJECT XCPDemo ""
/begin MODULE XCP ""
/begin MOD_COMMON "" BYTE_ORDER MSB_FIRST ALIGNMENT_BYTE 1 ALIGNMENT_WORD 1 ALIGNMENT_LONG 1 ALIGNMENT_FLOAT32_IEEE 1 ALIGNMENT_FLOAT64_IEEE 1 /end MOD_COMMON
/begin IF_DATA XCPplus 0x0102
 /begin PAG 0x02 /end PAG
 /begin PGM PGM_MODE_ABSOLUTE 0x01 /* MAX_SECTORS */ 0x00 /* MAX_CTO_PGM */
  /begin SECTOR "Sector0" 0x00 /* SECTOR_NUMBER */ 0x00380000 /* address */ 0x00020000 /* length */ 0x00 /* Erase number */ 0x00 /* Program number */ 0x00 /* Programming method */ /end SECTOR
 /end PGM
 /begin XCP_ON_CAN 0x0102 CAN_ID_MASTER 0x0201 CAN_ID_SLAVE 0x0200 BAUDRATE 0x07A120 SAMPLE_POINT 0x4B SAMPLE_RATE SINGLE BTL_CYCLES 0x08 SJW 0x02 SYNC_EDGE SINGLE MAX_BUS_LOAD 100 /* maximum available bus */
  /begin PROTOCOL_LAYER 0x0102 /* XCP protocol layer version */ 5000 /* T1 [ms] */ 5000 /* T2 [ms] */ 0 /* T3 [ms] */ 0 /* T4 [ms] */ 0 /* T5 [ms] */ 0 /* T6 [ms] */ 0 /* T7 [ms] */ 8 /* MAX_CTO */ 8 /* MAX_DTO default for DAQ and STIM */ BYTE_ORDER_MSB_FIRST /* BYTE_ORDER: MOTOROLA */ ADDRESS_GRANULARITY_BYTE /* ADDRESS_GRANULARITY */ OPTIONAL_CMD GET_COMM_MODE_INFO OPTIONAL_CMD SET_MTA OPTIONAL_CMD UPLOAD OPTIONAL_CMD SHORT_UPLOAD OPTIONAL_CMD BUILD_CHECKSUM OPTIONAL_CMD DOWNLOAD OPTIONAL_CMD DOWNLOAD_NEXT OPTIONAL_CMD DOWNLOAD_MAX OPTIONAL_CMD SET_CAL_PAGE OPTIONAL_CMD GET_CAL_PAGE OPTIONAL_CMD COPY_CAL_PAGE OPTIONAL_CMD CLEAR_DAQ_LIST OPTIONAL_CMD SET_DAQ_PTR OPTIONAL_CMD WRITE_DAQ OPTIONAL_CMD SET_DAQ_LIST_MODE OPTIONAL_CMD START_STOP_DAQ_LIST OPTIONAL_CMD START_STOP_SYNCH OPTIONAL_CMD FREE_DAQ OPTIONAL_CMD ALLOC_DAQ OPTIONAL_CMD ALLOC_ODT OPTIONAL_CMD ALLOC_ODT_ENTRY /end PROTOCOL_LAYER
  /begin DAQ /* DAQ supported, at MODULE*/ DYNAMIC /* DAQ_CONFIG_TYPE */ 1024 /* MAX_DAQ */ 3 /* MAX_EVENT_CHANNEL */ 0 /* MIN_DAQ */ OPTIMISATION_TYPE_DEFAULT /* OPTIMISATION_TYPE */ ADDRESS_EXTENSION_FREE IDENTIFICATION_FIELD_TYPE_ABSOLUTE /* IDENTIFICATION_FIELD */ GRANULARITY_ODT_ENTRY_SIZE_DAQ_BYTE /* GRANULARITY_ODT_ENTRY_SIZE_DAQ */ 255 /* MAX_ODT_ENTRY_SIZE_DAQ */ OVERLOAD_INDICATION_EVENT /* OVERLOAD_INDICATION */ PRESCALER_SUPPORTED CPU_LOAD_MAX_TOTAL 0.1
   /begin DAQ_MEMORY_CONSUMPTION 2048 /* DAQ_MEMORY_LIMIT: in Elements[AG] */ 62 /* DAQ_SIZE: number of elements[AG] per DAQ list */ 8 /* ODT_SIZE: number of elements[AG] per ODT */ 7 /* ODT_ENTRY_SIZE: number of elements[AG] per ODT_entry */ 2 /* ODT_DAQ_BUFFER_ELEMENT_SIZE: number of */ /* payload elements[AG]*factor = sizeof(send buffer)[AG] */ 0 /* ODT_STIM_BUFFER_ELEMENT_SIZE: number of */ /* payload elements[AG]*factor = sizeof(receive buffer)[AG] */ /end DAQ_MEMORY_CONSUMPTION
   /begin EVENT "Task_10ms" "Task_10ms" 0x00 DAQ 0x20 0x0a 0x06 0x07 CONSISTENCY EVENT /end EVENT
   /begin EVENT "Task_20ms" "Task_20ms" 0x01 DAQ 0x40 0x14 0x06 0x06 CONSISTENCY EVENT /end EVENT
   /begin EVENT "Task_100ms" "Task_100ms" 0x02 DAQ 0x01 0x64 0x06 0x05 CONSISTENCY EVENT /end EVENT
  /end DAQ
 /end XCP_ON_CAN
/end IF_DATA
/begin MOD_PAR "" VERSION "1" CUSTOMER_NO "1" USER "Rainer" PHONE_NO "302" ECU "XCPDEMO" CPU_TYPE "MPC5644" EPK "XCPDEMO V1.0 26032010"
 /begin MEMORY_SEGMENT CALRAM "" DATA FLASH INTERN 0x00380000 0x00020000 -1 -1 -1 -1 -1
  /begin IF_DATA XCPplus 0x0102
   /begin SEGMENT 0x00 0x02 0x00 0x00 0x00
    /begin PAGE 0x00 ECU_ACCESS_DONT_CARE XCP_READ_ACCESS_DONT_CARE XCP_WRITE_ACCESS_NOT_ALLOWED /end PAGE
    /begin PAGE 0x01 ECU_ACCESS_DONT_CARE XCP_READ_ACCESS_DONT_CARE XCP_WRITE_ACCESS_DONT_CARE /end PAGE
   /end SEGMENT
  /end IF_DATA
 /end MEMORY_SEGMENT
 /begin MEMORY_SEGMENT CODE_FLASH_major "CODE major" CODE FLASH INTERN 0x00020000 0x000E0000 -1 -1 -1 -1 -1
  /begin IF_DATA XCPplus 0x0102
   /begin SEGMENT 0x00 0x02 0x00 0x00 0x00
    /begin PAGE 0x00 ECU_ACCESS_DONT_CARE XCP_READ_ACCESS_WITH_ECU_ONLY XCP_WRITE_ACCESS_NOT_ALLOWED /end PAGE
    /begin PAGE 0x01 ECU_ACCESS_DONT_CARE XCP_READ_ACCESS_DONT_CARE XCP_WRITE_ACCESS_WITH_ECU_ONLY /end PAGE
   /end SEGMENT
  /end IF_DATA
 /end MEMORY_SEGMENT
 /begin MEMORY_SEGMENT CODE_FLASH_minor "CODE minor " CODE FLASH INTERN 0x0017FF00 0x00000100 -1 -1 -1 -1 -1
  /begin IF_DATA XCPplus 0x0102
   /begin SEGMENT 0x00 0x02 0x00 0x00 0x00
    /begin PAGE 0x00 ECU_ACCESS_DONT_CARE XCP_READ_ACCESS_WITH_ECU_ONLY XCP_WRITE_ACCESS_NOT_ALLOWED /end PAGE
    /begin PAGE 0x01 ECU_ACCESS_DONT_CARE XCP_READ_ACCESS_DONT_CARE XCP_WRITE_ACCESS_WITH_ECU_ONLY /end PAGE
   /end SEGMENT
  /end IF_DATA
 /end MEMORY_SEGMENT
 SYSTEM_CONSTANT "New" "0" /end MOD_PAR
/begin COMPU_METHOD nse_basic_5 "f() = x" RAT_FUNC "%10.5" "-" COEFFS 0 1.00000 0 0 0 1.00000 /end COMPU_METHOD
/begin RECORD_LAYOUT RL_DOUBLE FNC_VALUES 1 FLOAT64_IEEE COLUMN_DIR DIRECT /end RECORD_LAYOUT
/begin RECORD_LAYOUT RL_FLOAT FNC_VALUES 1 FLOAT32_IEEE COLUMN_DIR DIRECT /end RECORD_LAYOUT
/begin MEASUREMENT Epm_nEng "Engine speed" SWORD EngSpeed_rpm 0 0 0.0 6000.0 ECU_ADDRESS 0x4002226E /end MEASUREMENT
/begin MEASUREMENT SyC_stPostDrv "PostDrive control state" UBYTE SyCPostDrvState_conv 0 0 0 8 ECU_ADDRESS 0x400228FE /end MEASUREMENT
/begin MEASUREMENT TSC_stAEErr "Error status of receiving the TSC1-AE CAN message" UBYTE State_uint8 0 0 0.0 1.0 ECU_ADDRESS 0x4002292A /end MEASUREMENT
/begin MEASUREMENT TSC_stAEMode "Override control mode of TSC1-AE CAN message" UBYTE State_uint8 0 0 0.0 3.0 ECU_ADDRESS 0x4002292B /end MEASUREMENT
/begin MEASUREMENT TSC_rTrqAEDes "Requested torque percent / torque limit by TSC1-AE CANmessage Nm" UBYTE State_uint8 0 0 0.0 125.0 ECU_ADDRESS 0x4002292C /end MEASUREMENT
/begin MEASUREMENT TSC_nAEDes "Requested speed / speed limit by TSC1-AE message" SWORD EngSpeed_rpm 0 0 0.0 6000.0 ECU_ADDRESS 0x4002292E /end MEASUREMENT
/begin MEASUREMENT TSC_stDEErr "Error status of receiving the TSC1-DE CAN message" UBYTE State_uint8 0 0 0.0 1.0 ECU_ADDRESS 0x40022930 /end MEASUREMENT
/begin MEASUREMENT TSC_stDEMode "Override control mode of TSC1-DE CAN message" UBYTE State_uint8 0 0 0.0 3.0 ECU_ADDRESS 0x40022931 /end MEASUREMENT
/begin MEASUREMENT TSC_rTrqDEDes "Requested torque percent/ torque limit by TSC1-DE CANmessage Nm" UBYTE State_uint8 0 0 0.0 125.0 ECU_ADDRESS 0x40022932 /end MEASUREMENT
/begin MEASUREMENT TSC_nDEDes "Requested speed / speed limit by TSC1-DE CANmessage rpm" SWORD EngSpeed_rpm 0 0 0.0 8000.0 ECU_ADDRESS 0x40022934 /end MEASUREMENT
/begin MEASUREMENT TSC_stPEErr "Error status of receiving the TSC1-PE CAN message" UBYTE State_uint8 0 0 0.0 1.0 ECU_ADDRESS 0x40022936 /end MEASUREMENT
/begin MEASUREMENT TSC_stPEMode "Override control mode of TSC1-PE CAN message" UBYTE State_uint8 0 0 0.0 3.0 ECU_ADDRESS 0x40022937 /end MEASUREMENT
/begin MEASUREMENT TSC_rTrqPEDes "Requested torque percent/ torque limit by TSC1-PE CANmessage Nm" UBYTE State_uint8 0 0 0.0 125.0 ECU_ADDRESS 0x40022938 /end MEASUREMENT
/begin MEASUREMENT TSC_nPEDes "Requested speed / speed limit by TSC1-PE CANmessage rpm" SWORD EngSpeed_rpm 0 0 0.0 8000.0 ECU_ADDRESS 0x4002293A /end MEASUREMENT
/begin MEASUREMENT TSC_stTEErr "Error status of receiving the TSC1-TE CAN message" UBYTE State_uint8 0 0 0.0 1.0 ECU_ADDRESS 0x4002293C /end MEASUREMENT
/begin MEASUREMENT TSC_stTEMode "Override control mode of TSC1-TE CAN message" UBYTE State_uint8 0 0 0.0 3.0 ECU_ADDRESS 0x4002293D /end MEASUREMENT
/begin MEASUREMENT TSC_rTrqTEDes "Requested torque percent / torque limit by TSC1-TE CANmessage Nm" UBYTE State_uint8 0 0 0.0 125.0 ECU_ADDRESS 0x4002293E /end MEASUREMENT
/begin MEASUREMENT TSC_nTEDes "Requested speed / speed limit by TSC1-TE CANmessage rpm" SWORD EngSpeed_rpm 0 0 0.0 8000.0 ECU_ADDRESS 0x40022940 /end MEASUREMENT
/begin MEASUREMENT TSC_stVEErr "Error status of receiving the TSC1-VE CAN message" UBYTE State_uint8 0 0 0.0 1.0 ECU_ADDRESS 0x40022942 /end MEASUREMENT
/begin MEASUREMENT TSC_stVEMode "Override control mode of TSC1-VE CAN message." UBYTE State_uint8 0 0 0.0 3.0 ECU_ADDRESS 0x40022943 /end MEASUREMENT
/begin MEASUREMENT TSC_rTrqVEDes "Requested torque percent/ torque limit by TSC1-VE CANmessage Nm" UBYTE State_uint8 0 0 0.0 125.0 ECU_ADDRESS 0x40022944 /end MEASUREMENT
/begin MEASUREMENT TSC_nVEDes "Requested speed / speed limit by TSC1-VE CANmessage rpm" SWORD EngSpeed_rpm 0 0 0.0 8000.0 ECU_ADDRESS 0x40022946 /end MEASUREMENT
/begin MEASUREMENT Gps_numSpdLmt "Tbox speed limit original value" UWORD State_uint16 0 0 0.0 65535.0 ECU_ADDRESS 0x40022948 /end MEASUREMENT
/begin MEASUREMENT Ecu_stGps_Status "Tbox control status" UBYTE State_uint8 0 0 0.0 255.0 ECU_ADDRESS 0x4002294A /end MEASUREMENT
/begin MEASUREMENT EpmSyn_stSync "state of synchronization" UBYTE EpmSynState_conv 0 0 0 60 ECU_ADDRESS 0x4002239C /end MEASUREMENT
/begin MEASUREMENT EISGov_st3 "Status information of WESDem client" ULONG State_uint32 0 0 0.0 2.147483648E+9 ECU_ADDRESS 0x40022270 /end MEASUREMENT
/begin MEASUREMENT WESDem_KpCurrHi_mp "Current small signal gain for the higher P component" SLONG HLSDem_Kp 0 0 -10000.0 10000.0 ECU_ADDRESS 0x4002279C /end MEASUREMENT
/begin MEASUREMENT WESDem_KpCurrLo_mp "Current small signal gain for the lower P component" SLONG HLSDem_Kp 0 0 -10000.0 10000.0 ECU_ADDRESS 0x400227A0 /end MEASUREMENT
/begin MEASUREMENT WESDem_KpPosCurrHi_mp "Current positive large signal gain for the higher P component" SLONG HLSDem_Kp 0 0 -10000.0 10000.0 ECU_ADDRESS 0x400227A4 /end MEASUREMENT
/begin MEASUREMENT WESDem_KpPosCurrLo_mp "Current positive large signal gain for the lower P component" SLONG HLSDem_Kp 0 0 -10000.0 10000.0 ECU_ADDRESS 0x400227A8 /end MEASUREMENT
/begin MEASUREMENT WESDem_KpNegCurrHi_mp "Current negative large signal gain for the higher P component" SLONG HLSDem_Kp 0 0 -10000.0 10000.0 ECU_ADDRESS 0x400227AC /end MEASUREMENT
/begin MEASUREMENT WESDem_KpNegCurrLo_mp "Current negative large signal gain for the lower P component" SLONG HLSDem_Kp 0 0 -10000.0 10000.0 ECU_ADDRESS 0x400227B0 /end MEASUREMENT
/begin MEASUREMENT WESDem_PWinPosHi "Positive higher small signal window for proportional component" SWORD EngSpeed_rpm 0 0 -6000.0 6000.0 ECU_ADDRESS 0x400227B4 /end MEASUREMENT
/begin MEASUREMENT WESDem_PWinPosLo "Positive lower small signal window for proportional component" SWORD EngSpeed_rpm 0 0 -6000.0 6000.0 ECU_ADDRESS 0x400227B6 /end MEASUREMENT
/begin MEASUREMENT WESDem_PWinNegHi "Negative higher small signal window for proportional component" SWORD EngSpeed_rpm 0 0 -6000.0 6000.0 ECU_ADDRESS 0x400227B8 /end MEASUREMENT
/begin MEASUREMENT WESDem_PWinNegLo "Negative lower small signal window for proportional component" SWORD EngSpeed_rpm 0 0 -6000.0 6000.0 ECU_ADDRESS 0x400227BA /end MEASUREMENT
/begin MEASUREMENT WESDem_KiCurrHi_mp "Current small signal gain for the higher I component" SLONG HLSDem_Ki 0 0 -18000.0 18000.0 ECU_ADDRESS 0x400227BC /end MEASUREMENT
/begin MEASUREMENT WESDem_KiCurrLo_mp "Current small signal gain for the lower I component" SLONG HLSDem_Ki 0 0 -18000.0 18000.0 ECU_ADDRESS 0x400227C0 /end MEASUREMENT
/begin MEASUREMENT WESDem_KiNegCurrHi_mp "Current negative large signal gain for the higher I component" SLONG HLSDem_Ki 0 0 -18000.0 18000.0 ECU_ADDRESS 0x400227C4 /end MEASUREMENT
/begin MEASUREMENT WESDem_KiNegCurrLo_mp "Current negative large signal gain for the lower I component" SLONG HLSDem_Ki 0 0 -18000.0 18000.0 ECU_ADDRESS 0x400227C8 /end MEASUREMENT
/begin MEASUREMENT WESDem_KiPosCurrHi_mp "Current positive large signal gain for the higher I component" SLONG HLSDem_Ki 0 0 -18000.0 18000.0 ECU_ADDRESS 0x400227CC /end MEASUREMENT
/begin MEASUREMENT WESDem_KiPosCurrLo_mp "Current positive large signal gain for the lower I component" SLONG HLSDem_Ki 0 0 -18000.0 18000.0 ECU_ADDRESS 0x400227D0 /end MEASUREMENT
/begin MEASUREMENT WESDem_IWinNegHi "Negative higher small signal window for integral component" SWORD EngSpeed_rpm 0 0 -6000.0 6000.0 ECU_ADDRESS 0x400227D4 /end MEASUREMENT
/begin MEASUREMENT WESDem_IWinNegLo "Negative lower small signal window for integral component" SWORD EngSpeed_rpm 0 0 -6000.0 6000.0 ECU_ADDRESS 0x400227D6 /end MEASUREMENT
/begin MEASUREMENT WESDem_IWinPosHi "Positive higher small signal window for integral component" SWORD EngSpeed_rpm 0 0 -6000.0 6000.0 ECU_ADDRESS 0x400227D8 /end MEASUREMENT
/begin MEASUREMENT WESDem_IWinPosLo "Positive lower small signal window for integral component" SWORD EngSpeed_rpm 0 0 -6000.0 6000.0 ECU_ADDRESS 0x400227DA /end MEASUREMENT
/begin MEASUREMENT WESDem_trqReq "Torque intialization request of working engine speed demand" SWORD Trq_Nm 0 0 -3276.0 3276.0 ECU_ADDRESS 0x400227DC /end MEASUREMENT
/begin MEASUREMENT WESDem_nSetPHi "Higher setpoint speed interval of WESDem" SWORD EngSpeed_rpm 0 0 0.0 6000.0 ECU_ADDRESS 0x400227DE /end MEASUREMENT
/begin MEASUREMENT WESDem_nSetPLo "Lower setpoint speed interval of WESDem" SWORD EngSpeed_rpm 0 0 0.0 6000.0 ECU_ADDRESS 0x4002267C /end MEASUREMENT
/begin MEASUREMENT WESDem_stCurr "Status of the working engine Speed Control" UBYTE WESDem_State_conv 0 0 0 32 ECU_ADDRESS 0x40022298 /end MEASUREMENT
/begin MEASUREMENT CoETS_numTSEAParSet "Number of requested parameter set for Engine speed governor" UBYTE State_uint8 0 0 0.0 255.0 ECU_ADDRESS 0x40022688 /end MEASUREMENT
/begin MEASUREMENT ExtDem_facFdbkCanActv "External intervention feedback factor from CAN" SWORD FdbkNm2rpm_rpm_Nm 0 0 -20.0 20.0 ECU_ADDRESS 0x4002268E /end MEASUREMENT
/begin MEASUREMENT SyC_stMn "Current system/ECU state" UBYTE SysExeState_conv 0 0 0 3 ECU_ADDRESS 0x40022638 /end MEASUREMENT
/begin MEASUREMENT FMA_qEmiCtlCor "FMA fuel mass correction quantity for emission control" SWORD FuelMass_mg_hub 0 0 -319.0 319.0 ECU_ADDRESS 0x400229AE /end MEASUREMENT
/begin MEASUREMENT FMO_qEmiCtlCor "FMO correction quantity for emission control" SWORD FuelMass_mg_hub 0 0 -319.0 319.0 ECU_ADDRESS 0x400229B0 /end MEASUREMENT
/begin MEASUREMENT FMA_trqEmiCtlCor "FMA torque correction quantity for emission control" SWORD Trq_Nm 0 0 -3000.0 3000.0 ECU_ADDRESS 0x400229B2 /end MEASUREMENT
/begin MEASUREMENT FMO_trqEmiCtlCor "FMO torque correction for emission control" SWORD Trq_Nm 0 0 -3000.0 3000.0 ECU_ADDRESS 0x400229B4 /end MEASUREMENT
/begin MEASUREMENT ASMod_pIntMnf "Pressure in the intake manifold" SWORD AirPressure_kPa 0 0 0.0 3000.0 ECU_ADDRESS 0x40022996 /end MEASUREMENT
/begin MEASUREMENT ASMod_pIndVol "Pressure in the induction volume" SWORD AirPressure_kPa 0 0 0.0 3000.0 ECU_ADDRESS 0x40022998 /end MEASUREMENT
/begin MEASUREMENT AfsP_flgEgrClsDem "Flag to indicate the requirement of a shutoff case for closing the EGR valve" UBYTE boolean 0 0 0.0 1.0 ECU_ADDRESS 0x4002299A /end MEASUREMENT
/begin MEASUREMENT Rail_stExtDemSp "Message to show external interventions on the rail pressure setpoint calculation" UBYTE boolean 0 0 0.0 1.0 ECU_ADDRESS 0x400223D1 /end MEASUREMENT
/begin MEASUREMENT InjCrv_stInjCharActVal "release status of injection types" UBYTE State_uint8 0 0 0.0 255.0 ECU_ADDRESS 0x400223D2 /end MEASUREMENT
/begin MEASUREMENT EpmCrS_ctRevTotal "Number of crankshaft rotations" ULONG Counter_num 0 0 0.0 65535.0 ECU_ADDRESS 0x400223CC /end MEASUREMENT
/begin MEASUREMENT Strt_stEngStrtReq "start switch via CAN" UBYTE boolean 0 0 0.0 1.0 ECU_ADDRESS 0x40022302 /end MEASUREMENT
/begin MEASUREMENT Tbox_msg_fence_out "fence out message from TBOX" UBYTE uint8 0 0 0.0 255.0 ECU_ADDRESS 0x40022893 /end MEASUREMENT
/begin MEASUREMENT WESDem_stMode "Operating mode of the working engine speed demand" UBYTE State_uint8 0 0 0.0 255.0 ECU_ADDRESS 0x40022297 /end MEASUREMENT
/begin MEASUREMENT EngTM_tiClgRgnDmd "Duration to keep fan On to cool the DPF and surrounding" ULONG EngTime_ms 0 0 0.0 4.294967295E+10 ECU_ADDRESS 0x40022674 /end MEASUREMENT
/begin MEASUREMENT EngTM_rClgRgnDmd "Cooling demand required to cool the DPF" SWORD Prc_100_rate 0 0 -300.0 300.0 ECU_ADDRESS 0x4002265A /end MEASUREMENT
/begin MEASUREMENT CoTS_rClgDem "cool demand percent" SWORD Prc_100_rate 0 0 -300.0 300.0 ECU_ADDRESS 0x4002265C /end MEASUREMENT
/begin MEASUREMENT ETM_rClgDem "Relative fan cooling power required by engine cooling" SWORD Prc_100_rate 0 0 -300.0 300.0 ECU_ADDRESS 0x4002265E /end MEASUREMENT
/begin MEASUREMENT AC_rClgDem "" SWORD Prc_100_rate 0 0 -300.0 300.0 ECU_ADDRESS 0x40022660 /end MEASUREMENT
/begin MEASUREMENT WESDem_stCfg "Configuration of the actual operating mode" UWORD State_uint16 0 0 0.0 65535.0 ECU_ADDRESS 0x400228A8 /end MEASUREMENT
/begin MEASUREMENT Epm_numCyl "Real number of cylinder" UBYTE State_uint8 0 0 0.0 255.0 ECU_ADDRESS 0x400224EE /end MEASUREMENT
/begin MEASUREMENT IVDia_stCylOkl "number of correct working cylinders (via bit)" UBYTE State_uint8 0 0 0.0 255.0 ECU_ADDRESS 0x400224EF /end MEASUREMENT
/begin MEASUREMENT ETClb_stDemCor "Request for energizing time correction of the energizing time calibration" UBYTE State_uint8 0 0 0.0 255.0 ECU_ADDRESS 0x400224F0 /end MEASUREMENT
/begin MEASUREMENT InjVlv_tiETPoI1_mp "Start of energizing for PoI1" SWORD InjTime_us 0 0 -13107.0 13106.0 ECU_ADDRESS 0x400224F2 /end MEASUREMENT
/begin MEASUREMENT AFS_tiRawFast "Raw air mass period" SLONG Time_PwmHigh_us 0 0 0.0 1.07374182E+8 ECU_ADDRESS 0x40022A10 /end MEASUREMENT
/begin MEASUREMENT EpmCrS_numSegASW "counter of part segments" UBYTE State_uint8 0 0 0.0 255.0 ECU_ADDRESS 0x40022A14 /end MEASUREMENT
/begin MEASUREMENT Epm_stSync "State of synchronization" UBYTE EpmSynState_conv 0 0 0 60 ECU_ADDRESS 0x40022A18 /end MEASUREMENT
/begin MEASUREMENT Air_rRawTAFS "Duty cycle value of PWM signal from the temperature sensor at HFM position" SWORD DutyCycle_rate 0 0 0.0 100.0 ECU_ADDRESS 0x40022A2A /end MEASUREMENT
/begin MEASUREMENT Air_tiRawTAFS "Raw value of input time period of the temperature signal from HFM sensor" SLONG Time_Period_HFM6 0 0 -107373.0 107374.0 ECU_ADDRESS 0x40022A2C /end MEASUREMENT
/begin MEASUREMENT Air_uRawTAFS "Raw voltage value  from the temperature sensor at HFM position" SWORD Ad_mv 0 0 0.0 5000.0 ECU_ADDRESS 0x40022A30 /end MEASUREMENT
/begin MEASUREMENT EGRVlv_uRaw "Raw voltage value of position sensor" SWORD Ad_mv 0 0 0.0 5000.0 ECU_ADDRESS 0x4002286C /end MEASUREMENT
/begin MEASUREMENT EGRVlv_rOfsLrnFrst_MR "First learnt offset value read from EEPROM" SWORD Prc_100_rate 0 0 -100.0 100.0 ECU_ADDRESS 0x4002286E /end MEASUREMENT
/begin MEASUREMENT EGRVlv_stTrgClnUp "Status of valve cleaning trigger, in case of unsuccessful offset learning because of plausibility errors" UBYTE boolean 0 0 0.0 1.0 ECU_ADDRESS 0x40022854 /end MEASUREMENT
/begin MEASUREMENT EGRVlv_stOfsLrnStrt "Diagnosis tester value to start offset learning" UBYTE boolean 0 0 0.0 1.0 ECU_ADDRESS 0x40022837 /end MEASUREMENT
/begin MEASUREMENT Air_uRawPIntkVUs_HW "Raw ADC value of air pressure upstream of the intake valve" SWORD Ad_mv 0 0 0.0 5000.0 ECU_ADDRESS 0x4002249C /end MEASUREMENT
/begin MEASUREMENT Air_uRawTIntkVUs "Raw ADC value of air temperature upstream of the intake valve" SWORD Ad_mv 0 0 0.0 5000.0 ECU_ADDRESS 0x400222C8 /end MEASUREMENT
/begin MEASUREMENT BattU_uRaw "Battery voltage before defect detection and handling" SWORD Ad_mv 0 0 0.0 5000.0 ECU_ADDRESS 0x40022980 /end MEASUREMENT
/begin MEASUREMENT SSpMon_uSplyRaw_mp "Raw value of 12V sensor supply " SWORD Ad_mv 0 0 0.0 5000.0 ECU_ADDRESS 0x40022326 /end MEASUREMENT
/begin MEASUREMENT SSpMon_uSply1Raw_mp "Raw value of 12V sensor supply 1" SWORD Ad_mv 0 0 0.0 5000.0 ECU_ADDRESS 0x40022328 /end MEASUREMENT
/begin MEASUREMENT T15_uRaw "Raw ADC value of downstream engine coolant temperature sensor signal" SWORD Ad_mv 0 0 0.0 5000.0 ECU_ADDRESS 0x400222E4 /end MEASUREMENT
/begin MEASUREMENT T50_uRaw "Raw ADC value of downstream engine coolant temperature sensor signal" SWORD Ad_mv 0 0 0.0 5000.0 ECU_ADDRESS 0x400222E2 /end MEASUREMENT
/begin MEASUREMENT Oil_uRawPSwmp "Raw value of voltage from the ADC" SWORD Ad_mv 0 0 0.0 5000.0 ECU_ADDRESS 0x400224BA /end MEASUREMENT
/begin MEASUREMENT Oil_stRawPSwmp "the digital sensor raw voltage value" UBYTE boolean 0 0 0.0 1.0 ECU_ADDRESS 0x400224BC /end MEASUREMENT
/begin MEASUREMENT Oil_uRawTSwmp "Raw ADC value of oil temperature sensor" SWORD Ad_mv 0 0 0.0 5000.0 ECU_ADDRESS 0x400224AC /end MEASUREMENT
/begin MEASUREMENT WtLvlSwt_stRaw "CAN interface message for the status of water in fuel" UBYTE boolean 0 0 0.0 1.0 ECU_ADDRESS 0x4002264E /end MEASUREMENT
/begin MEASUREMENT FlFltHt_bActvDem "Status of Fuel Filter Heating Digital output receivedover CAN" UBYTE boolean 0 0 0.0 1.0 ECU_ADDRESS 0x4002264A /end MEASUREMENT
/begin MEASUREMENT FuelT_uRaw "Raw ADC value of fuel temperature" SWORD Ad_mv 0 0 0.0 5000.0 ECU_ADDRESS 0x40022624 /end MEASUREMENT
/begin MEASUREMENT MeUn_uRaw "Raw value of meun" SWORD Ad_mv 0 0 0.0 5000.0 ECU_ADDRESS 0x400224C0 /end MEASUREMENT
/begin MEASUREMENT RailP_uRawSens "Raw value of rail pressure" SWORD Ad_mv 0 0 0.0 5000.0 ECU_ADDRESS 0x400223EE /end MEASUREMENT
/begin MEASUREMENT RailP_uRawSync "Raw value of rail pressure by teeth sample" SWORD Ad_mv 0 0 0.0 5000.0 ECU_ADDRESS 0x400223EC /end MEASUREMENT
/begin MEASUREMENT AirC_stSwtRaw "Raw value of AC-switch read from the sensor" UBYTE boolean 0 0 0.0 1.0 ECU_ADDRESS 0x40022A36 /end MEASUREMENT
/begin MEASUREMENT CEngDsT_uRaw "Raw ADC value of downstream engine coolant temperature sensor signal" SWORD Ad_mv 0 0 0.0 5000.0 ECU_ADDRESS 0x40022972 /end MEASUREMENT
/begin MEASUREMENT APP_uRaw1unLim "Acceleration pedal sensor 1 unlimited raw value" SWORD Ad_mv 0 0 0.0 5000.0 ECU_ADDRESS 0x40022A00 /end MEASUREMENT
/begin MEASUREMENT APP_uRaw2unLim "Acceleration pedal sensor 2 unlimited raw value" SWORD Ad_mv 0 0 0.0 5000.0 ECU_ADDRESS 0x40022A02 /end MEASUREMENT
/begin MEASUREMENT Brk_stMnRaw "State main brake switch, raw value" UBYTE boolean 0 0 0.0 1.0 ECU_ADDRESS 0x40022975 /end MEASUREMENT
/begin MEASUREMENT Brk_stRedRaw "State redundant brake switch, raw value" UBYTE boolean 0 0 0.0 1.0 ECU_ADDRESS 0x40022976 /end MEASUREMENT
/begin MEASUREMENT Clth_stRaw "Raw signal of clutch state" UBYTE State_uint8 0 0 0.0 255.0 ECU_ADDRESS 0x40022968 /end MEASUREMENT
/begin MEASUREMENT Gbx_stPNPos "Park Neutral Switch status" UBYTE State_uint8 0 0 0.0 255.0 ECU_ADDRESS 0x40022969 /end MEASUREMENT
/begin MEASUREMENT EBrk_stSwtRaw "Status of Low Idle Pre-Selection switch input" UBYTE boolean 0 0 0.0 1.0 ECU_ADDRESS 0x40022878 /end MEASUREMENT
/begin MEASUREMENT EnvP_uRaw "Sensor signal raw voltage" SWORD Ad_mv 0 0 0.0 5000.0 ECU_ADDRESS 0x400226F6 /end MEASUREMENT
/begin MEASUREMENT EnvT_uRaw "Sensor signal raw voltage" SWORD Ad_mv 0 0 0.0 5000.0 ECU_ADDRESS 0x400226F0 /end MEASUREMENT
/begin MEASUREMENT Gbx_stNPosRaw "Raw signal from the digital gearbox neutural position sensior" UBYTE State_uint8 0 0 0.0 255.0 ECU_ADDRESS 0x40022618 /end MEASUREMENT
/begin MEASUREMENT PTOEnblSwt_stRaw "PTO enable switch Raw" UBYTE boolean 0 0 0.0 1.0 ECU_ADDRESS 0x4002243E /end MEASUREMENT
/begin MEASUREMENT PTOSwt_uRaw "Raw input voltage value for PTO switch" SWORD Ad_mv 0 0 0.0 5000.0 ECU_ADDRESS 0x4002243C /end MEASUREMENT
/begin MEASUREMENT RmtAPP_uRaw1unLim "Remote Acceleration pedal sensor 1 unlimited raw value" SWORD Ad_mv 0 0 0.0 5000.0 ECU_ADDRESS 0x40022366 /end MEASUREMENT
/begin MEASUREMENT RmtAPP_uRaw2unLim "Remote Acceleration pedal sensor 2 unlimited raw value" SWORD Ad_mv 0 0 0.0 5000.0 ECU_ADDRESS 0x40022368 /end MEASUREMENT
/begin MEASUREMENT SpdDemSwt_stRaw "speed demand switch raw value from hardware pin" UBYTE boolean 0 0 0.0 1.0 ECU_ADDRESS 0x4002230D /end MEASUREMENT
/begin MEASUREMENT SpdGovSwt_stRaw "Speed Governor switch Raw" UBYTE boolean 0 0 0.0 1.0 ECU_ADDRESS 0x40022309 /end MEASUREMENT
/begin MEASUREMENT VehV_tiSigPer_mp "signal period duration" UWORD Period_us 0 0 0.0 6553.0 ECU_ADDRESS 0x4002227E /end MEASUREMENT
/begin MEASUREMENT GlbDa_lDst "travelled distance in this drive cycle" SLONG Length_m 0 0 0.0 2.147483E+6 ECU_ADDRESS 0x40022608 /end MEASUREMENT
/begin MEASUREMENT FlSys_volFlCons "absolute fuel consumption in ul/DT" SLONG FlConsum_ul_20ms 0 0 -2.147483648E+9 2.147483647E+9 ECU_ADDRESS 0x40022634 /end MEASUREMENT
/begin MEASUREMENT EngDa_tiEngOn_total "Engine on time" SLONG TimeEngOn_s 0 0 -2.147483648E+9 2.147483647E+9 ECU_ADDRESS 0x40022734 /end MEASUREMENT
/begin MEASUREMENT EngDa_tiEngOn_mp "Engine on time" SLONG TimeEngOn_s 0 0 -2.147483648E+9 2.147483647E+9 ECU_ADDRESS 0x40022390 /end MEASUREMENT
/begin MEASUREMENT Fan_tiPs "fan cycle" ULONG Debounce_ms 0 0 0.0 65535.0 ECU_ADDRESS 0x40022668 /end MEASUREMENT
/begin MEASUREMENT SyC_tiPostDrive_mp "Afterrun time" ULONG Debounce_ms 0 0 0.0 65535.0 ECU_ADDRESS 0x400222E8 /end MEASUREMENT
/begin MEASUREMENT MRly_ctErlyOpng "Errorcounter-message to detect early opening of the main relay" ULONG Counter_num 0 0 0.0 255.0 ECU_ADDRESS 0x400224D4 /end MEASUREMENT
/begin MEASUREMENT GlbDa_stTrqDem "contains highest prior function with torque demand" ULONG State_uint32 0 0 0.0 4.294967295E+9 ECU_ADDRESS 0x400225F8 /end MEASUREMENT
/begin MEASUREMENT CoETS_stInrDesBrk "Negative torque status for inner torque" ULONG State_uint32 0 0 0.0 4.294967295E+9 ECU_ADDRESS 0x40022918 /end MEASUREMENT
/begin MEASUREMENT CoEng_tiNormal "Time since state\"CONENG_RUNNING\"was reached" ULONG EngTime_ms 0 0 0.0 4.294967295E+10 ECU_ADDRESS 0x4002257C /end MEASUREMENT
/begin MEASUREMENT CoEng_tiStandby "Time since engine state COENG_STANDBY was reached" ULONG EngTime_ms 0 0 0.0 4.294967295E+10 ECU_ADDRESS 0x4002290C /end MEASUREMENT
/begin MEASUREMENT CoEng_tiStart "Time since state(COENG_READY&COENG_CRANKING) was reached" ULONG EngTime_ms 0 0 0.0 4.294967295E+10 ECU_ADDRESS 0x40022900 /end MEASUREMENT
/begin MEASUREMENT CoEng_tiAfterrun "Time since reaching engine state afterrun (COENG-_STOPPING & COENG_FINISH)" ULONG EngTime_ms 0 0 0.0 4.294967295E+10 ECU_ADDRESS 0x40022908 /end MEASUREMENT
/begin MEASUREMENT CoEng_tiNrml2Strt_mp "Devounce time for engine state transition from NORMAL to START" ULONG EngTime_ms 0 0 0.0 65535.0 ECU_ADDRESS 0x40022904 /end MEASUREMENT
/begin MEASUREMENT TClntDspl_tiPer "Class Instance for PWM / Reference value for period duration (small type to limit dynamic range)" SLONG Time_PwmHigh_us 0 0 -1.07374182E+8 1.07374182E+8 ECU_ADDRESS 0x400222D0 /end MEASUREMENT
/begin MEASUREMENT FuelConsDspl_tiPer "Class Instance for PWM / Reference value for period duration (small type to limit dynamic range)" SLONG Time_PwmHigh_us 0 0 -1.07374182E+8 1.07374182E+8 ECU_ADDRESS 0x4002262C /end MEASUREMENT
/begin MEASUREMENT EngSpd_tiPer_mp "signal period duration" SLONG Time_PwmHigh_us 0 0 -1.07374182E+8 1.07374182E+8 ECU_ADDRESS 0x400226F8 /end MEASUREMENT
/begin MEASUREMENT EGRVlv_tiPs "signal period duration" SLONG Time_PwmHigh_us 0 0 -1.07374182E+8 1.07374182E+8 ECU_ADDRESS 0x40022870 /end MEASUREMENT
/begin MEASUREMENT AFS_tiRaw "Raw air mass period" SLONG Time_PwmHigh_us 0 0 0.0 1.07374182E+8 ECU_ADDRESS 0x40022A1C /end MEASUREMENT
/begin MEASUREMENT RmtAPP_drUnFlt "Remote Acceleration pedal position gradient of unfilterd value" SLONG Accpedal_rate_s 0 0 -100000.0 100000.0 ECU_ADDRESS 0x40022348 /end MEASUREMENT
/begin MEASUREMENT APP_drUnFlt "Acceleration pedal position gradient of unfilterd value" SLONG Accpedal_rate_s 0 0 -100000.0 100000.0 ECU_ADDRESS 0x40022988 /end MEASUREMENT
/begin MEASUREMENT EGRVlv_drRawFlt "EGR rate gradient calculated over current position after PT1-filtering" SLONG EGR_rate_s 0 0 -1000.0 1000.0 ECU_ADDRESS 0x40022868 /end MEASUREMENT
/begin MEASUREMENT GlbDa_lTotDst "total distance since first start" SLONG Length_Km 0 0 0.0 2.147483E+6 ECU_ADDRESS 0x40022610 /end MEASUREMENT
/begin MEASUREMENT GlbDa_lDstLstStored "last value of total distance in EEP" SLONG Length_Km 0 0 0.0 2.147483E+6 ECU_ADDRESS 0x4002260C /end MEASUREMENT
/begin MEASUREMENT GlbDa_lTotDstVeh "total travelled distance of vehicle" SLONG Length_Km 0 0 0.0 2.147483E+6 ECU_ADDRESS 0x40022614 /end MEASUREMENT
/begin MEASUREMENT FlSys_volFlConsHiResTot "TotalFuelConsumption having higher resolution" ULONG FlConsum_L 0 0 0.0 4.294967E+6 ECU_ADDRESS 0x40022640 /end MEASUREMENT
/begin MEASUREMENT FlSys_volFlConsTot "fuel consumption per driving cycle [ul] (only torque relevant injection quantity)" ULONG Fl_Half_L 0 0 0.0 2.147483647E+9 ECU_ADDRESS 0x4002263C /end MEASUREMENT
/begin MEASUREMENT RmtAPP_uUnJit_mp "Remote Acceleration pedal position unjittered value" SWORD Ad_mv 0 0 0.0 5000.0 ECU_ADDRESS 0x4002234C /end MEASUREMENT
/begin MEASUREMENT RmtAPP_uRaw_mp "Remote Acceleration pedal position raw value" SWORD Ad_mv 0 0 0.0 5000.0 ECU_ADDRESS 0x40022344 /end MEASUREMENT
/begin MEASUREMENT RmtAPP_uRaw2 "Acceleration Pedal Position E" SWORD Ad_mv 0 0 0.0 5000.0 ECU_ADDRESS 0x40022358 /end MEASUREMENT
/begin MEASUREMENT RmtAPP_uRaw1 "Remote Acceleration Pedal Position D" SWORD Ad_mv 0 0 0.0 5000.0 ECU_ADDRESS 0x40022356 /end MEASUREMENT
/begin MEASUREMENT PTOSwt_uSens "Sensed value of multiple state switch" SWORD Ad_mv 0 0 0.0 5000.0 ECU_ADDRESS 0x40022436 /end MEASUREMENT
/begin MEASUREMENT APP_uUnJit_mp "Acceleration pedal position unjittered value" SWORD Ad_mv 0 0 0.0 5000.0 ECU_ADDRESS 0x400229EA /end MEASUREMENT
/begin MEASUREMENT APP_uRaw_mp "Acceleration pedal position raw value" SWORD Ad_mv 0 0 0.0 5000.0 ECU_ADDRESS 0x400229E6 /end MEASUREMENT
/begin MEASUREMENT APP_uRaw2 "Acceleration Pedal Position E" SWORD Ad_mv 0 0 0.0 5000.0 ECU_ADDRESS 0x400229F6 /end MEASUREMENT
/begin MEASUREMENT APP_uRaw1 "Acceleration Pedal Position D" SWORD Ad_mv 0 0 0.0 5000.0 ECU_ADDRESS 0x400229F8 /end MEASUREMENT
/begin MEASUREMENT Air_uRawPIntkVUs "Averaging raw ADC value of air pressure upstream of the intake valve" SWORD Ad_mv 0 0 0.0 5000.0 ECU_ADDRESS 0x400224A0 /end MEASUREMENT
/begin MEASUREMENT BattU_u "Battery voltage" UWORD Battery_mv 0 0 0.0 50000.0 ECU_ADDRESS 0x40022300 /end MEASUREMENT
/begin MEASUREMENT BattU_uRated "Rated battery voltage" UWORD Battery_mv 0 0 0.0 50000.0 ECU_ADDRESS 0x400224CE /end MEASUREMENT
/begin MEASUREMENT BattU_uSens "Sensed battery voltage" UWORD Battery_mv 0 0 0.0 50000.0 ECU_ADDRESS 0x4002297E /end MEASUREMENT
/begin MEASUREMENT DevLib_stPwrStgEnaCond "Control unit status relevant to power stage deactivation/error diagnosis" UWORD State_uint16 0 0 0.0 65535.0 ECU_ADDRESS 0x400222CE /end MEASUREMENT
/begin MEASUREMENT EGRVlv_stAdap "Status of offset learning" UWORD State_uint16 0 0 0.0 65535.0 ECU_ADDRESS 0x40022838 /end MEASUREMENT
/begin MEASUREMENT EGRVlv_stMon "State of system monitoring" UWORD State_uint16 0 0 0.0 65535.0 ECU_ADDRESS 0x40022852 /end MEASUREMENT
/begin MEASUREMENT InjVlv_freqBlkSht "output Blank shot frequency to excute" UWORD Freq_q1p0 0 0 0.0 65535.0 ECU_ADDRESS 0x400224F4 /end MEASUREMENT
/begin MEASUREMENT CoETS_stTSEATrqSpdReq "Status of information about torque and speed intervention" UWORD State_uint16 0 0 0.0 65535.0 ECU_ADDRESS 0x4002268A /end MEASUREMENT
/begin MEASUREMENT CoETS_stCurrLim "status word for type of lowest limitations" UWORD State_uint16 0 0 0.0 65535.0 ECU_ADDRESS 0x4002294E /end MEASUREMENT
/begin MEASUREMENT CoETS_stCurrLimActive "status of active minimum of limitation torques" UWORD State_uint16 0 0 0.0 65535.0 ECU_ADDRESS 0x4002294C /end MEASUREMENT
/begin MEASUREMENT CoEng_stShutOffPath "Active shut-off paths resulting from active reversible,irreversible and afterrun shut-off paths" UWORD State_uint16 0 0 0.0 65535.0 ECU_ADDRESS 0x400223CA /end MEASUREMENT
/begin MEASUREMENT EnvP_p "Barometric pressure" SWORD AirPressure_kPa 0 0 0.0 3276.0 ECU_ADDRESS 0x400222D8 /end MEASUREMENT
/begin MEASUREMENT EnvP_pSens "Raw physical value" SWORD AirPressure_kPa 0 0 0.0 1200.0 ECU_ADDRESS 0x4002249E /end MEASUREMENT
/begin MEASUREMENT Oil_pSwmp "Filtered oil pressure value" SWORD AirPressure_kPa 0 0 0.0 1200.0 ECU_ADDRESS 0x400224B6 /end MEASUREMENT
/begin MEASUREMENT Oil_pAna "Oil pressure for analog input" SWORD AirPressure_kPa 0 0 0.0 1200.0 ECU_ADDRESS 0x400224AE /end MEASUREMENT
/begin MEASUREMENT Air_pIntkVUs "Intake valve upstream pressure" SWORD AirPressure_kPa 0 0 0.0 1200.0 ECU_ADDRESS 0x4002249A /end MEASUREMENT
/begin MEASUREMENT Air_pSensPIntkVUs "Sensed manifold absolute pressure" SWORD AirPressure_kPa 0 0 0.0 1200.0 ECU_ADDRESS 0x40022494 /end MEASUREMENT
/begin MEASUREMENT VehMot_trqLead "Lead torque for propulsion (transmission output torque)" SWORD Trq_Nm 0 0 -3000.0 3000.0 ECU_ADDRESS 0x4002241C /end MEASUREMENT
/begin MEASUREMENT VehMot_trqDes "Desired torque for propulsion (transmission output torque)" SWORD Trq_Nm 0 0 -3000.0 3000.0 ECU_ADDRESS 0x40022420 /end MEASUREMENT
/begin MEASUREMENT CoVM_trqLead "Propulsion torque after coordination with ESP interventions(wheel torque)" SWORD Trq_Nm 0 0 -3000.0 3000.0 ECU_ADDRESS 0x40022416 /end MEASUREMENT
/begin MEASUREMENT CoVM_trqDes "Propulsion torque order after ESP-torque intervention coordination (wheel torque)" SWORD Trq_Nm 0 0 -3000.0 3000.0 ECU_ADDRESS 0x4002241E /end MEASUREMENT
/begin MEASUREMENT VehMot_trqDesAcs "Required engine speed of Vehicle Motion acsessories" SWORD Trq_Nm 0 0 -3000.0 3000.0 ECU_ADDRESS 0x4002289A /end MEASUREMENT
/begin MEASUREMENT VehMot_trqResvAcs "Demanded engine speed reserve by acsessories of Vehicle Motion" SWORD Trq_Nm 0 0 -3000.0 3000.0 ECU_ADDRESS 0x4002289C /end MEASUREMENT
/begin MEASUREMENT Fans_trqResv "Torque reserve for cooling fan" SWORD Trq_Nm 0 0 -3000.0 3000.0 ECU_ADDRESS 0x40022656 /end MEASUREMENT
/begin MEASUREMENT Fans_trqCons "Torque consumed by Fan" SWORD Trq_Nm 0 0 -3000.0 3000.0 ECU_ADDRESS 0x40022658 /end MEASUREMENT
/begin MEASUREMENT TS_trqDesAcs "Desired Torque demand of the thermal system" SWORD Trq_Nm 0 0 -3000.0 3276.7 ECU_ADDRESS 0x400228D2 /end MEASUREMENT
/begin MEASUREMENT TS_trqResvAcs "Torque reserve of the thermal system" SWORD Trq_Nm 0 0 -3000.0 3276.7 ECU_ADDRESS 0x400228D4 /end MEASUREMENT
/begin MEASUREMENT Tra_trqDesMin "Increment torque demand from gearbox" SWORD Trq_Nm 0 0 -3000.0 3000.0 ECU_ADDRESS 0x40022286 /end MEASUREMENT
/begin MEASUREMENT Tra_trqDesMax "Decrement torque demand from gearbox" SWORD Trq_Nm 0 0 -3000.0 3000.0 ECU_ADDRESS 0x40022288 /end MEASUREMENT
/begin MEASUREMENT Tra_trqLeadMax "decrement lead torque demand from gearbox" SWORD Trq_Nm 0 0 -3000.0 3000.0 ECU_ADDRESS 0x4002228A /end MEASUREMENT
/begin MEASUREMENT Tra_trqLeadMin "increment lead torque demand from gearbox" SWORD Trq_Nm 0 0 -3000.0 3000.0 ECU_ADDRESS 0x4002228C /end MEASUREMENT
/begin MEASUREMENT PT_trqTraPrt "Maximum allowed inner torque" SWORD Trq_Nm 0 0 -3000.0 3000.0 ECU_ADDRESS 0x400222A0 /end MEASUREMENT
/begin MEASUREMENT Tra_trqLos "Gearbox torque loss" SWORD Trq_Nm 0 0 -3000.0 3000.0 ECU_ADDRESS 0x400222A2 /end MEASUREMENT
/begin MEASUREMENT Tra_trqDblClthVehMax "minimum torque of highest speed limitation Nm" SWORD Trq_Nm 0 0 -3000.0 3000.0 ECU_ADDRESS 0x400222B4 /end MEASUREMENT
/begin MEASUREMENT Tra_trqDblClthEngMax "Application parameter for minimum torque of systemdegratation Nm" SWORD Trq_Nm 0 0 -3000.0 3000.0 ECU_ADDRESS 0x400222B6 /end MEASUREMENT
/begin MEASUREMENT Conv_trqLd "Application parameter for torque load from the converter" SWORD Trq_Nm 0 0 -3000.0 3000.0 ECU_ADDRESS 0x40022474 /end MEASUREMENT
/begin MEASUREMENT Conv_trqResv "Torque reserve from the converter" SWORD Trq_Nm 0 0 -3000.0 3000.0 ECU_ADDRESS 0x40022476 /end MEASUREMENT
/begin MEASUREMENT CoPT_trqLead "Rate action moment order moment place (Clutch moment)" SWORD Trq_Nm 0 0 -3000.0 3000.0 ECU_ADDRESS 0x40022440 /end MEASUREMENT
/begin MEASUREMENT CoPT_trqCurr "Lead torque order for rail pressure control (clutch torque)" SWORD Trq_Nm 0 0 -3000.0 3000.0 ECU_ADDRESS 0x40022442 /end MEASUREMENT
/begin MEASUREMENT CoPT_trqLeadClth "Lead torque demand at gearbox" SWORD Trq_Nm 0 0 -3000.0 3000.0 ECU_ADDRESS 0x4002229A /end MEASUREMENT
/begin MEASUREMENT CoPT_trqDesClth "Desired Clutch Torque" SWORD Trq_Nm 0 0 -3000.0 3000.0 ECU_ADDRESS 0x4002229C /end MEASUREMENT
/begin MEASUREMENT CoPT_trqDes "Total torque order for torque actuator (clutch torque)" SWORD Trq_Nm 0 0 -3000.0 3000.0 ECU_ADDRESS 0x4002244A /end MEASUREMENT
/begin MEASUREMENT CoPT_trqPTPrt "Drive train protection torque (clutch torque)" SWORD Trq_Nm 0 0 -3000.0 3000.0 ECU_ADDRESS 0x40022448 /end MEASUREMENT
/begin MEASUREMENT GlbDa_trqCrSVehLimMin "current limitation torque from GlbDa on torque level crankshaft" SWORD Trq_Nm 0 0 -3276.8 3276.7 ECU_ADDRESS 0x400225FE /end MEASUREMENT
/begin MEASUREMENT GlbDa_trqVehLimMin "Offset for Internal and External Speed Limitation" SWORD Trq_Nm 0 0 -3276.8 3276.7 ECU_ADDRESS 0x400225FC /end MEASUREMENT
/begin MEASUREMENT GlbDa_pEnv "environmental pressure" SWORD AirPressure_kPa 0 0 -3000.0 3000.0 ECU_ADDRESS 0x40022602 /end MEASUREMENT
/begin MEASUREMENT ESS_trqDesAcs "Torque request from Electrical Supply System" SWORD Trq_Nm 0 0 -3000.0 3276.7 ECU_ADDRESS 0x400228F0 /end MEASUREMENT
/begin MEASUREMENT ESS_trqResvAcs "Torque reserve due to on-board electrical system" SWORD Trq_Nm 0 0 -3000.0 3276.7 ECU_ADDRESS 0x400228F2 /end MEASUREMENT
/begin MEASUREMENT CoVeh_trqDesCompNoFl "compensation torque with the shares,which not slur by the drive behaviour filter" SWORD Trq_Nm 0 0 -3000.0 3000.0 ECU_ADDRESS 0x400224D8 /end MEASUREMENT
/begin MEASUREMENT CoVeh_trqDesCompVeh "Signal for compensation correction of wheel torque level (signal 1)" SWORD Trq_Nm 0 0 -3000.0 3000.0 ECU_ADDRESS 0x400224DA /end MEASUREMENT
/begin MEASUREMENT CoVeh_trqMaxAC "Maximum allowed AC torque consumption" SWORD Trq_Nm 0 0 -3000.0 3276.7 ECU_ADDRESS 0x400228EC /end MEASUREMENT
/begin MEASUREMENT CoME_trqDesComp "Application parameter for torque demand of mechanical co-ordinator" SWORD Trq_Nm 0 0 -3000.0 3000.0 ECU_ADDRESS 0x400228FA /end MEASUREMENT
/begin MEASUREMENT CoVeh_trqAcs "message for demand of accessories" SWORD Trq_Nm 0 0 -3276.8 3276.7 ECU_ADDRESS 0x4002233C /end MEASUREMENT
/begin MEASUREMENT CoME_trqResv "Reserve torque demand of mechanical co-ordinator" SWORD Trq_Nm 0 0 -3000.0 3276.7 ECU_ADDRESS 0x400228FC /end MEASUREMENT
/begin MEASUREMENT CoVeh_trqLead "Lead torque order on the drive train (gearbox output torque)" SWORD Trq_Nm 0 0 -3000.0 3000.0 ECU_ADDRESS 0x4002288A /end MEASUREMENT
/begin MEASUREMENT CoVeh_trqDes "Setpoint torque order to the drive train (gearbox output torque)" SWORD Trq_Nm 0 0 -3000.0 3000.0 ECU_ADDRESS 0x4002288C /end MEASUREMENT
/begin MEASUREMENT CoVeh_trqPrfmLimDes "Torque limitation from performence limiter" SWORD Trq_Nm 0 0 -3000.0 3276.7 ECU_ADDRESS 0x40022726 /end MEASUREMENT
/begin MEASUREMENT CoVeh_trqPrpLimErr "limitation torque for propulsion at system error" SWORD Trq_Nm 0 0 -3000.0 3000.0 ECU_ADDRESS 0x400225F4 /end MEASUREMENT
/begin MEASUREMENT StSys_trqSetAdjVal_mp "EPPROM adjustment value for start torque correction" SWORD Trq_Nm 0 0 0.0 1000.0 ECU_ADDRESS 0x400222F0 /end MEASUREMENT
/begin MEASUREMENT StSys_trqStrt "Engine starting torque" SWORD Trq_Nm 0 0 -3000.0 3000.0 ECU_ADDRESS 0x400222F8 /end MEASUREMENT
/begin MEASUREMENT StSys_trqBas "basic starting torque" SWORD Trq_Nm 0 0 0.0 1000.0 ECU_ADDRESS 0x400222F4 /end MEASUREMENT
/begin MEASUREMENT StSys_trqAddCor "additional correction torque for starting torque" SWORD Trq_Nm 0 0 -1000.0 1000.0 ECU_ADDRESS 0x40022306 /end MEASUREMENT
/begin MEASUREMENT FlSys_dvolPerStroke "fuel volumina per stroke ul/stroke" SWORD FuelMass_mm3_hub 0 0 0.0 3276.0 ECU_ADDRESS 0x40022648 /end MEASUREMENT
/begin MEASUREMENT FlSys_rhoFl "Fuel density coefficient" SWORD Fuel_Rho_kg_m3 0 0 0.0 3276.0 ECU_ADDRESS 0x4002239E /end MEASUREMENT
/begin MEASUREMENT FlSys_rhoFlCnvFac "customer specific fuel conversion factor" SWORD Fuel_Rho_kg_m3 0 0 0.0 3276.0 ECU_ADDRESS 0x40022646 /end MEASUREMENT
/begin MEASUREMENT InjSys_trqLim "Torque limitation of injection system" SWORD Trq_Nm 0 0 -3276.8 3276.7 ECU_ADDRESS 0x40022502 /end MEASUREMENT
/begin MEASUREMENT InjSys_trqLoss "Torque loss of injection system" SWORD Trq_Nm 0 0 -3276.8 3276.7 ECU_ADDRESS 0x4002232E /end MEASUREMENT
/begin MEASUREMENT EngTrqPtd_trqLim "Set path torque limitation from ECU monitoring" SWORD Trq_Nm 0 0 -3276.0 3276.0 ECU_ADDRESS 0x40022402 /end MEASUREMENT
/begin MEASUREMENT EngDa_trqEngMax "Maximum engine output torque" SWORD Trq_Nm 0 0 -3276.8 3276.7 ECU_ADDRESS 0x40022738 /end MEASUREMENT
/begin MEASUREMENT EngDem_trqLimErr "Substitute limiting torque in the event of an error" SWORD Trq_Nm 0 0 -3276.8 3276.7 ECU_ADDRESS 0x40022728 /end MEASUREMENT
/begin MEASUREMENT EngDem_trqLimPDiff "Limiting torque due to exhaust gas back-pressure" SWORD Trq_Nm 0 0 -3276.8 3276.7 ECU_ADDRESS 0x4002272A /end MEASUREMENT
/begin MEASUREMENT EngDem_trqInrLim "Resulting limiting torque (inner engine torque)" SWORD Trq_Nm 0 0 -3276.8 3276.7 ECU_ADDRESS 0x4002247E /end MEASUREMENT
/begin MEASUREMENT EngDem_trqInrLimLead "inner engine limted lead torque" SWORD Trq_Nm 0 0 -3276.8 3276.7 ECU_ADDRESS 0x4002272E /end MEASUREMENT
/begin MEASUREMENT EngDem_trqInrLimSlow "inner engine limted torque for Slow Path" SWORD Trq_Nm 0 0 -3276.8 3276.7 ECU_ADDRESS 0x4002272C /end MEASUREMENT
/begin MEASUREMENT CoETS_trqInrCurr "Inner torque current value" SWORD Trq_Nm 0 0 -3276.0 3276.0 ECU_ADDRESS 0x4002240C /end MEASUREMENT
/begin MEASUREMENT CoETS_trqInrCurrFast "Inner desired torque (fast path) calculated from CoPT_trqCurrEng [Nm]" SWORD Trq_Nm 0 0 -3276.0 3276.0 ECU_ADDRESS 0x4002291C /end MEASUREMENT
/begin MEASUREMENT CoETS_trqInrLead "desired lead (inner) torque (without Filter with reserve)" SWORD Trq_Nm 0 0 -3276.0 3276.0 ECU_ADDRESS 0x4002240E /end MEASUREMENT
/begin MEASUREMENT CoETS_trqInrLeadFast "Inner torque desired value (fast signal path) generated out of CoPT_trqLeadEng" SWORD Trq_Nm 0 0 -3276.0 3276.0 ECU_ADDRESS 0x4002291E /end MEASUREMENT
/begin MEASUREMENT CoETS_trqSpdGovLim "Inner engine limitation torque for EISGov" SWORD Trq_Nm 0 0 -3276.8 3276.7 ECU_ADDRESS 0x40022740 /end MEASUREMENT
/begin MEASUREMENT CoETS_trqLlim "Longitudinal limitation for inner engine torque" SWORD Trq_Nm 0 0 -3276.0 3276.0 ECU_ADDRESS 0x40022928 /end MEASUREMENT
/begin MEASUREMENT CoETS_trqInrLtd "inner torque set value after limitation, before AS" SWORD Trq_Nm 0 0 -3000.0 3000.0 ECU_ADDRESS 0x4002240A /end MEASUREMENT
/begin MEASUREMENT CoETS_trqUnFltLtd "Limited idle speed governor torque" SWORD Trq_Nm 0 0 -3276.0 3276.0 ECU_ADDRESS 0x400223FA /end MEASUREMENT
/begin MEASUREMENT CoETS_trqInrSet_mp "Intermediate inner torque for the set path without filteration" SWORD Trq_Nm 0 0 -3276.0 3276.0 ECU_ADDRESS 0x40022922 /end MEASUREMENT
/begin MEASUREMENT CoETS_trqInrSetSlow "Filtered inner torque ( positive torque) desired value (standard signal path) generated out of CoPT_trqDesEng" SWORD Trq_Nm 0 0 -3276.0 3276.0 ECU_ADDRESS 0x40022924 /end MEASUREMENT
/begin MEASUREMENT CoETS_trqUnFltLtdSet "Compensation torque of the accessories" SWORD Trq_Nm 0 0 -3276.0 3276.0 ECU_ADDRESS 0x40022920 /end MEASUREMENT
/begin MEASUREMENT CoETS_trqInrLtdPre_mp "inner set torque after limitation, before active surge damper" SWORD Trq_Nm 0 0 -3276.0 3276.0 ECU_ADDRESS 0x40022926 /end MEASUREMENT
/begin MEASUREMENT CoETS_trqUnFltSet "Compensation torque of \"loss torque compensation\" to bypass filter influences on the set path which is partly compensated" SWORD Trq_Nm 0 0 -3276.0 3276.0 ECU_ADDRESS 0x40022742 /end MEASUREMENT
/begin MEASUREMENT CoETS_trqInrLimSet "Limitation torque without the part of the speed governor" SWORD Trq_Nm 0 0 -3000.0 3000.0 ECU_ADDRESS 0x400223FC /end MEASUREMENT
/begin MEASUREMENT CoETS_trqInrDesNTC "Additional desired engine friction Nm" SWORD Trq_Nm 0 0 -3276.0 3276.0 ECU_ADDRESS 0x4002268C /end MEASUREMENT
/begin MEASUREMENT CoETS_trqTSEAEngMax "torque request to engine intervention decrement(Max)" SWORD Trq_Nm 0 0 -3276.0 3276.0 ECU_ADDRESS 0x40022912 /end MEASUREMENT
/begin MEASUREMENT CoETS_trqTSEAEngMin "torque request to engine intervention increment(Min)" SWORD Trq_Nm 0 0 -3276.0 3276.0 ECU_ADDRESS 0x40022914 /end MEASUREMENT
/begin MEASUREMENT CoETS_trqInrCurrLim "Current lowest limitation torque (inner engine torque)" SWORD Trq_Nm 0 0 -3276.8 3276.7 ECU_ADDRESS 0x40022744 /end MEASUREMENT
/begin MEASUREMENT CoETS_trqInrVehLimMin_mp "Coordinated limitation torque of vehicle functions  (inner torque)" SWORD Trq_Nm 0 0 -3276.8 3276.7 ECU_ADDRESS 0x40022950 /end MEASUREMENT
/begin MEASUREMENT CoETS_trqNTCLim "NTC torque limitation (0 in braking, ramped to max in braked to fired" SWORD Trq_Nm 0 0 0.0 1000.0 ECU_ADDRESS 0x40022724 /end MEASUREMENT
/begin MEASUREMENT CoETS_trqNTCInrAct "Actual braking torque" SWORD Trq_Nm 0 0 -3276.8 3276.7 ECU_ADDRESS 0x40022958 /end MEASUREMENT
/begin MEASUREMENT CoETS_trqNTCInrMax "Maximum available braking torque" SWORD Trq_Nm 0 0 -3276.8 3276.7 ECU_ADDRESS 0x4002295A /end MEASUREMENT
/begin MEASUREMENT VehV_nCrdSh "Cardan shaft speed" SWORD EngSpeed_rpm 0 0 0.0 6000.0 ECU_ADDRESS 0x40022278 /end MEASUREMENT
/begin MEASUREMENT VehV_nRawCrdSh "Raw Cardan shaft speed" SWORD EngSpeed_rpm 0 0 0.0 6000.0 ECU_ADDRESS 0x40022276 /end MEASUREMENT
/begin MEASUREMENT AFS_mAirPerCyl "Air mass per cylinder" SWORD AirMass_mg_hub 0 0 0.0 16383.0 ECU_ADDRESS 0x40022704 /end MEASUREMENT
/begin MEASUREMENT VehMot_nMin "Minimum engine speed for VehMot" SWORD EngSpeed_rpm 0 0 -12000.0 12000.0 ECU_ADDRESS 0x40022890 /end MEASUREMENT
/begin MEASUREMENT VehMot_nMax "Maximum engine speed for VehMot" SWORD EngSpeed_rpm 0 0 -12000.0 12000.0 ECU_ADDRESS 0x4002288E /end MEASUREMENT
/begin MEASUREMENT VehMot_nMinAcs "Minimum engine speed demand by accessories of Vehicle Motion" SWORD EngSpeed_rpm 0 0 -12000.0 12000.0 ECU_ADDRESS 0x400228A4 /end MEASUREMENT
/begin MEASUREMENT VehMot_nMaxAcs "Maximum engine speed demand by accessories of Vehicle Motion" SWORD EngSpeed_rpm 0 0 -12000.0 12000.0 ECU_ADDRESS 0x400228A6 /end MEASUREMENT
/begin MEASUREMENT TS_nMax "Highest engine speed requested by the thermal system" SWORD EngSpeed_rpm 0 0 -12000.0 12000.0 ECU_ADDRESS 0x400228D6 /end MEASUREMENT
/begin MEASUREMENT TS_nMin "Lowest engine speed requested by the thermal system" SWORD EngSpeed_rpm 0 0 -12000.0 12000.0 ECU_ADDRESS 0x400228D8 /end MEASUREMENT
/begin MEASUREMENT Tra_nMin "Minimum engine speed for gearbox" SWORD EngSpeed_rpm 0 0 -6000.0 6000.0 ECU_ADDRESS 0x40022290 /end MEASUREMENT
/begin MEASUREMENT Tra_nMax "Maximum engine speed for gearbox" SWORD EngSpeed_rpm 0 0 -6000.0 11000.0 ECU_ADDRESS 0x40022292 /end MEASUREMENT
/begin MEASUREMENT Gbx_nIdlDes "Desired idle speed setpoint for AT gear box rpm" SWORD EngSpeed_rpm 0 0 -6000.0 6000.0 ECU_ADDRESS 0x4002228E /end MEASUREMENT
/begin MEASUREMENT ESS_nMin "Min. engine speed request from Electrical Supply System" SWORD EngSpeed_rpm 0 0 -6000.0 6000.0 ECU_ADDRESS 0x400228F6 /end MEASUREMENT
/begin MEASUREMENT ESS_nMax "Max. engine speed request from Electrical Supply System" SWORD EngSpeed_rpm 0 0 -6000.0 6000.0 ECU_ADDRESS 0x400228F4 /end MEASUREMENT
/begin MEASUREMENT CoME_nMax "Maximum engine speed limit of accessories" SWORD EngSpeed_rpm 0 0 -12000.0 12000.0 ECU_ADDRESS 0x40022460 /end MEASUREMENT
/begin MEASUREMENT CoME_nMin "Minimum low-idle speed requirement of accessories" SWORD EngSpeed_rpm 0 0 -12000.0 12000.0 ECU_ADDRESS 0x4002245E /end MEASUREMENT
/begin MEASUREMENT CoVeh_nMaxSysErr "Maximum speed limitation in case of system errors" SWORD EngSpeed_rpm 0 0 -12000.0 12000.0 ECU_ADDRESS 0x4002245A /end MEASUREMENT
/begin MEASUREMENT CoVeh_nMinSysErr "Minimum speed limitation in case of system errors" SWORD EngSpeed_rpm 0 0 -12000.0 12000.0 ECU_ADDRESS 0x40022458 /end MEASUREMENT
/begin MEASUREMENT CoETS_nTSEASpdDes "The desired/control engine speed requested fromTSC1 CAN messages. This desired/control enginespeed is given to the speed governor." SWORD EngSpeed_rpm 0 0 0.0 6000.0 ECU_ADDRESS 0x40022680 /end MEASUREMENT
/begin MEASUREMENT CoETS_nTSEASpdLim "The engine speed limitation requested from TSC1CAN messages. This engine speed limit is given tothe speed governor" SWORD EngSpeed_rpm 0 0 0.0 6000.0 ECU_ADDRESS 0x4002267E /end MEASUREMENT
/begin MEASUREMENT VehV_v "Vehicle speed" SWORD VehSpeed_km_h 0 0 0.0 250.0 ECU_ADDRESS 0x4002227A /end MEASUREMENT
/begin MEASUREMENT VehV_vSens "Sensed vehicle speed" SWORD VehSpeed_km_h 0 0 0.0 250.0 ECU_ADDRESS 0x40022274 /end MEASUREMENT
/begin MEASUREMENT TClntDspl_rPs "Output to the power stage of coolant temperature PWM output to drive the gauge on the dashboard" SWORD DutyCycle_rate 0 0 0.0 100.0 ECU_ADDRESS 0x400222D4 /end MEASUREMENT
/begin MEASUREMENT FuelConsDspl_rPs "Output to the power stage of fuel consumption PWM output to drive the gauge on the dashboard" SWORD DutyCycle_rate 0 0 0.0 100.0 ECU_ADDRESS 0x40022630 /end MEASUREMENT
/begin MEASUREMENT EngSpd_rPs "Structure containing parameters for PWM output power stage error handling for engine speed PWM out" SWORD DutyCycle_rate 0 0 0.0 100.0 ECU_ADDRESS 0x400226FC /end MEASUREMENT
/begin MEASUREMENT Fan_rPs "Fan duty cycle" SWORD DutyCycle_rate 0 0 0.0 100.0 ECU_ADDRESS 0x4002266C /end MEASUREMENT
/begin MEASUREMENT Fan_rPs2 "Fan 2 duty cycle" SWORD DutyCycle_rate 0 0 0.0 100.0 ECU_ADDRESS 0x4002266E /end MEASUREMENT
/begin MEASUREMENT MeUn_rPsPreRot_mp "duty cycle of meun current governor before rotation" SWORD DutyCycle_rate 0 0 0.0 100.0 ECU_ADDRESS 0x400224CA /end MEASUREMENT
/begin MEASUREMENT Fan_r "Actuator setpoint value for the first fan output" SWORD DutyCycle_rate 0 0 0.0 100.0 ECU_ADDRESS 0x40022650 /end MEASUREMENT
/begin MEASUREMENT Fan_r2 "set point duty cycle for PWM fan power stage 2" SWORD DutyCycle_rate 0 0 0.0 100.0 ECU_ADDRESS 0x40022654 /end MEASUREMENT
/begin MEASUREMENT PT_rTraGear "Current ratio for transmission" SWORD TransRatio 0 0 -100.0 100.0 ECU_ADDRESS 0x400222AA /end MEASUREMENT
/begin MEASUREMENT Gbx_rTrq "Transmission function information from Gearbox ECU(including Torque converter)" SWORD TransRatio 0 0 -100.0 100.0 ECU_ADDRESS 0x40022430 /end MEASUREMENT
/begin MEASUREMENT PT_rTrq "Powertrain torque ratio" SWORD TransRatio 0 0 -100.0 100.0 ECU_ADDRESS 0x400223F8 /end MEASUREMENT
/begin MEASUREMENT PT_rTrqWoConvRat "torque ratio of the power train without differential and converter torque ratio" SWORD TransRatio 0 0 -100.0 100.0 ECU_ADDRESS 0x40022432 /end MEASUREMENT
/begin MEASUREMENT PT_rGrip "Analogue value for the grip states" SWORD Prc_Fact100 0 0 -300.0 300.0 ECU_ADDRESS 0x40022434 /end MEASUREMENT
/begin MEASUREMENT GlbDa_vX "Longitudinal vehicle speed (X-direction)" SWORD VehSpeed_km_h 0 0 0.0 250.0 ECU_ADDRESS 0x40022284 /end MEASUREMENT
/begin MEASUREMENT GlbDa_vXFlt "Vehicle velocity filtered" SWORD VehSpeed_km_h 0 0 0.0 250.0 ECU_ADDRESS 0x400222A6 /end MEASUREMENT
/begin MEASUREMENT GlbDa_rTrqTot "total ratio of the power train inclusive the differential and the converter torque ratio" SWORD TransRatio 0 0 -327.0 327.0 ECU_ADDRESS 0x4002258A /end MEASUREMENT
/begin MEASUREMENT FlSys_dvolFlCons "Fuel consumption [l/h]" SWORD FlCon_L_h 0 0 0.0 327.0 ECU_ADDRESS 0x4002262A /end MEASUREMENT
/begin MEASUREMENT EnvT_t "Environmental temperature" SWORD Temp_deg 0 0 -200.0 200.0 ECU_ADDRESS 0x40022500 /end MEASUREMENT
/begin MEASUREMENT EnvT_tSens "Raw physical value" SWORD Temp_deg 0 0 -200.0 200.0 ECU_ADDRESS 0x400226EA /end MEASUREMENT
/begin MEASUREMENT CEngDsT_tSensFlt "engine coolant sensor temperature without speed up" SWORD Temp_deg 0 0 -200.0 200.0 ECU_ADDRESS 0x40022970 /end MEASUREMENT
/begin MEASUREMENT CEngDsT_t "engine coolant temperature after filter" SWORD Temp_deg 0 0 -200.0 200.0 ECU_ADDRESS 0x400222CA /end MEASUREMENT
/begin MEASUREMENT CEngDsT_dt " temperature change rate" SWORD Temp_deg_s 0 0 -200.0 200.0 ECU_ADDRESS 0x4002296E /end MEASUREMENT
/begin MEASUREMENT CEngDsT_tSens "Sensed engine coolant temperature" SWORD Temp_deg 0 0 -200.0 200.0 ECU_ADDRESS 0x40022626 /end MEASUREMENT
/begin MEASUREMENT FuelT_dt "temperature change rate" SWORD Temp_deg_s 0 0 -200.0 200.0 ECU_ADDRESS 0x40022622 /end MEASUREMENT
/begin MEASUREMENT FuelT_t "Temperature of fuel" SWORD Temp_deg 0 0 -50.0 150.0 ECU_ADDRESS 0x4002236E /end MEASUREMENT
/begin MEASUREMENT FuelT_tFlSys "Fuel system temperature" SWORD Temp_deg 0 0 -50.0 200.0 ECU_ADDRESS 0x400223B0 /end MEASUREMENT
/begin MEASUREMENT FuelT_tFlt "fuel temperature after filter" SWORD Temp_deg 0 0 -50.0 150.0 ECU_ADDRESS 0x40022620 /end MEASUREMENT
/begin MEASUREMENT FuelT_tSens "Sensed fuel temperature" SWORD Temp_deg 0 0 -50.0 150.0 ECU_ADDRESS 0x4002261A /end MEASUREMENT
/begin MEASUREMENT Oil_tNoSpeedUpT_mp "Output of the trasition function without speedup" SWORD Temp_deg 0 0 -50.0 200.0 ECU_ADDRESS 0x400224A8 /end MEASUREMENT
/begin MEASUREMENT Oil_tSwmp "Oil temperature in oil sump" SWORD Temp_deg 0 0 -50.0 200.0 ECU_ADDRESS 0x40022330 /end MEASUREMENT
/begin MEASUREMENT Oil_tSensSwmp "Sensed value of oil temperature" SWORD Temp_deg 0 0 -50.0 200.0 ECU_ADDRESS 0x400224A4 /end MEASUREMENT
/begin MEASUREMENT Air_tIntkVUs "Intake air temperature upstream of the inlet valve" SWORD Temp_deg 0 0 -200.0 200.0 ECU_ADDRESS 0x400222C4 /end MEASUREMENT
/begin MEASUREMENT Air_tCACDs_mp "Charge-air temperature downstream from charge-air cooler" SWORD Temp_deg 0 0 -200.0 200.0 ECU_ADDRESS 0x400222C6 /end MEASUREMENT
/begin MEASUREMENT Air_tSensTIntkVUs "Sensed value of air temperature upstream of the intake valve" SWORD Temp_deg 0 0 -200.0 200.0 ECU_ADDRESS 0x400222C0 /end MEASUREMENT
/begin MEASUREMENT Air_tAFS_mp "Induction air temperature at the HFM" SWORD Temp_deg 0 0 -200.0 200.0 ECU_ADDRESS 0x400224FE /end MEASUREMENT
/begin MEASUREMENT Air_tUnFltAFS "Charge-air temperature downstream from charge-air cooler" SWORD Temp_deg 0 0 -200.0 200.0 ECU_ADDRESS 0x40022A28 /end MEASUREMENT
/begin MEASUREMENT Air_tSensTAFS "Sensed value of the air temperature at HFM position" SWORD Temp_deg 0 0 -200.0 200.0 ECU_ADDRESS 0x40022A22 /end MEASUREMENT
/begin MEASUREMENT Tra_tClntDes "Coolant temperature - Set point value" SWORD Temp_deg 0 0 -150.0 150.0 ECU_ADDRESS 0x400222BE /end MEASUREMENT
/begin MEASUREMENT Gbx_tClntDes "Setpoint value of the coolant temperature (via CAN)" SWORD Temp_deg 0 0 -150.0 150.0 ECU_ADDRESS 0x400222BA /end MEASUREMENT
/begin MEASUREMENT CoPT_tClntDes "Desired coolent temperature of the impulse rope" SWORD Temp_deg 0 0 -150.0 150.0 ECU_ADDRESS 0x400228DA /end MEASUREMENT
/begin MEASUREMENT GlbDa_tEnv "environment temperature" SWORD Temp_deg 0 0 -50.0 150.0 ECU_ADDRESS 0x40022604 /end MEASUREMENT
/begin MEASUREMENT CoVeh_tClntDes "Desired coolant temperature" SWORD Temp_deg 0 0 -150.0 150.0 ECU_ADDRESS 0x400228DE /end MEASUREMENT
/begin MEASUREMENT InjSys_tEng "Engine temperature selected for the injection system" SWORD Temp_deg 0 0 -1000.0 1000.0 ECU_ADDRESS 0x40022376 /end MEASUREMENT
/begin MEASUREMENT InjSys_tAir "Intake air temperature selected for the injection system" SWORD Temp_deg 0 0 -1000.0 1000.0 ECU_ADDRESS 0x40022504 /end MEASUREMENT
/begin MEASUREMENT Rail_tAir "Intake air temperature for the Rail subsystem" SWORD Temp_deg 0 0 -1000.0 1000.0 ECU_ADDRESS 0x40022378 /end MEASUREMENT
/begin MEASUREMENT InjCrv_tAirMI1 "Chosen temperature from the temperature field on the induction system" SWORD Temp_deg 0 0 -50.0 150.0 ECU_ADDRESS 0x40022508 /end MEASUREMENT
/begin MEASUREMENT InjCrv_tAir "Air temperature for environment corrections" SWORD Temp_deg 0 0 -50.0 150.0 ECU_ADDRESS 0x40022506 /end MEASUREMENT
/begin MEASUREMENT EngDa_tEng "Engine temperature" SWORD Temp_deg 0 0 -1000.0 1000.0 ECU_ADDRESS 0x40022332 /end MEASUREMENT
/begin MEASUREMENT EngDa_tStrt "Engine starting temperature" SWORD Temp_deg 0 0 -1000.0 1000.0 ECU_ADDRESS 0x40022318 /end MEASUREMENT
/begin MEASUREMENT EngDa_tFld "Engine temperature field" SWORD Temp_deg 0 0 -3000.0 3000.0 ARRAY_SIZE 3 ECU_ADDRESS 0x40022310 /end MEASUREMENT
/begin MEASUREMENT StSys_tStrt_mp "engine temperature for starting system" SWORD Temp_deg 0 0 -50.0 150.0 ECU_ADDRESS 0x400222F6 /end MEASUREMENT
/begin MEASUREMENT CoTemp_tEngDes "Coolant temperature of combustion engine" SWORD Temp_deg 0 0 -3549.0 3003.0 ECU_ADDRESS 0x400228D0 /end MEASUREMENT
/begin MEASUREMENT Air_facPerCorTAFS "Period correction factor for air mass signal." SWORD Fact8192 0 0 -4.0 3.9999 ECU_ADDRESS 0x40022A16 /end MEASUREMENT
/begin MEASUREMENT AFS_dmDrft "Compensated Air mass value for the drift" SWORD AirMassPerTime 0 0 -8192.0 8191.0 ECU_ADDRESS 0x40022A06 /end MEASUREMENT
/begin MEASUREMENT AFS_dm "Total air mass flow into the engine" SWORD AirMassPerTime 0 0 -8192.0 8191.0 ECU_ADDRESS 0x40022A0A /end MEASUREMENT
/begin MEASUREMENT AFS_dmPlsCorr "Pulsation corrected air mass." SWORD AirMassPerTime 0 0 -8192.0 8191.0 ECU_ADDRESS 0x40022A04 /end MEASUREMENT
/begin MEASUREMENT AFS_dmSensAvr "Averaged Sensed air mass flow" SWORD AirMassPerTime 0 0 -8192.0 8191.0 ECU_ADDRESS 0x40022A20 /end MEASUREMENT
/begin MEASUREMENT AFS_dmSens "Processed air mass flow signal of the HFM sensor" SWORD AirMassPerTime 0 0 -8192.0 8191.0 ECU_ADDRESS 0x40022A08 /end MEASUREMENT
/begin MEASUREMENT InjCtl_qSetUnBal "Current injection quantity" SWORD FuelMass_mg_hub 0 0 -319.0 319.0 ECU_ADDRESS 0x40022316 /end MEASUREMENT
/begin MEASUREMENT InjCtl_qCurr "Torque generating engine fuel injection quantity" SWORD FuelMass_mg_hub 0 0 -319.0 319.0 ECU_ADDRESS 0x40022374 /end MEASUREMENT
/begin MEASUREMENT InjCtl_qRaw "Raw value of injection mass" SWORD FuelMass_mg_hub 0 0 -319.0 319.0 ECU_ADDRESS 0x40022512 /end MEASUREMENT
/begin MEASUREMENT InjCtl_dqLead "Gradient of quantity" SWORD FuelMass_mg_hub 0 0 -319.0 319.0 ECU_ADDRESS 0x40022514 /end MEASUREMENT
/begin MEASUREMENT InjSys_qTot "Total engine injection quantity" SWORD FuelMass_mg_hub 0 0 -319.0 319.0 ECU_ADDRESS 0x4002237C /end MEASUREMENT
/begin MEASUREMENT InjSys_qOfsTot "Non-torque generating quantity, the offset-quantity from torque generating quantity to total quantity" SWORD FuelMass_mg_hub 0 0 -319.0 319.0 ECU_ADDRESS 0x40022394 /end MEASUREMENT
/begin MEASUREMENT RmtAPP_rLinAPP_mp "Linearisation ratio of remote accelerator pedal" SWORD Accpedal_rate 0 0 0.0 100.0 ECU_ADDRESS 0x4002234E /end MEASUREMENT
/begin MEASUREMENT RmtAPP_rUnFlt "Unfiltered RmtAPP value" SWORD Accpedal_rate 0 0 0.0 100.0 ECU_ADDRESS 0x40022350 /end MEASUREMENT
/begin MEASUREMENT RmtAPP_rFlt_mp "Remote Acceleration pedal position filtered value" SWORD Accpedal_rate 0 0 0.0 100.0 ECU_ADDRESS 0x40022352 /end MEASUREMENT
/begin MEASUREMENT RmtAPP_r "Remote Acceleration pedal sensor 1 value after fault handling" SWORD Accpedal_rate 0 0 0.0 100.0 ECU_ADDRESS 0x4002236C /end MEASUREMENT
/begin MEASUREMENT APP_rLinAPP_mp "Linearisation ratio of accelerator pedal" SWORD Accpedal_rate 0 0 0.0 100.0 ECU_ADDRESS 0x400229EC /end MEASUREMENT
/begin MEASUREMENT APP_rUnFlt "Unfiltered APP value" SWORD Accpedal_rate 0 0 0.0 100.0 ECU_ADDRESS 0x400225D8 /end MEASUREMENT
/begin MEASUREMENT APP_rFlt_mp "Acceleration pedal position filtered value" SWORD Accpedal_rate 0 0 0.0 100.0 ECU_ADDRESS 0x400229EE /end MEASUREMENT
/begin MEASUREMENT APP_r "Acceleration pedal sensor 1 value after fault handling" SWORD Accpedal_rate 0 0 0.0 100.0 ECU_ADDRESS 0x400223B6 /end MEASUREMENT
/begin MEASUREMENT EGRVlv_rActUnCor "Uncorrected position of the valve" SWORD Prc_100_rate 0 0 -100.0 100.0 ECU_ADDRESS 0x4002283A /end MEASUREMENT
/begin MEASUREMENT EGRVlv_rAct "Actuatorposition" SWORD Prc_100_rate 0 0 -100.0 100.0 ECU_ADDRESS 0x4002283E /end MEASUREMENT
/begin MEASUREMENT EGRVlv_rActInv "Actuatorposition (100% - rAct)" SWORD Prc_100_rate 0 0 -100.0 100.0 ECU_ADDRESS 0x40022840 /end MEASUREMENT
/begin MEASUREMENT EGRVlv_rActNoErrHdl "Valve position (offset corrected without error handling)" SWORD Prc_100_rate 0 0 -100.0 100.0 ECU_ADDRESS 0x4002283C /end MEASUREMENT
/begin MEASUREMENT EGRVlv_rAdapLrn_mp "Offset learnt value in the present driving cycle" SWORD Prc_100_rate 0 0 -100.0 100.0 ECU_ADDRESS 0x40022842 /end MEASUREMENT
/begin MEASUREMENT EGRVlv_rOfsLrnVlv "Control value for offset learning" SWORD Prc_100_rate 0 0 -100.0 100.0 ECU_ADDRESS 0x40022848 /end MEASUREMENT
/begin MEASUREMENT EGRVlv_rOfsLrnFrst "First learnt offset value stored in EEPROM" SWORD Prc_100_rate 0 0 -100.0 100.0 ECU_ADDRESS 0x40022844 /end MEASUREMENT
/begin MEASUREMENT EGRVlv_rOfsLrnLst "Last learnt offset value stored in EEPROM" SWORD Prc_100_rate 0 0 -100.0 100.0 ECU_ADDRESS 0x40022846 /end MEASUREMENT
/begin MEASUREMENT EGRVlv_rEGR "Control value for the EGR valve" SWORD Prc_100_rate 0 0 -100.0 100.0 ECU_ADDRESS 0x40022830 /end MEASUREMENT
/begin MEASUREMENT EGRVlv_rGovDesVal "Internal desired value for governor" SWORD Prc_100_rate 0 0 -100.0 100.0 ECU_ADDRESS 0x40022858 /end MEASUREMENT
/begin MEASUREMENT EGRVlv_rGovDvt "Control deviation" SWORD Prc_100_rate 0 0 -100.0 100.0 ECU_ADDRESS 0x40022834 /end MEASUREMENT
/begin MEASUREMENT EGRVlv_rOutD_mp "measurement point for D governor for single flow implementation" SWORD Prc_100_rate 0 0 -100.0 100.0 ECU_ADDRESS 0x4002285E /end MEASUREMENT
/begin MEASUREMENT EGRVlv_rGovEGR "Control value from the governor" SWORD Prc_100_rate 0 0 -100.0 100.0 ECU_ADDRESS 0x4002285C /end MEASUREMENT
/begin MEASUREMENT EGRVlv_rOutP_mp "measurement point for P governor for single flow implementation" SWORD Prc_100_rate 0 0 -100.0 100.0 ECU_ADDRESS 0x40022862 /end MEASUREMENT
/begin MEASUREMENT EGRVlv_rOutI_mp "measurement point for I governor for single flow implementation" SWORD Prc_100_rate 0 0 -100.0 100.0 ECU_ADDRESS 0x4002285A /end MEASUREMENT
/begin MEASUREMENT EGRVlv_rDesValNrm "Normalized desired value" SWORD Prc_100_rate 0 0 -100.0 100.0 ECU_ADDRESS 0x40022860 /end MEASUREMENT
/begin MEASUREMENT EGRVlv_rDesLMS "Desired value from LMS control" SWORD Prc_100_rate 0 0 -100.0 100.0 ECU_ADDRESS 0x40022832 /end MEASUREMENT
/begin MEASUREMENT EGRVlv_rGovDvtRel "Relative governor deviation for OBD purpose" SWORD Prc_100_rate 0 0 -100.0 100.0 ECU_ADDRESS 0x40022856 /end MEASUREMENT
/begin MEASUREMENT EGRVlv_rRlsEGR "Additional control value to release a jammed valve" SWORD Prc_100_rate 0 0 -100.0 100.0 ECU_ADDRESS 0x4002284E /end MEASUREMENT
/begin MEASUREMENT EGRVlv_rSens "Sensed value of actuator position without error handling" SWORD Prc_100_rate 0 0 -100.0 100.0 ECU_ADDRESS 0x4002282A /end MEASUREMENT
/begin MEASUREMENT EGRVlv_rPs "Duty cycle to power stage" SWORD Prc_100_rate 0 0 -100.0 100.0 ECU_ADDRESS 0x40022850 /end MEASUREMENT
/begin MEASUREMENT EGRVlv_rPsNrm "Normalized value of EGRVLv_rPSNrm" SWORD Prc_100_rate 0 0 -100.0 100.0 ECU_ADDRESS 0x40022874 /end MEASUREMENT
/begin MEASUREMENT Fans_rClgDesFan "Relative cooling performance demand to fan" SWORD Prc_100_rate 0 0 -300.0 300.0 ECU_ADDRESS 0x40022664 /end MEASUREMENT
/begin MEASUREMENT Fans_rCoolgDmdFan_mp "corrected fan?demand after maximum choice" SWORD Prc_100_rate 0 0 -300.0 300.0 ECU_ADDRESS 0x40022662 /end MEASUREMENT
/begin MEASUREMENT Tra_rClgDem "Relative fan cooling capacity" SWORD Prc_100_rate 0 0 -300.0 300.0 ECU_ADDRESS 0x400222BC /end MEASUREMENT
/begin MEASUREMENT Gbx_rFanClgDem "Percentage of fan cooling demand" SWORD Prc_100_rate 0 0 -300.0 300.0 ECU_ADDRESS 0x400222B8 /end MEASUREMENT
/begin MEASUREMENT CoPT_rClgDes "Whole cool demand of the impulse rope for the ventilator" SWORD Prc_100_rate 0 0 -300.0 300.0 ECU_ADDRESS 0x400228DC /end MEASUREMENT
/begin MEASUREMENT CoVeh_rClgDes "Desired relative air mass flow" SWORD Prc_100_rate 0 0 -300.0 300.0 ECU_ADDRESS 0x400228E0 /end MEASUREMENT
/begin MEASUREMENT CoETS_rTrq "Calculated load value" SWORD Prc_100_rate 0 0 -300.0 300.0 ECU_ADDRESS 0x40022952 /end MEASUREMENT
/begin MEASUREMENT CoETS_rTrqVMD "Ratio of driver requested torque to engine reference torque" SWORD Prc_100_rate 0 0 -300.0 300.0 ECU_ADDRESS 0x40022954 /end MEASUREMENT
/begin MEASUREMENT CoTemp_rClgDes "Cooling requirement of the combustion engine" SWORD Prc_100_rate 0 0 -300.0 300.0 ECU_ADDRESS 0x400228CE /end MEASUREMENT
/begin MEASUREMENT VehV_a "The acceleration of the vehicle" SWORD Acc_m_s2 0 0 -32.7 32.7 ECU_ADDRESS 0x4002227C /end MEASUREMENT
/begin MEASUREMENT BattU_facCor "Battery correction factor" SWORD Factor 0 0 -32.0 31.9 ECU_ADDRESS 0x400222CC /end MEASUREMENT
/begin MEASUREMENT FlSys_facStoich "Stochiometric fuel factor" SWORD Factor 0 0 -32.0 31.0 ECU_ADDRESS 0x4002231A /end MEASUREMENT
/begin MEASUREMENT EngDem_facAdj "EEPROM adjustment value for correction of the limiting torque" SWORD Factor 0 0 -10.0 10.0 ECU_ADDRESS 0x40022730 /end MEASUREMENT
/begin MEASUREMENT TrbCh_n "Turbo charger speed" SWORD Turbo_rpm 0 0 -327679.0 327671.0 ECU_ADDRESS 0x400222D6 /end MEASUREMENT
/begin MEASUREMENT InjVlv_phiBlkSht "measuring points blankshot execution control / angle of last blankshot programmed" SWORD Angle_CA 0 0 -360.0 0.0 ECU_ADDRESS 0x400224F8 /end MEASUREMENT
/begin MEASUREMENT InjVlv_tiETMI1_mp "Start of energizing for MI1" SWORD InjTime_us 0 0 -13107.0 13106.0 ECU_ADDRESS 0x400224E0 /end MEASUREMENT
/begin MEASUREMENT InjVlv_tiETPiI1_mp "Start of energizing for PiI1" SWORD InjTime_us 0 0 -13107.0 13106.0 ECU_ADDRESS 0x400224E4 /end MEASUREMENT
/begin MEASUREMENT InjVlv_tiETPoI2_mp "Start of energizing for PoI2" SWORD InjTime_us 0 0 -13107.0 13106.0 ECU_ADDRESS 0x400224EC /end MEASUREMENT
/begin MEASUREMENT InjCrv_tiPoI2Pse_mp "Minium injection interval between MI1 and PoI2" SWORD InjTime_us 0 0 -13107.0 13106.0 ECU_ADDRESS 0x400224DC /end MEASUREMENT
/begin MEASUREMENT InjCrv_tiPiIPse_mp "Minium injection interval between MI1 and PiI1" SWORD InjTime_us 0 0 -13107.0 13106.0 ECU_ADDRESS 0x400224DE /end MEASUREMENT
/begin MEASUREMENT InjCrv_tiMI1ET "Estimated MI1 energizing time" SWORD InjTime_us 0 0 -13107.0 13106.0 ECU_ADDRESS 0x400224E2 /end MEASUREMENT
/begin MEASUREMENT InjCrv_tiPiI1ET_mp "Estimated energizing time for PiI1" SWORD InjTime_us 0 0 -13107.0 13106.0 ECU_ADDRESS 0x400224E6 /end MEASUREMENT
/begin MEASUREMENT InjVlv_tiETPiI2_mp "Start of energizing for PiI2" SWORD InjTime_us 0 0 -13107.0 13106.0 ECU_ADDRESS 0x400224E8 /end MEASUREMENT
/begin MEASUREMENT InjCrv_tiPiI2ET_mp "Estimated energizing time for PiI2" SWORD InjTime_us 0 0 -13107.0 13106.0 ECU_ADDRESS 0x400224EA /end MEASUREMENT
/begin MEASUREMENT InjVlv_tiBlkShtET "measuring points blankshot execution control / energizing time of last blakshot programmed" SWORD InjTime_us 0 0 -13107.2 13106.8 ECU_ADDRESS 0x400224F6 /end MEASUREMENT
/begin MEASUREMENT VehVDspl_tiSigPer_mp "signal period duration used for vehcle speed display" UWORD Period_us 0 0 0.0 6553.0 ECU_ADDRESS 0x40022280 /end MEASUREMENT
/begin MEASUREMENT MeUn_tiPer_mp "Duration of the PWM power stage period" UWORD Period_us 0 0 0.0 6553.0 ECU_ADDRESS 0x400224D0 /end MEASUREMENT
/begin MEASUREMENT PT_rTraV2N "Quotient of velocity and engine speed" SWORD Tra_V2N_km_h_rpm 0 0 -0.32768 0.32767 ECU_ADDRESS 0x400222AC /end MEASUREMENT
/begin MEASUREMENT Tra_numParGear "Application parameter for gear number of the parameter gear of the transmission" SBYTE Tra_num 0 0 -128.0 127.0 ECU_ADDRESS 0x400222AE /end MEASUREMENT
/begin MEASUREMENT Tra_numGear "Current gear information" SBYTE Tra_num 0 0 -128.0 127.0 ECU_ADDRESS 0x40022295 /end MEASUREMENT
/begin MEASUREMENT Tra_numGearDes "Application parameter for gear number of the destination gear of the transmission" SBYTE Tra_num 0 0 -128.0 127.0 ECU_ADDRESS 0x400222AF /end MEASUREMENT
/begin MEASUREMENT PTOSwt_st "Power Take-off switch current state for a specific input voltage" UBYTE State_uint8 0 0 0.0 255.0 ECU_ADDRESS 0x40022296 /end MEASUREMENT
/begin MEASUREMENT HndBrk_stDebVal "Debounced value of Hand Brake switch" UBYTE State_uint8 0 0 0.0 255.0 ECU_ADDRESS 0x400222FD /end MEASUREMENT
/begin MEASUREMENT Clth_st "Clutch information" UBYTE State_uint8 0 0 0.0 255.0 ECU_ADDRESS 0x400222FC /end MEASUREMENT
/begin MEASUREMENT Brk_st "Brake switch state" UBYTE State_uint8 0 0 0.0 255.0 ECU_ADDRESS 0x40022360 /end MEASUREMENT
/begin MEASUREMENT DevLib_stMonActrPrt "The current status of the actuator protection control" UBYTE State_uint8 0 0 0.0 255.0 ECU_ADDRESS 0x40022887 /end MEASUREMENT
/begin MEASUREMENT EGRVlv_stOfsLrn "Offset learning for Throttle valve complete" UBYTE State_uint8 0 0 0.0 255.0 ECU_ADDRESS 0x4002284A /end MEASUREMENT
/begin MEASUREMENT EGRVlv_stClnUp "Status of valvle cleanup function" UBYTE State_uint8 0 0 0.0 255.0 ECU_ADDRESS 0x40022864 /end MEASUREMENT
/begin MEASUREMENT EGRVlv_stClnUpMchn "Status of cleanup state machine" UBYTE State_uint8 0 0 0.0 255.0 ECU_ADDRESS 0x40022865 /end MEASUREMENT
/begin MEASUREMENT EGRVlv_swtEGRTyp "Type of EGR actuator used" UBYTE State_uint8 0 0 0.0 255.0 ECU_ADDRESS 0x40022836 /end MEASUREMENT
/begin MEASUREMENT AFS_stDrft "Status of drift compensation" UBYTE State_uint8 0 0 0.0 255.0 ECU_ADDRESS 0x40022984 /end MEASUREMENT
/begin MEASUREMENT VehMot_stLimDfftl "Status torque intervention differential protection" UBYTE State_uint8 0 0 0.0 255.0 ECU_ADDRESS 0x40022422 /end MEASUREMENT
/begin MEASUREMENT VehMot_stNSetP "Status of engine speed request after driving assistance coordination" UBYTE State_uint8 0 0 0.0 255.0 ECU_ADDRESS 0x40022892 /end MEASUREMENT
/begin MEASUREMENT Tra_stNSetP "Status for current set point engine speed requirement" UBYTE State_uint8 0 0 0.0 255.0 ECU_ADDRESS 0x40022294 /end MEASUREMENT
/begin MEASUREMENT Gbx_stOvrSpdDem "status of engine overspeed request" UBYTE State_uint8 0 0 0.0 255.0 ECU_ADDRESS 0x40022578 /end MEASUREMENT
/begin MEASUREMENT PT_stTraIntv "Status of torque access gearbox interventions" UBYTE State_uint8 0 0 0.0 255.0 ECU_ADDRESS 0x400228E2 /end MEASUREMENT
/begin MEASUREMENT GlbDa_stVehLimMin "Current limitation state from GlbDa" UBYTE State_uint8 0 0 0.0 255.0 ECU_ADDRESS 0x40022600 /end MEASUREMENT
/begin MEASUREMENT CoME_stNSetP "Status: Nature of low-idle speed increase" UBYTE State_uint8 0 0 0.0 255.0 ECU_ADDRESS 0x40022462 /end MEASUREMENT
/begin MEASUREMENT CoVeh_stNSetPSysErr "Status word which defines the conversion of the system error speed requirements" UBYTE State_uint8 0 0 0.0 255.0 ECU_ADDRESS 0x4002245C /end MEASUREMENT
/begin MEASUREMENT EngTrqPtd_stPthLim "State of engine torque limitation from ECU monitoring" UBYTE State_uint8 0 0 0.0 255.0 ECU_ADDRESS 0x40022404 /end MEASUREMENT
/begin MEASUREMENT CoETS_stLimInfo "Status information on working torque limitation" UBYTE State_uint8 0 0 0.0 255.0 ECU_ADDRESS 0x40022956 /end MEASUREMENT
/begin MEASUREMENT CoEng_stEngStop "Bit coded output message from engine stop function for low idle, egine shut off and crank control" UBYTE State_uint8 0 0 0.0 255.0 ECU_ADDRESS 0x400222FB /end MEASUREMENT
/begin MEASUREMENT VehV_bSwtPrs "sensor switch" UBYTE boolean 0 0 0.0 1.0 ECU_ADDRESS 0x40022268 /end MEASUREMENT
/begin MEASUREMENT SpdGovSwt_st "Speed Governor Switch status" UBYTE boolean 0 0 0.0 1.0 ECU_ADDRESS 0x4002230A /end MEASUREMENT
/begin MEASUREMENT SpdDemSwt_st "Speed demand switch status" UBYTE boolean 0 0 0.0 1.0 ECU_ADDRESS 0x4002230C /end MEASUREMENT
/begin MEASUREMENT SpdDemSwt_stDebVal_mp "Debounced speed demand switch status" UBYTE boolean 0 0 0.0 1.0 ECU_ADDRESS 0x4002230B /end MEASUREMENT
/begin MEASUREMENT RmtAPP_stSigSrc_APPLIMP_BP "Substitute operation active, remote accelerator pedal sensor value and accelerator pedal sensor increase are limited" UBYTE boolean 0 0 0.0 1.0 ECU_ADDRESS 0x40022346 /end MEASUREMENT
/begin MEASUREMENT RmtAPP_stSigSrc_APPDEF_BP "both the sensors are defective. Use the default value" UBYTE boolean 0 0 0.0 1.0 ECU_ADDRESS 0x40022347 /end MEASUREMENT
/begin MEASUREMENT RmtAPP_stSigSrc_APP1_BP "Sensor 1 is the reference variable, Sensor 2 value is defective" UBYTE boolean 0 0 0.0 1.0 ECU_ADDRESS 0x4002235E /end MEASUREMENT
/begin MEASUREMENT RmtAPP_stSigSrc_APP2_BP "Sensor 2 is the reference variable,Sensor1 value is defective" UBYTE boolean 0 0 0.0 1.0 ECU_ADDRESS 0x4002235F /end MEASUREMENT
/begin MEASUREMENT RmtAPP_stPlaBrkDet_mp "State of detection plausibility with brake" UBYTE boolean 0 0 0.0 1.0 ECU_ADDRESS 0x40022363 /end MEASUREMENT
/begin MEASUREMENT RmtAPP_stPlaBrkRst_mp "State of reset plausibility with brake" UBYTE boolean 0 0 0.0 1.0 ECU_ADDRESS 0x40022364 /end MEASUREMENT
/begin MEASUREMENT RmtAPP_stPlaBrk_mp "State of plausibility RmtAPP with brake" UBYTE boolean 0 0 0.0 1.0 ECU_ADDRESS 0x40022365 /end MEASUREMENT
/begin MEASUREMENT RmtAPP_bSync "Status temporary sync check" UBYTE boolean 0 0 0.0 1.0 ECU_ADDRESS 0x40022354 /end MEASUREMENT
/begin MEASUREMENT RmtAPP_bSyncDeb "Status debounced sync check" UBYTE boolean 0 0 0.0 1.0 ECU_ADDRESS 0x40022355 /end MEASUREMENT
/begin MEASUREMENT RmtAPP_stKD "State of  remot accelerator pedal kick down" UBYTE boolean 0 0 0.0 1.0 ECU_ADDRESS 0x4002236A /end MEASUREMENT
/begin MEASUREMENT RmtAPP_bAPP2FinalDef "Status Sensor 2 of the remote acceleration pedal finally defect" UBYTE boolean 0 0 0.0 1.0 ECU_ADDRESS 0x4002235C /end MEASUREMENT
/begin MEASUREMENT RmtAPP_bAPP2ProvDef "Status Sensor 2 of the remote acceleration pedal temporary defect" UBYTE boolean 0 0 0.0 1.0 ECU_ADDRESS 0x4002235D /end MEASUREMENT
/begin MEASUREMENT RmtAPP_bAPP1FinalDef "Status Sensor 1 of the remote acceleration pedal finally defect" UBYTE boolean 0 0 0.0 1.0 ECU_ADDRESS 0x4002235A /end MEASUREMENT
/begin MEASUREMENT RmtAPP_bAPP1ProvDef "Status Sensor 1 of the remote acceleration pedal temporary defect" UBYTE boolean 0 0 0.0 1.0 ECU_ADDRESS 0x4002235B /end MEASUREMENT
/begin MEASUREMENT PTOSwt_bFinalDef "PTO switch sensor SRC finally defect flag" UBYTE boolean 0 0 0.0 1.0 ECU_ADDRESS 0x40022438 /end MEASUREMENT
/begin MEASUREMENT PTOSwt_bNpl "PTO switch sensor non plausible flag" UBYTE boolean 0 0 0.0 1.0 ECU_ADDRESS 0x40022439 /end MEASUREMENT
/begin MEASUREMENT PTOEnblSwt_st "PTO enable switch status" UBYTE boolean 0 0 0.0 1.0 ECU_ADDRESS 0x4002243A /end MEASUREMENT
/begin MEASUREMENT OilPLmp_st "oil pressure lamp status" UBYTE boolean 0 0 0.0 1.0 ECU_ADDRESS 0x400224BD /end MEASUREMENT
/begin MEASUREMENT GlwLmp_stReq "Glow lamp request status" UBYTE boolean 0 0 0.0 1.0 ECU_ADDRESS 0x400225F1 /end MEASUREMENT
/begin MEASUREMENT GlwLmp_stPs "Digital output to the actuator after diagnosis" UBYTE boolean 0 0 0.0 1.0 ECU_ADDRESS 0x400225F2 /end MEASUREMENT
/begin MEASUREMENT EnvT_bFinalDef "Environment temperature sensor finally defect flag" UBYTE boolean 0 0 0.0 1.0 ECU_ADDRESS 0x400226EC /end MEASUREMENT
/begin MEASUREMENT EnvT_bProvDef "Environment temperature sensor temporary defect flag" UBYTE boolean 0 0 0.0 1.0 ECU_ADDRESS 0x400226ED /end MEASUREMENT
/begin MEASUREMENT EnvT_bPhysRngFinalDef "Environment temperature sensor physical range finally defect" UBYTE boolean 0 0 0.0 1.0 ECU_ADDRESS 0x400226EE /end MEASUREMENT
/begin MEASUREMENT EnvT_bPhysRngProvDef "Environment temperature sensor physical range temporary defect" UBYTE boolean 0 0 0.0 1.0 ECU_ADDRESS 0x400226EF /end MEASUREMENT
/begin MEASUREMENT EnvP_bFinalDef "Environment pressure sensor finally defect flag" UBYTE boolean 0 0 0.0 1.0 ECU_ADDRESS 0x400226F2 /end MEASUREMENT
/begin MEASUREMENT EnvP_bProvDef "Environment pressure sensor temporary defect flag" UBYTE boolean 0 0 0.0 1.0 ECU_ADDRESS 0x400226F3 /end MEASUREMENT
/begin MEASUREMENT EnvP_bPhysRngFinalDef "Environment pressure sensor physical range finally defect" UBYTE boolean 0 0 0.0 1.0 ECU_ADDRESS 0x400226F4 /end MEASUREMENT
/begin MEASUREMENT EnvP_bPhysRngProvDef "Environment pressure sensor physical range temporary defect" UBYTE boolean 0 0 0.0 1.0 ECU_ADDRESS 0x400226F5 /end MEASUREMENT
/begin MEASUREMENT EBrk_st "Engine Brake switch status" UBYTE boolean 0 0 0.0 1.0 ECU_ADDRESS 0x40022877 /end MEASUREMENT
/begin MEASUREMENT EBrk_stSwtDeb "debounced value of Engine Brake switch signal" UBYTE boolean 0 0 0.0 1.0 ECU_ADDRESS 0x40022876 /end MEASUREMENT
/begin MEASUREMENT Brk_stFreeze_mp "Measuring Point to indicate whether the brake plausibility state machine is in Neutral State" UBYTE boolean 0 0 0.0 1.0 ECU_ADDRESS 0x40022974 /end MEASUREMENT
/begin MEASUREMENT Brk_stMn "Status of the main brake" UBYTE boolean 0 0 0.0 1.0 ECU_ADDRESS 0x40022361 /end MEASUREMENT
/begin MEASUREMENT Brk_stRed "Status of the redundant break" UBYTE boolean 0 0 0.0 1.0 ECU_ADDRESS 0x40022362 /end MEASUREMENT
/begin MEASUREMENT APP_stSigSrc_APPDEF_BP "both the sensors are defective. Use the default value" UBYTE boolean 0 0 0.0 1.0 ECU_ADDRESS 0x400229E9 /end MEASUREMENT
/begin MEASUREMENT APP_stSigSrc_APP1_BP "Sensor 1 is the reference variable, Sensor 2 value is defective" UBYTE boolean 0 0 0.0 1.0 ECU_ADDRESS 0x400229FA /end MEASUREMENT
/begin MEASUREMENT APP_stSigSrc_APP2_BP "Sensor 2 is the reference variable,Sensor1 value is defective" UBYTE boolean 0 0 0.0 1.0 ECU_ADDRESS 0x400229FB /end MEASUREMENT
/begin MEASUREMENT APP_stSigSrc_APPLIMP_BP "Substitute operation active, accelerator pedal sensor value and accelerator pedal sensor increase are limited" UBYTE boolean 0 0 0.0 1.0 ECU_ADDRESS 0x400229E8 /end MEASUREMENT
/begin MEASUREMENT APP_stPlaBrkDet_mp "State of detection plausibility with brake" UBYTE boolean 0 0 0.0 1.0 ECU_ADDRESS 0x400229FC /end MEASUREMENT
/begin MEASUREMENT APP_stPlaBrkRst_mp "State of reset plausibility with brake" UBYTE boolean 0 0 0.0 1.0 ECU_ADDRESS 0x400229FD /end MEASUREMENT
/begin MEASUREMENT APP_stPlaBrk_mp "State of plausibility APP with brake" UBYTE boolean 0 0 0.0 1.0 ECU_ADDRESS 0x400229FE /end MEASUREMENT
/begin MEASUREMENT APP_bSync "Status temporary sync check" UBYTE boolean 0 0 0.0 1.0 ECU_ADDRESS 0x400229F5 /end MEASUREMENT
/begin MEASUREMENT APP_bSyncDeb "Status debounced sync check" UBYTE boolean 0 0 0.0 1.0 ECU_ADDRESS 0x400229F2 /end MEASUREMENT
/begin MEASUREMENT APP_stKD "State of accelerator pedal kick down" UBYTE boolean 0 0 0.0 1.0 ECU_ADDRESS 0x4002229E /end MEASUREMENT
/begin MEASUREMENT APP_bAPP2FinalDef "Status Sensor 2 of the acceleration pedal finally defect" UBYTE boolean 0 0 0.0 1.0 ECU_ADDRESS 0x400229F1 /end MEASUREMENT
/begin MEASUREMENT APP_bAPP2ProvDef "Status Sensor 2 of the acceleration pedal temporary defect" UBYTE boolean 0 0 0.0 1.0 ECU_ADDRESS 0x400229F4 /end MEASUREMENT
/begin MEASUREMENT APP_bAPP1FinalDef "Status Sensor 1 of the acceleration pedal finally defect" UBYTE boolean 0 0 0.0 1.0 ECU_ADDRESS 0x400229F0 /end MEASUREMENT
/begin MEASUREMENT APP_bAPP1ProvDef "Status Sensor 1 of the acceleration pedal temporary defect" UBYTE boolean 0 0 0.0 1.0 ECU_ADDRESS 0x400229F3 /end MEASUREMENT
/begin MEASUREMENT Fan_stPs "fan output state" UBYTE boolean 0 0 0.0 1.0 ECU_ADDRESS 0x40022670 /end MEASUREMENT
/begin MEASUREMENT Fan_stPs2 "fan 2 output state" UBYTE boolean 0 0 0.0 1.0 ECU_ADDRESS 0x40022671 /end MEASUREMENT
/begin MEASUREMENT CEngDsT_bFinalDef "Status Sensor of the coolant temperature finally defect" UBYTE boolean 0 0 0.0 1.0 ECU_ADDRESS 0x4002261E /end MEASUREMENT
/begin MEASUREMENT CEngDsT_bProvDef "Status Sensor of the coolant temperature temporary defect" UBYTE boolean 0 0 0.0 1.0 ECU_ADDRESS 0x4002296B /end MEASUREMENT
/begin MEASUREMENT CEngDsT_bPhysRngFinalDef "Status Sensor of the CEngDsT physical Signal range check finally defect" UBYTE boolean 0 0 0.0 1.0 ECU_ADDRESS 0x4002296A /end MEASUREMENT
/begin MEASUREMENT CEngDsT_bPhysRngProvDef "Status Sensor of the CEngDsT physical Signal range check temporary defect" UBYTE boolean 0 0 0.0 1.0 ECU_ADDRESS 0x4002296C /end MEASUREMENT
/begin MEASUREMENT AirC_stSwtPrs "AC switch pressed/unpressed status" UBYTE boolean 0 0 0.0 1.0 ECU_ADDRESS 0x40022A35 /end MEASUREMENT
/begin MEASUREMENT AirC_stSwt "Status of AC switch" UBYTE boolean 0 0 0.0 1.0 ECU_ADDRESS 0x40022A34 /end MEASUREMENT
/begin MEASUREMENT AirC_stPsCmpr_mp "Measuring point for the digital output to the ACompressor actuator before error handling" UBYTE boolean 0 0 0.0 1.0 ECU_ADDRESS 0x40022A37 /end MEASUREMENT
/begin MEASUREMENT AirC_stPsCmprRedTrq_mp "Measuring point for the Reduce torque instruction to the AC compressor before error handling" UBYTE boolean 0 0 0.0 1.0 ECU_ADDRESS 0x40022A38 /end MEASUREMENT
/begin MEASUREMENT AirC_stPsCmpr "Final digital output to the power stage of AC compressor actuator" UBYTE boolean 0 0 0.0 1.0 ECU_ADDRESS 0x40022A39 /end MEASUREMENT
/begin MEASUREMENT FuelT_bFinalDef "Status sensor of the fuel temperature finally defect" UBYTE boolean 0 0 0.0 1.0 ECU_ADDRESS 0x4002261C /end MEASUREMENT
/begin MEASUREMENT FuelT_bProvDef "Status sensor of the fuel temperature temporary defect" UBYTE boolean 0 0 0.0 1.0 ECU_ADDRESS 0x4002261D /end MEASUREMENT
/begin MEASUREMENT FuelT_bPlsFinalDef "Status sensor of the fuel temperature physical signal range check finally defect" UBYTE boolean 0 0 0.0 1.0 ECU_ADDRESS 0x40022628 /end MEASUREMENT
/begin MEASUREMENT FuelT_bPlsProvDef "Status sensor of the fuel temperature physical signal range check temporary defect" UBYTE boolean 0 0 0.0 1.0 ECU_ADDRESS 0x40022629 /end MEASUREMENT
/begin MEASUREMENT FlWLmp_stPs "Status of the power stage for the indication lamp" UBYTE boolean 0 0 0.0 1.0 ECU_ADDRESS 0x40022633 /end MEASUREMENT
/begin MEASUREMENT FlFltHt_st "Status of Fuel Filter Heating Digital output" UBYTE boolean 0 0 0.0 1.0 ECU_ADDRESS 0x4002264B /end MEASUREMENT
/begin MEASUREMENT FlFWLvl_st "status of water in fuel" UBYTE boolean 0 0 0.0 1.0 ECU_ADDRESS 0x4002264D /end MEASUREMENT
/begin MEASUREMENT Fl_stWLvlSensDebVal "Debounced value of fuel filter water level sensor signal" UBYTE boolean 0 0 0.0 1.0 ECU_ADDRESS 0x4002264C /end MEASUREMENT
/begin MEASUREMENT FlWLmp_st "Status of Water Level Indication lamp" UBYTE boolean 0 0 0.0 1.0 ECU_ADDRESS 0x40022632 /end MEASUREMENT
/begin MEASUREMENT Strt_stPs "Status of starter power stage" UBYTE boolean 0 0 0.0 1.0 ECU_ADDRESS 0x400222EE /end MEASUREMENT
/begin MEASUREMENT OilT_bPlsFinalDef "Status sensor of the oil temperature physical signal range check finally defect" UBYTE boolean 0 0 0.0 1.0 ECU_ADDRESS 0x400224AA /end MEASUREMENT
/begin MEASUREMENT OilT_bFinalDef "Status Sensor of the oil temperature finally defect" UBYTE boolean 0 0 0.0 1.0 ECU_ADDRESS 0x400224A6 /end MEASUREMENT
/begin MEASUREMENT OilT_bProvDef "Status sensor of the oil temperature temporary defect" UBYTE boolean 0 0 0.0 1.0 ECU_ADDRESS 0x400224A7 /end MEASUREMENT
/begin MEASUREMENT Oil_stPSwmp "sensor out oil pressure status" UBYTE boolean 0 0 0.0 1.0 ECU_ADDRESS 0x400224B8 /end MEASUREMENT
/begin MEASUREMENT OilP_bFinalDef "Status sensor of the oil pressure finally defect" UBYTE boolean 0 0 0.0 1.0 ECU_ADDRESS 0x400224B0 /end MEASUREMENT
/begin MEASUREMENT OilP_bProvDef "Status sensor of the oil pressure temporary defect" UBYTE boolean 0 0 0.0 1.0 ECU_ADDRESS 0x400224B2 /end MEASUREMENT
/begin MEASUREMENT OilP_bPhysRngFinalDef "Status sensor of the oil pressure physical signal range check finally defect" UBYTE boolean 0 0 0.0 1.0 ECU_ADDRESS 0x400224B1 /end MEASUREMENT
/begin MEASUREMENT OilP_bPhysRngProvDef "Status sensor of the oil pressure physical signal range check temporary defect" UBYTE boolean 0 0 0.0 1.0 ECU_ADDRESS 0x400224B3 /end MEASUREMENT
/begin MEASUREMENT Oil_stPresAna "Oil pressure status for analog input" UBYTE boolean 0 0 0.0 1.0 ECU_ADDRESS 0x400224B4 /end MEASUREMENT
/begin MEASUREMENT Oil_stPresDig "Oil pressure status for digital input" UBYTE boolean 0 0 0.0 1.0 ECU_ADDRESS 0x400224B5 /end MEASUREMENT
/begin MEASUREMENT T50_stEmgcy "Terminal 50 status after debouncing" UBYTE boolean 0 0 0.0 1.0 ECU_ADDRESS 0x400222DF /end MEASUREMENT
/begin MEASUREMENT PSP_st "source for activating the pre-supply pump (1=on/0-=off)" UBYTE boolean 0 0 0.0 1.0 ECU_ADDRESS 0x40022492 /end MEASUREMENT
/begin MEASUREMENT BattU_bFinalDef "Status Sensor of the battery voltage finally defect" UBYTE boolean 0 0 0.0 1.0 ECU_ADDRESS 0x4002297B /end MEASUREMENT
/begin MEASUREMENT BattU_bProvDef "Status Sensor of the battery voltage temporary defect" UBYTE boolean 0 0 0.0 1.0 ECU_ADDRESS 0x40022979 /end MEASUREMENT
/begin MEASUREMENT BattU_bPhysRngFinalDef "Status Sensor of the  battery voltage physical Signal range check finally defect" UBYTE boolean 0 0 0.0 1.0 ECU_ADDRESS 0x4002297C /end MEASUREMENT
/begin MEASUREMENT BattU_bPhysRngProvDef "Status Sensor of the battery voltage physical Signal range check temporary defect" UBYTE boolean 0 0 0.0 1.0 ECU_ADDRESS 0x4002297A /end MEASUREMENT
/begin MEASUREMENT Air_bTIntkVUsFinalDef "Final defect of the raw air temperature upstream of the intake valve" UBYTE boolean 0 0 0.0 1.0 ECU_ADDRESS 0x400222C2 /end MEASUREMENT
/begin MEASUREMENT Air_bTIntkVUsProvDef "Provisional defect of the raw air temperature upstream of the intake valve" UBYTE boolean 0 0 0.0 1.0 ECU_ADDRESS 0x400222C3 /end MEASUREMENT
/begin MEASUREMENT Air_bPIntkVUsFinalDef "Final defect of the raw air pressure upstream of the intake valve" UBYTE boolean 0 0 0.0 1.0 ECU_ADDRESS 0x40022496 /end MEASUREMENT
/begin MEASUREMENT Air_bPIntkVUsProvDef "Provisional defect of the raw air pressure upstream of the intake valve" UBYTE boolean 0 0 0.0 1.0 ECU_ADDRESS 0x40022498 /end MEASUREMENT
/begin MEASUREMENT Air_bPhysRngPIntkVUsFinalDef "Final defect of the physical air pressure upstream of the intake valve" UBYTE boolean 0 0 0.0 1.0 ECU_ADDRESS 0x40022497 /end MEASUREMENT
/begin MEASUREMENT Air_bPhysRngPIntkVUsProvDef "Provisional defect of the physical air pressure upstream of the intake valve" UBYTE boolean 0 0 0.0 1.0 ECU_ADDRESS 0x40022499 /end MEASUREMENT
/begin MEASUREMENT Air_bPlsPIntkVUsFinalDef "Final defect which the air pressure upstream of the intake valve is not plausible" UBYTE boolean 0 0 0.0 1.0 ECU_ADDRESS 0x400224A2 /end MEASUREMENT
/begin MEASUREMENT Air_bPlsPIntkVUsProvDef "Provisional defect which the air pressure upstream of the intake valve is not plausible" UBYTE boolean 0 0 0.0 1.0 ECU_ADDRESS 0x400224A3 /end MEASUREMENT
/begin MEASUREMENT IAirHt_stReq "Logical Output of Intake Air Heating" UBYTE boolean 0 0 0.0 1.0 ECU_ADDRESS 0x40022569 /end MEASUREMENT
/begin MEASUREMENT IAirHt_stPs "Logical Output of Intake Air Heating" UBYTE boolean 0 0 0.0 1.0 ECU_ADDRESS 0x4002256A /end MEASUREMENT
/begin MEASUREMENT EGRVlv_stTmpOfsLrnt "Temporary offset of the EGR valve is already learnt in the current driving cycle" UBYTE boolean 0 0 0.0 1.0 ECU_ADDRESS 0x4002284B /end MEASUREMENT
/begin MEASUREMENT EGRVlv_stNewVlvTrg_mp "New valve trigger status" UBYTE boolean 0 0 0.0 1.0 ECU_ADDRESS 0x4002284C /end MEASUREMENT
/begin MEASUREMENT EGRVlv_stOfsLrnTrgClnUp "Offset learning trigger from EGR valve cleanup function" UBYTE boolean 0 0 0.0 1.0 ECU_ADDRESS 0x40022866 /end MEASUREMENT
/begin MEASUREMENT EGRVlv_stJamVlv "Status indicates that the valve is jammed" UBYTE boolean 0 0 0.0 1.0 ECU_ADDRESS 0x40022855 /end MEASUREMENT
/begin MEASUREMENT EGRVlv_bFinalDef "the final fault flag" UBYTE boolean 0 0 0.0 1.0 ECU_ADDRESS 0x4002282C /end MEASUREMENT
/begin MEASUREMENT EGRVlv_bProvDef "the fault flag for the moment" UBYTE boolean 0 0 0.0 1.0 ECU_ADDRESS 0x4002282D /end MEASUREMENT
/begin MEASUREMENT EGRVlv_bPhysRngFinalDef "Status Sensor of the EGR valve physical Signal range check finally defect" UBYTE boolean 0 0 0.0 1.0 ECU_ADDRESS 0x4002282E /end MEASUREMENT
/begin MEASUREMENT EGRVlv_bPhysRngProvDef "Status Sensor of the EGR valve physical Signal range check temporary defect" UBYTE boolean 0 0 0.0 1.0 ECU_ADDRESS 0x4002282F /end MEASUREMENT
/begin MEASUREMENT Air_bDtyCycTAFSFinalDef "Fault flag of TAFS Duty Cycle Final fault" UBYTE boolean 0 0 0.0 1.0 ECU_ADDRESS 0x40022A24 /end MEASUREMENT
/begin MEASUREMENT Air_bDtyCycTAFSProvDef "Fault flag of TAFS Duty Cycle fault Proving" UBYTE boolean 0 0 0.0 1.0 ECU_ADDRESS 0x40022A25 /end MEASUREMENT
/begin MEASUREMENT Air_bPerTAFSFinalDef "Fault flag of TAFS Period Final fault" UBYTE boolean 0 0 0.0 1.0 ECU_ADDRESS 0x40022A26 /end MEASUREMENT
/begin MEASUREMENT Air_bPerTAFSProvDef "Fault flag of TAFS Period fault Proving" UBYTE boolean 0 0 0.0 1.0 ECU_ADDRESS 0x40022A27 /end MEASUREMENT
/begin MEASUREMENT Air_bVoltTAFSFinalDef "Fault flag of TAFS voltage Final fault" UBYTE boolean 0 0 0.0 1.0 ECU_ADDRESS 0x40022A32 /end MEASUREMENT
/begin MEASUREMENT Air_bVoltTAFSProvDef "Fault flag of TAFS voltage fault Proving" UBYTE boolean 0 0 0.0 1.0 ECU_ADDRESS 0x40022A33 /end MEASUREMENT
/begin MEASUREMENT AFS_stDrftMonRls_mp "Status of monitoring conditions for the sensitivity drift test" UBYTE boolean 0 0 0.0 1.0 ECU_ADDRESS 0x40022A0C /end MEASUREMENT
/begin MEASUREMENT InjVlv_bBlkShtEnb "flag to indicate blank shot enable or not" UBYTE boolean 0 0 0.0 1.0 ECU_ADDRESS 0x400224FA /end MEASUREMENT
/begin MEASUREMENT FanCtl_stXPostDrv "Prolonging post drive due to fan" UBYTE boolean 0 0 0.0 1.0 ECU_ADDRESS 0x40022678 /end MEASUREMENT
/begin MEASUREMENT FanCtl_flgAftRunActv "fan afterrun active" UBYTE boolean 0 0 0.0 1.0 ECU_ADDRESS 0x40022679 /end MEASUREMENT
/begin MEASUREMENT FanCtl_bTrqResv "the additional torque required for Fan1 from the engine" UBYTE boolean 0 0 0.0 1.0 ECU_ADDRESS 0x40022652 /end MEASUREMENT
/begin MEASUREMENT FanCtl_bTrqResv2 "the additional torque required for Fan2 from the engine" UBYTE boolean 0 0 0.0 1.0 ECU_ADDRESS 0x40022653 /end MEASUREMENT
/begin MEASUREMENT Fan_st "Fan status based on fan opening" UBYTE boolean 0 0 0.0 1.0 ECU_ADDRESS 0x40022666 /end MEASUREMENT
/begin MEASUREMENT Fan_st2 "Fan 2 status based on fan opening" UBYTE boolean 0 0 0.0 1.0 ECU_ADDRESS 0x40022667 /end MEASUREMENT
/begin MEASUREMENT PT_stTraGrip "Gearbox grip status" UBYTE boolean 0 0 0.0 1.0 ECU_ADDRESS 0x400222A4 /end MEASUREMENT
/begin MEASUREMENT PT_stTraShftOp "Status if shift operation is active" UBYTE boolean 0 0 0.0 1.0 ECU_ADDRESS 0x400222B0 /end MEASUREMENT
/begin MEASUREMENT Tra_stStrtEna "Enable start function" UBYTE boolean 0 0 0.0 1.0 ECU_ADDRESS 0x400222B1 /end MEASUREMENT
/begin MEASUREMENT Tra_stStopEna "Enable stop function" UBYTE boolean 0 0 0.0 1.0 ECU_ADDRESS 0x400222B2 /end MEASUREMENT
/begin MEASUREMENT PT_stTraRevGear "Status if reverse gear is selected" UBYTE boolean 0 0 0.0 1.0 ECU_ADDRESS 0x400222B3 /end MEASUREMENT
/begin MEASUREMENT PT_stConvGrip "Grip status clutch" UBYTE boolean 0 0 0.0 1.0 ECU_ADDRESS 0x40022888 /end MEASUREMENT
/begin MEASUREMENT PT_bGrip "Grip is for sure present (the converter lockup clutch / the automated or manual clutch is completely closed and PT_bNoGrip = FALSE)" UBYTE boolean 0 0 0.0 1.0 ECU_ADDRESS 0x4002242E /end MEASUREMENT
/begin MEASUREMENT PT_bNoGrip "Grip reliable exclude" UBYTE boolean 0 0 0.0 1.0 ECU_ADDRESS 0x400223F6 /end MEASUREMENT
/begin MEASUREMENT CoVeh_stAlt "Status: Alternator start-up" UBYTE boolean 0 0 0.0 1.0 ECU_ADDRESS 0x400228EE /end MEASUREMENT
/begin MEASUREMENT CoVeh_stFan "Status: Fan start-up" UBYTE boolean 0 0 0.0 1.0 ECU_ADDRESS 0x400228EF /end MEASUREMENT
/begin MEASUREMENT StSys_stTrqShutOff "the status of the starting torque shuto-off input" UBYTE boolean 0 0 0.0 1.0 ECU_ADDRESS 0x400222F2 /end MEASUREMENT
/begin MEASUREMENT Strt_st "Control signal for the starter relay" UBYTE boolean 0 0 0.0 1.0 ECU_ADDRESS 0x400222ED /end MEASUREMENT
/begin MEASUREMENT EngDem_stErr_mp "Status of the limitation FIDs" UBYTE boolean 0 0 0.0 1.0 ECU_ADDRESS 0x40022732 /end MEASUREMENT
/begin MEASUREMENT CoETS_stEngStopReq "Tbox Engine stop request" UBYTE boolean 0 0 0.0 1.0 ECU_ADDRESS 0x40022303 /end MEASUREMENT
/begin MEASUREMENT CoETS_stEngEmgcyRunReq "Tbox Engine emergency start request" UBYTE boolean 0 0 0.0 1.0 ECU_ADDRESS 0x40022304 /end MEASUREMENT
/begin MEASUREMENT CoEng_st "Engine coordinator state" UBYTE EngState_conv 0 0 0 5 ECU_ADDRESS 0x40022308 /end MEASUREMENT
/begin MEASUREMENT CoEng_stOld "Engine state before current state was reached" UBYTE EngState_conv 0 0 0 5 ECU_ADDRESS 0x40022910 /end MEASUREMENT
/begin MEASUREMENT StSys_stStrt "state of starting system" UBYTE StSys_StrtState_conv 0 0 0 1 ECU_ADDRESS 0x400222FA /end MEASUREMENT
/begin MEASUREMENT T50_st "Terminal 50 status after Check" UBYTE Switch_conv 0 0 0 1 ECU_ADDRESS 0x400222E0 /end MEASUREMENT
/begin MEASUREMENT T50_stRaw "Terminal 50 status after debouncing" UBYTE Switch_conv 0 0 0 1 ECU_ADDRESS 0x400222DE /end MEASUREMENT
/begin MEASUREMENT T15_st "Terminal 15 status after debouncing" UBYTE Switch_conv 0 0 0 1 ECU_ADDRESS 0x4002229F /end MEASUREMENT
/begin MEASUREMENT FlSys_swtRhoFlCnv "switch for customer specific fuel conversion factor" UBYTE Switch_conv 0 0 0 1 ECU_ADDRESS 0x40022644 /end MEASUREMENT
/begin MEASUREMENT CoETS_stTSEASourceActv "Status of information about source active" UBYTE TSC1_stSource_conv 0 0 0 5 ECU_ADDRESS 0x4002294B /end MEASUREMENT
/begin MEASUREMENT PT_stTraType "Current transmission type" UBYTE PT_TraType_State_conv 0 0 0 4 ECU_ADDRESS 0x40022282 /end MEASUREMENT
/begin MEASUREMENT SyC_stSub "Current system/ECU sub-state" UBYTE SubSysExeState_conv 0 0 0 6 ECU_ADDRESS 0x400222EC /end MEASUREMENT
/begin COMPU_METHOD EngSpeed_rpm "f(x)=(c1*X*X+c2*X+c3)/(c4*X*X+c5*X+c6)" RAT_FUNC "%6.1" "rpm" COEFFS 0 2.000 0.000 0 0 1.000 /end COMPU_METHOD
/begin COMPU_METHOD SyCPostDrvState_conv "Enumerated data type: SyCPostDrvState_conv" TAB_VERB "%0.3" "" COMPU_TAB_REF VTAB_FOR_SyCPostDrvState_conv /end COMPU_METHOD
/begin COMPU_METHOD State_uint8 "f(x)=(c1*X*X+c2*X+c3)/(c4*X*X+c5*X+c6)" RAT_FUNC "%3.0" "" COEFFS 0 1 0 0 0 1 /end COMPU_METHOD
/begin COMPU_METHOD State_uint16 "f(x)=(c1*X*X+c2*X+c3)/(c4*X*X+c5*X+c6)" RAT_FUNC "%5.0" "" COEFFS 0 1 0 0 0 1 /end COMPU_METHOD
/begin COMPU_METHOD EpmSynState_conv "Enumerated data type: EpmSynState_conv" TAB_VERB "%0.3" "" COMPU_TAB_REF VTAB_FOR_EpmSynState_conv /end COMPU_METHOD
/begin COMPU_METHOD State_uint32 "f(x)=(c1*X*X+c2*X+c3)/(c4*X*X+c5*X+c6)" RAT_FUNC "%10.0" "" COEFFS 0 1 0 0 0 1 /end COMPU_METHOD
/begin COMPU_METHOD HLSDem_Kp "f(x)=(c1*X*X+c2*X+c3)/(c4*X*X+c5*X+c6)" RAT_FUNC "%0.3" "Nm/rpm" COEFFS 0 163840.000 0.000 0 0 1.000 /end COMPU_METHOD
/begin COMPU_METHOD HLSDem_Ki "f(x)=(c1*X*X+c2*X+c3)/(c4*X*X+c5*X+c6)" RAT_FUNC "%0.3" "Nm/(rpm*s)" COEFFS 0 10737.000 0.000 0 0 1.000 /end COMPU_METHOD
/begin COMPU_METHOD Trq_Nm "f(x)=(c1*X*X+c2*X+c3)/(c4*X*X+c5*X+c6)" RAT_FUNC "%0.3" "Nm" COEFFS 0 10.000 0.000 0 0 1.000 /end COMPU_METHOD
/begin COMPU_METHOD WESDem_State_conv "Enumerated data type: WESDem_State_conv" TAB_VERB "%0.3" "" COMPU_TAB_REF VTAB_FOR_WESDem_State_conv /end COMPU_METHOD
/begin COMPU_METHOD FdbkNm2rpm_rpm_Nm "f(x)=(c1*X*X+c2*X+c3)/(c4*X*X+c5*X+c6)" RAT_FUNC "%0.3" "rpm/Nm" COEFFS 0 1638.350 0.000 0 0 1.000 /end COMPU_METHOD
/begin COMPU_METHOD SysExeState_conv "Enumerated data type: SysExeState_conv" TAB_VERB "%0.3" "" COMPU_TAB_REF VTAB_FOR_SysExeState_conv /end COMPU_METHOD
/begin COMPU_METHOD FuelMass_mg_hub "f(x)=(c1*X*X+c2*X+c3)/(c4*X*X+c5*X+c6)" RAT_FUNC "%0.3" "mg/hub" COEFFS 0 102.400 0.000 0 0 1.000 /end COMPU_METHOD
/begin COMPU_METHOD AirPressure_kPa "f(x)=(c1*X*X+c2*X+c3)/(c4*X*X+c5*X+c6)" RAT_FUNC "%0.3" "kPa" COEFFS 0 10.000 0.000 0 0 1.000 /end COMPU_METHOD
/begin COMPU_METHOD boolean "f(x)=(c1*X*X+c2*X+c3)/(c4*X*X+c5*X+c6)" RAT_FUNC "%1.0" "" COEFFS 0 1 0 0 0 1 /end COMPU_METHOD
/begin COMPU_METHOD Counter_num "f(x)=(c1*X*X+c2*X+c3)/(c4*X*X+c5*X+c6)" RAT_FUNC "%10.0" "" COEFFS 0 1 0 0 0 1 /end COMPU_METHOD
/begin COMPU_METHOD uint8 "f(x)=(c1*X*X+c2*X+c3)/(c4*X*X+c5*X+c6)" RAT_FUNC "%3.0" "" COEFFS 0 1 0 0 0 1 /end COMPU_METHOD
/begin COMPU_METHOD EngTime_ms "f(x)=(c1*X*X+c2*X+c3)/(c4*X*X+c5*X+c6)" RAT_FUNC "%0.3" "ms" COEFFS 0 1.000 0.000 0 0 10.000 /end COMPU_METHOD
/begin COMPU_METHOD Prc_100_rate "f(x)=(c1*X*X+c2*X+c3)/(c4*X*X+c5*X+c6)" RAT_FUNC "%0.3" "%" COEFFS 0 81.920 0.000 0 0 1.000 /end COMPU_METHOD
/begin COMPU_METHOD InjTime_us "f(x)=(c1*X*X+c2*X+c3)/(c4*X*X+c5*X+c6)" RAT_FUNC "%0.3" "us" COEFFS 0 2.500 0.000 0 0 1.000 /end COMPU_METHOD
/begin COMPU_METHOD Time_PwmHigh_us "f(x)=(c1*X*X+c2*X+c3)/(c4*X*X+c5*X+c6)" RAT_FUNC "%0.3" "us" COEFFS 0 20.000 0.000 0 0 1.000 /end COMPU_METHOD
/begin COMPU_METHOD DutyCycle_rate "f(x)=(c1*X*X+c2*X+c3)/(c4*X*X+c5*X+c6)" RAT_FUNC "%0.3" "%" COEFFS 0 100.000 0.000 0 0 1.000 /end COMPU_METHOD
/begin COMPU_METHOD Time_Period_HFM6 "f(x)=(c1*X*X+c2*X+c3)/(c4*X*X+c5*X+c6)" RAT_FUNC "%0.3" "ms" COEFFS 0 20000.000 0.000 0 0 1.000 /end COMPU_METHOD
/begin COMPU_METHOD Ad_mv "f(x)=(c1*X*X+c2*X+c3)/(c4*X*X+c5*X+c6)" RAT_FUNC "%5.0" "mv" COEFFS 0 1 0 0 0 1 /end COMPU_METHOD
/begin COMPU_METHOD Period_us "f(x)=(c1*X*X+c2*X+c3)/(c4*X*X+c5*X+c6)" RAT_FUNC "%0.3" "us" COEFFS 0 10.000 0.000 0 0 1.000 /end COMPU_METHOD
/begin COMPU_METHOD Length_m "f(x)=(c1*X*X+c2*X+c3)/(c4*X*X+c5*X+c6)" RAT_FUNC "%10.0" "m" COEFFS 0 1 0 0 0 1 /end COMPU_METHOD
/begin COMPU_METHOD FlConsum_ul_20ms "f(x)=(c1*X*X+c2*X+c3)/(c4*X*X+c5*X+c6)" RAT_FUNC "%10.0" "ul/20ms" COEFFS 0 1 0 0 0 1 /end COMPU_METHOD
/begin COMPU_METHOD TimeEngOn_s "f(x)=(c1*X*X+c2*X+c3)/(c4*X*X+c5*X+c6)" RAT_FUNC "%10.0" "s" COEFFS 0 1 0 0 0 1 /end COMPU_METHOD
/begin COMPU_METHOD Debounce_ms "f(x)=(c1*X*X+c2*X+c3)/(c4*X*X+c5*X+c6)" RAT_FUNC "%10.0" "ms" COEFFS 0 1 0 0 0 1 /end COMPU_METHOD
/begin COMPU_METHOD Accpedal_rate_s "f(x)=(c1*X*X+c2*X+c3)/(c4*X*X+c5*X+c6)" RAT_FUNC "%0.3" "%/s" COEFFS 0 81.920 0.000 0 0 1.000 /end COMPU_METHOD
/begin COMPU_METHOD EGR_rate_s "f(x)=(c1*X*X+c2*X+c3)/(c4*X*X+c5*X+c6)" RAT_FUNC "%0.3" "r/s" COEFFS 0 1000.000 0.000 0 0 1.000 /end COMPU_METHOD
/begin COMPU_METHOD Length_Km "f(x)=(c1*X*X+c2*X+c3)/(c4*X*X+c5*X+c6)" RAT_FUNC "%0.3" "Km" COEFFS 0 1000.000 0.000 0 0 1.000 /end COMPU_METHOD
/begin COMPU_METHOD FlConsum_L "f(x)=(c1*X*X+c2*X+c3)/(c4*X*X+c5*X+c6)" RAT_FUNC "%0.3" "L" COEFFS 0 1000.000 0.000 0 0 1.000 /end COMPU_METHOD
/begin COMPU_METHOD Fl_Half_L "f(x)=(c1*X*X+c2*X+c3)/(c4*X*X+c5*X+c6)" RAT_FUNC "%11.1" "L" COEFFS 0 2.000 0.000 0 0 1.000 /end COMPU_METHOD
/begin COMPU_METHOD Battery_mv "f(x)=(c1*X*X+c2*X+c3)/(c4*X*X+c5*X+c6)" RAT_FUNC "%5.0" "mv" COEFFS 0 1 0 0 0 1 /end COMPU_METHOD
/begin COMPU_METHOD Freq_q1p0 "f(x)=(c1*X*X+c2*X+c3)/(c4*X*X+c5*X+c6)" RAT_FUNC "%5.0" "Hz" COEFFS 0 1 0 0 0 1 /end COMPU_METHOD
/begin COMPU_METHOD FuelMass_mm3_hub "f(x)=(c1*X*X+c2*X+c3)/(c4*X*X+c5*X+c6)" RAT_FUNC "%0.3" "mm^3/hub" COEFFS 0 10.000 0.000 0 0 1.000 /end COMPU_METHOD
/begin COMPU_METHOD Fuel_Rho_kg_m3 "f(x)=(c1*X*X+c2*X+c3)/(c4*X*X+c5*X+c6)" RAT_FUNC "%0.3" "kg/m^3" COEFFS 0 10.000 0.000 0 0 1.000 /end COMPU_METHOD
/begin COMPU_METHOD AirMass_mg_hub "f(x)=(c1*X*X+c2*X+c3)/(c4*X*X+c5*X+c6)" RAT_FUNC "%6.1" "mg/hub" COEFFS 0 2.000 0.000 0 0 1.000 /end COMPU_METHOD
/begin COMPU_METHOD VehSpeed_km_h "f(x)=(c1*X*X+c2*X+c3)/(c4*X*X+c5*X+c6)" RAT_FUNC "%0.3" "km/h" COEFFS 0 100.000 0.000 0 0 1.000 /end COMPU_METHOD
/begin COMPU_METHOD TransRatio "f(x)=(c1*X*X+c2*X+c3)/(c4*X*X+c5*X+c6)" RAT_FUNC "%0.3" "" COEFFS 0 100.000 0.000 0 0 1.000 /end COMPU_METHOD
/begin COMPU_METHOD Prc_Fact100 "f(x)=(c1*X*X+c2*X+c3)/(c4*X*X+c5*X+c6)" RAT_FUNC "%0.3" "" COEFFS 0 100.000 0.000 0 0 1.000 /end COMPU_METHOD
/begin COMPU_METHOD FlCon_L_h "f(x)=(c1*X*X+c2*X+c3)/(c4*X*X+c5*X+c6)" RAT_FUNC "%0.3" "L/h" COEFFS 0 100.000 0.000 0 0 1.000 /end COMPU_METHOD
/begin COMPU_METHOD Temp_deg "f(x)=(c1*X*X+c2*X+c3)/(c4*X*X+c5*X+c6)" RAT_FUNC "%0.3" "deg" COEFFS 0 10.000 2731.400 0 0 1.000 /end COMPU_METHOD
/begin COMPU_METHOD Temp_deg_s "f(x)=(c1*X*X+c2*X+c3)/(c4*X*X+c5*X+c6)" RAT_FUNC "%0.3" "deg/s" COEFFS 0 10.000 2731.400 0 0 1.000 /end COMPU_METHOD
/begin COMPU_METHOD Fact8192 "f(x)=(c1*X*X+c2*X+c3)/(c4*X*X+c5*X+c6)" RAT_FUNC "%14.6" "" COEFFS 0 8192.000 0.000 0 0 1.000 /end COMPU_METHOD
/begin COMPU_METHOD AirMassPerTime "f(x)=(c1*X*X+c2*X+c3)/(c4*X*X+c5*X+c6)" RAT_FUNC "%7.2" "kg/h" COEFFS 0 4.000 0.000 0 0 1.000 /end COMPU_METHOD
/begin COMPU_METHOD Accpedal_rate "f(x)=(c1*X*X+c2*X+c3)/(c4*X*X+c5*X+c6)" RAT_FUNC "%0.3" "%" COEFFS 0 81.920 0.000 0 0 1.000 /end COMPU_METHOD
/begin COMPU_METHOD Acc_m_s2 "f(x)=(c1*X*X+c2*X+c3)/(c4*X*X+c5*X+c6)" RAT_FUNC "%0.3" "m/s^2" COEFFS 0 1000.000 0.000 0 0 1.000 /end COMPU_METHOD
/begin COMPU_METHOD Factor "f(x)=(c1*X*X+c2*X+c3)/(c4*X*X+c5*X+c6)" RAT_FUNC "%12.6" "" COEFFS 0 1024.000 0.000 0 0 1.000 /end COMPU_METHOD
/begin COMPU_METHOD Turbo_rpm "f(x)=(c1*X*X+c2*X+c3)/(c4*X*X+c5*X+c6)" RAT_FUNC "%0.3" "rpm" COEFFS 0 1.000 0.000 0 0 10.000 /end COMPU_METHOD
/begin COMPU_METHOD Angle_CA "f(x)=(c1*X*X+c2*X+c3)/(c4*X*X+c5*X+c6)" RAT_FUNC "%0.3" "CA" COEFFS 0 45.511 0.000 0 0 1.000 /end COMPU_METHOD
/begin COMPU_METHOD Tra_V2N_km_h_rpm "f(x)=(c1*X*X+c2*X+c3)/(c4*X*X+c5*X+c6)" RAT_FUNC "%0.3" "km/h/rpm" COEFFS 0 100000.000 0.000 0 0 1.000 /end COMPU_METHOD
/begin COMPU_METHOD Tra_num "f(x)=(c1*X*X+c2*X+c3)/(c4*X*X+c5*X+c6)" RAT_FUNC "%3.0" "" COEFFS 0 1 0 0 0 1 /end COMPU_METHOD
/begin COMPU_METHOD EngState_conv "Enumerated data type: EngState_conv" TAB_VERB "%0.3" "" COMPU_TAB_REF VTAB_FOR_EngState_conv /end COMPU_METHOD
/begin COMPU_METHOD StSys_StrtState_conv "Enumerated data type: StSys_StrtState_conv" TAB_VERB "%0.3" "" COMPU_TAB_REF VTAB_FOR_StSys_StrtState_conv /end COMPU_METHOD
/begin COMPU_METHOD Switch_conv "Enumerated data type: Switch_conv" TAB_VERB "%0.3" "" COMPU_TAB_REF VTAB_FOR_Switch_conv /end COMPU_METHOD
/begin COMPU_METHOD TSC1_stSource_conv "Enumerated data type: TSC1_stSource_conv" TAB_VERB "%0.3" "" COMPU_TAB_REF VTAB_FOR_TSC1_stSource_conv /end COMPU_METHOD
/begin COMPU_METHOD PT_TraType_State_conv "Enumerated data type: PT_TraType_State_conv" TAB_VERB "%0.3" "" COMPU_TAB_REF VTAB_FOR_PT_TraType_State_conv /end COMPU_METHOD
/begin COMPU_METHOD SubSysExeState_conv "Enumerated data type: SubSysExeState_conv" TAB_VERB "%0.3" "" COMPU_TAB_REF VTAB_FOR_SubSysExeState_conv /end COMPU_METHOD
/begin COMPU_VTAB VTAB_FOR_SyCPostDrvState_conv "Enumerated data type: SyCPostDrvState_conv" TAB_VERB 9 0 "SYC_POSTDRV_INACTV" 1 "SYC_POSTDRV_DSM_BGN" 2 "SYC_POSTDRV_EEP_BGN" 3 "SYC_POSTDRV_WAIT" 4 "SYC_POSTDRV_NWM" 5 "SYC_POSTDRV_DSM_END" 6 "SYC_POSTDRV_EEP_END" 7 "SYC_POSTDRV_MIN_TIME" 8 "SYC_POSTDRV_DONE" /end COMPU_VTAB
/begin COMPU_VTAB VTAB_FOR_EpmSynState_conv "Enumerated data type: EpmSynState_conv" TAB_VERB 5 0 "EPMSYN_NO_SYNC" 30 "EPMSYN_FULL_SYNC" 33 "EPMSYN_HALF_SYNC" 38 "EPMSYN_CRS_SYNC" 60 "EPMSYN_CAS_SYNC" /end COMPU_VTAB
/begin COMPU_VTAB VTAB_FOR_WESDem_State_conv "Enumerated data type: WESDem_State_conv" TAB_VERB 7 0 "WESDEM_STOFF" 1 "WESDEM_STACCDEC" 2 "WESDEM_STRESRAMP" 4 "WESDEM_STOFFRAMP" 8 "WESDEM_STNEUTRAL" 16 "WESDEM_STDIRECT" 32 "WESDEM_STSTRTBTN" /end COMPU_VTAB
/begin COMPU_VTAB VTAB_FOR_SysExeState_conv "Enumerated data type: SysExeState_conv" TAB_VERB 4 0 "SYC_BOOT" 1 "SYC_PROC_INIT" 2 "SYC_PROC_EXEC" 3 "SYC_SHUTDOWN" /end COMPU_VTAB
/begin COMPU_VTAB VTAB_FOR_EngState_conv "Enumerated data type: EngState_conv" TAB_VERB 6 0 "COENG_STANDBY" 1 "COENG_READY" 2 "COENG_CRANKING" 3 "COENG_RUNNING" 4 "COENG_STOPPING" 5 "COENG_FINISH" /end COMPU_VTAB
/begin COMPU_VTAB VTAB_FOR_StSys_StrtState_conv "Enumerated data type: StSys_StrtState_conv" TAB_VERB 2 0 "STSYS_STRTDONE" 1 "STSYS_STRT" /end COMPU_VTAB
/begin COMPU_VTAB VTAB_FOR_Switch_conv "Enumerated data type: Switch_conv" TAB_VERB 2 0 "OFF" 1 "ON" /end COMPU_VTAB
/begin COMPU_VTAB VTAB_FOR_TSC1_stSource_conv "Enumerated data type: TSC1_stSource_conv" TAB_VERB 6 0 "TSC1_OFF" 1 "TSC1_AE" 2 "TSC1_DE" 3 "TSC1_PE" 4 "TSC1_TE" 5 "TSC1_VE" /end COMPU_VTAB
/begin COMPU_VTAB VTAB_FOR_PT_TraType_State_conv "Enumerated data type: PT_TraType_State_conv" TAB_VERB 5 0 "TRA_MT" 1 "TRA_AT" 2 "TRA_AST" 3 "TRA_CVT" 4 "TRA_DCT" /end COMPU_VTAB
/begin COMPU_VTAB VTAB_FOR_SubSysExeState_conv "Enumerated data type: SubSysExeState_conv" TAB_VERB 7 0 "SYC_INI" 1 "SYC_INISYN" 2 "SYC_INIEND" 3 "SYC_PREDRIVE" 4 "SYC_DRIVE" 5 "SYC_POSTDRIVE" 6 "SYC_POST_OS_EXIT" /end COMPU_VTAB
/begin GROUP DCRS_FrameModel_TorqueStructure "DCRS_FrameModel_TorqueStructure" /* Root */ ROOT /begin SUB_GROUP Root_Subsystem /end SUB_GROUP
 /begin REF_MEASUREMENT AC_rClgDem AFS_tiRawFast APP_uRaw1unLim APP_uRaw2unLim ASMod_pIndVol ASMod_pIntMnf AfsP_flgEgrClsDem AirC_stSwtRaw Air_rRawTAFS Air_tiRawTAFS Air_uRawPIntkVUs_HW Air_uRawTAFS Air_uRawTIntkVUs BattU_uRaw Brk_stMnRaw Brk_stRedRaw CEngDsT_uRaw Clth_stRaw CoETS_numTSEAParSet CoTS_rClgDem EBrk_stSwtRaw EGRVlv_rOfsLrnFrst_MR EGRVlv_stOfsLrnStrt EGRVlv_stTrgClnUp EGRVlv_uRaw EISGov_st3 ETClb_stDemCor ETM_rClgDem Ecu_stGps_Status EngTM_rClgRgnDmd EngTM_tiClgRgnDmd EnvP_uRaw EnvT_uRaw EpmCrS_ctRevTotal EpmCrS_numSegASW EpmSyn_stSync Epm_nEng Epm_numCyl Epm_stSync ExtDem_facFdbkCanActv FMA_qEmiCtlCor FMA_trqEmiCtlCor FMO_qEmiCtlCor FMO_trqEmiCtlCor FlFltHt_bActvDem FuelT_uRaw Gbx_stNPosRaw Gbx_stPNPos Gps_numSpdLmt IVDia_stCylOkl InjCrv_stInjCharActVal InjVlv_tiETPoI1_mp MeUn_uRaw Oil_stRawPSwmp Oil_uRawPSwmp Oil_uRawTSwmp PTOEnblSwt_stRaw PTOSwt_uRaw RailP_uRawSens RailP_uRawSync Rail_stExtDemSp RmtAPP_uRaw1unLim RmtAPP_uRaw2unLim SSpMon_uSply1Raw_mp SSpMon_uSplyRaw_mp SpdDemSwt_stRaw SpdGovSwt_stRaw Strt_stEngStrtReq SyC_stMn SyC_stPostDrv T15_uRaw T50_uRaw TSC_nAEDes TSC_nDEDes TSC_nPEDes TSC_nTEDes TSC_nVEDes TSC_rTrqAEDes TSC_rTrqDEDes TSC_rTrqPEDes TSC_rTrqTEDes TSC_rTrqVEDes TSC_stAEErr TSC_stAEMode TSC_stDEErr TSC_stDEMode TSC_stPEErr TSC_stPEMode TSC_stTEErr TSC_stTEMode TSC_stVEErr TSC_stVEMode Tbox_msg_fence_out VehV_tiSigPer_mp WESDem_IWinNegHi WESDem_IWinNegLo WESDem_IWinPosHi WESDem_IWinPosLo WESDem_KiCurrHi_mp WESDem_KiCurrLo_mp WESDem_KiNegCurrHi_mp WESDem_KiNegCurrLo_mp WESDem_KiPosCurrHi_mp WESDem_KiPosCurrLo_mp WESDem_KpCurrHi_mp WESDem_KpCurrLo_mp WESDem_KpNegCurrHi_mp WESDem_KpNegCurrLo_mp WESDem_KpPosCurrHi_mp WESDem_KpPosCurrLo_mp WESDem_PWinNegHi WESDem_PWinNegLo WESDem_PWinPosHi WESDem_PWinPosLo WESDem_nSetPHi WESDem_nSetPLo WESDem_stCfg WESDem_stCurr WESDem_stMode WESDem_trqReq WtLvlSwt_stRaw /end REF_MEASUREMENT
/end GROUP
/begin GROUP Root_Subsystem "DCRS_FrameModel_TorqueStructure/Subsystem" /begin SUB_GROUP S1_CORE /end SUB_GROUP /end GROUP
/begin GROUP S1_CORE "DCRS_FrameModel_TorqueStructure/Subsystem/CORE" /begin SUB_GROUP S2_ASW S2_CDrv S2_DE /end SUB_GROUP /end GROUP
/begin GROUP S2_ASW "DCRS_FrameModel_TorqueStructure/Subsystem/CORE/ASW" /begin SUB_GROUP S4_Eng S4_Veh /end SUB_GROUP /end GROUP
/begin GROUP S2_CDrv "DCRS_FrameModel_TorqueStructure/Subsystem/CORE/CDrv" /begin SUB_GROUP S5_InjVlv /end SUB_GROUP /end GROUP
/begin GROUP S2_DE "DCRS_FrameModel_TorqueStructure/Subsystem/CORE/DE"
 /begin SUB_GROUP S6_Air S6_DevLib S6_ElecDev S6_EngDev S6_Fl S6_ThmDev S6_VehDev /end SUB_GROUP
/end GROUP
/begin GROUP S4_Eng "DCRS_FrameModel_TorqueStructure/Subsystem/CORE/ASW/Eng"
 /begin SUB_GROUP S7_CoEng S7_ETS S7_EngDa S7_EngTrqPtd S7_GsSys S7_InjSys S7_StSys /end SUB_GROUP
/end GROUP
/begin GROUP S4_Veh "DCRS_FrameModel_TorqueStructure/Subsystem/CORE/ASW/Veh" /begin SUB_GROUP S8_CoVeh S8_ESS S8_GlbDa S8_PT S8_TS S8_VehMot /end SUB_GROUP /end GROUP
/begin GROUP S5_InjVlv "DCRS_FrameModel_TorqueStructure/Subsystem/CORE/CDrv/InjVlv" /begin SUB_GROUP S245_InjVlv_BlkSht S245_InjVlv_CalcET /end SUB_GROUP /end GROUP
/begin GROUP S6_Air "DCRS_FrameModel_TorqueStructure/Subsystem/CORE/DE/Air"
 /begin SUB_GROUP S248_AFS S248_AFST S248_EGRVlv S248_IAirHt S248_PIntkVUs S248_TIntkVUs /end SUB_GROUP
/end GROUP
/begin GROUP S6_DevLib "DCRS_FrameModel_TorqueStructure/Subsystem/CORE/DE/DevLib" /begin SUB_GROUP S249_DevLib_ActrPrt S249_DevLib_PwrStgState /end SUB_GROUP /end GROUP
/begin GROUP S6_ElecDev "DCRS_FrameModel_TorqueStructure/Subsystem/CORE/DE/ElecDev"
 /begin SUB_GROUP S250_BattU S250_MRly S250_PSP S250_SSpMon S250_SyC S250_T15 S250_T50 /end SUB_GROUP
/end GROUP
/begin GROUP S6_EngDev "DCRS_FrameModel_TorqueStructure/Subsystem/CORE/DE/EngDev" /begin SUB_GROUP S251_Oil S251_Strt /end SUB_GROUP /end GROUP
/begin GROUP S6_Fl "DCRS_FrameModel_TorqueStructure/Subsystem/CORE/DE/Fl" /begin SUB_GROUP S252_Fuel S252_Rail /end SUB_GROUP /end GROUP
/begin GROUP S6_ThmDev "DCRS_FrameModel_TorqueStructure/Subsystem/CORE/DE/ThmDev" /begin SUB_GROUP S253_AirC S253_CEngDsT S253_Fan /end SUB_GROUP /end GROUP
/begin GROUP S6_VehDev "DCRS_FrameModel_TorqueStructure/Subsystem/CORE/DE/VehDev"
 /begin SUB_GROUP S254_APP S254_Brk S254_Clth S254_Ebrk S254_EngSpd S254_EnvP S254_EnvT S254_FuelConsDspl S254_Gbx S254_GlwLmp S254_HndBrk S254_OilPLmp S254_PTOEnblSwt S254_PTOSwt S254_RmtAPP S254_SpdDemSwt S254_SpdGovSwt S254_TClntDspl S254_VehV S254_VehVDspl /end SUB_GROUP
/end GROUP
/begin GROUP S7_CoEng "DCRS_FrameModel_TorqueStructure/Subsystem/CORE/ASW/Eng/CoEng" /begin SUB_GROUP S9_CoEng_Mon S9_CoEng_StEng S9_CoEng_Stop S9_CoTemp /end SUB_GROUP /end GROUP
/begin GROUP S7_ETS "DCRS_FrameModel_TorqueStructure/Subsystem/CORE/ASW/Eng/ETS"
 /begin SUB_GROUP S10_ASD S10_CoETS S10_ETSPth S10_EngDem S10_SpdGov S10_TrqCnv S10_TrqMod /end SUB_GROUP
/end GROUP
/begin GROUP S7_EngDa "DCRS_FrameModel_TorqueStructure/Subsystem/CORE/ASW/Eng/EngDa" /begin SUB_GROUP S11_EngDa_PwrEng S11_EngDa_TEng S11_EngDa_tiEngOn /end SUB_GROUP /end GROUP
/begin GROUP S7_EngTrqPtd "DCRS_FrameModel_TorqueStructure/Subsystem/CORE/ASW/Eng/EngTrqPtd" /begin SUB_GROUP S12_EngTrqPtd_CoOfs /end SUB_GROUP /end GROUP
/begin GROUP S7_GsSys "DCRS_FrameModel_TorqueStructure/Subsystem/CORE/ASW/Eng/GsSys" /begin SUB_GROUP S13_ASMod S13_AirSys S13_EGSys /end SUB_GROUP /end GROUP
/begin GROUP S7_InjSys "DCRS_FrameModel_TorqueStructure/Subsystem/CORE/ASW/Eng/InjSys"
 /begin SUB_GROUP S14_FlSys S14_InjCtl S14_InjSys_Co S14_InjSys_CtlQnt S14_InjUn /end SUB_GROUP
/end GROUP
/begin GROUP S7_StSys "DCRS_FrameModel_TorqueStructure/Subsystem/CORE/ASW/Eng/StSys"
 /begin SUB_GROUP S15_StSys_AddCor S15_StSys_Strt S15_StSys_StrtBas S15_StSys_StrtCtl S15_StSys_StrtRmp S15_StSys_TrqShutOff /end SUB_GROUP
/end GROUP
/begin GROUP S8_CoVeh "DCRS_FrameModel_TorqueStructure/Subsystem/CORE/ASW/Veh/CoVeh"
 /begin SUB_GROUP S158_CoME S158_CoTE S158_CoVeh_CalcTrqPrpLimErr S158_CoVeh_PrfmLim S158_CoVeh_SpdCoord S158_CoVeh_TrqDesCoord S158_CoVeh_TrqLeadCoord S158_LsComp /end SUB_GROUP
/end GROUP
/begin GROUP S8_ESS "DCRS_FrameModel_TorqueStructure/Subsystem/CORE/ASW/Veh/ESS" /begin SUB_GROUP S159_CoESS /end SUB_GROUP /end GROUP
/begin GROUP S8_GlbDa "DCRS_FrameModel_TorqueStructure/Subsystem/CORE/ASW/Veh/GlbDa" /begin SUB_GROUP S160_GlbDa_LSum S160_GlbDa_SetData S160_GlbDa_TrqDem /end SUB_GROUP /end GROUP
/begin GROUP S8_PT "DCRS_FrameModel_TorqueStructure/Subsystem/CORE/ASW/Veh/PT"
 /begin SUB_GROUP S161_CoPT S161_Conv S161_Gbx S161_PT_Grip S161_PT_TrqRat S161_Tra /end SUB_GROUP
/end GROUP
/begin GROUP S8_TS "DCRS_FrameModel_TorqueStructure/Subsystem/CORE/ASW/Veh/TS" /begin SUB_GROUP S162_CTM S162_CoTS S162_Fans /end SUB_GROUP /end GROUP
/begin GROUP S8_VehMot "DCRS_FrameModel_TorqueStructure/Subsystem/CORE/ASW/Veh/VehMot" /begin SUB_GROUP S163_CoVM S163_Prp S163_VMD /end SUB_GROUP /end GROUP
/begin GROUP S245_InjVlv_BlkSht "DCRS_FrameModel_TorqueStructure/Subsystem/CORE/CDrv/InjVlv/InjVlv_BlkSht" /begin SUB_GROUP InjVlv_BlkSht /end SUB_GROUP
 /begin REF_MEASUREMENT InjVlv_bBlkShtEnb InjVlv_freqBlkSht InjVlv_phiBlkSht InjVlv_tiBlkShtET /end REF_MEASUREMENT
/end GROUP
/begin GROUP S245_InjVlv_CalcET "DCRS_FrameModel_TorqueStructure/Subsystem/CORE/CDrv/InjVlv/InjVlv_CalcET" /begin SUB_GROUP InjVlv_CalcET /end SUB_GROUP
 /begin REF_MEASUREMENT InjCrv_tiMI1ET InjCrv_tiPiI1ET_mp InjCrv_tiPiI2ET_mp InjCrv_tiPiIPse_mp InjCrv_tiPoI2Pse_mp InjVlv_tiETMI1_mp InjVlv_tiETPiI1_mp InjVlv_tiETPiI2_mp InjVlv_tiETPoI2_mp /end REF_MEASUREMENT
/end GROUP
/begin GROUP S248_AFS "DCRS_FrameModel_TorqueStructure/Subsystem/CORE/DE/Air/AFS" /begin SUB_GROUP S255_AFS_DD S255_AFS_DD1ms S255_AFS_VD S255_AFS_VDDrftComp /end SUB_GROUP /end GROUP
/begin GROUP S248_AFST "DCRS_FrameModel_TorqueStructure/Subsystem/CORE/DE/Air/AFST" /begin SUB_GROUP S256_AFST_DD S256_AFST_VD /end SUB_GROUP /end GROUP
/begin GROUP S248_EGRVlv "DCRS_FrameModel_TorqueStructure/Subsystem/CORE/DE/Air/EGRVlv"
 /begin SUB_GROUP S257_EGRVlv_DD S257_EGRVlv_DDSens S257_EGRVlv_VDMon S257_EGRVlv_VDPosGov S257_EGRVlv_VDSens /end SUB_GROUP
/end GROUP
/begin GROUP S248_IAirHt "DCRS_FrameModel_TorqueStructure/Subsystem/CORE/DE/Air/IAirHt" /begin SUB_GROUP S258_IAirHt_DD S258_IAirHt_VD /end SUB_GROUP /end GROUP
/begin GROUP S248_PIntkVUs "DCRS_FrameModel_TorqueStructure/Subsystem/CORE/DE/Air/PIntkVUs" /begin SUB_GROUP S259_PIntkVUs_DD S259_PIntkVUs_VD /end SUB_GROUP /end GROUP
/begin GROUP S248_TIntkVUs "DCRS_FrameModel_TorqueStructure/Subsystem/CORE/DE/Air/TIntkVUs" /begin SUB_GROUP S260_TIntkVUs_DD S260_TIntkVUs_VD /end SUB_GROUP /end GROUP
/begin GROUP S249_DevLib_ActrPrt "DCRS_FrameModel_TorqueStructure/Subsystem/CORE/DE/DevLib/DevLib_ActrPrt" /begin SUB_GROUP DevLib_ActrPrt /end SUB_GROUP /begin REF_MEASUREMENT DevLib_stMonActrPrt /end REF_MEASUREMENT /end GROUP
/begin GROUP S249_DevLib_PwrStgState "DCRS_FrameModel_TorqueStructure/Subsystem/CORE/DE/DevLib/DevLib_PwrStgState" /begin SUB_GROUP DevLib_PwrStgState /end SUB_GROUP /begin REF_MEASUREMENT DevLib_stPwrStgEnaCond /end REF_MEASUREMENT /end GROUP
/begin GROUP S250_BattU "DCRS_FrameModel_TorqueStructure/Subsystem/CORE/DE/ElecDev/BattU" /begin SUB_GROUP S280_BattU_DD S280_BattU_VD /end SUB_GROUP /end GROUP
/begin GROUP S250_MRly "DCRS_FrameModel_TorqueStructure/Subsystem/CORE/DE/ElecDev/MRly" /begin SUB_GROUP S281_MRly_ShOff S281_MRly_VD /end SUB_GROUP /end GROUP
/begin GROUP S250_PSP "DCRS_FrameModel_TorqueStructure/Subsystem/CORE/DE/ElecDev/PSP" /begin SUB_GROUP S282_PSPCtl_Co /end SUB_GROUP /end GROUP
/begin GROUP S250_SSpMon "DCRS_FrameModel_TorqueStructure/Subsystem/CORE/DE/ElecDev/SSpMon" /begin SUB_GROUP S283_SSpMon_Co /end SUB_GROUP /end GROUP
/begin GROUP S250_SyC "DCRS_FrameModel_TorqueStructure/Subsystem/CORE/DE/ElecDev/SyC" /begin SUB_GROUP S284_SyC_Main /end SUB_GROUP /end GROUP
/begin GROUP S250_T15 "DCRS_FrameModel_TorqueStructure/Subsystem/CORE/DE/ElecDev/T15" /begin SUB_GROUP S285_T15_DD /end SUB_GROUP /end GROUP
/begin GROUP S250_T50 "DCRS_FrameModel_TorqueStructure/Subsystem/CORE/DE/ElecDev/T50" /begin SUB_GROUP S286_T50_DD S286_T50_VD /end SUB_GROUP /end GROUP
/begin GROUP S251_Oil "DCRS_FrameModel_TorqueStructure/Subsystem/CORE/DE/EngDev/Oil" /begin SUB_GROUP S297_OilP S297_OilT /end SUB_GROUP /end GROUP
/begin GROUP S251_Strt "DCRS_FrameModel_TorqueStructure/Subsystem/CORE/DE/EngDev/Strt" /begin SUB_GROUP S298_Strt_DD /end SUB_GROUP /end GROUP
/begin GROUP S252_Fuel "DCRS_FrameModel_TorqueStructure/Subsystem/CORE/DE/Fl/Fuel" /begin SUB_GROUP S306_FlFWLvl S306_FlFltHt S306_FlWtDet S306_FuelT /end SUB_GROUP /end GROUP
/begin GROUP S252_Rail "DCRS_FrameModel_TorqueStructure/Subsystem/CORE/DE/Fl/Rail" /begin SUB_GROUP S307_MeUn S307_RailP /end SUB_GROUP /end GROUP
/begin GROUP S253_AirC "DCRS_FrameModel_TorqueStructure/Subsystem/CORE/DE/ThmDev/AirC" /begin SUB_GROUP S330_ACCmpr_DD S330_ACCmpr_VD S330_ACSwt_DD S330_ACSwt_VD /end SUB_GROUP /end GROUP
/begin GROUP S253_CEngDsT "DCRS_FrameModel_TorqueStructure/Subsystem/CORE/DE/ThmDev/CEngDsT" /begin SUB_GROUP S331_CEngDsT_DD S331_CEngDsT_VD /end SUB_GROUP /end GROUP
/begin GROUP S253_Fan "DCRS_FrameModel_TorqueStructure/Subsystem/CORE/DE/ThmDev/Fan" /begin SUB_GROUP S332_Fan_DD /end SUB_GROUP /end GROUP
/begin GROUP S254_APP "DCRS_FrameModel_TorqueStructure/Subsystem/CORE/DE/VehDev/APP"
 /begin SUB_GROUP S340_APP_ChkSig S340_APP_DD1 S340_APP_DD2 S340_APP_Kickdown S340_APP_Plaus12 S340_APP_PlausBrk S340_APP_SelSig S340_APP_VD /end SUB_GROUP
/end GROUP
/begin GROUP S254_Brk "DCRS_FrameModel_TorqueStructure/Subsystem/CORE/DE/VehDev/Brk" /begin SUB_GROUP S341_Brk_DD S341_Brk_VD /end SUB_GROUP /end GROUP
/begin GROUP S254_Clth "DCRS_FrameModel_TorqueStructure/Subsystem/CORE/DE/VehDev/Clth" /begin SUB_GROUP S342_Clth_DD S342_Clth_VD /end SUB_GROUP /end GROUP
/begin GROUP S254_Ebrk "DCRS_FrameModel_TorqueStructure/Subsystem/CORE/DE/VehDev/Ebrk" /begin SUB_GROUP S343_EBrk_DD S343_EBrk_VD /end SUB_GROUP /end GROUP
/begin GROUP S254_EngSpd "DCRS_FrameModel_TorqueStructure/Subsystem/CORE/DE/VehDev/EngSpd" /begin SUB_GROUP S344_EngSpd_DD /end SUB_GROUP /end GROUP
/begin GROUP S254_EnvP "DCRS_FrameModel_TorqueStructure/Subsystem/CORE/DE/VehDev/EnvP" /begin SUB_GROUP S345_EnvP_DD S345_EnvP_VD /end SUB_GROUP /end GROUP
/begin GROUP S254_EnvT "DCRS_FrameModel_TorqueStructure/Subsystem/CORE/DE/VehDev/EnvT" /begin SUB_GROUP S346_EnvT_DD S346_EnvT_VD /end SUB_GROUP /end GROUP
/begin GROUP S254_FuelConsDspl "DCRS_FrameModel_TorqueStructure/Subsystem/CORE/DE/VehDev/FuelConsDspl" /begin SUB_GROUP S347_FuelConsDspl_DD /end SUB_GROUP /end GROUP
/begin GROUP S254_Gbx "DCRS_FrameModel_TorqueStructure/Subsystem/CORE/DE/VehDev/Gbx" /begin SUB_GROUP S348_GbxNPos /end SUB_GROUP /end GROUP
/begin GROUP S254_GlwLmp "DCRS_FrameModel_TorqueStructure/Subsystem/CORE/DE/VehDev/GlwLmp" /begin SUB_GROUP S349_GlwLmp_DD S349_GlwLmp_VD /end SUB_GROUP /end GROUP
/begin GROUP S254_HndBrk "DCRS_FrameModel_TorqueStructure/Subsystem/CORE/DE/VehDev/HndBrk" /begin SUB_GROUP S350_HndBrk_DD /end SUB_GROUP /end GROUP
/begin GROUP S254_OilPLmp "DCRS_FrameModel_TorqueStructure/Subsystem/CORE/DE/VehDev/OilPLmp" /begin SUB_GROUP S351_OilPLmp_DD /end SUB_GROUP /end GROUP
/begin GROUP S254_PTOEnblSwt "DCRS_FrameModel_TorqueStructure/Subsystem/CORE/DE/VehDev/PTOEnblSwt" /begin SUB_GROUP S352_PTOEnblSwt_DD /end SUB_GROUP /end GROUP
/begin GROUP S254_PTOSwt "DCRS_FrameModel_TorqueStructure/Subsystem/CORE/DE/VehDev/PTOSwt" /begin SUB_GROUP S353_PTOSwt_DD S353_PTOSwt_VD /end SUB_GROUP /end GROUP
/begin GROUP S254_RmtAPP "DCRS_FrameModel_TorqueStructure/Subsystem/CORE/DE/VehDev/RmtAPP"
 /begin SUB_GROUP S354_RmtAPP_ChkSig S354_RmtAPP_DD1 S354_RmtAPP_DD2 S354_RmtAPP_Kickdown S354_RmtAPP_Plaus12 S354_RmtAPP_PlausBrk S354_RmtAPP_SelSig S354_RmtAPP_VD /end SUB_GROUP
/end GROUP
/begin GROUP S254_SpdDemSwt "DCRS_FrameModel_TorqueStructure/Subsystem/CORE/DE/VehDev/SpdDemSwt" /begin SUB_GROUP S355_SpdDemSwt_DD S355_SpdDemSwt_VD /end SUB_GROUP /end GROUP
/begin GROUP S254_SpdGovSwt "DCRS_FrameModel_TorqueStructure/Subsystem/CORE/DE/VehDev/SpdGovSwt" /begin SUB_GROUP S356_SpdGovSwt_DD /end SUB_GROUP /end GROUP
/begin GROUP S254_TClntDspl "DCRS_FrameModel_TorqueStructure/Subsystem/CORE/DE/VehDev/TClntDspl" /begin SUB_GROUP S357_TClntDspl_DD /end SUB_GROUP /end GROUP
/begin GROUP S254_VehV "DCRS_FrameModel_TorqueStructure/Subsystem/CORE/DE/VehDev/VehV" /begin SUB_GROUP S358_VehV_DD S358_VehV_VD /end SUB_GROUP /end GROUP
/begin GROUP S254_VehVDspl "DCRS_FrameModel_TorqueStructure/Subsystem/CORE/DE/VehDev/VehVDspl" /begin SUB_GROUP S359_VehVDspl_DD /end SUB_GROUP /end GROUP
/begin GROUP S9_CoEng_Mon "DCRS_FrameModel_TorqueStructure/Subsystem/CORE/ASW/Eng/CoEng/CoEng_Mon" /begin SUB_GROUP /end SUB_GROUP /begin REF_MEASUREMENT CoEng_stShutOffPath /end REF_MEASUREMENT /end GROUP
/begin GROUP S9_CoEng_StEng "DCRS_FrameModel_TorqueStructure/Subsystem/CORE/ASW/Eng/CoEng/CoEng_StEng" /begin SUB_GROUP CoEng_StEng /end SUB_GROUP
 /begin REF_MEASUREMENT CoEng_st CoEng_stOld CoEng_tiAfterrun CoEng_tiNormal CoEng_tiNrml2Strt_mp CoEng_tiStandby CoEng_tiStart /end REF_MEASUREMENT
/end GROUP
/begin GROUP S9_CoEng_Stop "DCRS_FrameModel_TorqueStructure/Subsystem/CORE/ASW/Eng/CoEng/CoEng_Stop" /begin SUB_GROUP CoEng_Stop /end SUB_GROUP /begin REF_MEASUREMENT CoEng_stEngStop /end REF_MEASUREMENT /end GROUP
/begin GROUP S9_CoTemp "DCRS_FrameModel_TorqueStructure/Subsystem/CORE/ASW/Eng/CoEng/CoTemp" /begin SUB_GROUP CoTemp /end SUB_GROUP /begin REF_MEASUREMENT CoTemp_rClgDes CoTemp_tEngDes /end REF_MEASUREMENT /end GROUP
/begin GROUP S10_ASD "DCRS_FrameModel_TorqueStructure/Subsystem/CORE/ASW/Eng/ETS/ASD" /begin SUB_GROUP S20_ASDdc S20_ASDrf /end SUB_GROUP /end GROUP
/begin GROUP S10_CoETS "DCRS_FrameModel_TorqueStructure/Subsystem/CORE/ASW/Eng/ETS/CoETS"
 /begin SUB_GROUP S21_CoETS_NTC S21_CoETS_StTrqLimCalc S21_CoETS_TSEACo S21_CoETS_TrqCalc /end SUB_GROUP
/end GROUP
/begin GROUP S10_ETSPth "DCRS_FrameModel_TorqueStructure/Subsystem/CORE/ASW/Eng/ETS/ETSPth" /begin SUB_GROUP S22_PthLead S22_PthSet /end SUB_GROUP /end GROUP
/begin GROUP S10_EngDem "DCRS_FrameModel_TorqueStructure/Subsystem/CORE/ASW/Eng/ETS/EngDem" /begin SUB_GROUP S23_EngDem_TrqLimCoord S23_EngPrt S23_EngReq /end SUB_GROUP /end GROUP
/begin GROUP S10_SpdGov "DCRS_FrameModel_TorqueStructure/Subsystem/CORE/ASW/Eng/ETS/SpdGov" /begin SUB_GROUP S24_DrvDem S24_EISGov S24_ExtDem S24_HLSDem /end SUB_GROUP /end GROUP
/begin GROUP S10_TrqCnv "DCRS_FrameModel_TorqueStructure/Subsystem/CORE/ASW/Eng/ETS/TrqCnv" /begin SUB_GROUP S25_CnvLead S25_CnvSet /end SUB_GROUP /end GROUP
/begin GROUP S10_TrqMod "DCRS_FrameModel_TorqueStructure/Subsystem/CORE/ASW/Eng/ETS/TrqMod" /begin SUB_GROUP S26_ActMod S26_PhyMod S26_RngMod /end SUB_GROUP /end GROUP
/begin GROUP S11_EngDa_PwrEng "DCRS_FrameModel_TorqueStructure/Subsystem/CORE/ASW/Eng/EngDa/EngDa_PwrEng" /begin SUB_GROUP EngDa_PwrEng /end SUB_GROUP /begin REF_MEASUREMENT EngDa_trqEngMax /end REF_MEASUREMENT /end GROUP
/begin GROUP S11_EngDa_TEng "DCRS_FrameModel_TorqueStructure/Subsystem/CORE/ASW/Eng/EngDa/EngDa_TEng" /begin SUB_GROUP /end SUB_GROUP /begin REF_MEASUREMENT EngDa_tEng EngDa_tFld EngDa_tStrt StSys_tStrt_mp /end REF_MEASUREMENT /end GROUP
/begin GROUP S11_EngDa_tiEngOn "DCRS_FrameModel_TorqueStructure/Subsystem/CORE/ASW/Eng/EngDa/EngDa_tiEngOn" /begin SUB_GROUP EngDa_tiEngOn /end SUB_GROUP /begin REF_MEASUREMENT EngDa_tiEngOn_mp EngDa_tiEngOn_total /end REF_MEASUREMENT /end GROUP
/begin GROUP S12_EngTrqPtd_CoOfs "DCRS_FrameModel_TorqueStructure/Subsystem/CORE/ASW/Eng/EngTrqPtd/EngTrqPtd_CoOfs" /begin SUB_GROUP EngTrqPtd_CoOfs /end SUB_GROUP /begin REF_MEASUREMENT EngTrqPtd_stPthLim EngTrqPtd_trqLim /end REF_MEASUREMENT /end GROUP
/begin GROUP S13_ASMod "DCRS_FrameModel_TorqueStructure/Subsystem/CORE/ASW/Eng/GsSys/ASMod" /begin SUB_GROUP S89_AirMod S89_ExhMod /end SUB_GROUP /end GROUP
/begin GROUP S13_AirSys "DCRS_FrameModel_TorqueStructure/Subsystem/CORE/ASW/Eng/GsSys/AirSys" /begin SUB_GROUP S90_AirCtl S90_AirHt S90_CoAS S90_TCPrt /end SUB_GROUP /end GROUP
/begin GROUP S13_EGSys "DCRS_FrameModel_TorqueStructure/Subsystem/CORE/ASW/Eng/GsSys/EGSys" /begin SUB_GROUP S91_SmkLim /end SUB_GROUP /end GROUP
/begin GROUP S14_FlSys "DCRS_FrameModel_TorqueStructure/Subsystem/CORE/ASW/Eng/InjSys/FlSys"
 /begin SUB_GROUP S111_FlSys_CalcCnvFac S111_FlSys_FlCons S111_FlSys_FlConsTot /end SUB_GROUP
/end GROUP
/begin GROUP S14_InjCtl "DCRS_FrameModel_TorqueStructure/Subsystem/CORE/ASW/Eng/InjSys/InjCtl" /begin SUB_GROUP S112_InjCrv S112_InjCtl_qCo S112_InjCtl_qCoSync /end SUB_GROUP /end GROUP
/begin GROUP S14_InjSys_Co "DCRS_FrameModel_TorqueStructure/Subsystem/CORE/ASW/Eng/InjSys/InjSys_Co" /begin SUB_GROUP InjSys_Co /end SUB_GROUP
 /begin REF_MEASUREMENT InjCrv_tAir InjCrv_tAirMI1 InjSys_tAir InjSys_tEng InjSys_trqLim InjSys_trqLoss Rail_tAir /end REF_MEASUREMENT
/end GROUP
/begin GROUP S14_InjSys_CtlQnt "DCRS_FrameModel_TorqueStructure/Subsystem/CORE/ASW/Eng/InjSys/InjSys_CtlQnt" /begin SUB_GROUP /end SUB_GROUP /begin REF_MEASUREMENT InjSys_qOfsTot InjSys_qTot /end REF_MEASUREMENT /end GROUP
/begin GROUP S14_InjUn "DCRS_FrameModel_TorqueStructure/Subsystem/CORE/ASW/Eng/InjSys/InjUn" /begin SUB_GROUP S115_HPUn S115_Rail /end SUB_GROUP /end GROUP
/begin GROUP S15_StSys_AddCor "DCRS_FrameModel_TorqueStructure/Subsystem/CORE/ASW/Eng/StSys/StSys_AddCor" /begin SUB_GROUP StSys_AddCor /end SUB_GROUP /begin REF_MEASUREMENT StSys_trqAddCor /end REF_MEASUREMENT /end GROUP
/begin GROUP S15_StSys_Strt "DCRS_FrameModel_TorqueStructure/Subsystem/CORE/ASW/Eng/StSys/StSys_Strt" /begin SUB_GROUP StSys_Strt /end SUB_GROUP /begin REF_MEASUREMENT StSys_stStrt /end REF_MEASUREMENT /end GROUP
/begin GROUP S15_StSys_StrtBas "DCRS_FrameModel_TorqueStructure/Subsystem/CORE/ASW/Eng/StSys/StSys_StrtBas" /begin SUB_GROUP StSys_StrtBas /end SUB_GROUP /begin REF_MEASUREMENT StSys_trqBas /end REF_MEASUREMENT /end GROUP
/begin GROUP S15_StSys_StrtCtl "DCRS_FrameModel_TorqueStructure/Subsystem/CORE/ASW/Eng/StSys/StSys_StrtCtl" /begin SUB_GROUP StSys_StrtCtl /end SUB_GROUP /begin REF_MEASUREMENT Strt_st /end REF_MEASUREMENT /end GROUP
/begin GROUP S15_StSys_StrtRmp "DCRS_FrameModel_TorqueStructure/Subsystem/CORE/ASW/Eng/StSys/StSys_StrtRmp" /begin SUB_GROUP StSys_StrtRmp /end SUB_GROUP /begin REF_MEASUREMENT StSys_trqStrt /end REF_MEASUREMENT /end GROUP
/begin GROUP S15_StSys_TrqShutOff "DCRS_FrameModel_TorqueStructure/Subsystem/CORE/ASW/Eng/StSys/StSys_TrqShutOff" /begin SUB_GROUP StSys_TrqShutOff /end SUB_GROUP /begin REF_MEASUREMENT StSys_stTrqShutOff StSys_trqSetAdjVal_mp /end REF_MEASUREMENT /end GROUP
/begin GROUP S158_CoME "DCRS_FrameModel_TorqueStructure/Subsystem/CORE/ASW/Veh/CoVeh/CoME" /begin SUB_GROUP S164_CoME_DemCoord S164_CoME_ShutOff /end SUB_GROUP /end GROUP
/begin GROUP S158_CoTE "DCRS_FrameModel_TorqueStructure/Subsystem/CORE/ASW/Veh/CoVeh/CoTE" /begin SUB_GROUP S165_CoTE_ThermDem /end SUB_GROUP /end GROUP
/begin GROUP S158_CoVeh_CalcTrqPrpLimErr "DCRS_FrameModel_TorqueStructure/Subsystem/CORE/ASW/Veh/CoVeh/CoVeh_CalcTrqPrpLimErr" /begin SUB_GROUP CoVeh_CalcTrqPrpLimErr /end SUB_GROUP /begin REF_MEASUREMENT CoVeh_trqPrpLimErr /end REF_MEASUREMENT /end GROUP
/begin GROUP S158_CoVeh_PrfmLim "DCRS_FrameModel_TorqueStructure/Subsystem/CORE/ASW/Veh/CoVeh/CoVeh_PrfmLim" /begin SUB_GROUP CoVeh_PrfmLim /end SUB_GROUP /begin REF_MEASUREMENT CoVeh_trqPrfmLimDes /end REF_MEASUREMENT /end GROUP
/begin GROUP S158_CoVeh_SpdCoord "DCRS_FrameModel_TorqueStructure/Subsystem/CORE/ASW/Veh/CoVeh/CoVeh_SpdCoord" /begin SUB_GROUP /end SUB_GROUP /begin REF_MEASUREMENT CoVeh_nMaxSysErr CoVeh_nMinSysErr CoVeh_stNSetPSysErr /end REF_MEASUREMENT /end GROUP
/begin GROUP S158_CoVeh_TrqDesCoord "DCRS_FrameModel_TorqueStructure/Subsystem/CORE/ASW/Veh/CoVeh/CoVeh_TrqDesCoord" /begin SUB_GROUP /end SUB_GROUP /begin REF_MEASUREMENT CoVeh_trqDes /end REF_MEASUREMENT /end GROUP
/begin GROUP S158_CoVeh_TrqLeadCoord "DCRS_FrameModel_TorqueStructure/Subsystem/CORE/ASW/Veh/CoVeh/CoVeh_TrqLeadCoord" /begin SUB_GROUP /end SUB_GROUP /begin REF_MEASUREMENT CoVeh_trqLead /end REF_MEASUREMENT /end GROUP
/begin GROUP S158_LsComp "DCRS_FrameModel_TorqueStructure/Subsystem/CORE/ASW/Veh/CoVeh/LsComp" /begin SUB_GROUP S171_LsComp_TrqCalc /end SUB_GROUP /end GROUP
/begin GROUP S159_CoESS "DCRS_FrameModel_TorqueStructure/Subsystem/CORE/ASW/Veh/ESS/CoESS" /begin SUB_GROUP S176_CoESS_Dem /end SUB_GROUP /end GROUP
/begin GROUP S160_GlbDa_LSum "DCRS_FrameModel_TorqueStructure/Subsystem/CORE/ASW/Veh/GlbDa/GlbDa_LSum" /begin SUB_GROUP GlbDa_LSum /end SUB_GROUP
 /begin REF_MEASUREMENT GlbDa_lDst GlbDa_lDstLstStored GlbDa_lTotDst GlbDa_lTotDstVeh /end REF_MEASUREMENT
/end GROUP
/begin GROUP S160_GlbDa_SetData "DCRS_FrameModel_TorqueStructure/Subsystem/CORE/ASW/Veh/GlbDa/GlbDa_SetData" /begin SUB_GROUP GlbDa_SetData /end SUB_GROUP
 /begin REF_MEASUREMENT GlbDa_pEnv GlbDa_rTrqTot GlbDa_tEnv GlbDa_vX GlbDa_vXFlt TrbCh_n /end REF_MEASUREMENT
/end GROUP
/begin GROUP S160_GlbDa_TrqDem "DCRS_FrameModel_TorqueStructure/Subsystem/CORE/ASW/Veh/GlbDa/GlbDa_TrqDem" /begin SUB_GROUP GlbDa_TrqDem /end SUB_GROUP
 /begin REF_MEASUREMENT GlbDa_stTrqDem GlbDa_stVehLimMin GlbDa_trqCrSVehLimMin GlbDa_trqVehLimMin /end REF_MEASUREMENT
/end GROUP
/begin GROUP S161_CoPT "DCRS_FrameModel_TorqueStructure/Subsystem/CORE/ASW/Veh/PT/CoPT"
 /begin SUB_GROUP S181_CoPT_ThermDem S181_CoPT_TrqDesCoord S181_CoPT_TrqLeadCoord S181_PTCOP S181_PTLo S181_PTODi /end SUB_GROUP
/end GROUP
/begin GROUP S161_Conv "DCRS_FrameModel_TorqueStructure/Subsystem/CORE/ASW/Veh/PT/Conv" /begin SUB_GROUP S182_Conv_GripIntrlck S182_Conv_LdCalc /end SUB_GROUP /end GROUP
/begin GROUP S161_Gbx "DCRS_FrameModel_TorqueStructure/Subsystem/CORE/ASW/Veh/PT/Gbx" /begin SUB_GROUP S183_Gbx_Data /end SUB_GROUP /end GROUP
/begin GROUP S161_PT_Grip "DCRS_FrameModel_TorqueStructure/Subsystem/CORE/ASW/Veh/PT/PT_Grip" /begin SUB_GROUP PT_Grip /end SUB_GROUP /begin REF_MEASUREMENT PT_bGrip PT_bNoGrip PT_rGrip /end REF_MEASUREMENT /end GROUP
/begin GROUP S161_PT_TrqRat "DCRS_FrameModel_TorqueStructure/Subsystem/CORE/ASW/Veh/PT/PT_TrqRat" /begin SUB_GROUP PT_TrqRat /end SUB_GROUP /begin REF_MEASUREMENT PT_rTrq PT_rTrqWoConvRat /end REF_MEASUREMENT /end GROUP
/begin GROUP S161_Tra "DCRS_FrameModel_TorqueStructure/Subsystem/CORE/ASW/Veh/PT/Tra"
 /begin SUB_GROUP S186_Tra_Add S186_Tra_DblClthDet S186_Tra_GearInfo S186_Tra_Grip S186_Tra_Los S186_Tra_Prt S186_Tra_RtnIntfc S186_Tra_TrqRed S186_Tra_TypeInfo /end SUB_GROUP
/end GROUP
/begin GROUP S162_CTM "DCRS_FrameModel_TorqueStructure/Subsystem/CORE/ASW/Veh/TS/CTM" /begin SUB_GROUP S211_AC /end SUB_GROUP /end GROUP
/begin GROUP S162_CoTS "DCRS_FrameModel_TorqueStructure/Subsystem/CORE/ASW/Veh/TS/CoTS" /begin SUB_GROUP S212_CoTS_MechDem /end SUB_GROUP /end GROUP
/begin GROUP S162_Fans "DCRS_FrameModel_TorqueStructure/Subsystem/CORE/ASW/Veh/TS/Fans" /begin SUB_GROUP S213_FanCtl_Spd S213_Fans_ClgDem S213_Fans_trq /end SUB_GROUP /end GROUP
/begin GROUP S163_CoVM "DCRS_FrameModel_TorqueStructure/Subsystem/CORE/ASW/Veh/VehMot/CoVM"
 /begin SUB_GROUP S221_CoVM_SpdCoord S221_CoVM_TrqAcsCoord S221_CoVM_TrqDesCoord S221_CoVM_TrqLeadCoord /end SUB_GROUP
/end GROUP
/begin GROUP S163_Prp "DCRS_FrameModel_TorqueStructure/Subsystem/CORE/ASW/Veh/VehMot/Prp" /begin SUB_GROUP S222_Diff S222_Prp_TrqDesCoord S222_Prp_TrqLeadCoord /end SUB_GROUP /end GROUP
/begin GROUP S163_VMD "DCRS_FrameModel_TorqueStructure/Subsystem/CORE/ASW/Veh/VehMot/VMD" /begin SUB_GROUP S223_AccPed S223_BrkPed S223_CoVMD /end SUB_GROUP /end GROUP
/begin GROUP S255_AFS_DD "DCRS_FrameModel_TorqueStructure/Subsystem/CORE/DE/Air/AFS/AFS_DD" /begin SUB_GROUP AFS_DD /end SUB_GROUP /begin REF_MEASUREMENT AFS_dmSens /end REF_MEASUREMENT /end GROUP
/begin GROUP S255_AFS_DD1ms "DCRS_FrameModel_TorqueStructure/Subsystem/CORE/DE/Air/AFS/AFS_DD1ms" /begin SUB_GROUP AFS_DD1ms /end SUB_GROUP /begin REF_MEASUREMENT AFS_dmSensAvr AFS_tiRaw /end REF_MEASUREMENT /end GROUP
/begin GROUP S255_AFS_VD "DCRS_FrameModel_TorqueStructure/Subsystem/CORE/DE/Air/AFS/AFS_VD" /begin SUB_GROUP AFS_VD /end SUB_GROUP /begin REF_MEASUREMENT AFS_dm AFS_dmPlsCorr AFS_mAirPerCyl AFS_stDrftMonRls_mp /end REF_MEASUREMENT /end GROUP
/begin GROUP S255_AFS_VDDrftComp "DCRS_FrameModel_TorqueStructure/Subsystem/CORE/DE/Air/AFS/AFS_VDDrftComp" /begin SUB_GROUP AFS_VDDrftComp /end SUB_GROUP /begin REF_MEASUREMENT AFS_dmDrft AFS_stDrft /end REF_MEASUREMENT /end GROUP
/begin GROUP S256_AFST_DD "DCRS_FrameModel_TorqueStructure/Subsystem/CORE/DE/Air/AFST/AFST_DD" /begin SUB_GROUP AFST_DD /end SUB_GROUP
 /begin REF_MEASUREMENT Air_bDtyCycTAFSFinalDef Air_bDtyCycTAFSProvDef Air_bPerTAFSFinalDef Air_bPerTAFSProvDef Air_bVoltTAFSFinalDef Air_bVoltTAFSProvDef Air_facPerCorTAFS Air_tSensTAFS /end REF_MEASUREMENT
/end GROUP
/begin GROUP S256_AFST_VD "DCRS_FrameModel_TorqueStructure/Subsystem/CORE/DE/Air/AFST/AFST_VD" /begin SUB_GROUP AFST_VD /end SUB_GROUP /begin REF_MEASUREMENT Air_tAFS_mp Air_tUnFltAFS /end REF_MEASUREMENT /end GROUP
/begin GROUP S257_EGRVlv_DD "DCRS_FrameModel_TorqueStructure/Subsystem/CORE/DE/Air/EGRVlv/EGRVlv_DD" /begin SUB_GROUP EGRVlv_DD /end SUB_GROUP /begin REF_MEASUREMENT EGRVlv_rPs EGRVlv_rPsNrm EGRVlv_tiPs /end REF_MEASUREMENT /end GROUP
/begin GROUP S257_EGRVlv_DDSens "DCRS_FrameModel_TorqueStructure/Subsystem/CORE/DE/Air/EGRVlv/EGRVlv_DDSens" /begin SUB_GROUP EGRVlv_DDSens /end SUB_GROUP
 /begin REF_MEASUREMENT EGRVlv_bFinalDef EGRVlv_bPhysRngFinalDef EGRVlv_bPhysRngProvDef EGRVlv_bProvDef EGRVlv_rSens /end REF_MEASUREMENT
/end GROUP
/begin GROUP S257_EGRVlv_VDMon "DCRS_FrameModel_TorqueStructure/Subsystem/CORE/DE/Air/EGRVlv/EGRVlv_VDMon" /begin SUB_GROUP EGRVlv_VDMon /end SUB_GROUP
 /begin REF_MEASUREMENT EGRVlv_drRawFlt EGRVlv_rRlsEGR EGRVlv_stJamVlv EGRVlv_stMon /end REF_MEASUREMENT
/end GROUP
/begin GROUP S257_EGRVlv_VDPosGov "DCRS_FrameModel_TorqueStructure/Subsystem/CORE/DE/Air/EGRVlv/EGRVlv_VDPosGov" /begin SUB_GROUP EGRVlv_VDPosGov /end SUB_GROUP
 /begin REF_MEASUREMENT EGRVlv_rDesLMS EGRVlv_rDesValNrm EGRVlv_rEGR EGRVlv_rGovDesVal EGRVlv_rGovDvt EGRVlv_rGovDvtRel EGRVlv_rGovEGR EGRVlv_rOutD_mp EGRVlv_rOutI_mp EGRVlv_rOutP_mp EGRVlv_stClnUp EGRVlv_stClnUpMchn EGRVlv_stOfsLrnTrgClnUp EGRVlv_swtEGRTyp /end REF_MEASUREMENT
/end GROUP
/begin GROUP S257_EGRVlv_VDSens "DCRS_FrameModel_TorqueStructure/Subsystem/CORE/DE/Air/EGRVlv/EGRVlv_VDSens" /begin SUB_GROUP EGRVlv_VDSens /end SUB_GROUP
 /begin REF_MEASUREMENT EGRVlv_rAct EGRVlv_rActInv EGRVlv_rActNoErrHdl EGRVlv_rActUnCor EGRVlv_rAdapLrn_mp EGRVlv_rOfsLrnFrst EGRVlv_rOfsLrnLst EGRVlv_rOfsLrnVlv EGRVlv_stAdap EGRVlv_stNewVlvTrg_mp EGRVlv_stOfsLrn EGRVlv_stTmpOfsLrnt /end REF_MEASUREMENT
/end GROUP
/begin GROUP S258_IAirHt_DD "DCRS_FrameModel_TorqueStructure/Subsystem/CORE/DE/Air/IAirHt/IAirHt_DD" /begin SUB_GROUP IAirHt_DD /end SUB_GROUP /begin REF_MEASUREMENT IAirHt_stPs /end REF_MEASUREMENT /end GROUP
/begin GROUP S258_IAirHt_VD "DCRS_FrameModel_TorqueStructure/Subsystem/CORE/DE/Air/IAirHt/IAirHt_VD" /begin SUB_GROUP /end SUB_GROUP /begin REF_MEASUREMENT IAirHt_stReq /end REF_MEASUREMENT /end GROUP
/begin GROUP S259_PIntkVUs_DD "DCRS_FrameModel_TorqueStructure/Subsystem/CORE/DE/Air/PIntkVUs/PIntkVUs_DD" /begin SUB_GROUP PIntkVUs_DD /end SUB_GROUP
 /begin REF_MEASUREMENT Air_bPIntkVUsFinalDef Air_bPIntkVUsProvDef Air_bPhysRngPIntkVUsFinalDef Air_bPhysRngPIntkVUsProvDef Air_bPlsPIntkVUsFinalDef Air_bPlsPIntkVUsProvDef Air_pSensPIntkVUs Air_uRawPIntkVUs /end REF_MEASUREMENT
/end GROUP
/begin GROUP S259_PIntkVUs_VD "DCRS_FrameModel_TorqueStructure/Subsystem/CORE/DE/Air/PIntkVUs/PIntkVUs_VD" /begin SUB_GROUP PIntkVUs_VD /end SUB_GROUP /begin REF_MEASUREMENT Air_pIntkVUs /end REF_MEASUREMENT /end GROUP
/begin GROUP S260_TIntkVUs_DD "DCRS_FrameModel_TorqueStructure/Subsystem/CORE/DE/Air/TIntkVUs/TIntkVUs_DD" /begin SUB_GROUP TIntkVUs_DD /end SUB_GROUP
 /begin REF_MEASUREMENT Air_bTIntkVUsFinalDef Air_bTIntkVUsProvDef Air_tSensTIntkVUs /end REF_MEASUREMENT
/end GROUP
/begin GROUP S260_TIntkVUs_VD "DCRS_FrameModel_TorqueStructure/Subsystem/CORE/DE/Air/TIntkVUs/TIntkVUs_VD" /begin SUB_GROUP TIntkVUs_VD /end SUB_GROUP /begin REF_MEASUREMENT Air_tCACDs_mp Air_tIntkVUs /end REF_MEASUREMENT /end GROUP
/begin GROUP S280_BattU_DD "DCRS_FrameModel_TorqueStructure/Subsystem/CORE/DE/ElecDev/BattU/BattU_DD" /begin SUB_GROUP BattU_DD /end SUB_GROUP
 /begin REF_MEASUREMENT BattU_bFinalDef BattU_bPhysRngFinalDef BattU_bPhysRngProvDef BattU_bProvDef BattU_uSens /end REF_MEASUREMENT
/end GROUP
/begin GROUP S280_BattU_VD "DCRS_FrameModel_TorqueStructure/Subsystem/CORE/DE/ElecDev/BattU/BattU_VD" /begin SUB_GROUP BattU_VD /end SUB_GROUP /begin REF_MEASUREMENT BattU_facCor BattU_u BattU_uRated /end REF_MEASUREMENT /end GROUP
/begin GROUP S281_MRly_ShOff "DCRS_FrameModel_TorqueStructure/Subsystem/CORE/DE/ElecDev/MRly/MRly_ShOff" /begin SUB_GROUP MRly_ShOff /end SUB_GROUP /begin REF_MEASUREMENT MRly_ctErlyOpng /end REF_MEASUREMENT /end GROUP
/begin GROUP S281_MRly_VD "DCRS_FrameModel_TorqueStructure/Subsystem/CORE/DE/ElecDev/MRly/MRly_VD" /begin SUB_GROUP MRly_VD /end SUB_GROUP /end GROUP
/begin GROUP S282_PSPCtl_Co "DCRS_FrameModel_TorqueStructure/Subsystem/CORE/DE/ElecDev/PSP/PSPCtl_Co" /begin SUB_GROUP /end SUB_GROUP /begin REF_MEASUREMENT PSP_st /end REF_MEASUREMENT /end GROUP
/begin GROUP S283_SSpMon_Co "DCRS_FrameModel_TorqueStructure/Subsystem/CORE/DE/ElecDev/SSpMon/SSpMon_Co" /begin SUB_GROUP SSpMon_Co /end SUB_GROUP /end GROUP
/begin GROUP S284_SyC_Main "DCRS_FrameModel_TorqueStructure/Subsystem/CORE/DE/ElecDev/SyC/SyC_Main" /begin SUB_GROUP SyC_Main /end SUB_GROUP /begin REF_MEASUREMENT SyC_stSub SyC_tiPostDrive_mp /end REF_MEASUREMENT /end GROUP
/begin GROUP S285_T15_DD "DCRS_FrameModel_TorqueStructure/Subsystem/CORE/DE/ElecDev/T15/T15_DD" /begin SUB_GROUP T15_DD /end SUB_GROUP /begin REF_MEASUREMENT T15_st /end REF_MEASUREMENT /end GROUP
/begin GROUP S286_T50_DD "DCRS_FrameModel_TorqueStructure/Subsystem/CORE/DE/ElecDev/T50/T50_DD" /begin SUB_GROUP T50_DD /end SUB_GROUP /begin REF_MEASUREMENT T50_stRaw /end REF_MEASUREMENT /end GROUP
/begin GROUP S286_T50_VD "DCRS_FrameModel_TorqueStructure/Subsystem/CORE/DE/ElecDev/T50/T50_VD" /begin SUB_GROUP T50_VD /end SUB_GROUP /begin REF_MEASUREMENT T50_st T50_stEmgcy /end REF_MEASUREMENT /end GROUP
/begin GROUP S297_OilP "DCRS_FrameModel_TorqueStructure/Subsystem/CORE/DE/EngDev/Oil/OilP" /begin SUB_GROUP S299_OilP_DD S299_OilP_VD /end SUB_GROUP /end GROUP
/begin GROUP S297_OilT "DCRS_FrameModel_TorqueStructure/Subsystem/CORE/DE/EngDev/Oil/OilT" /begin SUB_GROUP S300_OilT_DD S300_OilT_VD /end SUB_GROUP /end GROUP
/begin GROUP S298_Strt_DD "DCRS_FrameModel_TorqueStructure/Subsystem/CORE/DE/EngDev/Strt/Strt_DD" /begin SUB_GROUP Strt_DD /end SUB_GROUP /begin REF_MEASUREMENT Strt_stPs /end REF_MEASUREMENT /end GROUP
/begin GROUP S306_FlFWLvl "DCRS_FrameModel_TorqueStructure/Subsystem/CORE/DE/Fl/Fuel/FlFWLvl" /begin SUB_GROUP S308_FlFWLvl_DD S308_FlFWLvl_VD /end SUB_GROUP /end GROUP
/begin GROUP S306_FlFltHt "DCRS_FrameModel_TorqueStructure/Subsystem/CORE/DE/Fl/Fuel/FlFltHt" /begin SUB_GROUP S309_FlFltCtl_Ht /end SUB_GROUP /end GROUP
/begin GROUP S306_FlWtDet "DCRS_FrameModel_TorqueStructure/Subsystem/CORE/DE/Fl/Fuel/FlWtDet" /begin SUB_GROUP S310_FlWtDet_DD /end SUB_GROUP /end GROUP
/begin GROUP S306_FuelT "DCRS_FrameModel_TorqueStructure/Subsystem/CORE/DE/Fl/Fuel/FuelT" /begin SUB_GROUP S311_FuelT_DD S311_FuelT_VD /end SUB_GROUP /end GROUP
/begin GROUP S307_MeUn "DCRS_FrameModel_TorqueStructure/Subsystem/CORE/DE/Fl/Rail/MeUn" /begin SUB_GROUP S318_MeUn_DD S318_MeUn_Rot S318_MeUn_VD /end SUB_GROUP /end GROUP
/begin GROUP S307_RailP "DCRS_FrameModel_TorqueStructure/Subsystem/CORE/DE/Fl/Rail/RailP"
 /begin SUB_GROUP S319_RailP_DD S319_RailP_DD1ms S319_RailP_DDsync S319_RailP_PRV S319_RailP_VD S319_RailP_VDGradMon S319_RailP_VDSync /end SUB_GROUP
/end GROUP
/begin GROUP S330_ACCmpr_DD "DCRS_FrameModel_TorqueStructure/Subsystem/CORE/DE/ThmDev/AirC/ACCmpr_DD" /begin SUB_GROUP ACCmpr_DD /end SUB_GROUP /begin REF_MEASUREMENT AirC_stPsCmpr /end REF_MEASUREMENT /end GROUP
/begin GROUP S330_ACCmpr_VD "DCRS_FrameModel_TorqueStructure/Subsystem/CORE/DE/ThmDev/AirC/ACCmpr_VD" /begin SUB_GROUP ACCmpr_VD /end SUB_GROUP /begin REF_MEASUREMENT AirC_stPsCmprRedTrq_mp AirC_stPsCmpr_mp /end REF_MEASUREMENT /end GROUP
/begin GROUP S330_ACSwt_DD "DCRS_FrameModel_TorqueStructure/Subsystem/CORE/DE/ThmDev/AirC/ACSwt_DD" /begin SUB_GROUP ACSwt_DD /end SUB_GROUP /begin REF_MEASUREMENT AirC_stSwt /end REF_MEASUREMENT /end GROUP
/begin GROUP S330_ACSwt_VD "DCRS_FrameModel_TorqueStructure/Subsystem/CORE/DE/ThmDev/AirC/ACSwt_VD" /begin SUB_GROUP ACSwt_VD /end SUB_GROUP /begin REF_MEASUREMENT AirC_stSwtPrs /end REF_MEASUREMENT /end GROUP
/begin GROUP S331_CEngDsT_DD "DCRS_FrameModel_TorqueStructure/Subsystem/CORE/DE/ThmDev/CEngDsT/CEngDsT_DD" /begin SUB_GROUP CEngDsT_DD /end SUB_GROUP
 /begin REF_MEASUREMENT CEngDsT_bFinalDef CEngDsT_bPhysRngFinalDef CEngDsT_bPhysRngProvDef CEngDsT_bProvDef CEngDsT_tSens /end REF_MEASUREMENT
/end GROUP
/begin GROUP S331_CEngDsT_VD "DCRS_FrameModel_TorqueStructure/Subsystem/CORE/DE/ThmDev/CEngDsT/CEngDsT_VD" /begin SUB_GROUP CEngDsT_VD /end SUB_GROUP /begin REF_MEASUREMENT CEngDsT_dt CEngDsT_t CEngDsT_tSensFlt /end REF_MEASUREMENT /end GROUP
/begin GROUP S332_Fan_DD "DCRS_FrameModel_TorqueStructure/Subsystem/CORE/DE/ThmDev/Fan/Fan_DD" /begin SUB_GROUP Fan_DD /end SUB_GROUP /begin REF_MEASUREMENT Fan_rPs Fan_rPs2 Fan_stPs Fan_stPs2 Fan_tiPs /end REF_MEASUREMENT /end GROUP
/begin GROUP S340_APP_ChkSig "DCRS_FrameModel_TorqueStructure/Subsystem/CORE/DE/VehDev/APP/APP_ChkSig" /begin SUB_GROUP APP_ChkSig /end SUB_GROUP /begin REF_MEASUREMENT APP_r /end REF_MEASUREMENT /end GROUP
/begin GROUP S340_APP_DD1 "DCRS_FrameModel_TorqueStructure/Subsystem/CORE/DE/VehDev/APP/APP_DD1" /begin SUB_GROUP APP_DD1 /end SUB_GROUP /begin REF_MEASUREMENT APP_bAPP1FinalDef APP_bAPP1ProvDef APP_uRaw1 /end REF_MEASUREMENT /end GROUP
/begin GROUP S340_APP_DD2 "DCRS_FrameModel_TorqueStructure/Subsystem/CORE/DE/VehDev/APP/APP_DD2" /begin SUB_GROUP APP_DD2 /end SUB_GROUP /begin REF_MEASUREMENT APP_bAPP2FinalDef APP_bAPP2ProvDef APP_uRaw2 /end REF_MEASUREMENT /end GROUP
/begin GROUP S340_APP_Kickdown "DCRS_FrameModel_TorqueStructure/Subsystem/CORE/DE/VehDev/APP/APP_Kickdown" /begin SUB_GROUP APP_Kickdown /end SUB_GROUP /begin REF_MEASUREMENT APP_stKD /end REF_MEASUREMENT /end GROUP
/begin GROUP S340_APP_Plaus12 "DCRS_FrameModel_TorqueStructure/Subsystem/CORE/DE/VehDev/APP/APP_Plaus12" /begin SUB_GROUP APP_Plaus12 /end SUB_GROUP /begin REF_MEASUREMENT APP_bSync APP_bSyncDeb /end REF_MEASUREMENT /end GROUP
/begin GROUP S340_APP_PlausBrk "DCRS_FrameModel_TorqueStructure/Subsystem/CORE/DE/VehDev/APP/APP_PlausBrk" /begin SUB_GROUP APP_PlausBrk /end SUB_GROUP /begin REF_MEASUREMENT APP_stPlaBrkDet_mp APP_stPlaBrkRst_mp APP_stPlaBrk_mp /end REF_MEASUREMENT /end GROUP
/begin GROUP S340_APP_SelSig "DCRS_FrameModel_TorqueStructure/Subsystem/CORE/DE/VehDev/APP/APP_SelSig" /begin SUB_GROUP APP_SelSig /end SUB_GROUP
 /begin REF_MEASUREMENT APP_stSigSrc_APP1_BP APP_stSigSrc_APP2_BP APP_stSigSrc_APPDEF_BP APP_stSigSrc_APPLIMP_BP APP_uRaw_mp /end REF_MEASUREMENT
/end GROUP
/begin GROUP S340_APP_VD "DCRS_FrameModel_TorqueStructure/Subsystem/CORE/DE/VehDev/APP/APP_VD" /begin SUB_GROUP APP_VD /end SUB_GROUP
 /begin REF_MEASUREMENT APP_drUnFlt APP_rFlt_mp APP_rLinAPP_mp APP_rUnFlt APP_uUnJit_mp /end REF_MEASUREMENT
/end GROUP
/begin GROUP S341_Brk_DD "DCRS_FrameModel_TorqueStructure/Subsystem/CORE/DE/VehDev/Brk/Brk_DD" /begin SUB_GROUP Brk_DD /end SUB_GROUP /begin REF_MEASUREMENT Brk_stMn Brk_stRed /end REF_MEASUREMENT /end GROUP
/begin GROUP S341_Brk_VD "DCRS_FrameModel_TorqueStructure/Subsystem/CORE/DE/VehDev/Brk/Brk_VD" /begin SUB_GROUP Brk_VD /end SUB_GROUP /begin REF_MEASUREMENT Brk_st Brk_stFreeze_mp /end REF_MEASUREMENT /end GROUP
/begin GROUP S342_Clth_DD "DCRS_FrameModel_TorqueStructure/Subsystem/CORE/DE/VehDev/Clth/Clth_DD" /begin SUB_GROUP Clth_DD /end SUB_GROUP /begin REF_MEASUREMENT Clth_st /end REF_MEASUREMENT /end GROUP
/begin GROUP S342_Clth_VD "DCRS_FrameModel_TorqueStructure/Subsystem/CORE/DE/VehDev/Clth/Clth_VD" /begin SUB_GROUP Clth_VD /end SUB_GROUP /end GROUP
/begin GROUP S343_EBrk_DD "DCRS_FrameModel_TorqueStructure/Subsystem/CORE/DE/VehDev/Ebrk/EBrk_DD" /begin SUB_GROUP /end SUB_GROUP /begin REF_MEASUREMENT EBrk_stSwtDeb /end REF_MEASUREMENT /end GROUP
/begin GROUP S343_EBrk_VD "DCRS_FrameModel_TorqueStructure/Subsystem/CORE/DE/VehDev/Ebrk/EBrk_VD" /begin SUB_GROUP /end SUB_GROUP /begin REF_MEASUREMENT EBrk_st /end REF_MEASUREMENT /end GROUP
/begin GROUP S344_EngSpd_DD "DCRS_FrameModel_TorqueStructure/Subsystem/CORE/DE/VehDev/EngSpd/EngSpd_DD" /begin SUB_GROUP EngSpd_DD /end SUB_GROUP /begin REF_MEASUREMENT EngSpd_rPs EngSpd_tiPer_mp /end REF_MEASUREMENT /end GROUP
/begin GROUP S345_EnvP_DD "DCRS_FrameModel_TorqueStructure/Subsystem/CORE/DE/VehDev/EnvP/EnvP_DD" /begin SUB_GROUP EnvP_DD /end SUB_GROUP
 /begin REF_MEASUREMENT EnvP_bFinalDef EnvP_bPhysRngFinalDef EnvP_bPhysRngProvDef EnvP_bProvDef EnvP_pSens /end REF_MEASUREMENT
/end GROUP
/begin GROUP S345_EnvP_VD "DCRS_FrameModel_TorqueStructure/Subsystem/CORE/DE/VehDev/EnvP/EnvP_VD" /begin SUB_GROUP EnvP_VD /end SUB_GROUP /begin REF_MEASUREMENT EnvP_p /end REF_MEASUREMENT /end GROUP
/begin GROUP S346_EnvT_DD "DCRS_FrameModel_TorqueStructure/Subsystem/CORE/DE/VehDev/EnvT/EnvT_DD" /begin SUB_GROUP EnvT_DD /end SUB_GROUP
 /begin REF_MEASUREMENT EnvT_bFinalDef EnvT_bPhysRngFinalDef EnvT_bPhysRngProvDef EnvT_bProvDef EnvT_tSens /end REF_MEASUREMENT
/end GROUP
/begin GROUP S346_EnvT_VD "DCRS_FrameModel_TorqueStructure/Subsystem/CORE/DE/VehDev/EnvT/EnvT_VD" /begin SUB_GROUP EnvT_VD /end SUB_GROUP /begin REF_MEASUREMENT EnvT_t /end REF_MEASUREMENT /end GROUP
/begin GROUP S347_FuelConsDspl_DD "DCRS_FrameModel_TorqueStructure/Subsystem/CORE/DE/VehDev/FuelConsDspl/FuelConsDspl_DD" /begin SUB_GROUP FuelConsDspl_DD /end SUB_GROUP /begin REF_MEASUREMENT FuelConsDspl_rPs FuelConsDspl_tiPer /end REF_MEASUREMENT /end GROUP
/begin GROUP S348_GbxNPos "DCRS_FrameModel_TorqueStructure/Subsystem/CORE/DE/VehDev/Gbx/GbxNPos" /begin SUB_GROUP S380_GbxNPos_DD /end SUB_GROUP /end GROUP
/begin GROUP S349_GlwLmp_DD "DCRS_FrameModel_TorqueStructure/Subsystem/CORE/DE/VehDev/GlwLmp/GlwLmp_DD" /begin SUB_GROUP GlwLmp_DD /end SUB_GROUP /begin REF_MEASUREMENT GlwLmp_stPs /end REF_MEASUREMENT /end GROUP
/begin GROUP S349_GlwLmp_VD "DCRS_FrameModel_TorqueStructure/Subsystem/CORE/DE/VehDev/GlwLmp/GlwLmp_VD" /begin SUB_GROUP /end SUB_GROUP /begin REF_MEASUREMENT GlwLmp_stReq /end REF_MEASUREMENT /end GROUP
/begin GROUP S350_HndBrk_DD "DCRS_FrameModel_TorqueStructure/Subsystem/CORE/DE/VehDev/HndBrk/HndBrk_DD" /begin SUB_GROUP HndBrk_DD /end SUB_GROUP /begin REF_MEASUREMENT HndBrk_stDebVal /end REF_MEASUREMENT /end GROUP
/begin GROUP S351_OilPLmp_DD "DCRS_FrameModel_TorqueStructure/Subsystem/CORE/DE/VehDev/OilPLmp/OilPLmp_DD" /begin SUB_GROUP OilPLmp_DD /end SUB_GROUP /begin REF_MEASUREMENT OilPLmp_st /end REF_MEASUREMENT /end GROUP
/begin GROUP S352_PTOEnblSwt_DD "DCRS_FrameModel_TorqueStructure/Subsystem/CORE/DE/VehDev/PTOEnblSwt/PTOEnblSwt_DD" /begin SUB_GROUP PTOEnblSwt_DD /end SUB_GROUP /begin REF_MEASUREMENT PTOEnblSwt_st /end REF_MEASUREMENT /end GROUP
/begin GROUP S353_PTOSwt_DD "DCRS_FrameModel_TorqueStructure/Subsystem/CORE/DE/VehDev/PTOSwt/PTOSwt_DD" /begin SUB_GROUP PTOSwt_DD /end SUB_GROUP /begin REF_MEASUREMENT PTOSwt_bFinalDef PTOSwt_bNpl PTOSwt_uSens /end REF_MEASUREMENT /end GROUP
/begin GROUP S353_PTOSwt_VD "DCRS_FrameModel_TorqueStructure/Subsystem/CORE/DE/VehDev/PTOSwt/PTOSwt_VD" /begin SUB_GROUP PTOSwt_VD /end SUB_GROUP /begin REF_MEASUREMENT PTOSwt_st /end REF_MEASUREMENT /end GROUP
/begin GROUP S354_RmtAPP_ChkSig "DCRS_FrameModel_TorqueStructure/Subsystem/CORE/DE/VehDev/RmtAPP/RmtAPP_ChkSig" /begin SUB_GROUP RmtAPP_ChkSig /end SUB_GROUP /begin REF_MEASUREMENT RmtAPP_r /end REF_MEASUREMENT /end GROUP
/begin GROUP S354_RmtAPP_DD1 "DCRS_FrameModel_TorqueStructure/Subsystem/CORE/DE/VehDev/RmtAPP/RmtAPP_DD1" /begin SUB_GROUP RmtAPP_DD1 /end SUB_GROUP /begin REF_MEASUREMENT RmtAPP_bAPP1FinalDef RmtAPP_bAPP1ProvDef RmtAPP_uRaw1 /end REF_MEASUREMENT /end GROUP
/begin GROUP S354_RmtAPP_DD2 "DCRS_FrameModel_TorqueStructure/Subsystem/CORE/DE/VehDev/RmtAPP/RmtAPP_DD2" /begin SUB_GROUP RmtAPP_DD2 /end SUB_GROUP /begin REF_MEASUREMENT RmtAPP_bAPP2FinalDef RmtAPP_bAPP2ProvDef RmtAPP_uRaw2 /end REF_MEASUREMENT /end GROUP
/begin GROUP S354_RmtAPP_Kickdown "DCRS_FrameModel_TorqueStructure/Subsystem/CORE/DE/VehDev/RmtAPP/RmtAPP_Kickdown" /begin SUB_GROUP RmtAPP_Kickdown /end SUB_GROUP /begin REF_MEASUREMENT RmtAPP_stKD /end REF_MEASUREMENT /end GROUP
/begin GROUP S354_RmtAPP_Plaus12 "DCRS_FrameModel_TorqueStructure/Subsystem/CORE/DE/VehDev/RmtAPP/RmtAPP_Plaus12" /begin SUB_GROUP RmtAPP_Plaus12 /end SUB_GROUP /begin REF_MEASUREMENT RmtAPP_bSync RmtAPP_bSyncDeb /end REF_MEASUREMENT /end GROUP
/begin GROUP S354_RmtAPP_PlausBrk "DCRS_FrameModel_TorqueStructure/Subsystem/CORE/DE/VehDev/RmtAPP/RmtAPP_PlausBrk" /begin SUB_GROUP RmtAPP_PlausBrk /end SUB_GROUP
 /begin REF_MEASUREMENT RmtAPP_stPlaBrkDet_mp RmtAPP_stPlaBrkRst_mp RmtAPP_stPlaBrk_mp /end REF_MEASUREMENT
/end GROUP
/begin GROUP S354_RmtAPP_SelSig "DCRS_FrameModel_TorqueStructure/Subsystem/CORE/DE/VehDev/RmtAPP/RmtAPP_SelSig" /begin SUB_GROUP RmtAPP_SelSig /end SUB_GROUP
 /begin REF_MEASUREMENT RmtAPP_stSigSrc_APP1_BP RmtAPP_stSigSrc_APP2_BP RmtAPP_stSigSrc_APPDEF_BP RmtAPP_stSigSrc_APPLIMP_BP RmtAPP_uRaw_mp /end REF_MEASUREMENT
/end GROUP
/begin GROUP S354_RmtAPP_VD "DCRS_FrameModel_TorqueStructure/Subsystem/CORE/DE/VehDev/RmtAPP/RmtAPP_VD" /begin SUB_GROUP RmtAPP_VD /end SUB_GROUP
 /begin REF_MEASUREMENT RmtAPP_drUnFlt RmtAPP_rFlt_mp RmtAPP_rLinAPP_mp RmtAPP_rUnFlt RmtAPP_uUnJit_mp /end REF_MEASUREMENT
/end GROUP
/begin GROUP S355_SpdDemSwt_DD "DCRS_FrameModel_TorqueStructure/Subsystem/CORE/DE/VehDev/SpdDemSwt/SpdDemSwt_DD" /begin SUB_GROUP SpdDemSwt_DD /end SUB_GROUP /begin REF_MEASUREMENT SpdDemSwt_stDebVal_mp /end REF_MEASUREMENT /end GROUP
/begin GROUP S355_SpdDemSwt_VD "DCRS_FrameModel_TorqueStructure/Subsystem/CORE/DE/VehDev/SpdDemSwt/SpdDemSwt_VD" /begin SUB_GROUP SpdDemSwt_VD /end SUB_GROUP /begin REF_MEASUREMENT SpdDemSwt_st /end REF_MEASUREMENT /end GROUP
/begin GROUP S356_SpdGovSwt_DD "DCRS_FrameModel_TorqueStructure/Subsystem/CORE/DE/VehDev/SpdGovSwt/SpdGovSwt_DD" /begin SUB_GROUP SpdGovSwt_DD /end SUB_GROUP /begin REF_MEASUREMENT SpdGovSwt_st /end REF_MEASUREMENT /end GROUP
/begin GROUP S357_TClntDspl_DD "DCRS_FrameModel_TorqueStructure/Subsystem/CORE/DE/VehDev/TClntDspl/TClntDspl_DD" /begin SUB_GROUP TClntDspl_DD /end SUB_GROUP /begin REF_MEASUREMENT TClntDspl_rPs TClntDspl_tiPer /end REF_MEASUREMENT /end GROUP
/begin GROUP S358_VehV_DD "DCRS_FrameModel_TorqueStructure/Subsystem/CORE/DE/VehDev/VehV/VehV_DD" /begin SUB_GROUP VehV_DD /end SUB_GROUP /begin REF_MEASUREMENT VehV_bSwtPrs VehV_nRawCrdSh VehV_vSens /end REF_MEASUREMENT /end GROUP
/begin GROUP S358_VehV_VD "DCRS_FrameModel_TorqueStructure/Subsystem/CORE/DE/VehDev/VehV/VehV_VD" /begin SUB_GROUP VehV_VD /end SUB_GROUP /begin REF_MEASUREMENT VehV_a VehV_nCrdSh VehV_v /end REF_MEASUREMENT /end GROUP
/begin GROUP S359_VehVDspl_DD "DCRS_FrameModel_TorqueStructure/Subsystem/CORE/DE/VehDev/VehVDspl/VehVDspl_DD" /begin SUB_GROUP /end SUB_GROUP /begin REF_MEASUREMENT VehVDspl_tiSigPer_mp /end REF_MEASUREMENT /end GROUP
/begin GROUP S20_ASDdc "DCRS_FrameModel_TorqueStructure/Subsystem/CORE/ASW/Eng/ETS/ASD/ASDdc" /begin SUB_GROUP S27_ASDdc_Governor S27_ASDdc_SelectParameter /end SUB_GROUP /end GROUP
/begin GROUP S20_ASDrf "DCRS_FrameModel_TorqueStructure/Subsystem/CORE/ASW/Eng/ETS/ASD/ASDrf" /begin SUB_GROUP S28_ASDrf_Governor S28_ASDrf_SelectParameter /end SUB_GROUP /end GROUP
/begin GROUP S21_CoETS_NTC "DCRS_FrameModel_TorqueStructure/Subsystem/CORE/ASW/Eng/ETS/CoETS/CoETS_NTC" /begin SUB_GROUP CoETS_NTC /end SUB_GROUP /begin REF_MEASUREMENT CoETS_trqNTCInrAct CoETS_trqNTCInrMax CoETS_trqNTCLim /end REF_MEASUREMENT /end GROUP
/begin GROUP S21_CoETS_StTrqLimCalc "DCRS_FrameModel_TorqueStructure/Subsystem/CORE/ASW/Eng/ETS/CoETS/CoETS_StTrqLimCalc" /begin SUB_GROUP CoETS_StTrqLimCalc /end SUB_GROUP
 /begin REF_MEASUREMENT CoETS_rTrq CoETS_rTrqVMD CoETS_stCurrLim CoETS_stCurrLimActive CoETS_stLimInfo CoETS_trqInrCurrLim CoETS_trqInrVehLimMin_mp /end REF_MEASUREMENT
/end GROUP
/begin GROUP S21_CoETS_TSEACo "DCRS_FrameModel_TorqueStructure/Subsystem/CORE/ASW/Eng/ETS/CoETS/CoETS_TSEACo" /begin SUB_GROUP CoETS_TSEACo /end SUB_GROUP
 /begin REF_MEASUREMENT CoETS_nTSEASpdDes CoETS_nTSEASpdLim CoETS_stEngEmgcyRunReq CoETS_stEngStopReq CoETS_stTSEASourceActv CoETS_stTSEATrqSpdReq CoETS_trqTSEAEngMax CoETS_trqTSEAEngMin /end REF_MEASUREMENT
/end GROUP
/begin GROUP S21_CoETS_TrqCalc "DCRS_FrameModel_TorqueStructure/Subsystem/CORE/ASW/Eng/ETS/CoETS/CoETS_TrqCalc" /begin SUB_GROUP CoETS_TrqCalc /end SUB_GROUP
 /begin REF_MEASUREMENT CoETS_stInrDesBrk CoETS_trqInrCurr CoETS_trqInrCurrFast CoETS_trqInrDesNTC CoETS_trqInrLead CoETS_trqInrLeadFast CoETS_trqInrLimSet CoETS_trqInrLtd CoETS_trqInrLtdPre_mp CoETS_trqInrSetSlow CoETS_trqInrSet_mp CoETS_trqLlim CoETS_trqSpdGovLim CoETS_trqUnFltLtd CoETS_trqUnFltLtdSet CoETS_trqUnFltSet /end REF_MEASUREMENT
/end GROUP
/begin GROUP S22_PthLead "DCRS_FrameModel_TorqueStructure/Subsystem/CORE/ASW/Eng/ETS/ETSPth/PthLead" /begin SUB_GROUP S37_PthLead_TrqCalc /end SUB_GROUP /end GROUP
/begin GROUP S22_PthSet "DCRS_FrameModel_TorqueStructure/Subsystem/CORE/ASW/Eng/ETS/ETSPth/PthSet" /begin SUB_GROUP S38_PthSet_OvrRunCoord S38_PthSet_TrqCalc /end SUB_GROUP /end GROUP
/begin GROUP S23_EngDem_TrqLimCoord "DCRS_FrameModel_TorqueStructure/Subsystem/CORE/ASW/Eng/ETS/EngDem/EngDem_TrqLimCoord" /begin SUB_GROUP EngDem_TrqLimCoord /end SUB_GROUP
 /begin REF_MEASUREMENT EngDem_facAdj EngDem_stErr_mp EngDem_trqInrLim EngDem_trqInrLimLead EngDem_trqInrLimSlow EngDem_trqLimErr EngDem_trqLimPDiff /end REF_MEASUREMENT
/end GROUP
/begin GROUP S23_EngPrt "DCRS_FrameModel_TorqueStructure/Subsystem/CORE/ASW/Eng/ETS/EngDem/EngPrt"
 /begin SUB_GROUP S43_EngPrt_OvrSpd S43_EngPrt_PrtLimMech S43_EngPrt_PrtLimOvht S43_EngPrt_TrqLimCalc S43_EngPrt_TrqLimPTO /end SUB_GROUP
/end GROUP
/begin GROUP S23_EngReq "DCRS_FrameModel_TorqueStructure/Subsystem/CORE/ASW/Eng/ETS/EngDem/EngReq"
 /begin SUB_GROUP S44_EngReq_FullLdIncr S44_EngReq_InjLimCalc S44_EngReq_SmkLimCalc S44_EngReq_TrqLimCalc /end SUB_GROUP
/end GROUP
/begin GROUP S24_DrvDem "DCRS_FrameModel_TorqueStructure/Subsystem/CORE/ASW/Eng/ETS/SpdGov/DrvDem"
 /begin SUB_GROUP S54_DrvDem_CalcState S54_DrvDem_SelectParameter S54_DrvDem_SetPoint /end SUB_GROUP
/end GROUP
/begin GROUP S24_EISGov "DCRS_FrameModel_TorqueStructure/Subsystem/CORE/ASW/Eng/ETS/SpdGov/EISGov"
 /begin SUB_GROUP S55_EISGov_Governor S55_EISGov_SelectParameter S55_EISGov_SelectTrqLim S55_EISGov_TrqLosEst /end SUB_GROUP
/end GROUP
/begin GROUP S24_ExtDem "DCRS_FrameModel_TorqueStructure/Subsystem/CORE/ASW/Eng/ETS/SpdGov/ExtDem"
 /begin SUB_GROUP S56_ExtDem_CalcState S56_ExtDem_SelectParameter S56_ExtDem_SetPoint /end SUB_GROUP
/end GROUP
/begin GROUP S24_HLSDem "DCRS_FrameModel_TorqueStructure/Subsystem/CORE/ASW/Eng/ETS/SpdGov/HLSDem"
 /begin SUB_GROUP S57_HLSDem_CalcState S57_HLSDem_SelectParameter S57_HLSDem_SetPoint /end SUB_GROUP
/end GROUP
/begin GROUP S25_CnvLead "DCRS_FrameModel_TorqueStructure/Subsystem/CORE/ASW/Eng/ETS/TrqCnv/CnvLead" /begin SUB_GROUP S71_CnvLead_Trq2Q /end SUB_GROUP /end GROUP
/begin GROUP S25_CnvSet "DCRS_FrameModel_TorqueStructure/Subsystem/CORE/ASW/Eng/ETS/TrqCnv/CnvSet" /begin SUB_GROUP S72_CnvSet_Trq2Q /end SUB_GROUP /end GROUP
/begin GROUP S26_ActMod "DCRS_FrameModel_TorqueStructure/Subsystem/CORE/ASW/Eng/ETS/TrqMod/ActMod" /begin SUB_GROUP S75_ActMod_Q2Trq S75_ActMod_TrqCalc /end SUB_GROUP /end GROUP
/begin GROUP S26_PhyMod "DCRS_FrameModel_TorqueStructure/Subsystem/CORE/ASW/Eng/ETS/TrqMod/PhyMod" /begin SUB_GROUP S76_PhyMod_CalcCor /end SUB_GROUP /end GROUP
/begin GROUP S26_RngMod "DCRS_FrameModel_TorqueStructure/Subsystem/CORE/ASW/Eng/ETS/TrqMod/RngMod"
 /begin SUB_GROUP S77_RngMod_TrqCalc S77_RngMod_TrqFrcAdpt S77_RngMod_TrqFrcCalc S77_RngMod_TrqSpdCrv /end SUB_GROUP
/end GROUP
/begin GROUP S89_AirMod "DCRS_FrameModel_TorqueStructure/Subsystem/CORE/ASW/Eng/GsSys/ASMod/AirMod" /begin SUB_GROUP S92_ASMod_VolEff /end SUB_GROUP /end GROUP
/begin GROUP S89_ExhMod "DCRS_FrameModel_TorqueStructure/Subsystem/CORE/ASW/Eng/GsSys/ASMod/ExhMod" /begin SUB_GROUP S93_ASMod_TempCatMod /end SUB_GROUP /end GROUP
/begin GROUP S90_AirCtl "DCRS_FrameModel_TorqueStructure/Subsystem/CORE/ASW/Eng/GsSys/AirSys/AirCtl"
 /begin SUB_GROUP S96_AirCtl_Co S96_AirCtl_CtlValCalc S96_AirCtl_DesValCalc S96_AirCtl_Gov S96_AirCtl_Mon /end SUB_GROUP
/end GROUP
/begin GROUP S90_AirHt "DCRS_FrameModel_TorqueStructure/Subsystem/CORE/ASW/Eng/GsSys/AirSys/AirHt" /begin SUB_GROUP S97_AirHt_Ctl /end SUB_GROUP /end GROUP
/begin GROUP S90_CoAS "DCRS_FrameModel_TorqueStructure/Subsystem/CORE/ASW/Eng/GsSys/AirSys/CoAS" /begin SUB_GROUP S98_CoAS_RlsCmpn /end SUB_GROUP /end GROUP
/begin GROUP S90_TCPrt "DCRS_FrameModel_TorqueStructure/Subsystem/CORE/ASW/Eng/GsSys/AirSys/TCPrt" /begin SUB_GROUP S99_TCPrt_TrqLim /end SUB_GROUP /end GROUP
/begin GROUP S91_SmkLim "DCRS_FrameModel_TorqueStructure/Subsystem/CORE/ASW/Eng/GsSys/EGSys/SmkLim" /begin SUB_GROUP S108_SmkLim_AirMsSel S108_SmkLim_InjMassLim /end SUB_GROUP /end GROUP
/begin GROUP S111_FlSys_CalcCnvFac "DCRS_FrameModel_TorqueStructure/Subsystem/CORE/ASW/Eng/InjSys/FlSys/FlSys_CalcCnvFac" /begin SUB_GROUP FlSys_CalcCnvFac /end SUB_GROUP
 /begin REF_MEASUREMENT FlSys_facStoich FlSys_rhoFl FlSys_rhoFlCnvFac FlSys_swtRhoFlCnv /end REF_MEASUREMENT
/end GROUP
/begin GROUP S111_FlSys_FlCons "DCRS_FrameModel_TorqueStructure/Subsystem/CORE/ASW/Eng/InjSys/FlSys/FlSys_FlCons" /begin SUB_GROUP FlSys_FlCons /end SUB_GROUP /begin REF_MEASUREMENT FlSys_dvolFlCons FlSys_dvolPerStroke FlSys_volFlCons /end REF_MEASUREMENT /end GROUP
/begin GROUP S111_FlSys_FlConsTot "DCRS_FrameModel_TorqueStructure/Subsystem/CORE/ASW/Eng/InjSys/FlSys/FlSys_FlConsTot" /begin SUB_GROUP FlSys_FlConsTot /end SUB_GROUP /begin REF_MEASUREMENT FlSys_volFlConsHiResTot FlSys_volFlConsTot /end REF_MEASUREMENT /end GROUP
/begin GROUP S112_InjCrv "DCRS_FrameModel_TorqueStructure/Subsystem/CORE/ASW/Eng/InjSys/InjCtl/InjCrv"
 /begin SUB_GROUP S119_InjCrv_MI1 S119_InjCrv_MI1Cor S119_InjCrv_MI1SOEAirMsCor S119_InjCrv_PiI1 S119_InjCrv_PiI1AddCor S119_InjCrv_PiI1Cor S119_InjCrv_PiI1Set S119_InjCrv_PiI2 S119_InjCrv_PiI2AddCor S119_InjCrv_PiI2Cor S119_InjCrv_PiI2Set S119_InjCrv_PoI2 S119_InjCrv_PoI2AddCor S119_InjCrv_PoI2Cor S119_InjCrv_PoI2Set /end SUB_GROUP
/end GROUP
/begin GROUP S112_InjCtl_qCo "DCRS_FrameModel_TorqueStructure/Subsystem/CORE/ASW/Eng/InjSys/InjCtl/InjCtl_qCo" /begin SUB_GROUP InjCtl_qCo /end SUB_GROUP /begin REF_MEASUREMENT InjCtl_dqLead InjCtl_qCurr InjCtl_qRaw /end REF_MEASUREMENT /end GROUP
/begin GROUP S112_InjCtl_qCoSync "DCRS_FrameModel_TorqueStructure/Subsystem/CORE/ASW/Eng/InjSys/InjCtl/InjCtl_qCoSync" /begin SUB_GROUP InjCtl_qCoSync /end SUB_GROUP /begin REF_MEASUREMENT InjCtl_qSetUnBal /end REF_MEASUREMENT /end GROUP
/begin GROUP S115_HPUn "DCRS_FrameModel_TorqueStructure/Subsystem/CORE/ASW/Eng/InjSys/InjUn/HPUn" /begin SUB_GROUP S137_HPUn_Co S137_HPUn_QntBalInjLim /end SUB_GROUP /end GROUP
/begin GROUP S115_Rail "DCRS_FrameModel_TorqueStructure/Subsystem/CORE/ASW/Eng/InjSys/InjUn/Rail"
 /begin SUB_GROUP S138_Rail_BlkShtCtl S138_Rail_CtlLoop S138_Rail_CtlLoopLimMeUn S138_Rail_CtlLoopParaMeUn S138_Rail_MonMeUn S138_Rail_PreCtlMeUn S138_Rail_PresPeakLim S138_Rail_SetPoint S138_Rail_SetPointAddCor S138_Rail_SetPointCor S138_Rail_TempLim /end SUB_GROUP
/end GROUP
/begin GROUP S164_CoME_DemCoord "DCRS_FrameModel_TorqueStructure/Subsystem/CORE/ASW/Veh/CoVeh/CoME/CoME_DemCoord" /begin SUB_GROUP CoME_DemCoord /end SUB_GROUP
 /begin REF_MEASUREMENT CoME_nMax CoME_nMin CoME_stNSetP CoME_trqDesComp CoME_trqResv CoVeh_trqAcs /end REF_MEASUREMENT
/end GROUP
/begin GROUP S164_CoME_ShutOff "DCRS_FrameModel_TorqueStructure/Subsystem/CORE/ASW/Veh/CoVeh/CoME/CoME_ShutOff" /begin SUB_GROUP CoME_ShutOff /end SUB_GROUP /begin REF_MEASUREMENT CoVeh_stAlt CoVeh_stFan CoVeh_trqMaxAC /end REF_MEASUREMENT /end GROUP
/begin GROUP S165_CoTE_ThermDem "DCRS_FrameModel_TorqueStructure/Subsystem/CORE/ASW/Veh/CoVeh/CoTE/CoTE_ThermDem" /begin SUB_GROUP /end SUB_GROUP /begin REF_MEASUREMENT CoVeh_rClgDes CoVeh_tClntDes /end REF_MEASUREMENT /end GROUP
/begin GROUP S171_LsComp_TrqCalc "DCRS_FrameModel_TorqueStructure/Subsystem/CORE/ASW/Veh/CoVeh/LsComp/LsComp_TrqCalc" /begin SUB_GROUP LsComp_TrqCalc /end SUB_GROUP /begin REF_MEASUREMENT CoVeh_trqDesCompNoFl CoVeh_trqDesCompVeh /end REF_MEASUREMENT /end GROUP
/begin GROUP S176_CoESS_Dem "DCRS_FrameModel_TorqueStructure/Subsystem/CORE/ASW/Veh/ESS/CoESS/CoESS_Dem" /begin SUB_GROUP CoESS_Dem /end SUB_GROUP /begin REF_MEASUREMENT ESS_nMax ESS_nMin ESS_trqDesAcs ESS_trqResvAcs /end REF_MEASUREMENT /end GROUP
/begin GROUP S181_CoPT_ThermDem "DCRS_FrameModel_TorqueStructure/Subsystem/CORE/ASW/Veh/PT/CoPT/CoPT_ThermDem" /begin SUB_GROUP CoPT_ThermDem /end SUB_GROUP /begin REF_MEASUREMENT CoPT_rClgDes CoPT_tClntDes /end REF_MEASUREMENT /end GROUP
/begin GROUP S181_CoPT_TrqDesCoord "DCRS_FrameModel_TorqueStructure/Subsystem/CORE/ASW/Veh/PT/CoPT/CoPT_TrqDesCoord" /begin SUB_GROUP CoPT_TrqDesCoord /end SUB_GROUP /begin REF_MEASUREMENT CoPT_trqDes CoPT_trqDesClth CoPT_trqPTPrt PT_stTraIntv /end REF_MEASUREMENT /end GROUP
/begin GROUP S181_CoPT_TrqLeadCoord "DCRS_FrameModel_TorqueStructure/Subsystem/CORE/ASW/Veh/PT/CoPT/CoPT_TrqLeadCoord" /begin SUB_GROUP CoPT_TrqLeadCoord /end SUB_GROUP /begin REF_MEASUREMENT CoPT_trqCurr CoPT_trqLead CoPT_trqLeadClth /end REF_MEASUREMENT /end GROUP
/begin GROUP S181_PTCOP "DCRS_FrameModel_TorqueStructure/Subsystem/CORE/ASW/Veh/PT/CoPT/PTCOP" /begin SUB_GROUP S190_PTCOP_TrqCnv /end SUB_GROUP /end GROUP
/begin GROUP S181_PTLo "DCRS_FrameModel_TorqueStructure/Subsystem/CORE/ASW/Veh/PT/CoPT/PTLo" /begin SUB_GROUP S191_PTLo_LosCalc /end SUB_GROUP /end GROUP
/begin GROUP S181_PTODi "DCRS_FrameModel_TorqueStructure/Subsystem/CORE/ASW/Veh/PT/CoPT/PTODi"
 /begin SUB_GROUP S192_PTODi_SpdCoord S192_PTODi_TrqComp S192_PTODi_TrqDesCoord S192_PTODi_TrqLeadCoord /end SUB_GROUP
/end GROUP
/begin GROUP S182_Conv_GripIntrlck "DCRS_FrameModel_TorqueStructure/Subsystem/CORE/ASW/Veh/PT/Conv/Conv_GripIntrlck" /begin SUB_GROUP /end SUB_GROUP /begin REF_MEASUREMENT PT_stConvGrip /end REF_MEASUREMENT /end GROUP
/begin GROUP S182_Conv_LdCalc "DCRS_FrameModel_TorqueStructure/Subsystem/CORE/ASW/Veh/PT/Conv/Conv_LdCalc" /begin SUB_GROUP Conv_LdCalc /end SUB_GROUP /begin REF_MEASUREMENT Conv_trqLd Conv_trqResv /end REF_MEASUREMENT /end GROUP
/begin GROUP S183_Gbx_Data "DCRS_FrameModel_TorqueStructure/Subsystem/CORE/ASW/Veh/PT/Gbx/Gbx_Data" /begin SUB_GROUP Gbx_Data /end SUB_GROUP
 /begin REF_MEASUREMENT Gbx_nIdlDes Gbx_rFanClgDem Gbx_rTrq Gbx_stOvrSpdDem Gbx_tClntDes /end REF_MEASUREMENT
/end GROUP
/begin GROUP S186_Tra_Add "DCRS_FrameModel_TorqueStructure/Subsystem/CORE/ASW/Veh/PT/Tra/Tra_Add" /begin SUB_GROUP Tra_Add /end SUB_GROUP /begin REF_MEASUREMENT Tra_rClgDem Tra_tClntDes /end REF_MEASUREMENT /end GROUP
/begin GROUP S186_Tra_DblClthDet "DCRS_FrameModel_TorqueStructure/Subsystem/CORE/ASW/Veh/PT/Tra/Tra_DblClthDet" /begin SUB_GROUP Tra_DblClthDet /end SUB_GROUP /begin REF_MEASUREMENT Tra_trqDblClthEngMax Tra_trqDblClthVehMax /end REF_MEASUREMENT /end GROUP
/begin GROUP S186_Tra_GearInfo "DCRS_FrameModel_TorqueStructure/Subsystem/CORE/ASW/Veh/PT/Tra/Tra_GearInfo" /begin SUB_GROUP Tra_GearInfo /end SUB_GROUP
 /begin REF_MEASUREMENT PT_rTraGear PT_rTraV2N PT_stTraRevGear PT_stTraShftOp Tra_numGear Tra_numGearDes Tra_numParGear Tra_stStopEna Tra_stStrtEna /end REF_MEASUREMENT
/end GROUP
/begin GROUP S186_Tra_Grip "DCRS_FrameModel_TorqueStructure/Subsystem/CORE/ASW/Veh/PT/Tra/Tra_Grip" /begin SUB_GROUP /end SUB_GROUP /begin REF_MEASUREMENT PT_stTraGrip /end REF_MEASUREMENT /end GROUP
/begin GROUP S186_Tra_Los "DCRS_FrameModel_TorqueStructure/Subsystem/CORE/ASW/Veh/PT/Tra/Tra_Los" /begin SUB_GROUP Tra_Los /end SUB_GROUP /begin REF_MEASUREMENT Tra_trqLos /end REF_MEASUREMENT /end GROUP
/begin GROUP S186_Tra_Prt "DCRS_FrameModel_TorqueStructure/Subsystem/CORE/ASW/Veh/PT/Tra/Tra_Prt" /begin SUB_GROUP Tra_Prt /end SUB_GROUP /begin REF_MEASUREMENT PT_trqTraPrt /end REF_MEASUREMENT /end GROUP
/begin GROUP S186_Tra_RtnIntfc "DCRS_FrameModel_TorqueStructure/Subsystem/CORE/ASW/Veh/PT/Tra/Tra_RtnIntfc" /begin SUB_GROUP Tra_RtnIntfc /end SUB_GROUP /begin REF_MEASUREMENT Tra_nMax Tra_nMin Tra_stNSetP /end REF_MEASUREMENT /end GROUP
/begin GROUP S186_Tra_TrqRed "DCRS_FrameModel_TorqueStructure/Subsystem/CORE/ASW/Veh/PT/Tra/Tra_TrqRed" /begin SUB_GROUP Tra_TrqRed /end SUB_GROUP /begin REF_MEASUREMENT Tra_trqDesMax Tra_trqDesMin Tra_trqLeadMax Tra_trqLeadMin /end REF_MEASUREMENT /end GROUP
/begin GROUP S186_Tra_TypeInfo "DCRS_FrameModel_TorqueStructure/Subsystem/CORE/ASW/Veh/PT/Tra/Tra_TypeInfo" /begin SUB_GROUP Tra_TypeInfo /end SUB_GROUP /begin REF_MEASUREMENT PT_stTraType /end REF_MEASUREMENT /end GROUP
/begin GROUP S211_AC "DCRS_FrameModel_TorqueStructure/Subsystem/CORE/ASW/Veh/TS/CTM/AC" /begin SUB_GROUP S214_ACCtl /end SUB_GROUP /end GROUP
/begin GROUP S212_CoTS_MechDem "DCRS_FrameModel_TorqueStructure/Subsystem/CORE/ASW/Veh/TS/CoTS/CoTS_MechDem" /begin SUB_GROUP CoTS_MechDem /end SUB_GROUP /begin REF_MEASUREMENT TS_nMax TS_nMin TS_trqDesAcs TS_trqResvAcs /end REF_MEASUREMENT /end GROUP
/begin GROUP S213_FanCtl_Spd "DCRS_FrameModel_TorqueStructure/Subsystem/CORE/ASW/Veh/TS/Fans/FanCtl_Spd" /begin SUB_GROUP FanCtl_Spd /end SUB_GROUP
 /begin REF_MEASUREMENT FanCtl_bTrqResv FanCtl_bTrqResv2 FanCtl_flgAftRunActv FanCtl_stXPostDrv Fan_r Fan_r2 Fan_st Fan_st2 /end REF_MEASUREMENT
/end GROUP
/begin GROUP S213_Fans_ClgDem "DCRS_FrameModel_TorqueStructure/Subsystem/CORE/ASW/Veh/TS/Fans/Fans_ClgDem" /begin SUB_GROUP Fans_ClgDem /end SUB_GROUP /begin REF_MEASUREMENT Fans_rClgDesFan Fans_rCoolgDmdFan_mp /end REF_MEASUREMENT /end GROUP
/begin GROUP S213_Fans_trq "DCRS_FrameModel_TorqueStructure/Subsystem/CORE/ASW/Veh/TS/Fans/Fans_trq" /begin SUB_GROUP Fans_trq /end SUB_GROUP /begin REF_MEASUREMENT Fans_trqCons Fans_trqResv /end REF_MEASUREMENT /end GROUP
/begin GROUP S221_CoVM_SpdCoord "DCRS_FrameModel_TorqueStructure/Subsystem/CORE/ASW/Veh/VehMot/CoVM/CoVM_SpdCoord" /begin SUB_GROUP /end SUB_GROUP
 /begin REF_MEASUREMENT VehMot_nMax VehMot_nMaxAcs VehMot_nMin VehMot_nMinAcs VehMot_stNSetP /end REF_MEASUREMENT
/end GROUP
/begin GROUP S221_CoVM_TrqAcsCoord "DCRS_FrameModel_TorqueStructure/Subsystem/CORE/ASW/Veh/VehMot/CoVM/CoVM_TrqAcsCoord" /begin SUB_GROUP /end SUB_GROUP /begin REF_MEASUREMENT VehMot_trqDesAcs VehMot_trqResvAcs /end REF_MEASUREMENT /end GROUP
/begin GROUP S221_CoVM_TrqDesCoord "DCRS_FrameModel_TorqueStructure/Subsystem/CORE/ASW/Veh/VehMot/CoVM/CoVM_TrqDesCoord" /begin SUB_GROUP /end SUB_GROUP /begin REF_MEASUREMENT CoVM_trqDes /end REF_MEASUREMENT /end GROUP
/begin GROUP S221_CoVM_TrqLeadCoord "DCRS_FrameModel_TorqueStructure/Subsystem/CORE/ASW/Veh/VehMot/CoVM/CoVM_TrqLeadCoord" /begin SUB_GROUP /end SUB_GROUP /begin REF_MEASUREMENT CoVM_trqLead /end REF_MEASUREMENT /end GROUP
/begin GROUP S222_Diff "DCRS_FrameModel_TorqueStructure/Subsystem/CORE/ASW/Veh/VehMot/Prp/Diff" /begin SUB_GROUP S228_Diff_PlausPrtTrq S228_Diff_TrqRat /end SUB_GROUP /end GROUP
/begin GROUP S222_Prp_TrqDesCoord "DCRS_FrameModel_TorqueStructure/Subsystem/CORE/ASW/Veh/VehMot/Prp/Prp_TrqDesCoord" /begin SUB_GROUP Prp_TrqDesCoord /end SUB_GROUP /begin REF_MEASUREMENT VehMot_stLimDfftl VehMot_trqDes /end REF_MEASUREMENT /end GROUP
/begin GROUP S222_Prp_TrqLeadCoord "DCRS_FrameModel_TorqueStructure/Subsystem/CORE/ASW/Veh/VehMot/Prp/Prp_TrqLeadCoord" /begin SUB_GROUP Prp_TrqLeadCoord /end SUB_GROUP /begin REF_MEASUREMENT VehMot_trqLead /end REF_MEASUREMENT /end GROUP
/begin GROUP S223_AccPed "DCRS_FrameModel_TorqueStructure/Subsystem/CORE/ASW/Veh/VehMot/VMD/AccPed"
 /begin SUB_GROUP S233_AccPed_DoCoordOut S233_AccPed_DrvDemDes S233_AccPed_DrvDemLead S233_AccPed_DrvDemStpLim /end SUB_GROUP
/end GROUP
/begin GROUP S223_BrkPed "DCRS_FrameModel_TorqueStructure/Subsystem/CORE/ASW/Veh/VehMot/VMD/BrkPed" /begin SUB_GROUP S234_BrkPed_SetData /end SUB_GROUP /end GROUP
/begin GROUP S223_CoVMD "DCRS_FrameModel_TorqueStructure/Subsystem/CORE/ASW/Veh/VehMot/VMD/CoVMD"
 /begin SUB_GROUP S235_CoVMD_SpdCoord S235_CoVMD_TrqCalc S235_CoVMD_TrqDesCoord S235_CoVMD_TrqLeadCoord /end SUB_GROUP
/end GROUP
/begin GROUP S299_OilP_DD "DCRS_FrameModel_TorqueStructure/Subsystem/CORE/DE/EngDev/Oil/OilP/OilP_DD" /begin SUB_GROUP OilP_DD /end SUB_GROUP
 /begin REF_MEASUREMENT OilP_bFinalDef OilP_bPhysRngFinalDef OilP_bPhysRngProvDef OilP_bProvDef Oil_pAna Oil_stPresAna Oil_stPresDig /end REF_MEASUREMENT
/end GROUP
/begin GROUP S299_OilP_VD "DCRS_FrameModel_TorqueStructure/Subsystem/CORE/DE/EngDev/Oil/OilP/OilP_VD" /begin SUB_GROUP OilP_VD /end SUB_GROUP /begin REF_MEASUREMENT Oil_pSwmp Oil_stPSwmp /end REF_MEASUREMENT /end GROUP
/begin GROUP S300_OilT_DD "DCRS_FrameModel_TorqueStructure/Subsystem/CORE/DE/EngDev/Oil/OilT/OilT_DD" /begin SUB_GROUP OilT_DD /end SUB_GROUP /begin REF_MEASUREMENT OilT_bFinalDef OilT_bProvDef Oil_tSensSwmp /end REF_MEASUREMENT /end GROUP
/begin GROUP S300_OilT_VD "DCRS_FrameModel_TorqueStructure/Subsystem/CORE/DE/EngDev/Oil/OilT/OilT_VD" /begin SUB_GROUP OilT_VD /end SUB_GROUP /begin REF_MEASUREMENT OilT_bPlsFinalDef Oil_tNoSpeedUpT_mp Oil_tSwmp /end REF_MEASUREMENT /end GROUP
/begin GROUP S308_FlFWLvl_DD "DCRS_FrameModel_TorqueStructure/Subsystem/CORE/DE/Fl/Fuel/FlFWLvl/FlFWLvl_DD" /begin SUB_GROUP FlFWLvl_DD /end SUB_GROUP /begin REF_MEASUREMENT FlWLmp_st Fl_stWLvlSensDebVal /end REF_MEASUREMENT /end GROUP
/begin GROUP S308_FlFWLvl_VD "DCRS_FrameModel_TorqueStructure/Subsystem/CORE/DE/Fl/Fuel/FlFWLvl/FlFWLvl_VD" /begin SUB_GROUP FlFWLvl_VD /end SUB_GROUP /begin REF_MEASUREMENT FlFWLvl_st /end REF_MEASUREMENT /end GROUP
/begin GROUP S309_FlFltCtl_Ht "DCRS_FrameModel_TorqueStructure/Subsystem/CORE/DE/Fl/Fuel/FlFltHt/FlFltCtl_Ht" /begin SUB_GROUP FlFltCtl_Ht /end SUB_GROUP /begin REF_MEASUREMENT FlFltHt_st /end REF_MEASUREMENT /end GROUP
/begin GROUP S310_FlWtDet_DD "DCRS_FrameModel_TorqueStructure/Subsystem/CORE/DE/Fl/Fuel/FlWtDet/FlWtDet_DD" /begin SUB_GROUP FlWtDet_DD /end SUB_GROUP /begin REF_MEASUREMENT FlWLmp_stPs /end REF_MEASUREMENT /end GROUP
/begin GROUP S311_FuelT_DD "DCRS_FrameModel_TorqueStructure/Subsystem/CORE/DE/Fl/Fuel/FuelT/FuelT_DD" /begin SUB_GROUP FuelT_DD /end SUB_GROUP
 /begin REF_MEASUREMENT FuelT_bFinalDef FuelT_bPlsFinalDef FuelT_bPlsProvDef FuelT_bProvDef FuelT_tSens /end REF_MEASUREMENT
/end GROUP
/begin GROUP S311_FuelT_VD "DCRS_FrameModel_TorqueStructure/Subsystem/CORE/DE/Fl/Fuel/FuelT/FuelT_VD" /begin SUB_GROUP FuelT_VD /end SUB_GROUP /begin REF_MEASUREMENT FuelT_dt FuelT_t FuelT_tFlSys FuelT_tFlt /end REF_MEASUREMENT /end GROUP
/begin GROUP S318_MeUn_DD "DCRS_FrameModel_TorqueStructure/Subsystem/CORE/DE/Fl/Rail/MeUn/MeUn_DD" /begin SUB_GROUP MeUn_DD /end SUB_GROUP /begin REF_MEASUREMENT MeUn_rPsPreRot_mp MeUn_tiPer_mp /end REF_MEASUREMENT /end GROUP
/begin RECORD_LAYOUT Scalar_FLOAT32_IEEE FNC_VALUES 1 FLOAT32_IEEE COLUMN_DIR DIRECT /end RECORD_LAYOUT
/end MODULE
/end PROJECT
