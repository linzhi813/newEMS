ASAP2_VERSION 1 51
/begin PROJECT XCPDemo ""
/begin MODULE XCP ""
/begin MOD_COMMON "" BYTE_ORDER MSB_FIRST ALIGNMENT_BYTE 1 ALIGNMENT_WORD 1 ALIGNMENT_LONG 1 ALIGNMENT_FLOAT32_IEEE 1 ALIGNMENT_FLOAT64_IEEE 1 /end MOD_COMMON
/begin CHARACTERISTIC EngPrt_trqOvhtPrvHigh_MAP "Injection mass at high temperature" MAP 0x38884C Lookup2D_WORD 0 Trq_Nm -3276.8 3276.7
 /begin AXIS_DESCR COM_AXIS Epm_nEng EngSpeed_rpm 16 0.0 6000.0 AXIS_PTS_REF EngPrt_trqOvhtPrvHigh_MAPX /end AXIS_DESCR
 /begin AXIS_DESCR COM_AXIS AFS_mAirPerCyl AirMass_mg_hub 16 -16384.0 16383.5 AXIS_PTS_REF EngPrt_trqOvhtPrvHigh_MAPY /end AXIS_DESCR
/end CHARACTERISTIC
/begin CHARACTERISTIC EngPrt_trqOvhtPrvLow_MAP "Injection mass at low temperature" MAP 0x388A8C Lookup2D_WORD 0 Trq_Nm -3276.8 3276.7
 /begin AXIS_DESCR COM_AXIS Epm_nEng EngSpeed_rpm 16 0.0 6000.0 AXIS_PTS_REF EngPrt_trqOvhtPrvLow_MAPX /end AXIS_DESCR
 /begin AXIS_DESCR COM_AXIS AFS_mAirPerCyl AirMass_mg_hub 16 -16384.0 16383.5 AXIS_PTS_REF EngPrt_trqOvhtPrvLow_MAPY /end AXIS_DESCR
/end CHARACTERISTIC
/begin CHARACTERISTIC EngPrt_trqOvhtPrvMax_MAP "Injection mass at maximum temperature" MAP 0x388CCC Lookup2D_WORD 0 Trq_Nm -3276.8 3276.7
 /begin AXIS_DESCR COM_AXIS Epm_nEng EngSpeed_rpm 16 0.0 6000.0 AXIS_PTS_REF EngPrt_trqOvhtPrvMax_MAPX /end AXIS_DESCR
 /begin AXIS_DESCR COM_AXIS AFS_mAirPerCyl AirMass_mg_hub 16 -16384.0 16383.5 AXIS_PTS_REF EngPrt_trqOvhtPrvMax_MAPY /end AXIS_DESCR
/end CHARACTERISTIC
/begin CHARACTERISTIC EngPrt_facOvhtPrvCT_CUR "Curve for coolant temperature dependent limitation factor" CURVE 0x3879E8 Lookup1D_WORD 0 Factor -10.0 10.0
 /begin AXIS_DESCR COM_AXIS CEngDsT_t Temp_deg 25 -3000.0 3000.0 AXIS_PTS_REF EngPrt_facOvhtPrvCT_CURX /end AXIS_DESCR
/end CHARACTERISTIC
/begin CHARACTERISTIC EngPrt_facOvhtPrvFT_CUR "Curve for fuel temperature dependent limitation factor" CURVE 0x387A4E Lookup1D_WORD 0 Factor -10.0 10.0
 /begin AXIS_DESCR COM_AXIS FuelT_t Temp_deg 25 -3000.0 3000.0 AXIS_PTS_REF EngPrt_facOvhtPrvFT_CURX /end AXIS_DESCR
/end CHARACTERISTIC
/begin CHARACTERISTIC EngPrt_facOvhtPrvIAT_CUR "Overheat protection curve intake air temperature in factor" CURVE 0x387AB4 Lookup1D_WORD 0 Factor -10.0 10.0
 /begin AXIS_DESCR COM_AXIS EngPrt_tAirDes_mp Temp_deg 25 -3000.0 3000.0 AXIS_PTS_REF EngPrt_facOvhtPrvIAT_CURX /end AXIS_DESCR
/end CHARACTERISTIC
/begin CHARACTERISTIC EngPrt_facOvhtPrvOT_CUR "Curve for oil temperature dependent limitation factor" CURVE 0x387B18 Lookup1D_WORD 0 Factor -10.0 10.0
 /begin AXIS_DESCR COM_AXIS Oil_tSwmp Temp_deg 25 -3000.0 3000.0 AXIS_PTS_REF EngPrt_facOvhtPrvOT_CURX /end AXIS_DESCR
/end CHARACTERISTIC
/begin CHARACTERISTIC EngPrt_trqOvhtPrvNRng_MAP "Map for Engine protection" MAP 0x388F0C Lookup2D_WORD 0 Trq_Nm -3276.8 3276.7
 /begin AXIS_DESCR COM_AXIS Epm_nEng EngSpeed_rpm 16 0.0 6000.0 AXIS_PTS_REF EngPrt_trqOvhtPrvNRng_MAPX /end AXIS_DESCR
 /begin AXIS_DESCR COM_AXIS EngPrt_facOvhtPrv_mp Factor 16 -10.0 10.0 AXIS_PTS_REF EngPrt_trqOvhtPrvNRng_MAPY /end AXIS_DESCR
/end CHARACTERISTIC
/begin CHARACTERISTIC EngPrt_trqOvhtPrvVRng_MAP "Map for Engine protection" MAP 0x38914C Lookup2D_WORD 0 Trq_Nm -3276.8 3276.7
 /begin AXIS_DESCR COM_AXIS EngPrt_facOvhtPrv_mp Factor 16 -10.0 10.0 AXIS_PTS_REF EngPrt_trqOvhtPrvVRng_MAPX /end AXIS_DESCR
 /begin AXIS_DESCR COM_AXIS VehV_v VehSpeed_km_h 16 0.0 255.0 AXIS_PTS_REF EngPrt_trqOvhtPrvVRng_MAPY /end AXIS_DESCR
/end CHARACTERISTIC
/begin CHARACTERISTIC EngPrt_facOvhtPrvAdd_CUR "Curve for calculated injection mass factor (facQntTemp statergy)" CURVE 0x387984 Lookup1D_WORD 0 Factor -10.0 10.0
 /begin AXIS_DESCR COM_AXIS Epm_nEng EngSpeed_rpm 25 0.0 6000.0 AXIS_PTS_REF EngPrt_facOvhtPrvAdd_CURX /end AXIS_DESCR
/end CHARACTERISTIC
/begin CHARACTERISTIC EngPrt_tOvhtPrvIATRef_CUR "Curve for intake air temperature dependent correction of calculated stabilized" CURVE 0x38802A Lookup1D_WORD 0 Temp_deg -3000.0 3000.0
 /begin AXIS_DESCR COM_AXIS Epm_nEng EngSpeed_rpm 25 0.0 6000.0 AXIS_PTS_REF EngPrt_tOvhtPrvIATRef_CURX /end AXIS_DESCR
/end CHARACTERISTIC
/begin CHARACTERISTIC EngPrt_trqOvhtPrvAdd_MAP "Dynamic calculated injection mass (MAP strategy)" MAP 0x388608 Lookup2D_WORD 0 Trq_Nm -3276.8 3276.7
 /begin AXIS_DESCR COM_AXIS Epm_nEng EngSpeed_rpm 16 20.0 10000.0 AXIS_PTS_REF EngPrt_trqOvhtPrvAdd_MAPX /end AXIS_DESCR
 /begin AXIS_DESCR COM_AXIS EngPrt_tOvhtPrvDiff_mp Temp_deg 16 -3000.0 3000.0 AXIS_PTS_REF EngPrt_trqOvhtPrvAdd_MAPY /end AXIS_DESCR
/end CHARACTERISTIC
/begin CHARACTERISTIC EngPrt_tOvhtPrvAllwMax_C "maximum allowed temperature" VALUE 0x388026 Scalar_SWORD 0 Temp_deg -3000.0 3000.0 /end CHARACTERISTIC
/begin CHARACTERISTIC EngPrt_tOvhtPrvHighMapRef_C "Reference temperature for high injection mass MAP EngPrt_qOvhtPrvHigh_MAP" VALUE 0x388028 Scalar_SWORD 0 Temp_deg -3000.0 3000.0 /end CHARACTERISTIC
/begin CHARACTERISTIC EngPrt_tOvhtPrvLowMapRef_C "Reference temperature for low injection mass MAP EngPrt_qOvhtPrvLow_MAP" VALUE 0x38808E Scalar_SWORD 0 Temp_deg -3000.0 3000.0 /end CHARACTERISTIC
/begin CHARACTERISTIC EngPrt_tOvhtPrvMinCalc_C "Lowest calculated temperature after correction" VALUE 0x388090 Scalar_SWORD 0 Temp_deg -3000.0 3000.0 /end CHARACTERISTIC
/begin CHARACTERISTIC EngPrt_trqOvhtPrvDynLimMax_C "Maximum limitation of dynamic injection mass" VALUE 0x388848 Scalar_SWORD 0 Trq_Nm -3276.8 3276.7 /end CHARACTERISTIC
/begin CHARACTERISTIC EngPrt_trqOvhtPrvDynLimMin_C "Minimum limitation of dynamic injection mass" VALUE 0x38884A Scalar_SWORD 0 Trq_Nm -3276.8 3276.7 /end CHARACTERISTIC
/begin CHARACTERISTIC EngPrt_facOvhtPrvDown_C "Time constant for lowpass filter, decreasing temperature" VALUE 0x387A4C Scalar_UWORD 0 PT_fac 0.0 99.9985 /end CHARACTERISTIC
/begin CHARACTERISTIC EngPrt_facOvhtPrvUp_C "Time constant for lowpass filter, increasing temperature" VALUE 0x387B7C Scalar_UWORD 0 PT_fac 0.0 99.9985 /end CHARACTERISTIC
/begin CHARACTERISTIC EngPrt_facOvhtPrvIATCor_C "Factor for correction of calculated stabilized temperature" VALUE 0x387AB2 Scalar_SWORD 0 Factor -10.0 10.0 /end CHARACTERISTIC
/begin CHARACTERISTIC EngPrt_swtOvhtPrvDyn_C "Switch for choosing the dynamic correction behavour (0 = MAP; 1=facQntTemp)" VALUE 0x388023 Scalar_UBYTE 0 Switch_conv 0 1 /end CHARACTERISTIC
/begin CHARACTERISTIC EngPrt_swtOvhtPrvOn_C "Switch to enable overheat temperature prevention (1 = enable )" VALUE 0x388024 Scalar_UBYTE 0 Switch_conv 0 1 /end CHARACTERISTIC
/begin CHARACTERISTIC EngPrt_numAir_C "0-->Air_tCACDs,1-->Air_tAFS,2-->EnvT_t,3-->Air_tIntkVUs" VALUE 0x387FBC Scalar_UBYTE 0 AirTempFldSel_conv 0 3 /end CHARACTERISTIC
/begin AXIS_PTS EngPrt_trqOvhtPrvHigh_MAPY "AFS_mAirPerCylFlt" 0x388A6C AFS_mAirPerCyl Lookup2D_X_WORD 0 AirMass_mg_hub 16 -16384.0 16383.5 /end AXIS_PTS
/begin AXIS_PTS EngPrt_trqOvhtPrvHigh_MAPX "Epm_nEng" 0x388A4C Epm_nEng Lookup2D_X_WORD 0 EngSpeed_rpm 16 0.0 6000.0 /end AXIS_PTS
/begin AXIS_PTS EngPrt_trqOvhtPrvLow_MAPY "AFS_mAirPerCylFlt" 0x388CAC AFS_mAirPerCyl Lookup2D_X_WORD 0 AirMass_mg_hub 16 -16384.0 16383.5 /end AXIS_PTS
/begin AXIS_PTS EngPrt_trqOvhtPrvLow_MAPX "Epm_nEng" 0x388C8C Epm_nEng Lookup2D_X_WORD 0 EngSpeed_rpm 16 0.0 6000.0 /end AXIS_PTS
/begin AXIS_PTS EngPrt_trqOvhtPrvMax_MAPY "AFS_mAirPerCylFlt" 0x388EEC AFS_mAirPerCyl Lookup2D_X_WORD 0 AirMass_mg_hub 16 -16384.0 16383.5 /end AXIS_PTS
/begin AXIS_PTS EngPrt_trqOvhtPrvMax_MAPX "Epm_nEng" 0x388ECC Epm_nEng Lookup2D_X_WORD 0 EngSpeed_rpm 16 0.0 6000.0 /end AXIS_PTS
/begin AXIS_PTS EngPrt_facOvhtPrvCT_CURX "CEngDsT_t" 0x387A1A CEngDsT_t Lookup1D_X_WORD 0 Temp_deg 25 -3000.0 3000.0 /end AXIS_PTS
/begin AXIS_PTS EngPrt_facOvhtPrvFT_CURX "FuelT_t" 0x387A80 FuelT_t Lookup1D_X_WORD 0 Temp_deg 25 -3000.0 3000.0 /end AXIS_PTS
/begin AXIS_PTS EngPrt_facOvhtPrvIAT_CURX "AirSys_tFld" 0x387AE6 EngPrt_tAirDes_mp Lookup1D_X_WORD 0 Temp_deg 25 -3000.0 3000.0 /end AXIS_PTS
/begin AXIS_PTS EngPrt_facOvhtPrvOT_CURX "Oil_tSwmp" 0x387B4A Oil_tSwmp Lookup1D_X_WORD 0 Temp_deg 25 -3000.0 3000.0 /end AXIS_PTS
/begin AXIS_PTS EngPrt_trqOvhtPrvNRng_MAPY "EngPrt_facOvhtPrv_mp" 0x38912C EngPrt_facOvhtPrv_mp Lookup2D_X_WORD 0 Factor 16 -10.0 10.0 /end AXIS_PTS
/begin AXIS_PTS EngPrt_trqOvhtPrvNRng_MAPX "Epm_nEng" 0x38910C Epm_nEng Lookup2D_X_WORD 0 EngSpeed_rpm 16 0.0 6000.0 /end AXIS_PTS
/begin AXIS_PTS EngPrt_trqOvhtPrvVRng_MAPY "VehV_v" 0x38936C VehV_v Lookup2D_X_WORD 0 VehSpeed_km_h 16 0.0 255.0 /end AXIS_PTS
/begin AXIS_PTS EngPrt_trqOvhtPrvVRng_MAPX "EngPrt_facOvhtPrv_mp" 0x38934C EngPrt_facOvhtPrv_mp Lookup2D_X_WORD 0 Factor 16 -10.0 10.0 /end AXIS_PTS
/begin AXIS_PTS EngPrt_facOvhtPrvAdd_CURX "Epm_nEng" 0x3879B6 Epm_nEng Lookup1D_X_WORD 0 EngSpeed_rpm 25 0.0 6000.0 /end AXIS_PTS
/begin AXIS_PTS EngPrt_tOvhtPrvIATRef_CURX "Epm_nEng" 0x38805C Epm_nEng Lookup1D_X_WORD 0 EngSpeed_rpm 25 0.0 6000.0 /end AXIS_PTS
/begin AXIS_PTS EngPrt_trqOvhtPrvAdd_MAPY "EngPrt_tOvhtPrvDiff_mp" 0x388828 EngPrt_tOvhtPrvDiff_mp Lookup2D_X_WORD 0 Temp_deg 16 -3000.0 3000.0 /end AXIS_PTS
/begin AXIS_PTS EngPrt_trqOvhtPrvAdd_MAPX "Epm_nEng" 0x388808 Epm_nEng Lookup2D_X_WORD 0 EngSpeed_rpm 16 20.0 10000.0 /end AXIS_PTS
/begin CHARACTERISTIC EngPrt_facPTOLim0_CUR "Curve for PTO switch 0 limitation factor" CURVE 0x387B7E Lookup1D_WORD 0 Factor -10.0 10.0
 /begin AXIS_DESCR COM_AXIS Epm_nEng EngSpeed_rpm 25 0.0 6000.0 AXIS_PTS_REF EngPrt_facPTOLim0_CURX /end AXIS_DESCR
/end CHARACTERISTIC
/begin CHARACTERISTIC EngPrt_facPTOLim1_CUR "Curve for PTO switch 1 limitation factor" CURVE 0x387BE2 Lookup1D_WORD 0 Factor -10.0 10.0
 /begin AXIS_DESCR COM_AXIS Epm_nEng EngSpeed_rpm 25 0.0 6000.0 AXIS_PTS_REF EngPrt_facPTOLim1_CURX /end AXIS_DESCR
/end CHARACTERISTIC
/begin CHARACTERISTIC EngPrt_facPTOLim2_CUR "Curve for PTO switch 2 limitation factor" CURVE 0x387C46 Lookup1D_WORD 0 Factor -10.0 10.0
 /begin AXIS_DESCR COM_AXIS Epm_nEng EngSpeed_rpm 25 0.0 6000.0 AXIS_PTS_REF EngPrt_facPTOLim2_CURX /end AXIS_DESCR
/end CHARACTERISTIC
/begin CHARACTERISTIC EngPrt_facPTOLim3_CUR "Curve for PTO switch 3 limitation factor" CURVE 0x387CAA Lookup1D_WORD 0 Factor -10.0 10.0
 /begin AXIS_DESCR COM_AXIS Epm_nEng EngSpeed_rpm 25 0.0 6000.0 AXIS_PTS_REF EngPrt_facPTOLim3_CURX /end AXIS_DESCR
/end CHARACTERISTIC
/begin CHARACTERISTIC EngPrt_facPTOLim4_CUR "Curve for PTO switch 4 limitation factor" CURVE 0x387D0E Lookup1D_WORD 0 Factor -10.0 10.0
 /begin AXIS_DESCR COM_AXIS Epm_nEng EngSpeed_rpm 25 0.0 6000.0 AXIS_PTS_REF EngPrt_facPTOLim4_CURX /end AXIS_DESCR
/end CHARACTERISTIC
/begin AXIS_PTS EngPrt_facPTOLim0_CURX "Engine speed" 0x387BB0 Epm_nEng Lookup1D_X_WORD 0 EngSpeed_rpm 25 0.0 6000.0 /end AXIS_PTS
/begin AXIS_PTS EngPrt_facPTOLim1_CURX "Engine speed" 0x387C14 Epm_nEng Lookup1D_X_WORD 0 EngSpeed_rpm 25 0.0 6000.0 /end AXIS_PTS
/begin AXIS_PTS EngPrt_facPTOLim2_CURX "Engine speed" 0x387C78 Epm_nEng Lookup1D_X_WORD 0 EngSpeed_rpm 25 0.0 6000.0 /end AXIS_PTS
/begin AXIS_PTS EngPrt_facPTOLim3_CURX "Engine speed" 0x387CDC Epm_nEng Lookup1D_X_WORD 0 EngSpeed_rpm 25 0.0 6000.0 /end AXIS_PTS
/begin AXIS_PTS EngPrt_facPTOLim4_CURX "Engine speed" 0x387D40 Epm_nEng Lookup1D_X_WORD 0 EngSpeed_rpm 25 0.0 6000.0 /end AXIS_PTS
/begin CHARACTERISTIC SmkLim_facSmkATSCor_CUR "Intake air Temperature Correction factor for smoke Limitation" CURVE 0x39813C Lookup1D_WORD 0 Factor -10.0 10.0
 /begin AXIS_DESCR COM_AXIS Air_tIntkVUs Temp_deg 8 -3000.0 3000.0 AXIS_PTS_REF SmkLim_facSmkATSCor_CURX /end AXIS_DESCR
/end CHARACTERISTIC
/begin CHARACTERISTIC SmkLim_facSmkEnvPCor_CUR "Smoke limitation correction curve of EnvP" CURVE 0x39815C Lookup1D_WORD 0 Factor -30.0 30.0
 /begin AXIS_DESCR COM_AXIS EnvP_p AirPressure_kPa 16 0.0 3276.0 AXIS_PTS_REF SmkLim_facSmkEnvPCor_CURX /end AXIS_DESCR
/end CHARACTERISTIC
/begin CHARACTERISTIC SmkLim_trqLimSmkAFSEnvPCor_MAP "correction torque for smoke limitation when use AFS" MAP 0x39975E Lookup2D_WORD 0 Trq_Nm -3276.8 3276.7
 /begin AXIS_DESCR COM_AXIS Epm_nEng EngSpeed_rpm 25 0.0 6000.0 AXIS_PTS_REF SmkLim_trqLimSmkAFSEnvPCor_MAPX /end AXIS_DESCR
 /begin AXIS_DESCR COM_AXIS AFS_mAirPerCylFlt AirMass_mg_hub 25 0.0 16383.0 AXIS_PTS_REF SmkLim_trqLimSmkAFSEnvPCor_MAPY /end AXIS_DESCR
/end CHARACTERISTIC
/begin CHARACTERISTIC SmkLim_trqLimSmkAFS_MAP "base torque for smoke limitation when use AFS" MAP 0x399CA4 Lookup2D_WORD 0 Trq_Nm -3276.8 3276.7
 /begin AXIS_DESCR COM_AXIS Epm_nEng EngSpeed_rpm 25 0.0 6000.0 AXIS_PTS_REF SmkLim_trqLimSmkAFS_MAPX /end AXIS_DESCR
 /begin AXIS_DESCR COM_AXIS AFS_mAirPerCylFlt AirMass_mg_hub 25 0.0 16383.0 AXIS_PTS_REF SmkLim_trqLimSmkAFS_MAPY /end AXIS_DESCR
/end CHARACTERISTIC
/begin CHARACTERISTIC SmkLim_trqLimSmk_MAP "base torque for smoke limitation" MAP 0x39A1EA Lookup2D_WORD 0 Trq_Nm -3276.8 3276.7
 /begin AXIS_DESCR COM_AXIS Epm_nEng EngSpeed_rpm 25 0.0 6000.0 AXIS_PTS_REF SmkLim_trqLimSmk_MAPX /end AXIS_DESCR
 /begin AXIS_DESCR COM_AXIS Air_pIntkVUs AirPressure_kPa 9 0.0 500.0 AXIS_PTS_REF SmkLim_trqLimSmk_MAPY /end AXIS_DESCR
/end CHARACTERISTIC
/begin CHARACTERISTIC EngReq_SlpLimNeg_C "Increase limitation ramp / negative ramp slope" VALUE 0x38938C Scalar_SWORD 0 Trq_Nm_s -1000.0 1000.0 /end CHARACTERISTIC
/begin CHARACTERISTIC EngReq_SlpLimPos_C "Increase limitation ramp / Slope if the ramp has to be increased" VALUE 0x38938E Scalar_SWORD 0 Trq_Nm_s -1000.0 1000.0 /end CHARACTERISTIC
/begin CHARACTERISTIC EngReq_nSlpLimMin_C "Engine speed threshold for activating smoke limitation rise limiting" VALUE 0x389394 Scalar_SWORD 0 EngSpeed_rpm 0.0 6000.0 /end CHARACTERISTIC
/begin CHARACTERISTIC EngReq_facAFSFlt_C "filter for AFS signal used to smoke limit" VALUE 0x389392 Scalar_UWORD 0 PT_fac 0.0 99.9 /end CHARACTERISTIC
/begin CHARACTERISTIC EngReq_bSmkLimCnv_C "boolean flag for  smoke limit trq sources select based on fuel quantity to torque or (BPS/AFS)work" VALUE 0x389390 Scalar_BOOLEAN 0 boolean 0.0 1.0 /end CHARACTERISTIC
/begin CHARACTERISTIC EngReq_bSmkLimIntkP_C "boolean flag for BPS or AFS work for smoke limit" VALUE 0x389391 Scalar_BOOLEAN 0 boolean 0.0 1.0 /end CHARACTERISTIC
/begin AXIS_PTS SmkLim_facSmkATSCor_CURX "Air_tIntkVUs" 0x39814C Air_tIntkVUs Lookup1D_X_WORD 0 Temp_deg 8 -3000.0 3000.0 /end AXIS_PTS
/begin AXIS_PTS SmkLim_facSmkEnvPCor_CURX "Axis points of curve, EnvP_p" 0x39817C EnvP_p Lookup1D_X_WORD 0 AirPressure_kPa 16 0.0 3276.0 /end AXIS_PTS
/begin AXIS_PTS SmkLim_trqLimSmkAFSEnvPCor_MAPY "Yaxis point, AFS_mAirPerCylFlt" 0x399C72 AFS_mAirPerCylFlt Lookup2D_X_WORD 0 AirMass_mg_hub 25 0.0 16383.0 /end AXIS_PTS
/begin AXIS_PTS SmkLim_trqLimSmkAFSEnvPCor_MAPX "Epm_nEng" 0x399C40 Epm_nEng Lookup2D_X_WORD 0 EngSpeed_rpm 25 0.0 6000.0 /end AXIS_PTS
/begin AXIS_PTS SmkLim_trqLimSmkAFS_MAPY "Yaxis point, AFS_mAirPerCylFlt" 0x39A1B8 AFS_mAirPerCylFlt Lookup2D_X_WORD 0 AirMass_mg_hub 25 0.0 16383.0 /end AXIS_PTS
/begin AXIS_PTS SmkLim_trqLimSmkAFS_MAPX "Epm_nEng" 0x39A186 Epm_nEng Lookup2D_X_WORD 0 EngSpeed_rpm 25 0.0 6000.0 /end AXIS_PTS
/begin AXIS_PTS SmkLim_trqLimSmk_MAPY "Air_pIntkVUs" 0x39A3DE Air_pIntkVUs Lookup2D_X_WORD 0 AirPressure_kPa 9 0.0 500.0 /end AXIS_PTS
/begin AXIS_PTS SmkLim_trqLimSmk_MAPX "Epm_nEng" 0x39A3AC Epm_nEng Lookup2D_X_WORD 0 EngSpeed_rpm 25 0.0 6000.0 /end AXIS_PTS
/begin CHARACTERISTIC DrvDem_tiNormal_C "Threshold time since Time elapsed since reaching normal state" VALUE 0x386D3C Scalar_ULONG 0 EngTime_ms 0.0 4.294967295E+10 /end CHARACTERISTIC
/begin CHARACTERISTIC DrvDem_vThres_C "threshold vehicle speed for DrvDem status evaluation" VALUE 0x386D40 Scalar_SWORD 0 VehSpeed_km_h 0.0 200.0 /end CHARACTERISTIC
/begin CHARACTERISTIC DrvDem_stShOffCfg_C "shuttoff conditions for DrvDem_stShOff" VALUE 0x386D36 Scalar_UBYTE 0 State_uint8 0.0 255.0 /end CHARACTERISTIC
/begin CHARACTERISTIC DrvDem_ParSetIKiLo_CUR "Curve for I-element lower path of Current gain " CURVE 0x386B0C Lookup1D_SLONG 0 HLSDem_Ki -18000.0 18000.0
 /begin AXIS_DESCR COM_AXIS PT_rTrq TransRatio 8 -100.0 100.0 AXIS_PTS_REF DrvDem_ParSetIKiLo_CURX /end AXIS_DESCR
/end CHARACTERISTIC
/begin CHARACTERISTIC DrvDem_ParSetIKiNegLo_CUR "Curve for I-component negative large signal parameterset lower PI-path" CURVE 0x386B3C Lookup1D_SLONG 0 HLSDem_Ki -18000.0 18000.0
 /begin AXIS_DESCR COM_AXIS PT_rTrq TransRatio 8 -100.0 100.0 AXIS_PTS_REF DrvDem_ParSetIKiNegLo_CURX /end AXIS_DESCR
/end CHARACTERISTIC
/begin CHARACTERISTIC DrvDem_ParSetIKiPosLo_CUR "Curve for I-component positive large signal parameterset lower PI-path" CURVE 0x386B6C Lookup1D_SLONG 0 HLSDem_Ki -18000.0 18000.0
 /begin AXIS_DESCR COM_AXIS PT_rTrq TransRatio 8 -100.0 100.0 AXIS_PTS_REF DrvDem_ParSetIKiPosLo_CURX /end AXIS_DESCR
/end CHARACTERISTIC
/begin CHARACTERISTIC DrvDem_ParSetPKpLo_CUR "Curve for P-element lower path of Current gain " CURVE 0x386BC4 Lookup1D_SLONG 0 HLSDem_Kp -10000.0 10000.0
 /begin AXIS_DESCR COM_AXIS PT_rTrq TransRatio 8 -100.0 100.0 AXIS_PTS_REF DrvDem_ParSetPKpLo_CURX /end AXIS_DESCR
/end CHARACTERISTIC
/begin CHARACTERISTIC DrvDem_ParSetPKpNegLo_CUR "Curve for P-component negative large signal parameterset lower PI-path" CURVE 0x386BF4 Lookup1D_SLONG 0 HLSDem_Kp -10000.0 10000.0
 /begin AXIS_DESCR COM_AXIS PT_rTrq TransRatio 8 -100.0 100.0 AXIS_PTS_REF DrvDem_ParSetPKpNegLo_CURX /end AXIS_DESCR
/end CHARACTERISTIC
/begin CHARACTERISTIC DrvDem_ParSetPKpPosLo_CUR "Curve for P-component positive large signal parameterset lower PI-path" CURVE 0x386C24 Lookup1D_SLONG 0 HLSDem_Kp -10000.0 10000.0
 /begin AXIS_DESCR COM_AXIS PT_rTrq TransRatio 8 -100.0 100.0 AXIS_PTS_REF DrvDem_ParSetPKpPosLo_CURX /end AXIS_DESCR
/end CHARACTERISTIC
/begin CHARACTERISTIC DrvDem_KiCorTempFac_MAP "Correction factor MAP for I gain" MAP 0x386858 Lookup2D_WORD 0 Factor -30.0 30.0
 /begin AXIS_DESCR COM_AXIS DrvDem_nAvrgFlt_mp EngSpeed_rpm 8 -6000.0 6000.0 AXIS_PTS_REF DrvDem_KiCorTempFac_MAPX /end AXIS_DESCR
 /begin AXIS_DESCR COM_AXIS DrvDem_tParAdap_mp Temp_deg 5 -150.0 150.0 AXIS_PTS_REF DrvDem_KiCorTempFac_MAPY /end AXIS_DESCR
/end CHARACTERISTIC
/begin CHARACTERISTIC DrvDem_KiCorTrqFac_MAP "Torque dependent correction factor MAP for I gain" MAP 0x3868C2 Lookup2D_WORD 0 Factor -30.0 30.0
 /begin AXIS_DESCR COM_AXIS DrvDem_trqCorFacFlt_mp Trq_Nm 10 -3000.0 3000.0 AXIS_PTS_REF DrvDem_KiCorTrqFac_MAPX /end AXIS_DESCR
 /begin AXIS_DESCR COM_AXIS DrvDem_nAvrgFlt_mp EngSpeed_rpm 10 -6000.0 6000.0 AXIS_PTS_REF DrvDem_KiCorTrqFac_MAPY /end AXIS_DESCR
/end CHARACTERISTIC
/begin CHARACTERISTIC DrvDem_KpCorTempFac_MAP "Correction factor MAP for P gain" MAP 0x3869B2 Lookup2D_WORD 0 Factor -30.0 30.0
 /begin AXIS_DESCR COM_AXIS DrvDem_nAvrgFlt_mp EngSpeed_rpm 8 -6000.0 6000.0 AXIS_PTS_REF DrvDem_KpCorTempFac_MAPX /end AXIS_DESCR
 /begin AXIS_DESCR COM_AXIS DrvDem_tParAdap_mp Temp_deg 5 -150.0 150.0 AXIS_PTS_REF DrvDem_KpCorTempFac_MAPY /end AXIS_DESCR
/end CHARACTERISTIC
/begin CHARACTERISTIC DrvDem_KpCorTrqFac_MAP "Torque dependent correction factor MAP for P gain" MAP 0x386A1C Lookup2D_WORD 0 Factor -30.0 30.0
 /begin AXIS_DESCR COM_AXIS DrvDem_trqCorFacFlt_mp Trq_Nm 10 -3000.0 3000.0 AXIS_PTS_REF DrvDem_KpCorTrqFac_MAPX /end AXIS_DESCR
 /begin AXIS_DESCR COM_AXIS DrvDem_nAvrgFlt_mp EngSpeed_rpm 10 -6000.0 6000.0 AXIS_PTS_REF DrvDem_KpCorTrqFac_MAPY /end AXIS_DESCR
/end CHARACTERISTIC
/begin CHARACTERISTIC DrvDem_ParSetInrtVeh_CUR "Mass Inertia based curve for EISGov torque loss estimation" CURVE 0x386BA4 Lookup1D_WORD 0 HLSDem_Inrt -50.0 50.0
 /begin AXIS_DESCR COM_AXIS PT_rTrq TransRatio 8 -100.0 100.0 AXIS_PTS_REF DrvDem_ParSetInrtVeh_CURX /end AXIS_DESCR
/end CHARACTERISTIC
/begin CHARACTERISTIC DrvDem_ParSetTiFltTrqLos_CUR "Time constant (PT1filter) based curve for EISGov torque loss estimation" CURVE 0x386C5C Lookup1D_UWORD 0 PT_fac 0.0 99.998
 /begin AXIS_DESCR COM_AXIS PT_rTrq TransRatio 8 -100.0 100.0 AXIS_PTS_REF DrvDem_ParSetTiFltTrqLos_CURX /end AXIS_DESCR
/end CHARACTERISTIC
/begin CHARACTERISTIC DrvDem_facFdbkTrqLosHiParSet_CUR "Inner feedback factor for the upper setpoint" CURVE 0x386CBE Lookup1D_WORD 0 FdbkNm2rpm_rpm_Nm -20.0 20.0
 /begin AXIS_DESCR COM_AXIS PT_rTrq TransRatio 8 -100.0 100.0 AXIS_PTS_REF DrvDem_facFdbkTrqLosHiParSet_CURX /end AXIS_DESCR
/end CHARACTERISTIC
/begin CHARACTERISTIC DrvDem_facFdbkTrqLosLoParSet_CUR "Inner feedback factor for the lower setpoint" CURVE 0x386CDE Lookup1D_WORD 0 FdbkNm2rpm_rpm_Nm -20.0 20.0
 /begin AXIS_DESCR COM_AXIS PT_rTrq TransRatio 8 -100.0 100.0 AXIS_PTS_REF DrvDem_facFdbkTrqLosLoParSet_CURX /end AXIS_DESCR
/end CHARACTERISTIC
/begin CHARACTERISTIC DrvDem_dnAccLim_CUR "Upper limit for the permissible acceleration of engine speed" CURVE 0x386C7C Lookup1D_WORD 0 EngSpeed_rpm_s -12000.0 12000.0
 /begin AXIS_DESCR COM_AXIS PT_rTrq TransRatio 8 -100.0 100.0 AXIS_PTS_REF DrvDem_dnAccLim_CURX /end AXIS_DESCR
/end CHARACTERISTIC
/begin CHARACTERISTIC DrvDem_dnDeclLim_CUR "Lower limit for the permissible deceleration of engine speed" CURVE 0x386C9C Lookup1D_WORD 0 EngSpeed_rpm_s -12000.0 12000.0
 /begin AXIS_DESCR COM_AXIS PT_rTrq TransRatio 8 -100.0 100.0 AXIS_PTS_REF DrvDem_dnDeclLim_CURX /end AXIS_DESCR
/end CHARACTERISTIC
/begin CHARACTERISTIC DrvDem_ParSetIWinNegHi_C "I component negative window for parameterset upper PI- path" VALUE 0x386B9C Scalar_SWORD 0 EngSpeed_rpm -6000.0 6000.0 /end CHARACTERISTIC
/begin CHARACTERISTIC DrvDem_ParSetIWinNegLo_C "I component negative window for parameterset lower PI- path" VALUE 0x386B9E Scalar_SWORD 0 EngSpeed_rpm -6000.0 6000.0 /end CHARACTERISTIC
/begin CHARACTERISTIC DrvDem_ParSetIWinPosHi_C "I component Positive window for parameterset upper PI- path" VALUE 0x386BA0 Scalar_SWORD 0 EngSpeed_rpm -6000.0 6000.0 /end CHARACTERISTIC
/begin CHARACTERISTIC DrvDem_ParSetIWinPosLo_C "I component Positive window for parameterset lower PI- path" VALUE 0x386BA2 Scalar_SWORD 0 EngSpeed_rpm -6000.0 6000.0 /end CHARACTERISTIC
/begin CHARACTERISTIC DrvDem_ParSetPWinNegHi_C "P component negative window for parameterset upper PI- path" VALUE 0x386C54 Scalar_SWORD 0 EngSpeed_rpm -6000.0 6000.0 /end CHARACTERISTIC
/begin CHARACTERISTIC DrvDem_ParSetPWinNegLo_C "P component negative window for parameterset lower PI- path" VALUE 0x386C56 Scalar_SWORD 0 EngSpeed_rpm -6000.0 6000.0 /end CHARACTERISTIC
/begin CHARACTERISTIC DrvDem_ParSetPWinPosHi_C "P component Positive window for parameterset upper PI- path" VALUE 0x386C58 Scalar_SWORD 0 EngSpeed_rpm -6000.0 6000.0 /end CHARACTERISTIC
/begin CHARACTERISTIC DrvDem_ParSetPWinPosLo_C "P component Positive window for parameterset lower PI- path" VALUE 0x386C5A Scalar_SWORD 0 EngSpeed_rpm -6000.0 6000.0 /end CHARACTERISTIC
/begin CHARACTERISTIC DrvDem_facNAvrgPT1CorFac_C "Time constant for PT1 delay element of engine speed filtering" VALUE 0x386CFE Scalar_UWORD 0 PT_fac 0.0 99.998 /end CHARACTERISTIC
/begin CHARACTERISTIC DrvDem_facTrqPT1CorFac_C "Time constant for PT1 delay element of torque filtering correction factor" VALUE 0x386D00 Scalar_UWORD 0 PT_fac 0.0 99.998 /end CHARACTERISTIC
/begin CHARACTERISTIC DrvDem_swtTrqSelCorFac_C "Switch to define the used torque for correction factor(0-set torque,1- current torque, 2 - lead torque)" VALUE 0x386D3A Scalar_UBYTE 0 State_uint8 0.0 255.0 /end CHARACTERISTIC
/begin CHARACTERISTIC DrvDem_swtTempSelParAdap_C "Switch to define the used engine temperature(0-coolant temperature,1-Oil temperature,2- Enginetemperature)" VALUE 0x386D39 Scalar_UBYTE 0 EngTempFldSel_conv 0 2 /end CHARACTERISTIC
/begin AXIS_PTS DrvDem_ParSetIKiLo_CURX "Curve axis point for I-element lower path of Current gain " 0x386B2C PT_rTrq Lookup1D_X_WORD 0 TransRatio 8 -100.0 100.0 /end AXIS_PTS
/begin AXIS_PTS DrvDem_ParSetIKiNegLo_CURX "Curve axis for I-component negative large signal parameterset lower PI-path" 0x386B5C PT_rTrq Lookup1D_X_WORD 0 TransRatio 8 -100.0 100.0 /end AXIS_PTS
/begin AXIS_PTS DrvDem_ParSetIKiPosLo_CURX "Curve axis for I-component positive large signal parameterset lower PI-path" 0x386B8C PT_rTrq Lookup1D_X_WORD 0 TransRatio 8 -100.0 100.0 /end AXIS_PTS
/begin AXIS_PTS DrvDem_ParSetPKpLo_CURX "Curve axis point for P-element lower path of Current gain " 0x386BE4 PT_rTrq Lookup1D_X_WORD 0 TransRatio 8 -100.0 100.0 /end AXIS_PTS
/begin AXIS_PTS DrvDem_ParSetPKpNegLo_CURX "Curve axis for P-component negative large signal parameterset lower PI-path" 0x386C14 PT_rTrq Lookup1D_X_WORD 0 TransRatio 8 -100.0 100.0 /end AXIS_PTS
/begin AXIS_PTS DrvDem_ParSetPKpPosLo_CURX "Curve axis for P-component positive large signal parameterset lower PI-path" 0x386C44 PT_rTrq Lookup1D_X_WORD 0 TransRatio 8 -100.0 100.0 /end AXIS_PTS
/begin AXIS_PTS DrvDem_KiCorTempFac_MAPY "Correction factor MAPY for I gain" 0x3868B8 DrvDem_tParAdap_mp Lookup2D_X_WORD 0 Temp_deg 5 -150.0 150.0 /end AXIS_PTS
/begin AXIS_PTS DrvDem_KiCorTempFac_MAPX "Correction factor MAPX for I gain" 0x3868A8 DrvDem_nAvrgFlt_mp Lookup2D_X_WORD 0 EngSpeed_rpm 8 -6000.0 6000.0 /end AXIS_PTS
/begin AXIS_PTS DrvDem_KiCorTrqFac_MAPY "Torque dependent correction factor MAPY for I gain" 0x38699E DrvDem_nAvrgFlt_mp Lookup2D_X_WORD 0 EngSpeed_rpm 10 -6000.0 6000.0 /end AXIS_PTS
/begin AXIS_PTS DrvDem_KiCorTrqFac_MAPX "Torque dependent correction factor MAPX for I gain" 0x38698A DrvDem_trqCorFacFlt_mp Lookup2D_X_WORD 0 Trq_Nm 10 -3000.0 3000.0 /end AXIS_PTS
/begin AXIS_PTS DrvDem_KpCorTempFac_MAPY "Correction factor MAPY for P gain" 0x386A12 DrvDem_tParAdap_mp Lookup2D_X_WORD 0 Temp_deg 5 -150.0 150.0 /end AXIS_PTS
/begin AXIS_PTS DrvDem_KpCorTempFac_MAPX "Correction factor MAPX for P gain" 0x386A02 DrvDem_nAvrgFlt_mp Lookup2D_X_WORD 0 EngSpeed_rpm 8 -6000.0 6000.0 /end AXIS_PTS
/begin AXIS_PTS DrvDem_KpCorTrqFac_MAPY "Torque dependent correction factor MAPY for P gain" 0x386AF8 DrvDem_nAvrgFlt_mp Lookup2D_X_WORD 0 EngSpeed_rpm 10 -6000.0 6000.0 /end AXIS_PTS
/begin AXIS_PTS DrvDem_KpCorTrqFac_MAPX "Torque dependent correction factor MAPX for P gain" 0x386AE4 DrvDem_trqCorFacFlt_mp Lookup2D_X_WORD 0 Trq_Nm 10 -3000.0 3000.0 /end AXIS_PTS
/begin AXIS_PTS DrvDem_ParSetInrtVeh_CURX "Mass Inertia based curve axis point for EISGov torque loss estimation" 0x386BB4 PT_rTrq Lookup1D_X_WORD 0 TransRatio 8 -100.0 100.0 /end AXIS_PTS
/begin AXIS_PTS DrvDem_ParSetTiFltTrqLos_CURX "Time constant (PT1filter) based curve axis point for EISGov torque loss estimation" 0x386C6C PT_rTrq Lookup1D_X_WORD 0 TransRatio 8 -100.0 100.0 /end AXIS_PTS
/begin AXIS_PTS DrvDem_facFdbkTrqLosHiParSet_CURX "Inner feedback factor for the upper setpoint axis point" 0x386CCE PT_rTrq Lookup1D_X_WORD 0 TransRatio 8 -100.0 100.0 /end AXIS_PTS
/begin AXIS_PTS DrvDem_facFdbkTrqLosLoParSet_CURX "Inner feedback factor for the lower setpoint aixs point" 0x386CEE PT_rTrq Lookup1D_X_WORD 0 TransRatio 8 -100.0 100.0 /end AXIS_PTS
/begin AXIS_PTS DrvDem_dnAccLim_CURX "Upper limit for the permissible acceleration of engine speed axis point" 0x386C8C PT_rTrq Lookup1D_X_WORD 0 TransRatio 8 -100.0 100.0 /end AXIS_PTS
/begin AXIS_PTS DrvDem_dnDeclLim_CURX "Lower limit for the permissible deceleration of engine speed axis point" 0x386CAC PT_rTrq Lookup1D_X_WORD 0 TransRatio 8 -100.0 100.0 /end AXIS_PTS
/begin CHARACTERISTIC DrvDem_nDrvSetPLo_CUR "driveability engine speed demandsetpoint" CURVE 0x386D02 Lookup1D_WORD 0 EngSpeed_rpm 0.0 6000.0
 /begin AXIS_DESCR COM_AXIS NO_INPUT_QUANTITY Accpedal_rate 12 0.0 100.0 AXIS_PTS_REF DrvDem_nDrvSetPLo_CURX /end AXIS_DESCR
/end CHARACTERISTIC
/begin CHARACTERISTIC DrvDem_nSpdDem_C "Constant Engine Speed demand for the DrvDem setpoint" VALUE 0x386D34 Scalar_SWORD 0 EngSpeed_rpm 0.0 6000.0 /end CHARACTERISTIC
/begin CHARACTERISTIC DrvDem_facDrvSetPPT1_C "Filter time constant for the filtered DrvDem torque" VALUE 0x386CBC Scalar_UWORD 0 PT_fac 0.0 99.998 /end CHARACTERISTIC
/begin CHARACTERISTIC DrvDem_swtDrvNGovcfg_C "Configuatiion of the DrvDem for the Setpoint caculation" VALUE 0x386D38 Scalar_UBYTE 0 State_uint8 0.0 2.0 /end CHARACTERISTIC
/begin CHARACTERISTIC DrvDem_swtDrvNGovActv_C "Switch to activate DrvDem" VALUE 0x386D37 Scalar_UBYTE 0 Switch_conv 0 1 /end CHARACTERISTIC
/begin AXIS_PTS DrvDem_nDrvSetPLo_CURX "accelerator pedal Position" 0x386D1A NO_INPUT_QUANTITY Lookup1D_X_WORD 0 Accpedal_rate 12 0.0 100.0 /end AXIS_PTS
/begin CHARACTERISTIC EISGov_DKd_CUR "D part time " CURVE 0x387580 Lookup1D_UWORD 0 Pid_Kp_Kd 0.0 15.0
 /begin AXIS_DESCR COM_AXIS EISGov_tDT1_mp Temp_deg 10 -50.0 200.0 AXIS_PTS_REF EISGov_DKd_CURX /end AXIS_DESCR
/end CHARACTERISTIC
/begin CHARACTERISTIC EISGov_facDT1_CUR "DT1 factor" CURVE 0x3875B4 Lookup1D_WORD 0 Factor 0.01 0.99
 /begin AXIS_DESCR COM_AXIS NO_INPUT_QUANTITY EngSpeed_rpm 10 0.0 6000.0 AXIS_PTS_REF EISGov_facDT1_CURX /end AXIS_DESCR
/end CHARACTERISTIC
/begin CHARACTERISTIC EISGov_tiDT1_CUR "DT1 part time " CURVE 0x3876A2 Lookup1D_UWORD 0 RailDT1_ms 0.0 65535.0
 /begin AXIS_DESCR COM_AXIS EISGov_tDT1_mp Temp_deg 10 -50.0 200.0 AXIS_PTS_REF EISGov_tiDT1_CURX /end AXIS_DESCR
/end CHARACTERISTIC
/begin CHARACTERISTIC EISGov_facPT1TrqFlt_CUR " PT1 filter time constants factor" CURVE 0x3875FE Lookup1D_UWORD 0 PT_fac 0.0 99.9985
 /begin AXIS_DESCR COM_AXIS EISGov_nDiffLoFlt_mp EngSpeed_rpm 10 -6000.0 6000.0 AXIS_PTS_REF EISGov_facPT1TrqFlt_CURX /end AXIS_DESCR
/end CHARACTERISTIC
/begin CHARACTERISTIC EISGov_tiTimeSPDropResActive_CUR "Time threshold to act  EngSpdn correction " CURVE 0x3876FC Lookup1D_SLONG 0 TimeEngOn_s 0.0 2.14748E+9
 /begin AXIS_DESCR COM_AXIS EngDa_tStrt Temp_deg 8 -45.0 200.0 AXIS_PTS_REF EISGov_tiTimeSPDropResActive_CURX /end AXIS_DESCR
/end CHARACTERISTIC
/begin CHARACTERISTIC EISGov_dnDiffHi_C "Engine speed gradient threshold value at High speed" VALUE 0x3875AE Scalar_SWORD 0 EngSpeed_rpm_s -12000.0 12000.0 /end CHARACTERISTIC
/begin CHARACTERISTIC EISGov_dnDiffLo_C "Engine speed gradient threshold value at low speed" VALUE 0x3875B0 Scalar_SWORD 0 EngSpeed_rpm_s -12000.0 12000.0 /end CHARACTERISTIC
/begin CHARACTERISTIC EISGov_nDHypDenom_C "fenmu" VALUE 0x387646 Scalar_SWORD 0 EngSpeed_rpm 0.0 6000.0 /end CHARACTERISTIC
/begin CHARACTERISTIC EISGov_nDHypNum_C "fenzi" VALUE 0x387648 Scalar_SWORD 0 EngSpeed_rpm 0.0 6000.0 /end CHARACTERISTIC
/begin CHARACTERISTIC EISGov_nDiffHiLim_C "Engine speed deviation threshold limitation value at High speed " VALUE 0x38764A Scalar_SWORD 0 EngSpeed_rpm 0.0 6000.0 /end CHARACTERISTIC
/begin CHARACTERISTIC EISGov_nDiffHi_C "Engine speed deviation threshold value at High speed" VALUE 0x38764C Scalar_SWORD 0 EngSpeed_rpm 0.0 6000.0 /end CHARACTERISTIC
/begin CHARACTERISTIC EISGov_nDiffLo_C "Engine speed deviation threshold value at low speed" VALUE 0x38764E Scalar_SWORD 0 EngSpeed_rpm 0.0 6000.0 /end CHARACTERISTIC
/begin CHARACTERISTIC EISGov_trqIHiLimMax_C "Sum of the torque of both (upper/lower) PI-paths" VALUE 0x38772E Scalar_SWORD 0 Trq_Nm -3276.8 3276.7 /end CHARACTERISTIC
/begin CHARACTERISTIC EISGov_trqIHiLimMin_C "Sum of the torque of both (upper/lower) PI-paths" VALUE 0x387730 Scalar_SWORD 0 Trq_Nm -3276.8 3276.7 /end CHARACTERISTIC
/begin CHARACTERISTIC EISGov_trqILoLimMax_C "Sum of the torque of both (upper/lower) PI-paths" VALUE 0x387732 Scalar_SWORD 0 Trq_Nm -3276.8 3276.7 /end CHARACTERISTIC
/begin CHARACTERISTIC EISGov_trqILoLimMin_C "Sum of the torque of both (upper/lower) PI-paths" VALUE 0x387734 Scalar_SWORD 0 Trq_Nm -3276.8 3276.7 /end CHARACTERISTIC
/begin CHARACTERISTIC EISGov_trqPIHiLimMax_C "Sum of the torque of both (upper/lower) PI-paths" VALUE 0x38773A Scalar_SWORD 0 Trq_Nm -3276.8 3276.7 /end CHARACTERISTIC
/begin CHARACTERISTIC EISGov_trqPIHiLimMin_C "Sum of the torque of both (upper/lower) PI-paths" VALUE 0x38773C Scalar_SWORD 0 Trq_Nm -3276.8 3276.7 /end CHARACTERISTIC
/begin CHARACTERISTIC EISGov_trqPILoLimMax_C "Sum of the torque of both (upper/lower) PI-paths" VALUE 0x38773E Scalar_SWORD 0 Trq_Nm -3276.8 3276.7 /end CHARACTERISTIC
/begin CHARACTERISTIC EISGov_trqPILoLimMin_C "Sum of the torque of both (upper/lower) PI-paths" VALUE 0x387740 Scalar_SWORD 0 Trq_Nm -3276.8 3276.7 /end CHARACTERISTIC
/begin CHARACTERISTIC EISGov_facPT1DiffLoFlt_C "PT1 low path filtered factor" VALUE 0x3875FC Scalar_UWORD 0 PT_fac 0.0 99.9985 /end CHARACTERISTIC
/begin CHARACTERISTIC EISGov_bEngSPDropRestrainEN_C "enable the resistance When Engine speed Drop and rise at idle" VALUE 0x3875AC Scalar_BOOLEAN 0 boolean 0.0 1.0 /end CHARACTERISTIC
/begin CHARACTERISTIC EISGov_stDTSlect_C "DT1 Slect" VALUE 0x387694 Scalar_BOOLEAN 0 boolean 0.0 1.0 /end CHARACTERISTIC
/begin CHARACTERISTIC EISGov_stIInitDemChange_C "enable  initialization of I From EISGov when demand change" VALUE 0x387695 Scalar_BOOLEAN 0 boolean 0.0 1.0 /end CHARACTERISTIC
/begin CHARACTERISTIC LIGov_numTempSel_C "select CEngDsT" VALUE 0x394E54 Scalar_UBYTE 0 EngTempFldSel_conv 0 2 /end CHARACTERISTIC
/begin CHARACTERISTIC EISGov_swtTrqFltNeg_C "Switch for activating the negative EISGov_trqFlt on the torque path (0: EISGov_trqFlt >= 0, 1: EISGov_trqFlt <=> 0)" VALUE 0x3876A0 Scalar_UBYTE 0 Switch_conv 0 1 /end CHARACTERISTIC
/begin AXIS_PTS EISGov_DKd_CURX "D part time " 0x387594 EISGov_tDT1_mp Lookup1D_X_WORD 0 Temp_deg 10 -50.0 200.0 /end AXIS_PTS
/begin AXIS_PTS EISGov_facDT1_CURX "Control deviation for lower engine speed" 0x3875C8 NO_INPUT_QUANTITY Lookup1D_X_WORD 0 EngSpeed_rpm 10 0.0 6000.0 /end AXIS_PTS
/begin AXIS_PTS EISGov_tiDT1_CURX "DT1 part time " 0x3876B6 EISGov_tDT1_mp Lookup1D_X_WORD 0 Temp_deg 10 -50.0 200.0 /end AXIS_PTS
/begin AXIS_PTS EISGov_facPT1TrqFlt_CURX "Control deviation between lower setpoint speed and current engine speed for calculating the PT1 filter time constants" 0x387612 EISGov_nDiffLoFlt_mp Lookup1D_X_WORD 0 EngSpeed_rpm 10 -6000.0 6000.0 /end AXIS_PTS
/begin AXIS_PTS EISGov_tiTimeSPDropResActive_CURX "Temperature used for correction factor calculation" 0x38771C EngDa_tStrt Lookup1D_X_WORD 0 Temp_deg 8 -45.0 200.0 /end AXIS_PTS
/begin CHARACTERISTIC EISGov_SetPLoRmpSlopeNeg_C "Ramp parameter set for  setpoint speed / Negative ramp step" VALUE 0x3875A8 Scalar_SWORD 0 EngSpeed_rpm_s 0.0 6000.0 /end CHARACTERISTIC
/begin CHARACTERISTIC EISGov_SetPLoRmpSlopePos_C "Ramp parameter set for  setpoint speed / Positive ramp step " VALUE 0x3875AA Scalar_SWORD 0 EngSpeed_rpm_s 0.0 6000.0 /end CHARACTERISTIC
/begin CHARACTERISTIC EISGov_stPrio_CA "Prioritising the EISGov client [index 0 highest priority]" VAL_BLK 0x387698 Scalar_UBYTE 0 EISGov_num_conv 0 127 NUMBER 7 /end CHARACTERISTIC
/begin CHARACTERISTIC EISGov_trqRedHiLimMin_C "Minimum torque value to deactivate the High Speed governor" VALUE 0x387742 Scalar_SWORD 0 Trq_Nm -3276.8 3276.7 /end CHARACTERISTIC
/begin CHARACTERISTIC EISGov_facEngDnFlt_CUR "Time constant (PT1filter) for Engine speed gradient" CURVE 0x3875DC Lookup1D_UWORD 0 PT_fac 0.0 99.998
 /begin AXIS_DESCR COM_AXIS NO_INPUT_QUANTITY EngSpeed_rpm_s 8 0.0 6000.0 AXIS_PTS_REF EISGov_facEngDnFlt_CURX /end AXIS_DESCR
/end CHARACTERISTIC
/begin CHARACTERISTIC EISGov_facdnAccDecLim_CUR "Correction factor for EngSpdnAccDec" CURVE 0x387626 Lookup1D_WORD 0 Factor 0.001 1.0
 /begin AXIS_DESCR COM_AXIS NO_INPUT_QUANTITY Temp_deg 8 -45.0 200.0 AXIS_PTS_REF EISGov_facdnAccDecLim_CURX /end AXIS_DESCR
/end CHARACTERISTIC
/begin CHARACTERISTIC EISGov_tiSetTimeAccDecLim_CUR "Time threshold to act  EngSpdn correction " CURVE 0x3876CC Lookup1D_SLONG 0 TimeEngOn_s 0.0 2.14748E+9
 /begin AXIS_DESCR COM_AXIS NO_INPUT_QUANTITY Temp_deg 8 -45.0 200.0 AXIS_PTS_REF EISGov_tiSetTimeAccDecLim_CURX /end AXIS_DESCR
/end CHARACTERISTIC
/begin CHARACTERISTIC EISGov_trqLossLimMax_C "Limitation of torque loss estimation" VALUE 0x387738 Scalar_SWORD 0 Trq_Nm -3276.8 3276.7 /end CHARACTERISTIC
/begin CHARACTERISTIC EISGov_dnEngFltIni_C "Engine speed gradient filt initial value" VALUE 0x3875B2 Scalar_SWORD 0 EngSpeed_rpm_s 0.0 6000.0 /end CHARACTERISTIC
/begin CHARACTERISTIC EISGov_titrqLosFlt_C "Time constant (PT1filter) for torque loss estimation" VALUE 0x38772C Scalar_UWORD 0 PT_fac 0.0 99.998 /end CHARACTERISTIC
/begin CHARACTERISTIC EISGov_trqLosEstSlect_C "torque loss estimation sources select" VALUE 0x387736 Scalar_BOOLEAN 0 boolean 0.0 1.0 /end CHARACTERISTIC
/begin CHARACTERISTIC EISGov_swtTempSel_C "0-coolant_temperature 1-oil_temperature 2-EngDa_tEng" VALUE 0x38769F Scalar_UBYTE 0 EngTempFldSel_conv 0 2 /end CHARACTERISTIC
/begin AXIS_PTS EISGov_facEngDnFlt_CURX "Engine speed gradient absolute value" 0x3875EC NO_INPUT_QUANTITY Lookup1D_X_WORD 0 EngSpeed_rpm_s 8 0.0 6000.0 /end AXIS_PTS
/begin AXIS_PTS EISGov_facdnAccDecLim_CURX "Temperature used for correction factor calculation" 0x387636 NO_INPUT_QUANTITY Lookup1D_X_WORD 0 Temp_deg 8 -45.0 200.0 /end AXIS_PTS
/begin AXIS_PTS EISGov_tiSetTimeAccDecLim_CURX "Temperature used for correction factor calculation" 0x3876EC NO_INPUT_QUANTITY Lookup1D_X_WORD 0 Temp_deg 8 -45.0 200.0 /end AXIS_PTS
/begin CHARACTERISTIC ExtDem_stMskFrzRls_C "Mask for torque request field" VALUE 0x389A30 Scalar_ULONG 0 State_uint32 0.0 4.294967295E+9 /end CHARACTERISTIC
/begin CHARACTERISTIC ExtDem_rAPPThresTrqDem_C "Threshold value for Accped value to remove/set I part" VALUE 0x389A2C Scalar_SWORD 0 Accpedal_rate -100.0 100.0 /end CHARACTERISTIC
/begin CHARACTERISTIC ExtDem_swtAct_C "Switch to enable the ExtDem" VALUE 0x389A34 Scalar_UBYTE 0 State_uint8 0.0 1.0 /end CHARACTERISTIC
/begin CHARACTERISTIC ExtDem_KiCorTempFac_MAP "Temperature external intervention upper setpoint based correction map for Ki gain" MAP 0x38947A Lookup2D_WORD 0 Factor -10.0 10.0
 /begin AXIS_DESCR COM_AXIS ExtDem_tParAdap_mp Temp_deg 10 -50.0 150.0 AXIS_PTS_REF ExtDem_KiCorTempFac_MAPY /end AXIS_DESCR
 /begin AXIS_DESCR COM_AXIS ExtDem_nSetP_mp EngSpeed_rpm 10 0.0 6000.0 AXIS_PTS_REF ExtDem_KiCorTempFac_MAPX /end AXIS_DESCR
/end CHARACTERISTIC
/begin CHARACTERISTIC ExtDem_KiCorTrqFac_MAP "Load based correction factor map for I gain" MAP 0x38956A Lookup2D_WORD 0 Factor -10.0 10.0
 /begin AXIS_DESCR COM_AXIS NO_INPUT_QUANTITY Trq_Nm 10 -3000.0 3000.0 AXIS_PTS_REF ExtDem_KiCorTrqFac_MAPY /end AXIS_DESCR
 /begin AXIS_DESCR COM_AXIS ExtDem_nSelCorFac_mp EngSpeed_rpm 10 0.0 6000.0 AXIS_PTS_REF ExtDem_KiCorTrqFac_MAPX /end AXIS_DESCR
/end CHARACTERISTIC
/begin CHARACTERISTIC ExtDem_KpCorTempFac_MAP "Temperature external intervention upper setpoint based correction map for Kp gain" MAP 0x38965A Lookup2D_WORD 0 Factor -10.0 10.0
 /begin AXIS_DESCR COM_AXIS ExtDem_tParAdap_mp Temp_deg 10 -50.0 150.0 AXIS_PTS_REF ExtDem_KpCorTempFac_MAPY /end AXIS_DESCR
 /begin AXIS_DESCR COM_AXIS ExtDem_nSetP_mp EngSpeed_rpm 10 0.0 6000.0 AXIS_PTS_REF ExtDem_KpCorTempFac_MAPX /end AXIS_DESCR
/end CHARACTERISTIC
/begin CHARACTERISTIC ExtDem_KpCorTrqFac_MAP "Load based correction factor map for P gain" MAP 0x38974A Lookup2D_WORD 0 Factor -10.0 10.0
 /begin AXIS_DESCR COM_AXIS NO_INPUT_QUANTITY Trq_Nm 10 -3000.0 3000.0 AXIS_PTS_REF ExtDem_KpCorTrqFac_MAPY /end AXIS_DESCR
 /begin AXIS_DESCR COM_AXIS ExtDem_nSelCorFac_mp EngSpeed_rpm 10 0.0 6000.0 AXIS_PTS_REF ExtDem_KpCorTrqFac_MAPX /end AXIS_DESCR
/end CHARACTERISTIC
/begin CHARACTERISTIC ExtDem_facFdbk_CUR "Upper external intervention setpoint speed basedfeedback factor curve" CURVE 0x3899EC Lookup1D_WORD 0 FdbkNm2rpm_rpm_Nm -10.0 10.0
 /begin AXIS_DESCR COM_AXIS CoETS_nTSEASpdDes EngSpeed_rpm 15 0.0 6000.0 AXIS_PTS_REF ExtDem_facFdbk_CURX /end AXIS_DESCR
/end CHARACTERISTIC
/begin CHARACTERISTIC ExtDem_Par0PKpNeg_C "Negative large signal amplification for proprtional component for parameter set 0" VALUE 0x389850 Scalar_LONG 0 HLSDem_Kp -20.0 20.0 /end CHARACTERISTIC
/begin CHARACTERISTIC ExtDem_Par0PKpPos_C "Positive large signal amplification for proprtional component for parameter set 0" VALUE 0x389854 Scalar_LONG 0 HLSDem_Kp -20.0 20.0 /end CHARACTERISTIC
/begin CHARACTERISTIC ExtDem_Par0PKp_C "Small signal amplification for proportional component for parameter set 0" VALUE 0x389858 Scalar_LONG 0 HLSDem_Kp -20.0 20.0 /end CHARACTERISTIC
/begin CHARACTERISTIC ExtDem_Par1PKpNeg_C "Negative large signal amplification for proprtional component for parameter set 1" VALUE 0x389884 Scalar_LONG 0 HLSDem_Kp -20.0 20.0 /end CHARACTERISTIC
/begin CHARACTERISTIC ExtDem_Par1PKpPos_C "Positive large signal amplification for proprtional component for parameter set 1" VALUE 0x389888 Scalar_LONG 0 HLSDem_Kp -20.0 20.0 /end CHARACTERISTIC
/begin CHARACTERISTIC ExtDem_Par1PKp_C "Small signal amplification for proportional component for parameter set 1" VALUE 0x38988C Scalar_LONG 0 HLSDem_Kp -20.0 20.0 /end CHARACTERISTIC
/begin CHARACTERISTIC ExtDem_Par2PKpNeg_C "Negative large signal amplification for proprtional component for parameter set 2" VALUE 0x3898B8 Scalar_LONG 0 HLSDem_Kp -20.0 20.0 /end CHARACTERISTIC
/begin CHARACTERISTIC ExtDem_Par2PKpPos_C "Positive large signal amplification for proprtional component for parameter set 2" VALUE 0x3898BC Scalar_LONG 0 HLSDem_Kp -20.0 20.0 /end CHARACTERISTIC
/begin CHARACTERISTIC ExtDem_Par2PKp_C "Small signal amplification for proportional component for parameter set 2" VALUE 0x3898C0 Scalar_LONG 0 HLSDem_Kp -20.0 20.0 /end CHARACTERISTIC
/begin CHARACTERISTIC ExtDem_Par3PKpNeg_C "Negative large signal amplification for proprtional component for parameter set 3" VALUE 0x3898EC Scalar_LONG 0 HLSDem_Kp -20.0 20.0 /end CHARACTERISTIC
/begin CHARACTERISTIC ExtDem_Par3PKpPos_C "Positive large signal amplification for proprtional component for parameter set 3" VALUE 0x3898F0 Scalar_LONG 0 HLSDem_Kp -20.0 20.0 /end CHARACTERISTIC
/begin CHARACTERISTIC ExtDem_Par3PKp_C "Small signal amplification for proportional component for parameter set 3" VALUE 0x3898F4 Scalar_LONG 0 HLSDem_Kp -20.0 20.0 /end CHARACTERISTIC
/begin CHARACTERISTIC ExtDem_Par4PKpNeg_C "Negative large signal amplification for proprtional component for parameter set 4" VALUE 0x389920 Scalar_LONG 0 HLSDem_Kp -20.0 20.0 /end CHARACTERISTIC
/begin CHARACTERISTIC ExtDem_Par4PKpPos_C "Positive large signal amplification for proprtional component for parameter set 4" VALUE 0x389924 Scalar_LONG 0 HLSDem_Kp -20.0 20.0 /end CHARACTERISTIC
/begin CHARACTERISTIC ExtDem_Par4PKp_C "Small signal amplification for proportional component for parameter set 4" VALUE 0x389928 Scalar_LONG 0 HLSDem_Kp -20.0 20.0 /end CHARACTERISTIC
/begin CHARACTERISTIC ExtDem_Par5PKpNeg_C "Negative large signal amplification for proprtional component for parameter set 5" VALUE 0x389954 Scalar_LONG 0 HLSDem_Kp -20.0 20.0 /end CHARACTERISTIC
/begin CHARACTERISTIC ExtDem_Par5PKpPos_C "Positive large signal amplification for proprtional component for parameter set 5" VALUE 0x389958 Scalar_LONG 0 HLSDem_Kp -20.0 20.0 /end CHARACTERISTIC
/begin CHARACTERISTIC ExtDem_Par5PKp_C "Small signal amplification for proportional component for parameter set 5" VALUE 0x38995C Scalar_LONG 0 HLSDem_Kp -20.0 20.0 /end CHARACTERISTIC
/begin CHARACTERISTIC ExtDem_Par6PKpNeg_C "Negative large signal amplification for proprtional component for parameter set 6" VALUE 0x389988 Scalar_LONG 0 HLSDem_Kp -20.0 20.0 /end CHARACTERISTIC
/begin CHARACTERISTIC ExtDem_Par6PKpPos_C "Positive large signal amplification for proprtional component for parameter set 6" VALUE 0x38998C Scalar_LONG 0 HLSDem_Kp -20.0 20.0 /end CHARACTERISTIC
/begin CHARACTERISTIC ExtDem_Par6PKp_C "Small signal amplification for proportional component for parameter set 6" VALUE 0x389990 Scalar_LONG 0 HLSDem_Kp -20.0 20.0 /end CHARACTERISTIC
/begin CHARACTERISTIC ExtDem_Par7PKpNeg_C "Negative large signal amplification for proprtional component for parameter set 7" VALUE 0x3899BC Scalar_LONG 0 HLSDem_Kp -20.0 20.0 /end CHARACTERISTIC
/begin CHARACTERISTIC ExtDem_Par7PKpPos_C "Positive large signal amplification for proprtional component for parameter set 7" VALUE 0x3899C0 Scalar_LONG 0 HLSDem_Kp -20.0 20.0 /end CHARACTERISTIC
/begin CHARACTERISTIC ExtDem_Par7PKp_C "Small signal amplification for proportional component for parameter set 7" VALUE 0x3899C4 Scalar_LONG 0 HLSDem_Kp -20.0 20.0 /end CHARACTERISTIC
/begin CHARACTERISTIC ExtDem_Par0IKiNeg_C "Negative large signal amplification for integral component for parameter set 0" VALUE 0x389840 Scalar_LONG 0 HLSDem_Ki -20.0 20.0 /end CHARACTERISTIC
/begin CHARACTERISTIC ExtDem_Par0IKiPos_C "Positive large signal amplification for integral component for parameter set 0" VALUE 0x389844 Scalar_LONG 0 HLSDem_Ki -20.0 20.0 /end CHARACTERISTIC
/begin CHARACTERISTIC ExtDem_Par0IKi_C "Small signal amplification for integral component for parameter set 0" VALUE 0x389848 Scalar_LONG 0 HLSDem_Ki -20.0 20.0 /end CHARACTERISTIC
/begin CHARACTERISTIC ExtDem_Par1IKiNeg_C "Negative large signal amplification for integral component for parameter set 1" VALUE 0x389874 Scalar_LONG 0 HLSDem_Ki -20.0 20.0 /end CHARACTERISTIC
/begin CHARACTERISTIC ExtDem_Par1IKiPos_C "Positive large signal amplification for integral component for parameter set 1" VALUE 0x389878 Scalar_LONG 0 HLSDem_Ki -20.0 20.0 /end CHARACTERISTIC
/begin CHARACTERISTIC ExtDem_Par1IKi_C "Small signal amplification for integral component for parameter set 1" VALUE 0x38987C Scalar_LONG 0 HLSDem_Ki -20.0 20.0 /end CHARACTERISTIC
/begin CHARACTERISTIC ExtDem_Par2IKiNeg_C "Negative large signal amplification for integral component for parameter set 2" VALUE 0x3898A8 Scalar_LONG 0 HLSDem_Ki -20.0 20.0 /end CHARACTERISTIC
/begin CHARACTERISTIC ExtDem_Par2IKiPos_C "Positive large signal amplification for integral component for parameter set 2" VALUE 0x3898AC Scalar_LONG 0 HLSDem_Ki -20.0 20.0 /end CHARACTERISTIC
/begin CHARACTERISTIC ExtDem_Par2IKi_C "Small signal amplification for integral component for parameter set 2" VALUE 0x3898B0 Scalar_LONG 0 HLSDem_Ki -20.0 20.0 /end CHARACTERISTIC
/begin CHARACTERISTIC ExtDem_Par3IKiNeg_C "Negative large signal amplification for integral component for parameter set 3" VALUE 0x3898DC Scalar_LONG 0 HLSDem_Ki -20.0 20.0 /end CHARACTERISTIC
/begin CHARACTERISTIC ExtDem_Par3IKiPos_C "Positive large signal amplification for integral component for parameter set 3" VALUE 0x3898E0 Scalar_LONG 0 HLSDem_Ki -20.0 20.0 /end CHARACTERISTIC
/begin CHARACTERISTIC ExtDem_Par3IKi_C "Small signal amplification for integral component for parameter set 3" VALUE 0x3898E4 Scalar_LONG 0 HLSDem_Ki -20.0 20.0 /end CHARACTERISTIC
/begin CHARACTERISTIC ExtDem_Par4IKiNeg_C "Negative large signal amplification for integral component for parameter set 4" VALUE 0x389910 Scalar_LONG 0 HLSDem_Ki -20.0 20.0 /end CHARACTERISTIC
/begin CHARACTERISTIC ExtDem_Par4IKiPos_C "Positive large signal amplification for integral component for parameter set 4" VALUE 0x389914 Scalar_LONG 0 HLSDem_Ki -20.0 20.0 /end CHARACTERISTIC
/begin CHARACTERISTIC ExtDem_Par4IKi_C "Small signal amplification for integral component for parameter set 4" VALUE 0x389918 Scalar_LONG 0 HLSDem_Ki -20.0 20.0 /end CHARACTERISTIC
/begin CHARACTERISTIC ExtDem_Par5IKiNeg_C "Negative large signal amplification for integral component for parameter set 5" VALUE 0x389944 Scalar_LONG 0 HLSDem_Ki -20.0 20.0 /end CHARACTERISTIC
/begin CHARACTERISTIC ExtDem_Par5IKiPos_C "Positive large signal amplification for integral component for parameter set 5" VALUE 0x389948 Scalar_LONG 0 HLSDem_Ki -20.0 20.0 /end CHARACTERISTIC
/begin CHARACTERISTIC ExtDem_Par5IKi_C "Small signal amplification for integral component for parameter set 5" VALUE 0x38994C Scalar_LONG 0 HLSDem_Ki -20.0 20.0 /end CHARACTERISTIC
/begin CHARACTERISTIC ExtDem_Par6IKiNeg_C "Negative large signal amplification for integral component for parameter set 6" VALUE 0x389978 Scalar_LONG 0 HLSDem_Ki -20.0 20.0 /end CHARACTERISTIC
/begin CHARACTERISTIC ExtDem_Par6IKiPos_C "Positive large signal amplification for integral component for parameter set 6" VALUE 0x38997C Scalar_LONG 0 HLSDem_Ki -20.0 20.0 /end CHARACTERISTIC
/begin CHARACTERISTIC ExtDem_Par6IKi_C "Small signal amplification for integral component for parameter set 6" VALUE 0x389980 Scalar_LONG 0 HLSDem_Ki -20.0 20.0 /end CHARACTERISTIC
/begin CHARACTERISTIC ExtDem_Par7IKiNeg_C "Negative large signal amplification for integral component for parameter set 7" VALUE 0x3899AC Scalar_LONG 0 HLSDem_Ki -20.0 20.0 /end CHARACTERISTIC
/begin CHARACTERISTIC ExtDem_Par7IKiPos_C "Positive large signal amplification for integral component for parameter set 7" VALUE 0x3899B0 Scalar_LONG 0 HLSDem_Ki -20.0 20.0 /end CHARACTERISTIC
/begin CHARACTERISTIC ExtDem_Par7IKi_C "Small signal amplification for integral component for parameter set 7" VALUE 0x3899B4 Scalar_LONG 0 HLSDem_Ki -20.0 20.0 /end CHARACTERISTIC
/begin CHARACTERISTIC ExtDem_Par0TiFltTrqLosEst_C "time constant for inner feedback factor for parameter set 0" VALUE 0x38985C Scalar_LONG 0 Time_s -180.0 180.0 /end CHARACTERISTIC
/begin CHARACTERISTIC ExtDem_Par1TiFltTrqLosEst_C "time constant for inner feedback factor for parameter set 1" VALUE 0x389890 Scalar_LONG 0 Time_s -180.0 180.0 /end CHARACTERISTIC
/begin CHARACTERISTIC ExtDem_Par2TiFltTrqLosEst_C "time constant for inner feedback factor for parameter set 2" VALUE 0x3898C4 Scalar_LONG 0 Time_s -180.0 180.0 /end CHARACTERISTIC
/begin CHARACTERISTIC ExtDem_Par3TiFltTrqLosEst_C "time constant for inner feedback factor for parameter set 3" VALUE 0x3898F8 Scalar_LONG 0 Time_s -180.0 180.0 /end CHARACTERISTIC
/begin CHARACTERISTIC ExtDem_Par4TiFltTrqLosEst_C "time constant for inner feedback factor for parameter set 4" VALUE 0x38992C Scalar_LONG 0 Time_s -180.0 180.0 /end CHARACTERISTIC
/begin CHARACTERISTIC ExtDem_Par5TiFltTrqLosEst_C "time constant for inner feedback factor for parameter set 5" VALUE 0x389960 Scalar_LONG 0 Time_s -180.0 180.0 /end CHARACTERISTIC
/begin CHARACTERISTIC ExtDem_Par6TiFltTrqLosEst_C "time constant for inner feedback factor for parameter set 6" VALUE 0x389994 Scalar_LONG 0 Time_s -180.0 180.0 /end CHARACTERISTIC
/begin CHARACTERISTIC ExtDem_Par7TiFltTrqLosEst_C "time constant for inner feedback factor for parameter set 7" VALUE 0x3899C8 Scalar_LONG 0 Time_s -180.0 180.0 /end CHARACTERISTIC
/begin CHARACTERISTIC ExtDem_Par0dnAccLim_C "Upper limit for the permissible acceleration of engine speed ( parameter set 0 for ExtDem)" VALUE 0x389860 Scalar_SWORD 0 EngSpeed_rpm_s -12000.0 12000.0 /end CHARACTERISTIC
/begin CHARACTERISTIC ExtDem_Par0dnDeclLimBrk_C "Lower limit for the permissible deceleration of engine speed in case of braking ( parameter set 0 for ExtDem)" VALUE 0x389862 Scalar_SWORD 0 EngSpeed_rpm_s -12000.0 12000.0 /end CHARACTERISTIC
/begin CHARACTERISTIC ExtDem_Par0dnDeclLim_C "Lower limit for the permissible deceleration of engine speed ( parameter set 0 for ExtDem)" VALUE 0x389864 Scalar_SWORD 0 EngSpeed_rpm_s -12000.0 12000.0 /end CHARACTERISTIC
/begin CHARACTERISTIC ExtDem_Par0nIWinNeg_C "Negative small signal window for integral component for parameter set 0" VALUE 0x389866 Scalar_SWORD 0 EngSpeed_rpm -6000.0 6000.0 /end CHARACTERISTIC
/begin CHARACTERISTIC ExtDem_Par0nIWinPos_C "Positive small signal window for integral component for parameter set 0" VALUE 0x389868 Scalar_SWORD 0 EngSpeed_rpm -6000.0 6000.0 /end CHARACTERISTIC
/begin CHARACTERISTIC ExtDem_Par0nPWinNeg_C "Negative small signal window for proportional component for parameter set 0" VALUE 0x38986A Scalar_SWORD 0 EngSpeed_rpm -6000.0 6000.0 /end CHARACTERISTIC
/begin CHARACTERISTIC ExtDem_Par0nPWinPos_C "Positive small signal window for proportional component for parameter set 0" VALUE 0x38986C Scalar_SWORD 0 EngSpeed_rpm -6000.0 6000.0 /end CHARACTERISTIC
/begin CHARACTERISTIC ExtDem_Par1dnAccLim_C "Upper limit for the permissible acceleration of engine speed ( parameter set 1 for ExtDem)" VALUE 0x389894 Scalar_SWORD 0 EngSpeed_rpm_s -12000.0 12000.0 /end CHARACTERISTIC
/begin CHARACTERISTIC ExtDem_Par1dnDeclLimBrk_C "Lower limit for the permissible deceleration of engine speed in case of braking ( parameter set 1 for ExtDem)" VALUE 0x389896 Scalar_SWORD 0 EngSpeed_rpm_s -12000.0 12000.0 /end CHARACTERISTIC
/begin CHARACTERISTIC ExtDem_Par1dnDeclLim_C "Lower limit for the permissible deceleration of engine speed ( parameter set 1 for ExtDem)" VALUE 0x389898 Scalar_SWORD 0 EngSpeed_rpm_s -12000.0 12000.0 /end CHARACTERISTIC
/begin CHARACTERISTIC ExtDem_Par1nIWinNeg_C "Negative small signal window for integral component for parameter set 1" VALUE 0x38989A Scalar_SWORD 0 EngSpeed_rpm -6000.0 6000.0 /end CHARACTERISTIC
/begin CHARACTERISTIC ExtDem_Par1nIWinPos_C "Positive small signal window for integral component for parameter set 1" VALUE 0x38989C Scalar_SWORD 0 EngSpeed_rpm -6000.0 6000.0 /end CHARACTERISTIC
/begin CHARACTERISTIC ExtDem_Par1nPWinNeg_C "Negative small signal window for proportional component for parameter set 1" VALUE 0x38989E Scalar_SWORD 0 EngSpeed_rpm -6000.0 6000.0 /end CHARACTERISTIC
/begin CHARACTERISTIC ExtDem_Par1nPWinPos_C "Positive small signal window for proportional component for parameter set 1" VALUE 0x3898A0 Scalar_SWORD 0 EngSpeed_rpm -6000.0 6000.0 /end CHARACTERISTIC
/begin CHARACTERISTIC ExtDem_Par2dnAccLim_C "Upper limit for the permissible acceleration of engine speed ( parameter set 2 for ExtDem)" VALUE 0x3898C8 Scalar_SWORD 0 EngSpeed_rpm_s -12000.0 12000.0 /end CHARACTERISTIC
/begin CHARACTERISTIC ExtDem_Par2dnDeclLimBrk_C "Lower limit for the permissible deceleration of engine speed in case of braking ( parameter set 2 for ExtDem)" VALUE 0x3898CA Scalar_SWORD 0 EngSpeed_rpm_s -12000.0 12000.0 /end CHARACTERISTIC
/begin CHARACTERISTIC ExtDem_Par2dnDeclLim_C "Lower limit for the permissible deceleration of engine speed ( parameter set 2 for ExtDem)" VALUE 0x3898CC Scalar_SWORD 0 EngSpeed_rpm_s -12000.0 12000.0 /end CHARACTERISTIC
/begin CHARACTERISTIC ExtDem_Par2nIWinNeg_C "Negative small signal window for integral component for parameter set 2" VALUE 0x3898CE Scalar_SWORD 0 EngSpeed_rpm -6000.0 6000.0 /end CHARACTERISTIC
/begin CHARACTERISTIC ExtDem_Par2nIWinPos_C "Positive small signal window for integral component for parameter set 2" VALUE 0x3898D0 Scalar_SWORD 0 EngSpeed_rpm -6000.0 6000.0 /end CHARACTERISTIC
/begin CHARACTERISTIC ExtDem_Par2nPWinNeg_C "Negative small signal window for proportional component for parameter set 2" VALUE 0x3898D2 Scalar_SWORD 0 EngSpeed_rpm -6000.0 6000.0 /end CHARACTERISTIC
/begin CHARACTERISTIC ExtDem_Par2nPWinPos_C "Positive small signal window for proportional component for parameter set 2" VALUE 0x3898D4 Scalar_SWORD 0 EngSpeed_rpm -6000.0 6000.0 /end CHARACTERISTIC
/begin CHARACTERISTIC ExtDem_Par3dnAccLim_C "Upper limit for the permissible acceleration of engine speed ( parameter set 3 for ExtDem)" VALUE 0x3898FC Scalar_SWORD 0 EngSpeed_rpm_s -12000.0 12000.0 /end CHARACTERISTIC
/begin CHARACTERISTIC ExtDem_Par3dnDeclLimBrk_C "Lower limit for the permissible deceleration of engine speed in case of braking ( parameter set 3 for ExtDem)" VALUE 0x3898FE Scalar_SWORD 0 EngSpeed_rpm_s -12000.0 12000.0 /end CHARACTERISTIC
/begin CHARACTERISTIC ExtDem_Par3dnDeclLim_C "Lower limit for the permissible deceleration of engine speed ( parameter set 3 for ExtDem)" VALUE 0x389900 Scalar_SWORD 0 EngSpeed_rpm_s -12000.0 12000.0 /end CHARACTERISTIC
/begin CHARACTERISTIC ExtDem_Par3nIWinNeg_C "Negative small signal window for integral component for parameter set 3" VALUE 0x389902 Scalar_SWORD 0 EngSpeed_rpm -6000.0 6000.0 /end CHARACTERISTIC
/begin CHARACTERISTIC ExtDem_Par3nIWinPos_C "Positive small signal window for integral component for parameter set 3" VALUE 0x389904 Scalar_SWORD 0 EngSpeed_rpm -6000.0 6000.0 /end CHARACTERISTIC
/begin CHARACTERISTIC ExtDem_Par3nPWinNeg_C "Negative small signal window for proportional component for parameter set 3" VALUE 0x389906 Scalar_SWORD 0 EngSpeed_rpm -6000.0 6000.0 /end CHARACTERISTIC
/begin CHARACTERISTIC ExtDem_Par3nPWinPos_C "Positive small signal window for proportional component for parameter set 3" VALUE 0x389908 Scalar_SWORD 0 EngSpeed_rpm -6000.0 6000.0 /end CHARACTERISTIC
/begin CHARACTERISTIC ExtDem_Par4dnAccLim_C "Upper limit for the permissible acceleration of engine speed ( parameter set 4 for ExtDem)" VALUE 0x389930 Scalar_SWORD 0 EngSpeed_rpm_s -12000.0 12000.0 /end CHARACTERISTIC
/begin CHARACTERISTIC ExtDem_Par4dnDeclLimBrk_C "Lower limit for the permissible deceleration of engine speed in case of braking ( parameter set 4 for ExtDem)" VALUE 0x389932 Scalar_SWORD 0 EngSpeed_rpm_s -12000.0 12000.0 /end CHARACTERISTIC
/begin CHARACTERISTIC ExtDem_Par4dnDeclLim_C "Lower limit for the permissible deceleration of engine speed ( parameter set 4 for ExtDem)" VALUE 0x389934 Scalar_SWORD 0 EngSpeed_rpm_s -12000.0 12000.0 /end CHARACTERISTIC
/begin CHARACTERISTIC ExtDem_Par4nIWinNeg_C "Negative small signal window for integral component for parameter set 4" VALUE 0x389936 Scalar_SWORD 0 EngSpeed_rpm -6000.0 6000.0 /end CHARACTERISTIC
/begin CHARACTERISTIC ExtDem_Par4nIWinPos_C "Positive small signal window for integral component for parameter set 4" VALUE 0x389938 Scalar_SWORD 0 EngSpeed_rpm -6000.0 6000.0 /end CHARACTERISTIC
/begin CHARACTERISTIC ExtDem_Par4nPWinNeg_C "Negative small signal window for proportional component for parameter set 4" VALUE 0x38993A Scalar_SWORD 0 EngSpeed_rpm -6000.0 6000.0 /end CHARACTERISTIC
/begin CHARACTERISTIC ExtDem_Par4nPWinPos_C "Positive small signal window for proportional component for parameter set 4" VALUE 0x38993C Scalar_SWORD 0 EngSpeed_rpm -6000.0 6000.0 /end CHARACTERISTIC
/begin CHARACTERISTIC ExtDem_Par5dnAccLim_C "Upper limit for the permissible acceleration of engine speed ( parameter set 5 for ExtDem)" VALUE 0x389964 Scalar_SWORD 0 EngSpeed_rpm_s -12000.0 12000.0 /end CHARACTERISTIC
/begin CHARACTERISTIC ExtDem_Par5dnDeclLimBrk_C "Lower limit for the permissible deceleration of engine speed in case of braking ( parameter set 5 for ExtDem)" VALUE 0x389966 Scalar_SWORD 0 EngSpeed_rpm_s -12000.0 12000.0 /end CHARACTERISTIC
/begin CHARACTERISTIC ExtDem_Par5dnDeclLim_C "Lower limit for the permissible deceleration of engine speed ( parameter set 5 for ExtDem)" VALUE 0x389968 Scalar_SWORD 0 EngSpeed_rpm_s -12000.0 12000.0 /end CHARACTERISTIC
/begin CHARACTERISTIC ExtDem_Par5nIWinNeg_C "Negative small signal window for integral component for parameter set 5" VALUE 0x38996A Scalar_SWORD 0 EngSpeed_rpm -6000.0 6000.0 /end CHARACTERISTIC
/begin CHARACTERISTIC ExtDem_Par5nIWinPos_C "Positive small signal window for integral component for parameter set 5" VALUE 0x38996C Scalar_SWORD 0 EngSpeed_rpm -6000.0 6000.0 /end CHARACTERISTIC
/begin CHARACTERISTIC ExtDem_Par5nPWinNeg_C "Negative small signal window for proportional component for parameter set 5" VALUE 0x38996E Scalar_SWORD 0 EngSpeed_rpm -6000.0 6000.0 /end CHARACTERISTIC
/begin CHARACTERISTIC ExtDem_Par5nPWinPos_C "Positive small signal window for proportional component for parameter set 5" VALUE 0x389970 Scalar_SWORD 0 EngSpeed_rpm -6000.0 6000.0 /end CHARACTERISTIC
/begin CHARACTERISTIC ExtDem_Par6dnAccLim_C "Upper limit for the permissible acceleration of engine speed ( parameter set 6 for ExtDem)" VALUE 0x389998 Scalar_SWORD 0 EngSpeed_rpm_s -12000.0 12000.0 /end CHARACTERISTIC
/begin CHARACTERISTIC ExtDem_Par6dnDeclLimBrk_C "Lower limit for the permissible deceleration of engine speed in case of braking ( parameter set 6 for ExtDem)" VALUE 0x38999A Scalar_SWORD 0 EngSpeed_rpm_s -12000.0 12000.0 /end CHARACTERISTIC
/begin CHARACTERISTIC ExtDem_Par6dnDeclLim_C "Lower limit for the permissible deceleration of engine speed ( parameter set 6 for ExtDem)" VALUE 0x38999C Scalar_SWORD 0 EngSpeed_rpm_s -12000.0 12000.0 /end CHARACTERISTIC
/begin CHARACTERISTIC ExtDem_Par6nIWinNeg_C "Negative small signal window for integral component for parameter set 6" VALUE 0x38999E Scalar_SWORD 0 EngSpeed_rpm -6000.0 6000.0 /end CHARACTERISTIC
/begin CHARACTERISTIC ExtDem_Par6nIWinPos_C "Positive small signal window for integral component for parameter set 6" VALUE 0x3899A0 Scalar_SWORD 0 EngSpeed_rpm -6000.0 6000.0 /end CHARACTERISTIC
/begin CHARACTERISTIC ExtDem_Par6nPWinNeg_C "Negative small signal window for proportional component for parameter set 6" VALUE 0x3899A2 Scalar_SWORD 0 EngSpeed_rpm -6000.0 6000.0 /end CHARACTERISTIC
/begin CHARACTERISTIC ExtDem_Par6nPWinPos_C "Positive small signal window for proportional component for parameter set 6" VALUE 0x3899A4 Scalar_SWORD 0 EngSpeed_rpm -6000.0 6000.0 /end CHARACTERISTIC
/begin CHARACTERISTIC ExtDem_Par7dnAccLim_C "Upper limit for the permissible acceleration of engine speed ( parameter set 7 for ExtDem)" VALUE 0x3899CC Scalar_SWORD 0 EngSpeed_rpm_s -12000.0 12000.0 /end CHARACTERISTIC
/begin CHARACTERISTIC ExtDem_Par7dnDeclLimBrk_C "Lower limit for the permissible deceleration of engine speed in case of braking ( parameter set 7 for ExtDem)" VALUE 0x3899CE Scalar_SWORD 0 EngSpeed_rpm_s -12000.0 12000.0 /end CHARACTERISTIC
/begin CHARACTERISTIC ExtDem_Par7dnDeclLim_C "Lower limit for the permissible deceleration of engine speed ( parameter set 7 for ExtDem)" VALUE 0x3899D0 Scalar_SWORD 0 EngSpeed_rpm_s -12000.0 12000.0 /end CHARACTERISTIC
/begin CHARACTERISTIC ExtDem_Par7nIWinNeg_C "Negative small signal window for integral component for parameter set 7" VALUE 0x3899D2 Scalar_SWORD 0 EngSpeed_rpm -6000.0 6000.0 /end CHARACTERISTIC
/begin CHARACTERISTIC ExtDem_Par7nIWinPos_C "Positive small signal window for integral component for parameter set 7" VALUE 0x3899D4 Scalar_SWORD 0 EngSpeed_rpm -6000.0 6000.0 /end CHARACTERISTIC
/begin CHARACTERISTIC ExtDem_Par7nPWinNeg_C "Negative small signal window for proportional component for parameter set 7" VALUE 0x3899D6 Scalar_SWORD 0 EngSpeed_rpm -6000.0 6000.0 /end CHARACTERISTIC
/begin CHARACTERISTIC ExtDem_Par7nPWinPos_C "Positive small signal window for proportional component for parameter set 7" VALUE 0x3899D8 Scalar_SWORD 0 EngSpeed_rpm -6000.0 6000.0 /end CHARACTERISTIC
/begin CHARACTERISTIC ExtDem_trqThresNTC_C "Threshold for the torque of the Negative Torque Converter" VALUE 0x389A3E Scalar_SWORD 0 Trq_Nm -3000.0 3000.0 /end CHARACTERISTIC
/begin CHARACTERISTIC ExtDem_Par0FacFdbkTrqLosHi_C "inner feedback factor for parameter set 0 high path" VALUE 0x38983C Scalar_SWORD 0 FdbkNm2rpm_rpm_Nm -20.0 20.0 /end CHARACTERISTIC
/begin CHARACTERISTIC ExtDem_Par0FacFdbkTrqLosLo_C "inner feedback factor for parameter set 0 low path" VALUE 0x38983E Scalar_SWORD 0 FdbkNm2rpm_rpm_Nm -20.0 20.0 /end CHARACTERISTIC
/begin CHARACTERISTIC ExtDem_Par1FacFdbkTrqLosHi_C "inner feedback factor for parameter set 1 high path" VALUE 0x389870 Scalar_SWORD 0 FdbkNm2rpm_rpm_Nm -20.0 20.0 /end CHARACTERISTIC
/begin CHARACTERISTIC ExtDem_Par1FacFdbkTrqLosLo_C "inner feedback factor for parameter set 1 low path" VALUE 0x389872 Scalar_SWORD 0 FdbkNm2rpm_rpm_Nm -20.0 20.0 /end CHARACTERISTIC
/begin CHARACTERISTIC ExtDem_Par2FacFdbkTrqLosHi_C "inner feedback factor for parameter set 2 high path" VALUE 0x3898A4 Scalar_SWORD 0 FdbkNm2rpm_rpm_Nm -20.0 20.0 /end CHARACTERISTIC
/begin CHARACTERISTIC ExtDem_Par2FacFdbkTrqLosLo_C "inner feedback factor for parameter set 2 low path" VALUE 0x3898A6 Scalar_SWORD 0 FdbkNm2rpm_rpm_Nm -20.0 20.0 /end CHARACTERISTIC
/begin CHARACTERISTIC ExtDem_Par3FacFdbkTrqLosHi_C "inner feedback factor for parameter set 3 high path" VALUE 0x3898D8 Scalar_SWORD 0 FdbkNm2rpm_rpm_Nm -20.0 20.0 /end CHARACTERISTIC
/begin CHARACTERISTIC ExtDem_Par3FacFdbkTrqLosLo_C "inner feedback factor for parameter set 3 low path" VALUE 0x3898DA Scalar_SWORD 0 FdbkNm2rpm_rpm_Nm -20.0 20.0 /end CHARACTERISTIC
/begin CHARACTERISTIC ExtDem_Par4FacFdbkTrqLosHi_C "inner feedback factor for parameter set 4 high path" VALUE 0x38990C Scalar_SWORD 0 FdbkNm2rpm_rpm_Nm -20.0 20.0 /end CHARACTERISTIC
/begin CHARACTERISTIC ExtDem_Par4FacFdbkTrqLosLo_C "inner feedback factor for parameter set 4 low path" VALUE 0x38990E Scalar_SWORD 0 FdbkNm2rpm_rpm_Nm -20.0 20.0 /end CHARACTERISTIC
/begin CHARACTERISTIC ExtDem_Par5FacFdbkTrqLosHi_C "inner feedback factor for parameter set 5 high path" VALUE 0x389940 Scalar_SWORD 0 FdbkNm2rpm_rpm_Nm -20.0 20.0 /end CHARACTERISTIC
/begin CHARACTERISTIC ExtDem_Par5FacFdbkTrqLosLo_C "inner feedback factor for parameter set 5 low path" VALUE 0x389942 Scalar_SWORD 0 FdbkNm2rpm_rpm_Nm -20.0 20.0 /end CHARACTERISTIC
/begin CHARACTERISTIC ExtDem_Par6FacFdbkTrqLosHi_C "inner feedback factor for parameter set 6 high path" VALUE 0x389974 Scalar_SWORD 0 FdbkNm2rpm_rpm_Nm -20.0 20.0 /end CHARACTERISTIC
/begin CHARACTERISTIC ExtDem_Par6FacFdbkTrqLosLo_C "inner feedback factor for parameter set 6 low path" VALUE 0x389976 Scalar_SWORD 0 FdbkNm2rpm_rpm_Nm -20.0 20.0 /end CHARACTERISTIC
/begin CHARACTERISTIC ExtDem_Par7FacFdbkTrqLosHi_C "inner feedback factor for parameter set 7 high path" VALUE 0x3899A8 Scalar_SWORD 0 FdbkNm2rpm_rpm_Nm -20.0 20.0 /end CHARACTERISTIC
/begin CHARACTERISTIC ExtDem_Par7FacFdbkTrqLosLo_C "inner feedback factor for parameter set 7 low path" VALUE 0x3899AA Scalar_SWORD 0 FdbkNm2rpm_rpm_Nm -20.0 20.0 /end CHARACTERISTIC
/begin CHARACTERISTIC ExtDem_facFdbkLimit_C "Default value of feedback factor" VALUE 0x3899DA Scalar_SWORD 0 FdbkNm2rpm_rpm_Nm -20.0 20.0 /end CHARACTERISTIC
/begin CHARACTERISTIC ExtDem_facFdbkParSet0_C "Feedback factor for parameter set 0" VALUE 0x3899DC Scalar_SWORD 0 FdbkNm2rpm_rpm_Nm -20.0 20.0 /end CHARACTERISTIC
/begin CHARACTERISTIC ExtDem_facFdbkParSet1_C "Feedback factor for parameter set 1" VALUE 0x3899DE Scalar_SWORD 0 FdbkNm2rpm_rpm_Nm -20.0 20.0 /end CHARACTERISTIC
/begin CHARACTERISTIC ExtDem_facFdbkParSet2_C "Feedback factor for parameter set 2" VALUE 0x3899E0 Scalar_SWORD 0 FdbkNm2rpm_rpm_Nm -20.0 20.0 /end CHARACTERISTIC
/begin CHARACTERISTIC ExtDem_facFdbkParSet3_C "Feedback factor for parameter set 3" VALUE 0x3899E2 Scalar_SWORD 0 FdbkNm2rpm_rpm_Nm -20.0 20.0 /end CHARACTERISTIC
/begin CHARACTERISTIC ExtDem_facFdbkParSet4_C "Feedback factor for parameter set 4" VALUE 0x3899E4 Scalar_SWORD 0 FdbkNm2rpm_rpm_Nm -20.0 20.0 /end CHARACTERISTIC
/begin CHARACTERISTIC ExtDem_facFdbkParSet5_C "Feedback factor for parameter set 5" VALUE 0x3899E6 Scalar_SWORD 0 FdbkNm2rpm_rpm_Nm -20.0 20.0 /end CHARACTERISTIC
/begin CHARACTERISTIC ExtDem_facFdbkParSet6_C "Feedback factor for parameter set 6" VALUE 0x3899E8 Scalar_SWORD 0 FdbkNm2rpm_rpm_Nm -20.0 20.0 /end CHARACTERISTIC
/begin CHARACTERISTIC ExtDem_facFdbkParSet7_C "Feedback factor for parameter set 7" VALUE 0x3899EA Scalar_SWORD 0 FdbkNm2rpm_rpm_Nm -20.0 20.0 /end CHARACTERISTIC
/begin CHARACTERISTIC ExtDem_facNAvrgPT1CorFac_C "Time constant for PT1 delay element of engine speed filtering" VALUE 0x389A28 Scalar_UWORD 0 PT_fac 0.0 99.998 /end CHARACTERISTIC
/begin CHARACTERISTIC ExtDem_facTrqPT1CorFac_C "Time constant for PT1 delay element of torque filtering correction factor" VALUE 0x389A2A Scalar_UWORD 0 PT_fac 0.0 99.998 /end CHARACTERISTIC
/begin CHARACTERISTIC ExtDem_Par0InrtVeh_C "inertial value for inner feedback factor for parameter set 0" VALUE 0x38984C Scalar_SWORD 0 HLSDem_Inrt -50.0 50.0 /end CHARACTERISTIC
/begin CHARACTERISTIC ExtDem_Par1InrtVeh_C "inertial value for inner feedback factor for parameter set 1" VALUE 0x389880 Scalar_SWORD 0 HLSDem_Inrt -50.0 50.0 /end CHARACTERISTIC
/begin CHARACTERISTIC ExtDem_Par2InrtVeh_C "inertial value for inner feedback factor for parameter set 2" VALUE 0x3898B4 Scalar_SWORD 0 HLSDem_Inrt -50.0 50.0 /end CHARACTERISTIC
/begin CHARACTERISTIC ExtDem_Par3InrtVeh_C "inertial value for inner feedback factor for parameter set 3" VALUE 0x3898E8 Scalar_SWORD 0 HLSDem_Inrt -50.0 50.0 /end CHARACTERISTIC
/begin CHARACTERISTIC ExtDem_Par4InrtVeh_C "inertial value for inner feedback factor for parameter set 4" VALUE 0x38991C Scalar_SWORD 0 HLSDem_Inrt -50.0 50.0 /end CHARACTERISTIC
/begin CHARACTERISTIC ExtDem_Par5InrtVeh_C "inertial value for inner feedback factor for parameter set 5" VALUE 0x389950 Scalar_SWORD 0 HLSDem_Inrt -50.0 50.0 /end CHARACTERISTIC
/begin CHARACTERISTIC ExtDem_Par6InrtVeh_C "inertial value for inner feedback factor for parameter set 6" VALUE 0x389984 Scalar_SWORD 0 HLSDem_Inrt -50.0 50.0 /end CHARACTERISTIC
/begin CHARACTERISTIC ExtDem_Par7InrtVeh_C "inertial value for inner feedback factor for parameter set 7" VALUE 0x3899B8 Scalar_SWORD 0 HLSDem_Inrt -50.0 50.0 /end CHARACTERISTIC
/begin CHARACTERISTIC ExtDem_Par0Cfg_C "Configuration of EISGov structure parameterset 0" VALUE 0x38983A Scalar_UBYTE 0 State_uint8 0.0 255.0 /end CHARACTERISTIC
/begin CHARACTERISTIC ExtDem_Par1Cfg_C "Configuration of EISGov structure parameterset 1" VALUE 0x38986E Scalar_UBYTE 0 State_uint8 0.0 255.0 /end CHARACTERISTIC
/begin CHARACTERISTIC ExtDem_Par2Cfg_C "Configuration of EISGov structure parameterset 2" VALUE 0x3898A2 Scalar_UBYTE 0 State_uint8 0.0 255.0 /end CHARACTERISTIC
/begin CHARACTERISTIC ExtDem_Par3Cfg_C "Configuration of EISGov structure parameterset 3" VALUE 0x3898D6 Scalar_UBYTE 0 State_uint8 0.0 255.0 /end CHARACTERISTIC
/begin CHARACTERISTIC ExtDem_Par4Cfg_C "Configuration of EISGov structure parameterset 4" VALUE 0x38990A Scalar_UBYTE 0 State_uint8 0.0 255.0 /end CHARACTERISTIC
/begin CHARACTERISTIC ExtDem_Par5Cfg_C "Configuration of EISGov structure parameterset 5" VALUE 0x38993E Scalar_UBYTE 0 State_uint8 0.0 255.0 /end CHARACTERISTIC
/begin CHARACTERISTIC ExtDem_Par6Cfg_C "Configuration of EISGov structure parameterset 6" VALUE 0x389972 Scalar_UBYTE 0 State_uint8 0.0 255.0 /end CHARACTERISTIC
/begin CHARACTERISTIC ExtDem_Par7Cfg_C "Configuration of EISGov structure parameterset 7" VALUE 0x3899A6 Scalar_UBYTE 0 State_uint8 0.0 255.0 /end CHARACTERISTIC
/begin CHARACTERISTIC ExtDem_swtCANActv_C "Switch to select feedback factor via CAN" VALUE 0x389A35 Scalar_UBYTE 0 State_uint8 0.0 255.0 /end CHARACTERISTIC
/begin CHARACTERISTIC ExtDem_swtFacFdbkSel_C "Switch to select parameter set feedback factor and upper external ontervention setpoint dependent feedback factor" VALUE 0x389A36 Scalar_UBYTE 0 State_uint8 0.0 255.0 /end CHARACTERISTIC
/begin CHARACTERISTIC ExtDem_swtNSelCorFac_C "switch for selection of engine speed for parameter selection" VALUE 0x389A37 Scalar_UBYTE 0 State_uint8 0.0 255.0 /end CHARACTERISTIC
/begin CHARACTERISTIC ExtDem_swtParCorActv_C "Switch for activation of parameter set correction" VALUE 0x389A38 Scalar_UBYTE 0 State_uint8 0.0 255.0 /end CHARACTERISTIC
/begin CHARACTERISTIC ExtDem_swtTrqSelCorFac_C "Switch for selection of torque for parameter correction" VALUE 0x389A3A Scalar_UBYTE 0 State_uint8 0.0 255.0 /end CHARACTERISTIC
/begin CHARACTERISTIC ExtDem_swtTempSel_C "Switch for selection of temperature from engine temperature field，0-->coolant_temperature,1-->oil_temperature,2-->EngDa_tEng" VALUE 0x389A39 Scalar_UBYTE 0 EngTempFldSel_conv 0 2 /end CHARACTERISTIC
/begin AXIS_PTS ExtDem_KiCorTempFac_MAPX "Temperature external intervention upper setpoint based correction map for Ki gain X axis" 0x389542 ExtDem_nSetP_mp Lookup2D_X_WORD 0 EngSpeed_rpm 10 0.0 6000.0 /end AXIS_PTS
/begin AXIS_PTS ExtDem_KiCorTempFac_MAPY "Temperature external intervention upper setpoint based correction map for Ki gain Y axis" 0x389556 ExtDem_tParAdap_mp Lookup2D_X_WORD 0 Temp_deg 10 -50.0 150.0 /end AXIS_PTS
/begin AXIS_PTS ExtDem_KiCorTrqFac_MAPX "Load based correction factor map for I gain X axis" 0x389632 ExtDem_nSelCorFac_mp Lookup2D_X_WORD 0 EngSpeed_rpm 10 0.0 6000.0 /end AXIS_PTS
/begin AXIS_PTS ExtDem_KiCorTrqFac_MAPY "Load based correction factor map for I gain Y axis" 0x389646 NO_INPUT_QUANTITY Lookup2D_X_WORD 0 Trq_Nm 10 -3000.0 3000.0 /end AXIS_PTS
/begin AXIS_PTS ExtDem_KpCorTempFac_MAPX "Temperature external intervention upper setpoint based correction map for Kp gain X axis" 0x389722 ExtDem_nSetP_mp Lookup2D_X_WORD 0 EngSpeed_rpm 10 0.0 6000.0 /end AXIS_PTS
/begin AXIS_PTS ExtDem_KpCorTempFac_MAPY "Temperature external intervention upper setpoint based correction map for Kp gain Y axis" 0x389736 ExtDem_tParAdap_mp Lookup2D_X_WORD 0 Temp_deg 10 -50.0 150.0 /end AXIS_PTS
/begin AXIS_PTS ExtDem_KpCorTrqFac_MAPX "Load based correction factor map for P gain X axis" 0x389812 ExtDem_nSelCorFac_mp Lookup2D_X_WORD 0 EngSpeed_rpm 10 0.0 6000.0 /end AXIS_PTS
/begin AXIS_PTS ExtDem_KpCorTrqFac_MAPY "Load based correction factor map for P gain Y axis" 0x389826 NO_INPUT_QUANTITY Lookup2D_X_WORD 0 Trq_Nm 10 -3000.0 3000.0 /end AXIS_PTS
/begin AXIS_PTS ExtDem_facFdbk_CURX "Upper external intervention setpoint speed basedfeedback factor curve ExtDem_facfdbk_CUR X axis" 0x389A0A CoETS_nTSEASpdDes Lookup1D_X_WORD 0 EngSpeed_rpm 15 0.0 6000.0 /end AXIS_PTS
/begin CHARACTERISTIC ExtDem_tiTrqPT1_C "Filter of the torque filter" VALUE 0x389A3C Scalar_UWORD 0 PT_fac 0.0 99.998 /end CHARACTERISTIC
/begin CHARACTERISTIC ExtDem_swtTrqSel_C "Selection of torque signal for torque in setpoint correction by outer feedback(0-set torque,1- current torque, 2 - lead torque)" VALUE 0x389A3B Scalar_UBYTE 0 State_uint8 0.0 255.0 /end CHARACTERISTIC
/begin CHARACTERISTIC EISGov_nOfsPreCtlActvFall_CUR "Transformation curve to DT1 activate speed based on engine temp" CURVE 0x387652 Lookup1D_WORD 0 EngSpeed_rpm 0.0 3000.0
 /begin AXIS_DESCR COM_AXIS HLSDem_tConv_mp Temp_deg 15 -150.0 150.0 AXIS_PTS_REF EISGov_nOfsPreCtlActvFall_CURX /end AXIS_DESCR
/end CHARACTERISTIC
/begin CHARACTERISTIC HLSDem_trqReqStrt_CUR "Transformation curve to convert total ratio of the power train to torque" CURVE 0x38A5F4 Lookup1D_WORD 0 Trq_Nm -3000.0 3000.0
 /begin AXIS_DESCR COM_AXIS HLSDem_tTrqReqStrt_mp Temp_deg 15 -150.0 150.0 AXIS_PTS_REF HLSDem_trqReqStrt_CURX /end AXIS_DESCR
/end CHARACTERISTIC
/begin CHARACTERISTIC HLSDem_GripPredef_CUR "Transformation curve to convert total ratio of the power train to torque" CURVE 0x38A08C Lookup1D_WORD 0 Trq_Nm -3000.0 3000.0
 /begin AXIS_DESCR COM_AXIS GlbDa_rTrqTot TransRatio 8 -100.0 100.0 AXIS_PTS_REF HLSDem_GripPredef_CURX /end AXIS_DESCR
/end CHARACTERISTIC
/begin CHARACTERISTIC HLSDem_facGripPredef_CUR "Transformation curve to convert temperatur to factor In state \" grip\"" CURVE 0x38A440 Lookup1D_WORD 0 Prc_Fact100 0.0 200.0
 /begin AXIS_DESCR COM_AXIS HLSDem_tConv_mp Temp_deg 12 -150.0 150.0 AXIS_PTS_REF HLSDem_facGripPredef_CURX /end AXIS_DESCR
/end CHARACTERISTIC
/begin CHARACTERISTIC HLSDem_facNoGripPredef_CUR "Transformation curve to convert temperatur to factor In state \"no grip\"" CURVE 0x38A472 Lookup1D_WORD 0 Prc_Fact100 0.0 200.0
 /begin AXIS_DESCR COM_AXIS HLSDem_tConv_mp Temp_deg 12 -150.0 150.0 AXIS_PTS_REF HLSDem_facNoGripPredef_CURX /end AXIS_DESCR
/end CHARACTERISTIC
/begin CHARACTERISTIC HLSDem_rAPPThresFrzI_C "Threshold for accelerator pedal for freezing of lower integrator" VALUE 0x38A548 Scalar_SWORD 0 Accpedal_rate -200.0 200.0 /end CHARACTERISTIC
/begin CHARACTERISTIC HLSDem_rAPPThresTrqDem_C "Threshold for accelerator pedal sensor value for resetting the HLSDem \"Torque demand\"" VALUE 0x38A54A Scalar_SWORD 0 Accpedal_rate -200.0 200.0 /end CHARACTERISTIC
/begin CHARACTERISTIC EISGov_nOfsPreCtlActvFall_C "Engine speed offset for detection of HLSDem state \"Underbraking\"" VALUE 0x387650 Scalar_SWORD 0 EngSpeed_rpm -6000.0 6000.0 /end CHARACTERISTIC
/begin CHARACTERISTIC EISGov_nOfsPreCtlINActvFall_C "Engine speed offset for detection of HLSDem state \"Underbraking\"" VALUE 0x38768E Scalar_SWORD 0 EngSpeed_rpm -6000.0 6000.0 /end CHARACTERISTIC
/begin CHARACTERISTIC EISGov_nOfsPreCtlPrepFall_C "Engine speed offset for detection of HLSDem state \"Underbraking\"" VALUE 0x387690 Scalar_SWORD 0 EngSpeed_rpm -6000.0 6000.0 /end CHARACTERISTIC
/begin CHARACTERISTIC EISGov_nPreCtlPrepFalloffset_C "Engine speed offset for detection of HLSDem state \"Underbraking\"" VALUE 0x387692 Scalar_SWORD 0 EngSpeed_rpm 0.0 3000.0 /end CHARACTERISTIC
/begin CHARACTERISTIC HLSDem_nOfsPredef_C "Engine speed offset for detection of HLSDem state \"Underbraking\"" VALUE 0x38A4B0 Scalar_SWORD 0 EngSpeed_rpm -6000.0 6000.0 /end CHARACTERISTIC
/begin CHARACTERISTIC HLSDem_nOfsUndrBrk_C "Engine speed offset for detection of HLSDem state \"Underbraking\"" VALUE 0x38A4B2 Scalar_SWORD 0 EngSpeed_rpm -6000.0 6000.0 /end CHARACTERISTIC
/begin CHARACTERISTIC LIGov_nOffsetPreCtltrqDem_C "Engine speed offset for detection of HLSDem state \"Underbraking\"" VALUE 0x394E52 Scalar_SWORD 0 EngSpeed_rpm -6000.0 6000.0 /end CHARACTERISTIC
/begin CHARACTERISTIC HLSDem_rGripUndrBrkThres_C "Threshold for detection of \"grip\" for the condition \"underbraking\"" VALUE 0x38A54C Scalar_SWORD 0 Prc_Fact100 -100.0 100.0 /end CHARACTERISTIC
/begin CHARACTERISTIC HLSDem_rNoGripThres_C "Threshold for detection of \"no grip\"" VALUE 0x38A54E Scalar_SWORD 0 Prc_Fact100 -100.0 100.0 /end CHARACTERISTIC
/begin CHARACTERISTIC HLSDem_vThresUndrBrk_C "Threshold speed for HLSDem state \"Underbraking\"" VALUE 0x38A630 Scalar_SWORD 0 VehSpeed_km_h 0.0 250.0 /end CHARACTERISTIC
/begin CHARACTERISTIC HLSDem_NoGripPredef_C "Predefined torque for parameterset NoGrip" VALUE 0x38A3C4 Scalar_SWORD 0 Trq_Nm -3000.0 3000.0 /end CHARACTERISTIC
/begin CHARACTERISTIC HLSDem_stIFrzInhib_C "Inhibit status of integrator freeze" VALUE 0x38A553 Scalar_BOOLEAN 0 boolean 0.0 1.0 /end CHARACTERISTIC
/begin CHARACTERISTIC HLSDem_swtAPPFrzI_C "Switch for the selection of filtered (0) or unfiltered (1) accelerator pedal sensor value for the determination of the HLSDem state \"Integrator freeze" VALUE 0x38A559 Scalar_UBYTE 0 Switch_conv 0 1 /end CHARACTERISTIC
/begin CHARACTERISTIC HLSDem_swtAPPTrqDem_C "Switch for the selection of filtered (0) or unfiltered (1) accelerator pedal sensor value for the determination of the HLSDem state \"Torque demand\"" VALUE 0x38A55A Scalar_UBYTE 0 Switch_conv 0 1 /end CHARACTERISTIC
/begin CHARACTERISTIC HLSDem_swtPredef_C "Switch for the selection of filtered (0) or unfiltered (1) accelerator pedal sensor value for the determination of the HLSDem state \"Integrator freeze" VALUE 0x38A55E Scalar_UBYTE 0 Switch_conv 0 1 /end CHARACTERISTIC
/begin CHARACTERISTIC HLSDem_numTempSelConv_C "0-->coolant_temperature,1-->oil_temperature,2-->EngDa_tEng" VALUE 0x38A546 Scalar_UBYTE 0 EngTempFldSel_conv 0 2 /end CHARACTERISTIC
/begin AXIS_PTS EISGov_nOfsPreCtlActvFall_CURX "Transformation axis to convert temperatur to factor In state \"no grip\"" 0x387670 HLSDem_tConv_mp Lookup1D_X_WORD 0 Temp_deg 15 -150.0 150.0 /end AXIS_PTS
/begin AXIS_PTS HLSDem_trqReqStrt_CURX "Transformation axis to convert temperatur to factor In state \"no grip\"" 0x38A612 HLSDem_tTrqReqStrt_mp Lookup1D_X_WORD 0 Temp_deg 15 -150.0 150.0 /end AXIS_PTS
/begin AXIS_PTS HLSDem_GripPredef_CURX "Transformation axis to convert total ratio of the power train to torque" 0x38A09C GlbDa_rTrqTot Lookup1D_X_WORD 0 TransRatio 8 -100.0 100.0 /end AXIS_PTS
/begin AXIS_PTS HLSDem_facGripPredef_CURX "Transformation axis to convert temperatur to factor In state \"grip\"" 0x38A458 HLSDem_tConv_mp Lookup1D_X_WORD 0 Temp_deg 12 -150.0 150.0 /end AXIS_PTS
/begin AXIS_PTS HLSDem_facNoGripPredef_CURX "Transformation axis to convert temperatur to factor In state \"no grip\"" 0x38A48A HLSDem_tConv_mp Lookup1D_X_WORD 0 Temp_deg 12 -150.0 150.0 /end AXIS_PTS
/begin CHARACTERISTIC HLSDem_KiCorFac_MAP "Correction factor MAP for I gain" MAP 0x38A0CE Lookup2D_WORD 0 Factor -30.0 30.0
 /begin AXIS_DESCR COM_AXIS HLSDem_nAvrgFlt_mp EngSpeed_rpm 8 -6000.0 6000.0 AXIS_PTS_REF HLSDem_KiCorFac_MAPX /end AXIS_DESCR
 /begin AXIS_DESCR COM_AXIS HLSDem_tParAdap_mp Temp_deg 5 -150.0 150.0 AXIS_PTS_REF HLSDem_KiCorFac_MAPY /end AXIS_DESCR
/end CHARACTERISTIC
/begin CHARACTERISTIC HLSDem_KiCorTrqFac_MAP "Torque dependent correction factor MAP for I gain" MAP 0x38A138 Lookup2D_WORD 0 Factor -30.0 30.0
 /begin AXIS_DESCR COM_AXIS HLSDem_trqCorFacFlt_mp Trq_Nm 10 -3000.0 3000.0 AXIS_PTS_REF HLSDem_KiCorTrqFac_MAPX /end AXIS_DESCR
 /begin AXIS_DESCR COM_AXIS HLSDem_nAvrgFlt_mp EngSpeed_rpm 10 -6000.0 6000.0 AXIS_PTS_REF HLSDem_KiCorTrqFac_MAPY /end AXIS_DESCR
/end CHARACTERISTIC
/begin CHARACTERISTIC HLSDem_KpCorFac_MAP "Correction factor MAP for P gain" MAP 0x38A228 Lookup2D_WORD 0 Factor -30.0 30.0
 /begin AXIS_DESCR COM_AXIS HLSDem_nAvrgFlt_mp EngSpeed_rpm 8 -6000.0 6000.0 AXIS_PTS_REF HLSDem_KpCorFac_MAPX /end AXIS_DESCR
 /begin AXIS_DESCR COM_AXIS HLSDem_tParAdap_mp Temp_deg 5 -150.0 150.0 AXIS_PTS_REF HLSDem_KpCorFac_MAPY /end AXIS_DESCR
/end CHARACTERISTIC
/begin CHARACTERISTIC HLSDem_KpCorTrqFac_MAP "Torque dependent correction factor MAP for P gain" MAP 0x38A292 Lookup2D_WORD 0 Factor -30.0 30.0
 /begin AXIS_DESCR COM_AXIS HLSDem_trqCorFacFlt_mp Trq_Nm 10 -3000.0 3000.0 AXIS_PTS_REF HLSDem_KpCorTrqFac_MAPX /end AXIS_DESCR
 /begin AXIS_DESCR COM_AXIS HLSDem_nAvrgFlt_mp EngSpeed_rpm 10 -6000.0 6000.0 AXIS_PTS_REF HLSDem_KpCorTrqFac_MAPY /end AXIS_DESCR
/end CHARACTERISTIC
/begin CHARACTERISTIC HLSDem_InrtVehGrip_CUR "Vehicle grip inertia" CURVE 0x38A0AC Lookup1D_WORD 0 HLSDem_Inrt -50.0 50.0
 /begin AXIS_DESCR COM_AXIS GlbDa_rTrqTot TransRatio 8 -100.0 100.0 AXIS_PTS_REF HLSDem_InrtVehGrip_CURX /end AXIS_DESCR
/end CHARACTERISTIC
/begin CHARACTERISTIC HLSDem_facFdbkTrqLosHiGrip_CUR "Torque lost high path feed back factor " CURVE 0x38A3FC Lookup1D_WORD 0 FdbkNm2rpm_rpm_Nm -20.0 20.0
 /begin AXIS_DESCR COM_AXIS GlbDa_rTrqTot TransRatio 8 -100.0 100.0 AXIS_PTS_REF HLSDem_facFdbkTrqLosHiGrip_CURX /end AXIS_DESCR
/end CHARACTERISTIC
/begin CHARACTERISTIC HLSDem_facFdbkTrqLosLoGrip_CUR "Torque lost low path feed back factor " CURVE 0x38A41E Lookup1D_WORD 0 FdbkNm2rpm_rpm_Nm -20.0 20.0
 /begin AXIS_DESCR COM_AXIS GlbDa_rTrqTot TransRatio 8 -100.0 100.0 AXIS_PTS_REF HLSDem_facFdbkTrqLosLoGrip_CURX /end AXIS_DESCR
/end CHARACTERISTIC
/begin CHARACTERISTIC HLSDem_tiFltTrqLosGrip_CUR "Grip filter torque lost time " CURVE 0x38A56A Lookup1D_UWORD 0 PT_fac 0.0 99.998
 /begin AXIS_DESCR COM_AXIS GlbDa_rTrqTot TransRatio 8 -100.0 100.0 AXIS_PTS_REF HLSDem_tiFltTrqLosGrip_CURX /end AXIS_DESCR
/end CHARACTERISTIC
/begin CHARACTERISTIC HLSDem_GripIKiHi_CUR "Transformation curve to convert transmission ratio to I-component small signal for parameterset Grip upper PI-path" CURVE 0x389E3C Lookup1D_SLONG 0 HLSDem_Ki -18000.0 18000.0
 /begin AXIS_DESCR COM_AXIS GlbDa_rTrqTot TransRatio 8 -100.0 100.0 AXIS_PTS_REF HLSDem_GripIKiHi_CURX /end AXIS_DESCR
/end CHARACTERISTIC
/begin CHARACTERISTIC HLSDem_GripIKiLo_CUR "Transformation curve to convert transmission ratio to I-component small signal for parameterset Grip lower PI-path" CURVE 0x389E6C Lookup1D_SLONG 0 HLSDem_Ki -18000.0 18000.0
 /begin AXIS_DESCR COM_AXIS GlbDa_rTrqTot TransRatio 8 -100.0 100.0 AXIS_PTS_REF HLSDem_GripIKiLo_CURX /end AXIS_DESCR
/end CHARACTERISTIC
/begin CHARACTERISTIC HLSDem_GripIKiNegHi_CUR "Transformation curve to convert transmission ratio to I-component  negative large signal for parameterset Grip upper PI-path" CURVE 0x389E9C Lookup1D_SLONG 0 HLSDem_Ki -18000.0 18000.0
 /begin AXIS_DESCR COM_AXIS GlbDa_rTrqTot TransRatio 8 -100.0 100.0 AXIS_PTS_REF HLSDem_GripIKiNegHi_CURX /end AXIS_DESCR
/end CHARACTERISTIC
/begin CHARACTERISTIC HLSDem_GripIKiNegLo_CUR "Transformation curve to convert transmission ratio to I-component  negative large signal for parameterset Grip lower PI-path" CURVE 0x389ECC Lookup1D_SLONG 0 HLSDem_Ki -18000.0 18000.0
 /begin AXIS_DESCR COM_AXIS GlbDa_rTrqTot TransRatio 8 -100.0 100.0 AXIS_PTS_REF HLSDem_GripIKiNegLo_CURX /end AXIS_DESCR
/end CHARACTERISTIC
/begin CHARACTERISTIC HLSDem_GripIKiPosHi_CUR "Transformation curve to convert transmission ratio to I-component  positive large signal for parameterset Grip upper PI-path" CURVE 0x389EFC Lookup1D_SLONG 0 HLSDem_Ki -18000.0 18000.0
 /begin AXIS_DESCR COM_AXIS GlbDa_rTrqTot TransRatio 8 -100.0 100.0 AXIS_PTS_REF HLSDem_GripIKiPosHi_CURX /end AXIS_DESCR
/end CHARACTERISTIC
/begin CHARACTERISTIC HLSDem_GripIKiPosLo_CUR "Transformation curve to convert transmission ratio to I-component  positive large signal for parameterset Grip lower PI-path" CURVE 0x389F2C Lookup1D_SLONG 0 HLSDem_Ki -18000.0 18000.0
 /begin AXIS_DESCR COM_AXIS GlbDa_rTrqTot TransRatio 8 -100.0 100.0 AXIS_PTS_REF HLSDem_GripIKiPosLo_CURX /end AXIS_DESCR
/end CHARACTERISTIC
/begin CHARACTERISTIC HLSDem_GripPKpHi_CUR "Transformation curve to convert transmission ratio to P-component small signal for parameterset Grip upper PI-path" CURVE 0x389F64 Lookup1D_SLONG 0 HLSDem_Kp -10000.0 10000.0
 /begin AXIS_DESCR COM_AXIS GlbDa_rTrqTot TransRatio 8 -100.0 100.0 AXIS_PTS_REF HLSDem_GripPKpHi_CURX /end AXIS_DESCR
/end CHARACTERISTIC
/begin CHARACTERISTIC HLSDem_GripPKpLo_CUR "Transformation curve to convert transmission ratio to P-component small signal for parameterset Grip lower PI-path" CURVE 0x389F94 Lookup1D_SLONG 0 HLSDem_Kp -10000.0 10000.0
 /begin AXIS_DESCR COM_AXIS GlbDa_rTrqTot TransRatio 8 -100.0 100.0 AXIS_PTS_REF HLSDem_GripPKpLo_CURX /end AXIS_DESCR
/end CHARACTERISTIC
/begin CHARACTERISTIC HLSDem_GripPKpNegHi_CUR "Transformation curve to convert transmission ratio to P-component  negative large signal for parameterset Grip upper PI-path" CURVE 0x389FC4 Lookup1D_SLONG 0 HLSDem_Kp -10000.0 10000.0
 /begin AXIS_DESCR COM_AXIS GlbDa_rTrqTot TransRatio 8 -100.0 100.0 AXIS_PTS_REF HLSDem_GripPKpNegHi_CURX /end AXIS_DESCR
/end CHARACTERISTIC
/begin CHARACTERISTIC HLSDem_GripPKpNegLo_CUR "Transformation curve to convert transmission ratio to P-component  negative large signal for parameterset Grip lower PI-path" CURVE 0x389FF4 Lookup1D_SLONG 0 HLSDem_Kp -10000.0 10000.0
 /begin AXIS_DESCR COM_AXIS GlbDa_rTrqTot TransRatio 8 -100.0 100.0 AXIS_PTS_REF HLSDem_GripPKpNegLo_CURX /end AXIS_DESCR
/end CHARACTERISTIC
/begin CHARACTERISTIC HLSDem_GripPKpPosHi_CUR "Transformation curve to convert transmission ratio to P-component  positive large signal for parameterset Grip upper PI-path" CURVE 0x38A024 Lookup1D_SLONG 0 HLSDem_Kp -10000.0 10000.0
 /begin AXIS_DESCR COM_AXIS GlbDa_rTrqTot TransRatio 8 -100.0 100.0 AXIS_PTS_REF HLSDem_GripPKpPosHi_CURX /end AXIS_DESCR
/end CHARACTERISTIC
/begin CHARACTERISTIC HLSDem_GripPKpPosLo_CUR "Transformation curve to convert transmission ratio to P-component  positive large signal for parameterset Grip lower PI-path" CURVE 0x38A054 Lookup1D_SLONG 0 HLSDem_Kp -10000.0 10000.0
 /begin AXIS_DESCR COM_AXIS GlbDa_rTrqTot TransRatio 8 -100.0 100.0 AXIS_PTS_REF HLSDem_GripPKpPosLo_CURX /end AXIS_DESCR
/end CHARACTERISTIC
/begin CHARACTERISTIC HLSDem_NoGripPKpHi_C "P-component small signal for parameterset NoGrip upper PI-path" VALUE 0x38A3A4 Scalar_LONG 0 HLSDem_Kp -10000.0 10000.0 /end CHARACTERISTIC
/begin CHARACTERISTIC HLSDem_NoGripPKpLo_C "P-component small signal for parameterset NoGrip lower PI-path" VALUE 0x38A3A8 Scalar_LONG 0 HLSDem_Kp -10000.0 10000.0 /end CHARACTERISTIC
/begin CHARACTERISTIC HLSDem_NoGripPKpNegHi_C "P-component negative large signal for parameterset NoGrip upper PI-path" VALUE 0x38A3AC Scalar_LONG 0 HLSDem_Kp -10000.0 10000.0 /end CHARACTERISTIC
/begin CHARACTERISTIC HLSDem_NoGripPKpNegLo_C "P-component negative large signal for parameterset NoGrip lower PI-path" VALUE 0x38A3B0 Scalar_LONG 0 HLSDem_Kp -10000.0 10000.0 /end CHARACTERISTIC
/begin CHARACTERISTIC HLSDem_NoGripPKpPosHi_C "P-component positive large signal for parameterset NoGrip upper PI-path" VALUE 0x38A3B4 Scalar_LONG 0 HLSDem_Kp -10000.0 10000.0 /end CHARACTERISTIC
/begin CHARACTERISTIC HLSDem_NoGripPKpPosLo_C "P-component positive large signal for parameterset NoGrip lower PI-path" VALUE 0x38A3B8 Scalar_LONG 0 HLSDem_Kp -10000.0 10000.0 /end CHARACTERISTIC
/begin CHARACTERISTIC HLSDem_NoGripIKiHi_C "I-component small signal for parameterset NoGrip upper PI-path" VALUE 0x38A384 Scalar_LONG 0 HLSDem_Ki -18000.0 18000.0 /end CHARACTERISTIC
/begin CHARACTERISTIC HLSDem_NoGripIKiLo_C "I-component small signal for parameterset NoGrip lower PI-path" VALUE 0x38A388 Scalar_LONG 0 HLSDem_Ki -18000.0 18000.0 /end CHARACTERISTIC
/begin CHARACTERISTIC HLSDem_NoGripIKiNegHi_C "I-component negative large signal for parameterset NoGrip upper PI-path" VALUE 0x38A38C Scalar_LONG 0 HLSDem_Ki -18000.0 18000.0 /end CHARACTERISTIC
/begin CHARACTERISTIC HLSDem_NoGripIKiNegLo_C "I-component negative large signal for parameterset NoGrip lower PI-path" VALUE 0x38A390 Scalar_LONG 0 HLSDem_Ki -18000.0 18000.0 /end CHARACTERISTIC
/begin CHARACTERISTIC HLSDem_NoGripIKiPosHi_C "I-component positive large signal for parameterset NoGrip upper PI-path" VALUE 0x38A394 Scalar_LONG 0 HLSDem_Ki -18000.0 18000.0 /end CHARACTERISTIC
/begin CHARACTERISTIC HLSDem_NoGripIKiPosLo_C "I-component positive large signal for parameterset NoGrip lower PI-path" VALUE 0x38A398 Scalar_LONG 0 HLSDem_Ki -18000.0 18000.0 /end CHARACTERISTIC
/begin CHARACTERISTIC HLSDem_GripIWinNegHi_C "I component negative window for parameterset Grip upper PI- path" VALUE 0x389F5C Scalar_SWORD 0 EngSpeed_rpm -6000.0 6000.0 /end CHARACTERISTIC
/begin CHARACTERISTIC HLSDem_GripIWinNegLo_C "I component negative window for parameterset Grip lower PI- path" VALUE 0x389F5E Scalar_SWORD 0 EngSpeed_rpm -6000.0 6000.0 /end CHARACTERISTIC
/begin CHARACTERISTIC HLSDem_GripIWinPosHi_C "I component positive window for parameterset Grip upper PI- path" VALUE 0x389F60 Scalar_SWORD 0 EngSpeed_rpm -6000.0 6000.0 /end CHARACTERISTIC
/begin CHARACTERISTIC HLSDem_GripIWinPosLo_C "I component positive window for parameterset Grip lower PI- path" VALUE 0x389F62 Scalar_SWORD 0 EngSpeed_rpm -6000.0 6000.0 /end CHARACTERISTIC
/begin CHARACTERISTIC HLSDem_GripPWinNegHi_C "P-component negative window for parameterset Grip upper PI-path" VALUE 0x38A084 Scalar_SWORD 0 EngSpeed_rpm -6000.0 6000.0 /end CHARACTERISTIC
/begin CHARACTERISTIC HLSDem_GripPWinNegLo_C "P-component negative window for parameterset Grip lower PI-path" VALUE 0x38A086 Scalar_SWORD 0 EngSpeed_rpm -6000.0 6000.0 /end CHARACTERISTIC
/begin CHARACTERISTIC HLSDem_GripPWinPosHi_C "P-component positive window for parameterset Grip upper PI-path" VALUE 0x38A088 Scalar_SWORD 0 EngSpeed_rpm -6000.0 6000.0 /end CHARACTERISTIC
/begin CHARACTERISTIC HLSDem_GripPWinPosLo_C "P-component positive window for parameterset Grip lower PI-path" VALUE 0x38A08A Scalar_SWORD 0 EngSpeed_rpm -6000.0 6000.0 /end CHARACTERISTIC
/begin CHARACTERISTIC HLSDem_NoGripIWinNegHi_C "I-component negative window for parameterset NoGrip upper PI-path" VALUE 0x38A39C Scalar_SWORD 0 EngSpeed_rpm -6000.0 6000.0 /end CHARACTERISTIC
/begin CHARACTERISTIC HLSDem_NoGripIWinNegLo_C "I-component negative window for parameterset NoGrip lower PI-path" VALUE 0x38A39E Scalar_SWORD 0 EngSpeed_rpm -6000.0 6000.0 /end CHARACTERISTIC
/begin CHARACTERISTIC HLSDem_NoGripIWinPosHi_C "I-component positive window for parameterset NoGrip upper PI-path" VALUE 0x38A3A0 Scalar_SWORD 0 EngSpeed_rpm -6000.0 6000.0 /end CHARACTERISTIC
/begin CHARACTERISTIC HLSDem_NoGripIWinPosLo_C "I-component positive window for parameterset NoGrip lower PI-path" VALUE 0x38A3A2 Scalar_SWORD 0 EngSpeed_rpm -6000.0 6000.0 /end CHARACTERISTIC
/begin CHARACTERISTIC HLSDem_NoGripPWinNegHi_C "P-component negative window for parameterset NoGrip upper PI-path" VALUE 0x38A3BC Scalar_SWORD 0 EngSpeed_rpm -6000.0 6000.0 /end CHARACTERISTIC
/begin CHARACTERISTIC HLSDem_NoGripPWinNegLo_C "P-component negative window for parameterset NoGrip lower PI-path" VALUE 0x38A3BE Scalar_SWORD 0 EngSpeed_rpm -6000.0 6000.0 /end CHARACTERISTIC
/begin CHARACTERISTIC HLSDem_NoGripPWinPosHi_C "P-component positive window for parameterset NoGrip upper PI-path" VALUE 0x38A3C0 Scalar_SWORD 0 EngSpeed_rpm -6000.0 6000.0 /end CHARACTERISTIC
/begin CHARACTERISTIC HLSDem_NoGripPWinPosLo_C "P-component positive window for parameterset NoGrip lower PI-path" VALUE 0x38A3C2 Scalar_SWORD 0 EngSpeed_rpm -6000.0 6000.0 /end CHARACTERISTIC
/begin CHARACTERISTIC HLSDem_NoGripdnAccLim_C "Upper limit for the permissible acceleration of engine speed (No Grip)" VALUE 0x38A3C6 Scalar_SWORD 0 EngSpeed_rpm_s -12000.0 12000.0 /end CHARACTERISTIC
/begin CHARACTERISTIC HLSDem_NoGripdnDeclLimBrk_C "Lower limit for the permissible deceleration of engine speed in case of braking (No Grip)" VALUE 0x38A3C8 Scalar_SWORD 0 EngSpeed_rpm_s -12000.0 12000.0 /end CHARACTERISTIC
/begin CHARACTERISTIC HLSDem_NoGripdnDeclLim_C "Lower limit for the permissible deceleration of engine speed (No Grip)" VALUE 0x38A3CA Scalar_SWORD 0 EngSpeed_rpm_s -12000.0 12000.0 /end CHARACTERISTIC
/begin CHARACTERISTIC HLSDem_facFdbkLoGrip_C "Outer feedback factor lower path in case grip" VALUE 0x38A3E4 Scalar_SWORD 0 FdbkNm2rpm_rpm_Nm -20.0 20.0 /end CHARACTERISTIC
/begin CHARACTERISTIC HLSDem_facFdbkLoNoGrip_C "Outer feedback factor lower path in case no grip" VALUE 0x38A3E6 Scalar_SWORD 0 FdbkNm2rpm_rpm_Nm -20.0 20.0 /end CHARACTERISTIC
/begin CHARACTERISTIC HLSDem_facFdbkTrqLosHiNoGrip_C "Inner feedback factor for parameter set NoGrip upper path" VALUE 0x38A41C Scalar_SWORD 0 FdbkNm2rpm_rpm_Nm -20.0 20.0 /end CHARACTERISTIC
/begin CHARACTERISTIC HLSDem_facFdbkTrqLosLoNoGrip_C "Inner feedback factor for parameter set NoGrip lower path" VALUE 0x38A43E Scalar_SWORD 0 FdbkNm2rpm_rpm_Nm -20.0 20.0 /end CHARACTERISTIC
/begin CHARACTERISTIC HLSDem_facNAvrgPT1_C "Time constant for PT1 delay element of engine speed filtering" VALUE 0x38A470 Scalar_UWORD 0 PT_fac 0.0 99.998 /end CHARACTERISTIC
/begin CHARACTERISTIC HLSDem_facTrqPT1CorFac_C "Time constant for PT1delay element of torque filtering" VALUE 0x38A4A8 Scalar_UWORD 0 PT_fac 0.0 99.998 /end CHARACTERISTIC
/begin CHARACTERISTIC HLSDem_tiFltTrqLosNoGrip_C "Time constant for inner feedback factor for different transmission ratios for parameter set No Grip" VALUE 0x38A58A Scalar_UWORD 0 PT_fac 0.0 99.998 /end CHARACTERISTIC
/begin CHARACTERISTIC HLSDem_InrtVehNoGrip_C "Inertial value for inner feedback factor for parameter set no Grip" VALUE 0x38A0CC Scalar_SWORD 0 HLSDem_Inrt -50.0 50.0 /end CHARACTERISTIC
/begin CHARACTERISTIC HLSDem_stBrkTrq_C "Measuring point to indicate the active status of the Hydraulic brake and the Engine Brake" VALUE 0x38A552 Scalar_UBYTE 0 State_uint8 0.0 255.0 /end CHARACTERISTIC
/begin CHARACTERISTIC HLSDem_swtTrqSelCorFac_C "Switch for selection of torque for parameter correction" VALUE 0x38A563 Scalar_UBYTE 0 State_uint8 0.0 255.0 /end CHARACTERISTIC
/begin CHARACTERISTIC HLSDem_swtTempSelParAdap_C "0-->coolant_temperature,1-->oil_temperature,2-->EngDa_tEng" VALUE 0x38A55F Scalar_UBYTE 0 EngTempFldSel_conv 0 2 /end CHARACTERISTIC
/begin AXIS_PTS HLSDem_KiCorFac_MAPY "Correction factor MAPY for I gain" 0x38A12E HLSDem_tParAdap_mp Lookup2D_X_WORD 0 Temp_deg 5 -150.0 150.0 /end AXIS_PTS
/begin AXIS_PTS HLSDem_KiCorFac_MAPX "Correction factor MAPX for I gain" 0x38A11E HLSDem_nAvrgFlt_mp Lookup2D_X_WORD 0 EngSpeed_rpm 8 -6000.0 6000.0 /end AXIS_PTS
/begin AXIS_PTS HLSDem_KiCorTrqFac_MAPY "Torque dependent correction factor MAPY for I gain" 0x38A214 HLSDem_nAvrgFlt_mp Lookup2D_X_WORD 0 EngSpeed_rpm 10 -6000.0 6000.0 /end AXIS_PTS
/begin AXIS_PTS HLSDem_KiCorTrqFac_MAPX "Torque dependent correction factor MAPX for I gain" 0x38A200 HLSDem_trqCorFacFlt_mp Lookup2D_X_WORD 0 Trq_Nm 10 -3000.0 3000.0 /end AXIS_PTS
/begin AXIS_PTS HLSDem_KpCorFac_MAPY "Correction factor MAPY for P gain" 0x38A288 HLSDem_tParAdap_mp Lookup2D_X_WORD 0 Temp_deg 5 -150.0 150.0 /end AXIS_PTS
/begin AXIS_PTS HLSDem_KpCorFac_MAPX "Correction factor MAPX for P gain" 0x38A278 HLSDem_nAvrgFlt_mp Lookup2D_X_WORD 0 EngSpeed_rpm 8 -6000.0 6000.0 /end AXIS_PTS
/begin AXIS_PTS HLSDem_KpCorTrqFac_MAPY "Torque dependent correction factor MAPY for P gain" 0x38A36E HLSDem_nAvrgFlt_mp Lookup2D_X_WORD 0 EngSpeed_rpm 10 -6000.0 6000.0 /end AXIS_PTS
/begin AXIS_PTS HLSDem_KpCorTrqFac_MAPX "Torque dependent correction factor MAPX for P gain" 0x38A35A HLSDem_trqCorFacFlt_mp Lookup2D_X_WORD 0 Trq_Nm 10 -3000.0 3000.0 /end AXIS_PTS
/begin AXIS_PTS HLSDem_InrtVehGrip_CURX "Vehicle grip inertia" 0x38A0BC GlbDa_rTrqTot Lookup1D_X_WORD 0 TransRatio 8 -100.0 100.0 /end AXIS_PTS
/begin AXIS_PTS HLSDem_facFdbkTrqLosHiGrip_CURX "Torque lost high path feed back factor " 0x38A40C GlbDa_rTrqTot Lookup1D_X_WORD 0 TransRatio 8 -100.0 100.0 /end AXIS_PTS
/begin AXIS_PTS HLSDem_facFdbkTrqLosLoGrip_CURX "Torque lost low path feed back factor " 0x38A42E GlbDa_rTrqTot Lookup1D_X_WORD 0 TransRatio 8 -100.0 100.0 /end AXIS_PTS
/begin AXIS_PTS HLSDem_tiFltTrqLosGrip_CURX "Grip filter torque lost time " 0x38A57A GlbDa_rTrqTot Lookup1D_X_WORD 0 TransRatio 8 -100.0 100.0 /end AXIS_PTS
/begin AXIS_PTS HLSDem_GripIKiHi_CURX "Transformation axis to convert transmission ratio to I-component small signal for parameterset Grip upper PI-path" 0x389E5C GlbDa_rTrqTot Lookup1D_X_WORD 0 TransRatio 8 -100.0 100.0 /end AXIS_PTS
/begin AXIS_PTS HLSDem_GripIKiLo_CURX "Transformation axis to convert transmission ratio to I-component small signal for parameterset Grip lower PI-path" 0x389E8C GlbDa_rTrqTot Lookup1D_X_WORD 0 TransRatio 8 -100.0 100.0 /end AXIS_PTS
/begin AXIS_PTS HLSDem_GripIKiNegHi_CURX "Transformation axis to convert transmission ratio to I-component  negative large signal for parameterset Grip upper PI-path" 0x389EBC GlbDa_rTrqTot Lookup1D_X_WORD 0 TransRatio 8 -100.0 100.0 /end AXIS_PTS
/begin AXIS_PTS HLSDem_GripIKiNegLo_CURX "Transformation axis to convert transmission ratio to I-component  negative large signal for parameterset Grip lower PI-path" 0x389EEC GlbDa_rTrqTot Lookup1D_X_WORD 0 TransRatio 8 -100.0 100.0 /end AXIS_PTS
/begin AXIS_PTS HLSDem_GripIKiPosHi_CURX "Transformation axis to convert transmission ratio to I-component  positive large signal for parameterset Grip upper PI-path" 0x389F1C GlbDa_rTrqTot Lookup1D_X_WORD 0 TransRatio 8 -100.0 100.0 /end AXIS_PTS
/begin AXIS_PTS HLSDem_GripIKiPosLo_CURX "Transformation axis to convert transmission ratio to I-component  positive large signal for parameterset Grip lower PI-path" 0x389F4C GlbDa_rTrqTot Lookup1D_X_WORD 0 TransRatio 8 -100.0 100.0 /end AXIS_PTS
/begin AXIS_PTS HLSDem_GripPKpHi_CURX "Transformation axis to convert transmission ratio to P-component small signal for parameterset Grip upper PI-path" 0x389F84 GlbDa_rTrqTot Lookup1D_X_WORD 0 TransRatio 8 -100.0 100.0 /end AXIS_PTS
/begin AXIS_PTS HLSDem_GripPKpLo_CURX "Transformation axis to convert transmission ratio to P-component small signal for parameterset Grip lower PI-path" 0x389FB4 GlbDa_rTrqTot Lookup1D_X_WORD 0 TransRatio 8 -100.0 100.0 /end AXIS_PTS
/begin AXIS_PTS HLSDem_GripPKpNegHi_CURX "Transformation axis to convert transmission ratio to P-component  negative large signal for parameterset Grip upper PI-path" 0x389FE4 GlbDa_rTrqTot Lookup1D_X_WORD 0 TransRatio 8 -100.0 100.0 /end AXIS_PTS
/begin AXIS_PTS HLSDem_GripPKpNegLo_CURX "Transformation axis to convert transmission ratio to P-component  negative large signal for parameterset Grip lower PI-path" 0x38A014 GlbDa_rTrqTot Lookup1D_X_WORD 0 TransRatio 8 -100.0 100.0 /end AXIS_PTS
/begin AXIS_PTS HLSDem_GripPKpPosHi_CURX "Transformation axis to convert transmission ratio to P-component  positive large signal for parameterset Grip upper PI-path" 0x38A044 GlbDa_rTrqTot Lookup1D_X_WORD 0 TransRatio 8 -100.0 100.0 /end AXIS_PTS
/begin AXIS_PTS HLSDem_GripPKpPosLo_CURX "Transformation axis to convert transmission ratio to P-component  positive large signal for parameterset Grip lower PI-path" 0x38A074 GlbDa_rTrqTot Lookup1D_X_WORD 0 TransRatio 8 -100.0 100.0 /end AXIS_PTS
/begin CHARACTERISTIC HLSDem_stSpdSel_C "Status of maximum engine setpoint speed selected" VALUE 0x38A556 Scalar_UWORD 0 State_uint16 1.0 4096.0 /end CHARACTERISTIC
/begin CHARACTERISTIC HLSDem_rTrqSwt_C "Threshold transmission ratio for lower/higher gear group" VALUE 0x38A550 Scalar_SWORD 0 TransRatio 0.0 1.0 /end CHARACTERISTIC
/begin CHARACTERISTIC HLSDem_SetPHiRmpSlopeNeg_C "Ramp step width for upper maximum engine speed / Negative ramp step width" VALUE 0x38A3CC Scalar_SWORD 0 EngSpeed_rpm_s 0.0 1000.0 /end CHARACTERISTIC
/begin CHARACTERISTIC HLSDem_SetPHiRmpSlopePos_C "Ramp step width for upper maximum engine speed / Positive ramp step width" VALUE 0x38A3CE Scalar_SWORD 0 EngSpeed_rpm_s 0.0 1000.0 /end CHARACTERISTIC
/begin CHARACTERISTIC HLSDem_nHGGSetPHi_C "Maximum Engine setpoint speed value for lower gear group" VALUE 0x38A4AA Scalar_SWORD 0 EngSpeed_rpm 0.0 6000.0 /end CHARACTERISTIC
/begin CHARACTERISTIC HLSDem_nKDSetPHi_C "Maximum Engine setpoint speed value for driver kick down" VALUE 0x38A4AC Scalar_SWORD 0 EngSpeed_rpm 0.0 6000.0 /end CHARACTERISTIC
/begin CHARACTERISTIC HLSDem_nLGGSetPHi_C "Maximum Engine setpoint speed value for higher gear group" VALUE 0x38A4AE Scalar_SWORD 0 EngSpeed_rpm 0.0 6000.0 /end CHARACTERISTIC
/begin CHARACTERISTIC HLSDem_nRed1SetPHi_C "Maximum Engine speed value for multiple state switch position 1" VALUE 0x38A4B4 Scalar_SWORD 0 EngSpeed_rpm 0.0 6000.0 /end CHARACTERISTIC
/begin CHARACTERISTIC HLSDem_nRed2SetPHi_C "Maximum Engine speed value for multiple state switch position 2" VALUE 0x38A4B6 Scalar_SWORD 0 EngSpeed_rpm 0.0 6000.0 /end CHARACTERISTIC
/begin CHARACTERISTIC HLSDem_nRed3SetPHi_C "Maximum Engine speed value for multiple state switch position 3" VALUE 0x38A4B8 Scalar_SWORD 0 EngSpeed_rpm 0.0 6000.0 /end CHARACTERISTIC
/begin CHARACTERISTIC HLSDem_nSetPLoOfsMoF_C "Offset for idle speed setpoint for level 2 monitoring" VALUE 0x38A514 Scalar_SWORD 0 EngSpeed_rpm 0.0 6000.0 /end CHARACTERISTIC
/begin CHARACTERISTIC HLSDem_nStrtSetPHi_C "Maximum Engine setpoint speed value after start" VALUE 0x38A542 Scalar_SWORD 0 EngSpeed_rpm 0.0 6000.0 /end CHARACTERISTIC
/begin CHARACTERISTIC HLSDem_nSysDgrtSetPHi_C "Maximum Engine setpoint speed value for system degradation" VALUE 0x38A544 Scalar_SWORD 0 EngSpeed_rpm 0.0 6000.0 /end CHARACTERISTIC
/begin CHARACTERISTIC SigTst_nSetPHi_C "Set SetPoint high idle speed by hand" VALUE 0x39803A Scalar_SWORD 0 EngSpeed_rpm 0.0 6000.0 /end CHARACTERISTIC
/begin CHARACTERISTIC HLSDem_facFdbkCANKick_C "Feedback factor for CAN kickdown setpoint" VALUE 0x38A3DC Scalar_SWORD 0 FdbkNm2rpm_rpm_Nm -20.0 20.0 /end CHARACTERISTIC
/begin CHARACTERISTIC HLSDem_facFdbkDrvKick_C "Feedback factor for driver kickdown setpoint" VALUE 0x38A3DE Scalar_SWORD 0 FdbkNm2rpm_rpm_Nm -20.0 20.0 /end CHARACTERISTIC
/begin CHARACTERISTIC HLSDem_facFdbkHGG_C "Feedback factor for higher gear group setpoint" VALUE 0x38A3E0 Scalar_SWORD 0 FdbkNm2rpm_rpm_Nm -20.0 20.0 /end CHARACTERISTIC
/begin CHARACTERISTIC HLSDem_facFdbkLGG_C "Feedback factor for lower gear group setpoint" VALUE 0x38A3E2 Scalar_SWORD 0 FdbkNm2rpm_rpm_Nm -20.0 20.0 /end CHARACTERISTIC
/begin CHARACTERISTIC HLSDem_facFdbkMaxAcs_C "Feedback factor when accessories sets the high idle setpoint" VALUE 0x38A3E8 Scalar_SWORD 0 FdbkNm2rpm_rpm_Nm -20.0 20.0 /end CHARACTERISTIC
/begin CHARACTERISTIC HLSDem_facFdbkMaxSysErr_C "Feedback factor when transmission demand sets the high idle setpoint" VALUE 0x38A3EA Scalar_SWORD 0 FdbkNm2rpm_rpm_Nm -20.0 20.0 /end CHARACTERISTIC
/begin CHARACTERISTIC HLSDem_facFdbkMaxTra_C "Feedback factor when error from vehcile side sets the high idle setpoint" VALUE 0x38A3EC Scalar_SWORD 0 FdbkNm2rpm_rpm_Nm -20.0 20.0 /end CHARACTERISTIC
/begin CHARACTERISTIC HLSDem_facFdbkRed1_C "Feedback factor for MSS position1 setpoint" VALUE 0x38A3EE Scalar_SWORD 0 FdbkNm2rpm_rpm_Nm -20.0 20.0 /end CHARACTERISTIC
/begin CHARACTERISTIC HLSDem_facFdbkRed2_C "Feedback factor for MSS position2 setpoint" VALUE 0x38A3F0 Scalar_SWORD 0 FdbkNm2rpm_rpm_Nm -20.0 20.0 /end CHARACTERISTIC
/begin CHARACTERISTIC HLSDem_facFdbkRed3_C "Feedback factor for MSS position3 setpoint" VALUE 0x38A3F2 Scalar_SWORD 0 FdbkNm2rpm_rpm_Nm -20.0 20.0 /end CHARACTERISTIC
/begin CHARACTERISTIC HLSDem_facFdbkStrt_C "Feedback factor for setpoint after start" VALUE 0x38A3F4 Scalar_SWORD 0 FdbkNm2rpm_rpm_Nm -20.0 20.0 /end CHARACTERISTIC
/begin CHARACTERISTIC HLSDem_facFdbkSysDgrt1_C "High idle governing setpoint speed under error condition1" VALUE 0x38A3F6 Scalar_SWORD 0 FdbkNm2rpm_rpm_Nm -20.0 20.0 /end CHARACTERISTIC
/begin CHARACTERISTIC HLSDem_facFdbkSysDgrt2_C "High idle governing setpoint speed under error condition2" VALUE 0x38A3F8 Scalar_SWORD 0 FdbkNm2rpm_rpm_Nm -20.0 20.0 /end CHARACTERISTIC
/begin CHARACTERISTIC HLSDem_facFdbkSysDgrt3_C "High idle governing setpoint speed under error condition3" VALUE 0x38A3FA Scalar_SWORD 0 FdbkNm2rpm_rpm_Nm -20.0 20.0 /end CHARACTERISTIC
/begin CHARACTERISTIC HLSDem_facTrqHiPT1_C "Time constant for PT1 delay element of feedback torque for maximum engine setpoint speed calculation" VALUE 0x38A4A4 Scalar_UWORD 0 PT_fac 0.0 99.9985 /end CHARACTERISTIC
/begin CHARACTERISTIC HLSDem_facTrqLoPT1_C "Time constant for PT1delay element of torque filtering" VALUE 0x38A4A6 Scalar_UWORD 0 PT_fac 0.0 99.9985 /end CHARACTERISTIC
/begin CHARACTERISTIC HLSDem_stSysDgrtSetPHi_C "Measurement point of the active system degradation FID" VALUE 0x38A558 Scalar_UBYTE 0 State_uint8 0.0 255.0 /end CHARACTERISTIC
/begin CHARACTERISTIC HLSDem_swtTrqHiSel_C "Switch for selection of feedback torque for load correction in maximum setpoint calculatio" VALUE 0x38A561 Scalar_UBYTE 0 State_uint8 0.0 255.0 /end CHARACTERISTIC
/begin CHARACTERISTIC HLSDem_swtTrqLoSel_C "Switch for selection of feedback torque for load correction in low idle setpoint calculation" VALUE 0x38A562 Scalar_UBYTE 0 State_uint8 0.0 255.0 /end CHARACTERISTIC
/begin CHARACTERISTIC HndBrk_stDebVal_C "Debounced value of Hand Brake switch" VALUE 0x38A8DE Scalar_UBYTE 0 State_uint8 0.0 255.0 /end CHARACTERISTIC
/begin CHARACTERISTIC HLSDem_swtDisblVehIfcSetPHi_C "Switch to deactivate the Veh interface (maximum speed)" VALUE 0x38A55B Scalar_UBYTE 0 Switch_conv 0 1 /end CHARACTERISTIC
/begin CHARACTERISTIC SigTst_swtSetPHi_C "Switch for enable Set SetPoint high idle speed by hand" VALUE 0x398092 Scalar_UBYTE 0 Switch_conv 0 1 /end CHARACTERISTIC
/begin MEASUREMENT EngPrt_tOvhtPrvCalc_mp "Calculated temperature under stable conditions[deg C] deg C" SWORD Temp_deg 0 0 -50.0 200.0 ECU_ADDRESS 0x40022BFA /end MEASUREMENT
/begin MEASUREMENT EngPrt_tOvhtPrvIATCor_mp "Temperature correction depending on intake air temperature [deg C] K" SWORD Temp_deg 0 0 -50.0 200.0 ECU_ADDRESS 0x40022BFC /end MEASUREMENT
/begin MEASUREMENT EngPrt_tOvhtPrvCor_mp "Corrected temperature under stable conditions[deg C] deg C" SWORD Temp_deg 0 0 -50.0 200.0 ECU_ADDRESS 0x40022BFE /end MEASUREMENT
/begin MEASUREMENT EngPrt_tOvhtPrvFlt_mp "Filtered dynamic temperature[deg C]" SWORD Temp_deg 0 0 -50.0 200.0 ECU_ADDRESS 0x40022C00 /end MEASUREMENT
/begin MEASUREMENT EngPrt_tOvhtPrvDiff_mp "Difference between allowed (EngPrt_tOvhtPrvAllwMax_C) and filtered (dynamic) temperature(EngPrt_tOvhtPrvFlt_mp) [degC] K" SWORD Temp_deg 0 0 -50.0 200.0 ECU_ADDRESS 0x40022C02 /end MEASUREMENT
/begin MEASUREMENT EngPrt_tAirDes_mp "Intake air temperature" SWORD Temp_deg 0 0 -50.0 200.0 ECU_ADDRESS 0x40022C04 /end MEASUREMENT
/begin MEASUREMENT EngPrt_trqOvhtPrvHigh_mp "Injection mass out of high temperature MAP[mg/stroke] mg/hub" SWORD Trq_Nm 0 0 -3276.8 3276.7 ECU_ADDRESS 0x40022C06 /end MEASUREMENT
/begin MEASUREMENT EngPrt_trqOvhtPrvLow_mp "Injection mass out of low temperature MAP EngPrt_qOvhtPrvLow_MAP [mg/stroke] mg/hub" SWORD Trq_Nm 0 0 -3276.8 3276.7 ECU_ADDRESS 0x40022C08 /end MEASUREMENT
/begin MEASUREMENT EngPrt_trqOvhtPrvStab_mp "Maximum allowed injection mass under stabilized conditions[mg/stroke] mg/hub" SWORD Trq_Nm 0 0 -3276.8 3276.7 ECU_ADDRESS 0x40022C0A /end MEASUREMENT
/begin MEASUREMENT EngPrt_trqOvhtPrvDyn_mp "Dynamical allowed injection mass[mg/stroke] mg/hub" SWORD Trq_Nm 0 0 -3276.8 3276.7 ECU_ADDRESS 0x40022C0C /end MEASUREMENT
/begin MEASUREMENT EngPrt_trqOvhtPrvDynLtd_mp "Dynamical allowed injection mass after limitation[mg/stroke] mg/hub" SWORD Trq_Nm 0 0 -3276.8 3276.7 ECU_ADDRESS 0x40022C0E /end MEASUREMENT
/begin MEASUREMENT EngPrt_trqOvhtPrvSum_mp "Injection mass with dynamic corrections[mg/stroke] mg/hub" SWORD Trq_Nm 0 0 -3276.8 3276.7 ECU_ADDRESS 0x40022C10 /end MEASUREMENT
/begin MEASUREMENT EngPrt_trqOvhtPrvMax_mp "Injection mass out of max temperature MAP EngPrt_qOvhtPrvMax_MAP [mg/stroke] mg/hub" SWORD Trq_Nm 0 0 -3276.8 3276.7 ECU_ADDRESS 0x40022C12 /end MEASUREMENT
/begin MEASUREMENT EngPrt_trqOvhtPrvTLim_mp "Exhaust gas temperature dependent injection mass protection[mg/stroke] mg/hub" SWORD Trq_Nm 0 0 -3276.8 3276.7 ECU_ADDRESS 0x40022C14 /end MEASUREMENT
/begin MEASUREMENT EngPrt_trqOvhtPrvNRng_mp "Engine speed dependent injection mass protection" SWORD Trq_Nm 0 0 -3276.8 3276.7 ECU_ADDRESS 0x40022C16 /end MEASUREMENT
/begin MEASUREMENT EngPrt_trqOvhtPrvVRng_mp "Vehicle speed dependent injection mass protection mghub" SWORD Trq_Nm 0 0 -3276.8 3276.7 ECU_ADDRESS 0x40022C18 /end MEASUREMENT
/begin MEASUREMENT EngPrt_facOvhtPrvTrqTemp_mp "injection mass by per  temperature[-] mg/hub/deg C" SWORD TrqPerDeg_Nm_deg 0 0 -16.0 16.0 ECU_ADDRESS 0x40022C1A /end MEASUREMENT
/begin MEASUREMENT EngPrt_facOvhtPrvCT_mp "Coolant temperature dependent prevention factor" SWORD Factor 0 0 -10.0 10.0 ECU_ADDRESS 0x40022C1C /end MEASUREMENT
/begin MEASUREMENT EngPrt_facOvhtPrvFT_mp "Fuel temperature dependent prevention factor" SWORD Factor 0 0 -10.0 10.0 ECU_ADDRESS 0x40022C1E /end MEASUREMENT
/begin MEASUREMENT EngPrt_facOvhtPrvIAT_mp "Intake air temperature dependent prevention factor" SWORD Factor 0 0 -10.0 10.0 ECU_ADDRESS 0x40022C20 /end MEASUREMENT
/begin MEASUREMENT EngPrt_facOvhtPrvOT_mp "Oil temperature dependent prevention factor" SWORD Factor 0 0 -10.0 10.0 ECU_ADDRESS 0x40022C22 /end MEASUREMENT
/begin MEASUREMENT EngPrt_facOvhtPrv_mp "minimum prevention factor calculated from temperature curves" SWORD Factor 0 0 -10.0 10.0 ECU_ADDRESS 0x40022C24 /end MEASUREMENT
/begin MEASUREMENT EngPrt_facPTOLim_mp "limitation factor calculate from PTO switch " SWORD Factor 0 0 -10.0 10.0 ECU_ADDRESS 0x40022C2C /end MEASUREMENT
/begin MEASUREMENT SmkLim_trqLimSmkBase_mp "Smoke Limitation torque" SWORD Trq_Nm 0 0 -3276.8 3276.7 ECU_ADDRESS 0x40022C2E /end MEASUREMENT
/begin MEASUREMENT SmkLim_trqLimSmkAFSBase_mp "Smoke Limitation torque when using AFS" SWORD Trq_Nm 0 0 -3276.8 3276.7 ECU_ADDRESS 0x40022C30 /end MEASUREMENT
/begin MEASUREMENT SmkLim_trqLimSmkAFSEnvPCor_mp "Smoke Limitation torque correction for EnvP" SWORD Trq_Nm 0 0 -3276.8 3276.7 ECU_ADDRESS 0x40022C32 /end MEASUREMENT
/begin MEASUREMENT SmkLim_facSmkATSCor_mp "air Temperature Correction factor for smoke Limitation" SWORD Factor 0 0 -10.0 10.0 ECU_ADDRESS 0x40022C34 /end MEASUREMENT
/begin MEASUREMENT SmkLim_facSmkEnvPCor_mp "Smoke limitation correction factor of EnvP" SWORD Factor 0 0 -30.0 30.0 ECU_ADDRESS 0x40022C36 /end MEASUREMENT
/begin MEASUREMENT DrvDem_trqCorFacFlt_mp "selected torque used for correction factor calculation" SWORD Trq_Nm 0 0 -3000.0 3000.0 ECU_ADDRESS 0x40022A88 /end MEASUREMENT
/begin MEASUREMENT DrvDem_nAvrgFlt_mp "Filtered average engine speed used for correction factor calculation" SWORD EngSpeed_rpm 0 0 0.0 6000.0 ECU_ADDRESS 0x40022A8A /end MEASUREMENT
/begin MEASUREMENT DrvDem_tParAdap_mp "Measuring point for used engine temperature" SWORD Temp_deg 0 0 -1000.0 1000.0 ECU_ADDRESS 0x40022A8C /end MEASUREMENT
/begin MEASUREMENT DrvDem_KiCorTrqFac_mp "Torque dependent correction factor for I gain" SWORD Factor 0 0 -30.0 30.0 ECU_ADDRESS 0x40022A8E /end MEASUREMENT
/begin MEASUREMENT DrvDem_KiCorTempFac_mp "Correction factor of I-parameter" SWORD Factor 0 0 -30.0 30.0 ECU_ADDRESS 0x40022A90 /end MEASUREMENT
/begin MEASUREMENT DrvDem_KiCorFac_mp "Correction factor for I gain" SWORD Factor 0 0 -30.0 30.0 ECU_ADDRESS 0x40022A92 /end MEASUREMENT
/begin MEASUREMENT DrvDem_KpCorTrqFac_mp "Torque dependent correction factor for P gain" SWORD Factor 0 0 -30.0 30.0 ECU_ADDRESS 0x40022A94 /end MEASUREMENT
/begin MEASUREMENT DrvDem_KpCorTempFac_mp "Correction factor of P-parameter" SWORD Factor 0 0 -30.0 30.0 ECU_ADDRESS 0x40022A96 /end MEASUREMENT
/begin MEASUREMENT DrvDem_KpCorFac_mp "Correction factor for P gain" SWORD Factor 0 0 -30.0 30.0 ECU_ADDRESS 0x40022A98 /end MEASUREMENT
/begin MEASUREMENT DrvDem_nDrvSetP_mp "Measuring point for driveability engine speed demandsetpoint" SWORD EngSpeed_rpm 0 0 0.0 6000.0 ECU_ADDRESS 0x40022A9A /end MEASUREMENT
/begin MEASUREMENT DrvDem_nDrvSetPBas_mp "Measuring point for driveability basic engine speedsetpoint" SWORD EngSpeed_rpm 0 0 0.0 6000.0 ECU_ADDRESS 0x40022A9C /end MEASUREMENT
/begin MEASUREMENT DrvDem_stDrvNGovActv_mp "Staus of the DrvDem Active" UBYTE boolean 0 0 0.0 1.0 ECU_ADDRESS 0x40022A9E /end MEASUREMENT
/begin MEASUREMENT EISGov_DT1Curr_mp "Current DT1-part" UWORD RailDT1_ms 0 0 0.0 65535.0 ECU_ADDRESS 0x40022B96 /end MEASUREMENT
/begin MEASUREMENT EISGov_nDiffLo_mp "Control deviation for lower engine speed limit" SWORD EngSpeed_rpm 0 0 0.0 6000.0 ECU_ADDRESS 0x40022B98 /end MEASUREMENT
/begin MEASUREMENT EISGov_nDiffHi_mp "Control deviation for upper engine speed limit" SWORD EngSpeed_rpm 0 0 0.0 6000.0 ECU_ADDRESS 0x40022B9A /end MEASUREMENT
/begin MEASUREMENT EISGov_nDiffLoFlt_mp "Control deviation for lower engine speed limit" SWORD EngSpeed_rpm 0 0 0.0 6000.0 ECU_ADDRESS 0x40022B9C /end MEASUREMENT
/begin MEASUREMENT EISGov_trqDRaw_mp "D-part raw torque" SWORD Trq_Nm 0 0 -3276.8 3276.7 ECU_ADDRESS 0x40022B9E /end MEASUREMENT
/begin MEASUREMENT EISGov_trqDT1_mp "DT1-part torque" SWORD Trq_Nm 0 0 -3276.8 3276.7 ECU_ADDRESS 0x40022BA0 /end MEASUREMENT
/begin MEASUREMENT EISGov_trqD_mp "D-part torque" SWORD Trq_Nm 0 0 -3276.8 3276.7 ECU_ADDRESS 0x40022BA2 /end MEASUREMENT
/begin MEASUREMENT EISGov_trqIHi_mp "I-part of high path" SWORD Trq_Nm 0 0 -3276.8 3276.7 ECU_ADDRESS 0x40022BA4 /end MEASUREMENT
/begin MEASUREMENT EISGov_trqILtdHi_mp "Limited I-component of the upper path" SWORD Trq_Nm 0 0 -3276.8 3276.7 ECU_ADDRESS 0x40022BA6 /end MEASUREMENT
/begin MEASUREMENT EISGov_trqPHi "P-component of the upper path" SWORD Trq_Nm 0 0 -3276.8 3276.7 ECU_ADDRESS 0x40022BA8 /end MEASUREMENT
/begin MEASUREMENT EISGov_trqPILtdHi_mp "Limited PI-component of the upper path" SWORD Trq_Nm 0 0 -3276.8 3276.7 ECU_ADDRESS 0x40022BAA /end MEASUREMENT
/begin MEASUREMENT EISGov_trqLoadEstimate_mp "Load torque estimate" SWORD Trq_Nm 0 0 -3276.8 3276.7 ECU_ADDRESS 0x40022BAC /end MEASUREMENT
/begin MEASUREMENT EISGov_trqInitI "I-part of low path" SWORD Trq_Nm 0 0 -3276.8 3276.7 ECU_ADDRESS 0x40022BAE /end MEASUREMENT
/begin MEASUREMENT EISGov_trqILo_mp "I-part of low path" SWORD Trq_Nm 0 0 -3276.8 3276.7 ECU_ADDRESS 0x40022BB0 /end MEASUREMENT
/begin MEASUREMENT EISGov_trqILtdLo_mp "Limited I-component of the lower path" SWORD Trq_Nm 0 0 -3276.8 3276.7 ECU_ADDRESS 0x40022BB2 /end MEASUREMENT
/begin MEASUREMENT EISGov_trqPILtdLo_mp "Limited PI-component of the lower path" SWORD Trq_Nm 0 0 -3276.8 3276.7 ECU_ADDRESS 0x40022BB4 /end MEASUREMENT
/begin MEASUREMENT EISGov_trqPISum_mp "Sum of the torque of both (upper/lower) PI-paths" SWORD Trq_Nm 0 0 -3276.8 3276.7 ECU_ADDRESS 0x40022BB6 /end MEASUREMENT
/begin MEASUREMENT EISGov_tDT1_mp "temperature for select parameter of DT1" SWORD Temp_deg 0 0 -50.0 200.0 ECU_ADDRESS 0x40022BB8 /end MEASUREMENT
/begin MEASUREMENT EISGov_DKdCurr_mp "Current D-part" UWORD Pid_Kp_Kd 0 0 0.0 15.0 ECU_ADDRESS 0x40022BBA /end MEASUREMENT
/begin MEASUREMENT EISGov_facDT1Trq_mp "DT1-part torque factor" SWORD Factor 0 0 -3.0 3.0 ECU_ADDRESS 0x40022BBC /end MEASUREMENT
/begin MEASUREMENT EISGov_facPT1TrqFlt "Filter time constant for the filtered EISGov output torque" UWORD PT_fac 0 0 0.0 99.9985 ECU_ADDRESS 0x40022BBE /end MEASUREMENT
/begin MEASUREMENT EISGov_stCompDT1_mp "status of DT enable" UBYTE boolean 0 0 0.0 1.0 ECU_ADDRESS 0x40022BC0 /end MEASUREMENT
/begin MEASUREMENT EISGov_stHiFrzI_mp "status of integrator freeze" UBYTE boolean 0 0 0.0 1.0 ECU_ADDRESS 0x40022BC1 /end MEASUREMENT
/begin MEASUREMENT EISGov_stLoFrzI_mp "status of integrator freeze" UBYTE boolean 0 0 0.0 1.0 ECU_ADDRESS 0x40022BC2 /end MEASUREMENT
/begin MEASUREMENT EISGov_stIdleLoadIncrease_mp "Load Increase indicate" UBYTE boolean 0 0 0.0 1.0 ECU_ADDRESS 0x40022BC3 /end MEASUREMENT
/begin MEASUREMENT EISGov_stIdleLoadReduce_mp "Load reduce indicate" UBYTE boolean 0 0 0.0 1.0 ECU_ADDRESS 0x40022BC4 /end MEASUREMENT
/begin MEASUREMENT EISGov_stInitIReq "status of integrator initialization" UBYTE boolean 0 0 0.0 1.0 ECU_ADDRESS 0x40022BC5 /end MEASUREMENT
/begin MEASUREMENT EISGov_trqInrSetFlt_mp "filtered torque inner set" SWORD Trq_Nm 0 0 -3276.8 3276.7 ECU_ADDRESS 0x40022BCE /end MEASUREMENT
/begin MEASUREMENT EISGov_trqAcc_mp "Acceleration torque resulting from the engine, drivetrain and the vehicle" SWORD Trq_Nm 0 0 -3276.8 3276.7 ECU_ADDRESS 0x40022BD0 /end MEASUREMENT
/begin MEASUREMENT EISGov_trqLosFlt_mp "Unfiltered estimated loss torque" SWORD Trq_Nm 0 0 -3276.8 3276.7 ECU_ADDRESS 0x40022BD2 /end MEASUREMENT
/begin MEASUREMENT Epm_dnEngFlt_mp "Engine speed gradient calculated over current crankshaft-segment (S0-S0 or S1-S1) after PT1-filtering" SWORD EngSpeed_rpm_s 0 0 -12000.0 12000.0 ECU_ADDRESS 0x40022BD4 /end MEASUREMENT
/begin MEASUREMENT EISGov_InrtVehCurr "Current moment of inertia of the vehicle" SWORD HLSDem_Inrt 0 0 -50.0 50.0 ECU_ADDRESS 0x40022BD6 /end MEASUREMENT
/begin MEASUREMENT ExtDem_KpCurr_mp "Current small signal gain for the P component" SLONG HLSDem_Kp 0 0 -10000.0 10000.0 ECU_ADDRESS 0x40022C70 /end MEASUREMENT
/begin MEASUREMENT ExtDem_KpPosCurr_mp "Current positive large signal gain for the P component" SLONG HLSDem_Kp 0 0 -10000.0 10000.0 ECU_ADDRESS 0x40022C74 /end MEASUREMENT
/begin MEASUREMENT ExtDem_KpNegCurr_mp "Current negative large signal gain for the P component" SLONG HLSDem_Kp 0 0 -10000.0 10000.0 ECU_ADDRESS 0x40022C78 /end MEASUREMENT
/begin MEASUREMENT ExtDem_KiCurr_mp "Current small signal gain for the I component" SLONG HLSDem_Ki 0 0 -18000.0 18000.0 ECU_ADDRESS 0x40022C7C /end MEASUREMENT
/begin MEASUREMENT ExtDem_KiPosCurr_mp "Current positive large signal gain for the I component" SLONG HLSDem_Ki 0 0 -18000.0 18000.0 ECU_ADDRESS 0x40022C80 /end MEASUREMENT
/begin MEASUREMENT ExtDem_KiNegCurr_mp "Current negative large signal gain for the I component" SLONG HLSDem_Ki 0 0 -18000.0 18000.0 ECU_ADDRESS 0x40022C84 /end MEASUREMENT
/begin MEASUREMENT ExtDem_tParAdap_mp "Selected temperature used for correction factor calculation" SWORD Temp_deg 0 0 -150.0 150.0 ECU_ADDRESS 0x40022C88 /end MEASUREMENT
/begin MEASUREMENT ExtDem_nSetP_mp "Upper or lower external intervention setpoint used for correction maps" SWORD EngSpeed_rpm 0 0 -8000.0 8000.0 ECU_ADDRESS 0x40022C8A /end MEASUREMENT
/begin MEASUREMENT ExtDem_nSelCorFac_mp "Selected engine speed used for correction factor calculation" SWORD EngSpeed_rpm 0 0 -8000.0 8000.0 ECU_ADDRESS 0x40022C8C /end MEASUREMENT
/begin MEASUREMENT ExtDem_IWinNegCurr "Negative small signal window for integral component" SWORD EngSpeed_rpm 0 0 -1000.0 1000.0 ECU_ADDRESS 0x40022C8E /end MEASUREMENT
/begin MEASUREMENT ExtDem_IWinPosCurr "Positive small signal window for integral component" SWORD EngSpeed_rpm 0 0 -1000.0 1000.0 ECU_ADDRESS 0x40022C90 /end MEASUREMENT
/begin MEASUREMENT ExtDem_PWinNegCurr "Negative small signal window for proportional component " SWORD EngSpeed_rpm 0 0 -1000.0 1000.0 ECU_ADDRESS 0x40022C92 /end MEASUREMENT
/begin MEASUREMENT ExtDem_PWinPosCurr "Positive small signal window for proportional component " SWORD EngSpeed_rpm 0 0 -1000.0 1000.0 ECU_ADDRESS 0x40022C94 /end MEASUREMENT
/begin MEASUREMENT ExtDem_facFdbkParSet_mp "Feedback factor for parameter set " SWORD FdbkNm2rpm_rpm_Nm 0 0 -20.0 20.0 ECU_ADDRESS 0x40022C96 /end MEASUREMENT
/begin MEASUREMENT ExtDem_KiCorTrqFac_mp "Load based correction factor for I gain" SWORD Factor 0 0 -30.0 30.0 ECU_ADDRESS 0x40022C98 /end MEASUREMENT
/begin MEASUREMENT ExtDem_KiCorTempFac_mp "Temperature based correction factor for I gain" SWORD Factor 0 0 -30.0 30.0 ECU_ADDRESS 0x40022C9A /end MEASUREMENT
/begin MEASUREMENT ExtDem_KpCorTrqFac_mp "Torque based correction factor for P gain" SWORD Factor 0 0 -30.0 30.0 ECU_ADDRESS 0x40022C9C /end MEASUREMENT
/begin MEASUREMENT ExtDem_KpCorTempFac_mp "Temperature based correction factor for P gain" SWORD Factor 0 0 -30.0 30.0 ECU_ADDRESS 0x40022C9E /end MEASUREMENT
/begin MEASUREMENT ExtDem_stBrkTrq_mp "Measuring point to indicate the active status of the Hydraulic brake and the Engine Brake" UBYTE uint8 0 0 0.0 255.0 ECU_ADDRESS 0x40022CA0 /end MEASUREMENT
/begin MEASUREMENT ExtDem_trqFdbkFlt_mp "Filtered feedback torque" SWORD Trq_Nm 0 0 -3000.0 3000.0 ECU_ADDRESS 0x40022CA2 /end MEASUREMENT
/begin MEASUREMENT HLSDem_trqReqStrt "Filtered inner torque ( positive torque) desired value (standard signal path) generated out of CoPT_trqDesEng" SWORD Trq_Nm 0 0 -3000.0 3000.0 ECU_ADDRESS 0x40022D48 /end MEASUREMENT
/begin MEASUREMENT HLSDem_trqNoGripPredef_mp "Filtered inner torque ( positive torque) desired value (standard signal path) generated out of CoPT_trqDesEng" SWORD Trq_Nm 0 0 -3000.0 3000.0 ECU_ADDRESS 0x40022D4A /end MEASUREMENT
/begin MEASUREMENT HLSDem_trqGripPredef_mp "Filtered inner torque ( positive torque) desired value (standard signal path) generated out of CoPT_trqDesEng" SWORD Trq_Nm 0 0 -3000.0 3000.0 ECU_ADDRESS 0x40022D4C /end MEASUREMENT
/begin MEASUREMENT HLSDem_trqPredef_mp "Filtered inner torque ( positive torque) desired value (standard signal path) generated out of CoPT_trqDesEng" SWORD Trq_Nm 0 0 -3000.0 3000.0 ECU_ADDRESS 0x40022D4E /end MEASUREMENT
/begin MEASUREMENT HLSDem_tConv_mp "Temperature used for predefined torque calculation" SWORD Temp_deg 0 0 -150.0 150.0 ECU_ADDRESS 0x40022D50 /end MEASUREMENT
/begin MEASUREMENT HLSDem_tTrqReqStrt_mp "Temperature used for predefined torque calculation" SWORD Temp_deg 0 0 -150.0 150.0 ECU_ADDRESS 0x40022D52 /end MEASUREMENT
/begin MEASUREMENT HLSDem_stPreCtlNotLock "Status information of prectl not lock" UBYTE boolean 0 0 0.0 1.0 ECU_ADDRESS 0x40022D54 /end MEASUREMENT
/begin MEASUREMENT HLSDem_stFrzI "Status information of prectl not lock" UBYTE boolean 0 0 0.0 1.0 ECU_ADDRESS 0x40022D55 /end MEASUREMENT
/begin MEASUREMENT HLSDem_stUnderBrk "Status information of prectl not lock" UBYTE boolean 0 0 0.0 1.0 ECU_ADDRESS 0x40022D56 /end MEASUREMENT
/begin MEASUREMENT HLSDem_stTrqInitReq "Status information of prectl not lock" UBYTE boolean 0 0 0.0 1.0 ECU_ADDRESS 0x40022D57 /end MEASUREMENT
/begin MEASUREMENT HLSDem_KpPosHiCurrGrip_mp "Current positive large signal gain of the P-element of upper path for Grip condition" SLONG HLSDem_Kp 0 0 -10000.0 10000.0 ECU_ADDRESS 0x40022D5C /end MEASUREMENT
/begin MEASUREMENT HLSDem_KpPosLoCurrGrip_mp "Current positive large signal gain of the P-element of Lower path for Grip condition" SLONG HLSDem_Kp 0 0 -10000.0 10000.0 ECU_ADDRESS 0x40022D60 /end MEASUREMENT
/begin MEASUREMENT HLSDem_KpHiCurrGrip_mp "Current gain of the P-element of upper path for Grip condition" SLONG HLSDem_Kp 0 0 -10000.0 10000.0 ECU_ADDRESS 0x40022D64 /end MEASUREMENT
/begin MEASUREMENT HLSDem_KpLoCurrGrip_mp "Current gain of the P-element of lower path for Grip condition" SLONG HLSDem_Kp 0 0 -10000.0 10000.0 ECU_ADDRESS 0x40022D68 /end MEASUREMENT
/begin MEASUREMENT HLSDem_KpNegHiCurrGrip_mp "Current negative large signal gain of the P-element of upper path for Grip condition" SLONG HLSDem_Kp 0 0 -10000.0 10000.0 ECU_ADDRESS 0x40022D6C /end MEASUREMENT
/begin MEASUREMENT HLSDem_KpNegLoCurrGrip_mp "Current negative large signal gain of the P-element of Lower path for Grip condition" SLONG HLSDem_Kp 0 0 -10000.0 10000.0 ECU_ADDRESS 0x40022D70 /end MEASUREMENT
/begin MEASUREMENT HLSDem_KpPosLoCurrNoGrip_mp "Current positive large signal gain of the P-element of Lower path for No Grip condition" SLONG HLSDem_Kp 0 0 -10000.0 10000.0 ECU_ADDRESS 0x40022D74 /end MEASUREMENT
/begin MEASUREMENT HLSDem_KpPosHiCurrNoGrip_mp "Current positive large signal gain of the P-element of upper path for No Grip condition" SLONG HLSDem_Kp 0 0 -10000.0 10000.0 ECU_ADDRESS 0x40022D78 /end MEASUREMENT
/begin MEASUREMENT HLSDem_KpLoCurrNoGrip_mp "Current gain of the P-element of lower path for No Grip condition" SLONG HLSDem_Kp 0 0 -10000.0 10000.0 ECU_ADDRESS 0x40022D7C /end MEASUREMENT
/begin MEASUREMENT HLSDem_KpHiCurrNoGrip_mp "Current gain of the P-element of upper path for No Grip condition" SLONG HLSDem_Kp 0 0 -10000.0 10000.0 ECU_ADDRESS 0x40022D80 /end MEASUREMENT
/begin MEASUREMENT HLSDem_KpNegLoCurrNoGrip_mp "Current negative large signal gain of the P-element of Lower path for No Grip condition" SLONG HLSDem_Kp 0 0 -10000.0 10000.0 ECU_ADDRESS 0x40022D84 /end MEASUREMENT
/begin MEASUREMENT HLSDem_KpNegHiCurrNoGrip_mp "Current negative large signal gain of the P-element of upper path for No Grip condition" SLONG HLSDem_Kp 0 0 -10000.0 10000.0 ECU_ADDRESS 0x40022D88 /end MEASUREMENT
/begin MEASUREMENT HLSDem_KiHiCurrGrip_mp "Current gain of the I-element of upper path for Grip condition" SLONG HLSDem_Ki 0 0 -18000.0 18000.0 ECU_ADDRESS 0x40022D8C /end MEASUREMENT
/begin MEASUREMENT HLSDem_KiLoCurrGrip_mp "Current gain of the I-element of lower path for Grip condition" SLONG HLSDem_Ki 0 0 -18000.0 18000.0 ECU_ADDRESS 0x40022D90 /end MEASUREMENT
/begin MEASUREMENT HLSDem_KiNegLoCurrGrip_mp "Current negative large signal gain of the I-element of Lower path for Grip condition" SLONG HLSDem_Ki 0 0 -18000.0 18000.0 ECU_ADDRESS 0x40022D94 /end MEASUREMENT
/begin MEASUREMENT HLSDem_KiNegHiCurrGrip_mp "Current negative large signal gain of the I-element of upper path for Grip condition" SLONG HLSDem_Ki 0 0 -18000.0 18000.0 ECU_ADDRESS 0x40022D98 /end MEASUREMENT
/begin MEASUREMENT HLSDem_KiPosHiCurrGrip_mp "Current positive large signal gain of the I-element of upper path for Grip condition" SLONG HLSDem_Ki 0 0 -18000.0 18000.0 ECU_ADDRESS 0x40022D9C /end MEASUREMENT
/begin MEASUREMENT HLSDem_KiPosLoCurrGrip_mp "Current positive large signal gain of the I-element of Lower path for Grip condition" SLONG HLSDem_Ki 0 0 -18000.0 18000.0 ECU_ADDRESS 0x40022DA0 /end MEASUREMENT
/begin MEASUREMENT HLSDem_KiPosLoCurrNoGrip_mp "Current positive large signal gain of the I-element of Lower path for No Grip condition" SLONG HLSDem_Ki 0 0 -18000.0 18000.0 ECU_ADDRESS 0x40022DA4 /end MEASUREMENT
/begin MEASUREMENT HLSDem_KiLoCurrNoGrip_mp "Current gain of the I-element of lower path for No Grip condition" SLONG HLSDem_Ki 0 0 -18000.0 18000.0 ECU_ADDRESS 0x40022DA8 /end MEASUREMENT
/begin MEASUREMENT HLSDem_KiNegLoCurrNoGrip_mp "Current negative large signal gain of the I-element of Lower path for No Grip condition" SLONG HLSDem_Ki 0 0 -18000.0 18000.0 ECU_ADDRESS 0x40022DAC /end MEASUREMENT
/begin MEASUREMENT HLSDem_KiHiCurrNoGrip_mp "Current gain of the I-element of upper path for No Grip condition" SLONG HLSDem_Ki 0 0 -18000.0 18000.0 ECU_ADDRESS 0x40022DB0 /end MEASUREMENT
/begin MEASUREMENT HLSDem_KiPosHiCurrNoGrip_mp "Current positive large signal gain of the I-element of upper path for No Grip condition" SLONG HLSDem_Ki 0 0 -18000.0 18000.0 ECU_ADDRESS 0x40022DB4 /end MEASUREMENT
/begin MEASUREMENT HLSDem_KiNegHiCurrNoGrip_mp "Current negative large signal gain of the I-element of upper path for No Grip condition" SLONG HLSDem_Ki 0 0 -18000.0 18000.0 ECU_ADDRESS 0x40022DB8 /end MEASUREMENT
/begin MEASUREMENT HLSDem_nAvrgFlt_mp "Filtered engine speed used for correction factor calculation" SWORD EngSpeed_rpm 0 0 -6000.0 6000.0 ECU_ADDRESS 0x40022DBC /end MEASUREMENT
/begin MEASUREMENT HLSDem_IWinPosLoCurrGrip_mp "engine speed positi vewindow" SWORD EngSpeed_rpm 0 0 -6000.0 6000.0 ECU_ADDRESS 0x40022DBE /end MEASUREMENT
/begin MEASUREMENT HLSDem_IWinNegLoCurrGrip_mp "engine speed negative window" SWORD EngSpeed_rpm 0 0 -6000.0 6000.0 ECU_ADDRESS 0x40022DC0 /end MEASUREMENT
/begin MEASUREMENT HLSDem_IWinPosHiCurrGrip_mp "engine speed positi vewindow" SWORD EngSpeed_rpm 0 0 -6000.0 6000.0 ECU_ADDRESS 0x40022DC2 /end MEASUREMENT
/begin MEASUREMENT HLSDem_IWinNegHiCurrGrip_mp "engine speed negative window" SWORD EngSpeed_rpm 0 0 -6000.0 6000.0 ECU_ADDRESS 0x40022DC4 /end MEASUREMENT
/begin MEASUREMENT HLSDem_PWinPosLoCurrGrip_mp "engine speed positi vewindow" SWORD EngSpeed_rpm 0 0 -6000.0 6000.0 ECU_ADDRESS 0x40022DC6 /end MEASUREMENT
/begin MEASUREMENT HLSDem_PWinNegLoCurrGrip_mp "engine speed negative window" SWORD EngSpeed_rpm 0 0 -6000.0 6000.0 ECU_ADDRESS 0x40022DC8 /end MEASUREMENT
/begin MEASUREMENT HLSDem_PWinPosHiCurrGrip_mp "engine speed positi vewindow" SWORD EngSpeed_rpm 0 0 -6000.0 6000.0 ECU_ADDRESS 0x40022DCA /end MEASUREMENT
/begin MEASUREMENT HLSDem_PWinNegHiCurrGrip_mp "engine speed negative window" SWORD EngSpeed_rpm 0 0 -6000.0 6000.0 ECU_ADDRESS 0x40022DCC /end MEASUREMENT
/begin MEASUREMENT HLSDem_PWinPosLoCurrNoGrip_mp "Filtered engine speed used for correction factor calculation" SWORD EngSpeed_rpm 0 0 -6000.0 6000.0 ECU_ADDRESS 0x40022DCE /end MEASUREMENT
/begin MEASUREMENT HLSDem_PWinNegLoCurrNoGrip_mp "Filtered engine speed used for correction factor calculation" SWORD EngSpeed_rpm 0 0 -6000.0 6000.0 ECU_ADDRESS 0x40022DD0 /end MEASUREMENT
/begin MEASUREMENT HLSDem_PWinPosHiCurrNoGrip_mp "engine speed positi vewindow" SWORD EngSpeed_rpm 0 0 -6000.0 6000.0 ECU_ADDRESS 0x40022DD2 /end MEASUREMENT
/begin MEASUREMENT HLSDem_PWinNegHiCurrNoGrip_mp "engine speed negative window" SWORD EngSpeed_rpm 0 0 -6000.0 6000.0 ECU_ADDRESS 0x40022DD4 /end MEASUREMENT
/begin MEASUREMENT HLSDem_IWinPosLoCurrNoGrip_mp "engine speed positi vewindow" SWORD EngSpeed_rpm 0 0 -6000.0 6000.0 ECU_ADDRESS 0x40022DD6 /end MEASUREMENT
/begin MEASUREMENT HLSDem_IWinNegLoCurrNoGrip_mp "engine speed negative window" SWORD EngSpeed_rpm 0 0 -6000.0 6000.0 ECU_ADDRESS 0x40022DD8 /end MEASUREMENT
/begin MEASUREMENT HLSDem_IWinPosHiCurrNoGrip_mp "engine speed positi vewindow" SWORD EngSpeed_rpm 0 0 -6000.0 6000.0 ECU_ADDRESS 0x40022DDA /end MEASUREMENT
/begin MEASUREMENT HLSDem_IWinNegHiCurrNoGrip_mp "engine speed negative window" SWORD EngSpeed_rpm 0 0 -6000.0 6000.0 ECU_ADDRESS 0x40022DDC /end MEASUREMENT
/begin MEASUREMENT HLSDem_trqCorFacFlt_mp "Selected torque used for correction factor calculation" SWORD Trq_Nm 0 0 -3000.0 3000.0 ECU_ADDRESS 0x40022DDE /end MEASUREMENT
/begin MEASUREMENT HLSDem_tParAdap_mp "Temperature used for correction factor calculation" SWORD Temp_deg 0 0 -150.0 150.0 ECU_ADDRESS 0x40022DE0 /end MEASUREMENT
/begin MEASUREMENT HLSDem_KpCorTrqFac_mp "Torque dependent correction factor for P gain" SWORD Factor 0 0 -30.0 30.0 ECU_ADDRESS 0x40022DE2 /end MEASUREMENT
/begin MEASUREMENT HLSDem_KpCorTempFac_mp "Correction factor of P-parameter" SWORD Factor 0 0 -30.0 30.0 ECU_ADDRESS 0x40022DE4 /end MEASUREMENT
/begin MEASUREMENT HLSDem_KpCorFac_mp "Correction factor for P gain" SWORD Factor 0 0 -30.0 30.0 ECU_ADDRESS 0x40022DE6 /end MEASUREMENT
/begin MEASUREMENT HLSDem_KiCorTrqFac_mp "Torque dependent correction factor for I gain" SWORD Factor 0 0 -30.0 30.0 ECU_ADDRESS 0x40022DE8 /end MEASUREMENT
/begin MEASUREMENT HLSDem_KiCorTempFac_mp "Correction factor of I-parameter" SWORD Factor 0 0 -30.0 30.0 ECU_ADDRESS 0x40022DEA /end MEASUREMENT
/begin MEASUREMENT HLSDem_KiCorFac_mp "Correction factor for I gain" SWORD Factor 0 0 -30.0 30.0 ECU_ADDRESS 0x40022DEC /end MEASUREMENT
/begin MEASUREMENT HLSDem_trqFdbkFltHi_mp "filtered torque value for maximum engine speed after load correction" SWORD Trq_Nm 0 0 0.0 1000.0 ECU_ADDRESS 0x40022E04 /end MEASUREMENT
/begin MEASUREMENT HLSDem_trqFdbkFltLo_mp "Filtered torque value for the low idle setpoint speed after load correction (Nm )" SWORD Trq_Nm 0 0 0.0 1000.0 ECU_ADDRESS 0x40022E06 /end MEASUREMENT
/begin MEASUREMENT HLSDem_nGear_mp "High Idle setpoint reduction based on the gear group(rpm)" SWORD EngSpeed_rpm 0 0 0.0 6000.0 ECU_ADDRESS 0x40022E0C /end MEASUREMENT
/begin MEASUREMENT HLSDem_nStrtLub_mp "Maximum Engine setpoint reduction after start for lubrication (rpm )" SWORD EngSpeed_rpm 0 0 0.0 6000.0 ECU_ADDRESS 0x40022E0E /end MEASUREMENT
/begin MEASUREMENT HLSDem_nKD_mp "Overriden Maximum Engine speed setpoint reduction due to accelerator pedal kickdown (rpm)" SWORD EngSpeed_rpm 0 0 0.0 6000.0 ECU_ADDRESS 0x40022E10 /end MEASUREMENT
/begin MEASUREMENT HLSDem_nRedSetPHi_mp "Reduced Engine setpoint based on MSS limitation (rpm)" SWORD EngSpeed_rpm 0 0 0.0 6000.0 ECU_ADDRESS 0x40022E12 /end MEASUREMENT
/begin MEASUREMENT HLSDem_nSetPHiRaw_mp "Base value of the gear dependant limit of the high idle setpoint before limitation" SWORD EngSpeed_rpm 0 0 0.0 6000.0 ECU_ADDRESS 0x40022E14 /end MEASUREMENT
/begin MEASUREMENT HLSDem_nSetPHiBas_mp "Base value of the gear dependant limit of the high idle setpoint before limitation" SWORD EngSpeed_rpm 0 0 0.0 6000.0 ECU_ADDRESS 0x40022E16 /end MEASUREMENT
/begin MEASUREMENT HLSDem_nSetPHiCorVal_mp "correct value for high engine speed set point" SWORD EngSpeed_rpm 0 0 0.0 6000.0 ECU_ADDRESS 0x40022E18 /end MEASUREMENT
/begin MEASUREMENT HLSDem_nSetPLoCorVal_mp "Load dependant correction value of the low idle setpoint (rpm)" SWORD EngSpeed_rpm 0 0 0.0 6000.0 ECU_ADDRESS 0x40022E26 /end MEASUREMENT
/begin MEASUREMENT HLSDem_nSetPLoMoF "idle speed setpoint for level 2 monitoring" SWORD EngSpeed_rpm 0 0 0.0 6000.0 ECU_ADDRESS 0x40022E28 /end MEASUREMENT
/begin MEASUREMENT HLSDem_facFdbkSysDgrt "Feedback factor from system degradation (rpm/Nm )" SWORD FdbkNm2rpm_rpm_Nm 0 0 -20.0 20.0 ECU_ADDRESS 0x40022E2A /end MEASUREMENT
/begin MEASUREMENT HLSDem_facFdbk "Resulting feedback factor for Maximum Engine Speed (rpm/Nm)" SWORD FdbkNm2rpm_rpm_Nm 0 0 -20.0 20.0 ECU_ADDRESS 0x40022E2C /end MEASUREMENT
/begin COMPU_METHOD EngSpeed_rpm "f(x)=(c1*X*X+c2*X+c3)/(c4*X*X+c5*X+c6)" RAT_FUNC "%6.1" "rpm" COEFFS 0 2.000 0.000 0 0 1.000 /end COMPU_METHOD
/begin COMPU_METHOD State_uint8 "f(x)=(c1*X*X+c2*X+c3)/(c4*X*X+c5*X+c6)" RAT_FUNC "%3.0" "" COEFFS 0 1 0 0 0 1 /end COMPU_METHOD
/begin COMPU_METHOD State_uint16 "f(x)=(c1*X*X+c2*X+c3)/(c4*X*X+c5*X+c6)" RAT_FUNC "%5.0" "" COEFFS 0 1 0 0 0 1 /end COMPU_METHOD
/begin COMPU_METHOD State_uint32 "f(x)=(c1*X*X+c2*X+c3)/(c4*X*X+c5*X+c6)" RAT_FUNC "%10.0" "" COEFFS 0 1 0 0 0 1 /end COMPU_METHOD
/begin COMPU_METHOD HLSDem_Kp "f(x)=(c1*X*X+c2*X+c3)/(c4*X*X+c5*X+c6)" RAT_FUNC "%0.3" "Nm/rpm" COEFFS 0 163840.000 0.000 0 0 1.000 /end COMPU_METHOD
/begin COMPU_METHOD HLSDem_Ki "f(x)=(c1*X*X+c2*X+c3)/(c4*X*X+c5*X+c6)" RAT_FUNC "%0.3" "Nm/(rpm*s)" COEFFS 0 10737.000 0.000 0 0 1.000 /end COMPU_METHOD
/begin COMPU_METHOD Trq_Nm "f(x)=(c1*X*X+c2*X+c3)/(c4*X*X+c5*X+c6)" RAT_FUNC "%0.3" "Nm" COEFFS 0 10.000 0.000 0 0 1.000 /end COMPU_METHOD
/begin COMPU_METHOD FdbkNm2rpm_rpm_Nm "f(x)=(c1*X*X+c2*X+c3)/(c4*X*X+c5*X+c6)" RAT_FUNC "%0.3" "rpm/Nm" COEFFS 0 1638.350 0.000 0 0 1.000 /end COMPU_METHOD
/begin COMPU_METHOD AirPressure_kPa "f(x)=(c1*X*X+c2*X+c3)/(c4*X*X+c5*X+c6)" RAT_FUNC "%0.3" "kPa" COEFFS 0 10.000 0.000 0 0 1.000 /end COMPU_METHOD
/begin COMPU_METHOD boolean "f(x)=(c1*X*X+c2*X+c3)/(c4*X*X+c5*X+c6)" RAT_FUNC "%1.0" "" COEFFS 0 1 0 0 0 1 /end COMPU_METHOD
/begin COMPU_METHOD uint8 "f(x)=(c1*X*X+c2*X+c3)/(c4*X*X+c5*X+c6)" RAT_FUNC "%3.0" "" COEFFS 0 1 0 0 0 1 /end COMPU_METHOD
/begin COMPU_METHOD EngTime_ms "f(x)=(c1*X*X+c2*X+c3)/(c4*X*X+c5*X+c6)" RAT_FUNC "%0.3" "ms" COEFFS 0 1.000 0.000 0 0 10.000 /end COMPU_METHOD
/begin COMPU_METHOD TimeEngOn_s "f(x)=(c1*X*X+c2*X+c3)/(c4*X*X+c5*X+c6)" RAT_FUNC "%10.0" "s" COEFFS 0 1 0 0 0 1 /end COMPU_METHOD
/begin COMPU_METHOD Time_s "f(x)=(c1*X*X+c2*X+c3)/(c4*X*X+c5*X+c6)" RAT_FUNC "%0.3" "s" COEFFS 0 100.000 0.000 0 0 1.000 /end COMPU_METHOD
/begin COMPU_METHOD RailDT1_ms "f(x)=(c1*X*X+c2*X+c3)/(c4*X*X+c5*X+c6)" RAT_FUNC "%5.0" "ms" COEFFS 0 1 0 0 0 1 /end COMPU_METHOD
/begin COMPU_METHOD AirMass_mg_hub "f(x)=(c1*X*X+c2*X+c3)/(c4*X*X+c5*X+c6)" RAT_FUNC "%6.1" "mg/hub" COEFFS 0 2.000 0.000 0 0 1.000 /end COMPU_METHOD
/begin COMPU_METHOD EngSpeed_rpm_s "f(x)=(c1*X*X+c2*X+c3)/(c4*X*X+c5*X+c6)" RAT_FUNC "%6.1" "rpm/s" COEFFS 0 2.000 0.000 0 0 1.000 /end COMPU_METHOD
/begin COMPU_METHOD VehSpeed_km_h "f(x)=(c1*X*X+c2*X+c3)/(c4*X*X+c5*X+c6)" RAT_FUNC "%0.3" "km/h" COEFFS 0 100.000 0.000 0 0 1.000 /end COMPU_METHOD
/begin COMPU_METHOD TransRatio "f(x)=(c1*X*X+c2*X+c3)/(c4*X*X+c5*X+c6)" RAT_FUNC "%0.3" "" COEFFS 0 100.000 0.000 0 0 1.000 /end COMPU_METHOD
/begin COMPU_METHOD Prc_Fact100 "f(x)=(c1*X*X+c2*X+c3)/(c4*X*X+c5*X+c6)" RAT_FUNC "%0.3" "" COEFFS 0 100.000 0.000 0 0 1.000 /end COMPU_METHOD
/begin COMPU_METHOD Temp_deg "f(x)=(c1*X*X+c2*X+c3)/(c4*X*X+c5*X+c6)" RAT_FUNC "%0.3" "deg" COEFFS 0 10.000 2731.400 0 0 1.000 /end COMPU_METHOD
/begin COMPU_METHOD PT_fac "f(x)=(c1*X*X+c2*X+c3)/(c4*X*X+c5*X+c6)" RAT_FUNC "%0.3" "" COEFFS 0 655.360 0.000 0 0 1.000 /end COMPU_METHOD
/begin COMPU_METHOD Accpedal_rate "f(x)=(c1*X*X+c2*X+c3)/(c4*X*X+c5*X+c6)" RAT_FUNC "%0.3" "%" COEFFS 0 81.920 0.000 0 0 1.000 /end COMPU_METHOD
/begin COMPU_METHOD Factor "f(x)=(c1*X*X+c2*X+c3)/(c4*X*X+c5*X+c6)" RAT_FUNC "%12.6" "" COEFFS 0 1024.000 0.000 0 0 1.000 /end COMPU_METHOD
/begin COMPU_METHOD Pid_Kp_Kd "f(x)=(c1*X*X+c2*X+c3)/(c4*X*X+c5*X+c6)" RAT_FUNC "%0.3" "" COEFFS 0 1000.000 0.000 0 0 1.000 /end COMPU_METHOD
/begin COMPU_METHOD HLSDem_Inrt "f(x)=(c1*X*X+c2*X+c3)/(c4*X*X+c5*X+c6)" RAT_FUNC "%0.3" "Nm/(rpm/s)" COEFFS 0 640.000 0.000 0 0 1.000 /end COMPU_METHOD
/begin COMPU_METHOD Switch_conv "Enumerated data type: Switch_conv" TAB_VERB "%0.3" "" COMPU_TAB_REF VTAB_FOR_Switch_conv /end COMPU_METHOD
/begin COMPU_METHOD EISGov_num_conv "Enumerated data type: EISGov_num_conv" TAB_VERB "%0.3" "" COMPU_TAB_REF VTAB_FOR_EISGov_num_conv /end COMPU_METHOD
/begin COMPU_METHOD Trq_Nm_s "f(x)=(c1*X*X+c2*X+c3)/(c4*X*X+c5*X+c6)" RAT_FUNC "%0.3" "Nm/s" COEFFS 0 10.000 0.000 0 0 1.000 /end COMPU_METHOD
/begin COMPU_METHOD EngTempFldSel_conv "Enumerated data type: EngTempFldSel_conv" TAB_VERB "%0.3" "" COMPU_TAB_REF VTAB_FOR_EngTempFldSel_conv /end COMPU_METHOD
/begin COMPU_METHOD AirTempFldSel_conv "Enumerated data type: AirTempFldSel_conv" TAB_VERB "%0.3" "" COMPU_TAB_REF VTAB_FOR_AirTempFldSel_conv /end COMPU_METHOD
/begin COMPU_METHOD TrqPerDeg_Nm_deg "f(x)=(c1*X*X+c2*X+c3)/(c4*X*X+c5*X+c6)" RAT_FUNC "%0.3" "Nm/deg" COEFFS 0 2000.000 0.000 0 0 1.000 /end COMPU_METHOD
/begin COMPU_VTAB VTAB_FOR_Switch_conv "Enumerated data type: Switch_conv" TAB_VERB 2 0 "OFF" 1 "ON" /end COMPU_VTAB
/begin COMPU_VTAB VTAB_FOR_EISGov_num_conv "Enumerated data type: EISGov_num_conv" TAB_VERB 9 0 "EISGov" 1 "HLSDem" 2 "GSHDem" 3 "WESDem" 4 "DiaDem" 5 "AGSDem" 6 "ExtDem" 127 "EngICO" 7 "DrvDem" /end COMPU_VTAB
/begin COMPU_VTAB VTAB_FOR_EngTempFldSel_conv "Enumerated data type: EngTempFldSel_conv" TAB_VERB 3 0 "Coolant_Temperature" 1 "Oil_Temperature" 2 "Eng_Temperature" /end COMPU_VTAB
/begin COMPU_VTAB VTAB_FOR_AirTempFldSel_conv "Enumerated data type: AirTempFldSel_conv" TAB_VERB 4 0 "Air_tCACDs" 1 "Air_tAFS" 2 "Air_tEnvT" 3 "Air_tIntkVUS" /end COMPU_VTAB
/begin GROUP Root_Exhaust_gas_temperature_limitation "EngPrt_PrtLimOvht/Exhaust gas temperature limitation" /begin SUB_GROUP S1_Dynamic_Calculation /end SUB_GROUP
 /begin REF_CHARACTERISTIC EngPrt_swtOvhtPrvOn_C EngPrt_tOvhtPrvAllwMax_C EngPrt_tOvhtPrvHighMapRef_C EngPrt_tOvhtPrvLowMapRef_C EngPrt_trqOvhtPrvDynLimMax_C EngPrt_trqOvhtPrvDynLimMin_C EngPrt_trqOvhtPrvHigh_MAP EngPrt_trqOvhtPrvLow_MAP EngPrt_trqOvhtPrvMax_MAP /end REF_CHARACTERISTIC
 /begin REF_MEASUREMENT EngPrt_facOvhtPrvTrqTemp_mp EngPrt_trqOvhtPrvDynLtd_mp EngPrt_trqOvhtPrvHigh_mp EngPrt_trqOvhtPrvLow_mp EngPrt_trqOvhtPrvMax_mp EngPrt_trqOvhtPrvStab_mp EngPrt_trqOvhtPrvSum_mp EngPrt_trqOvhtPrvTLim_mp /end REF_MEASUREMENT
/end GROUP
/begin GROUP Root_Temperature_Limitation "EngPrt_PrtLimOvht/Temperature Limitation" /begin SUB_GROUP S2_AirtFld_Selector /end SUB_GROUP
 /begin REF_CHARACTERISTIC EngPrt_facOvhtPrvCT_CUR EngPrt_facOvhtPrvFT_CUR EngPrt_facOvhtPrvIAT_CUR EngPrt_facOvhtPrvOT_CUR EngPrt_numAir_C EngPrt_trqOvhtPrvNRng_MAP EngPrt_trqOvhtPrvVRng_MAP /end REF_CHARACTERISTIC
 /begin REF_MEASUREMENT EngPrt_facOvhtPrvCT_mp EngPrt_facOvhtPrvFT_mp EngPrt_facOvhtPrvIAT_mp EngPrt_facOvhtPrvOT_mp EngPrt_facOvhtPrv_mp EngPrt_trqOvhtPrvNRng_mp EngPrt_trqOvhtPrvVRng_mp /end REF_MEASUREMENT
/end GROUP
/begin GROUP S1_Dynamic_Calculation "EngPrt_PrtLimOvht/Exhaust gas temperature limitation/Dynamic Calculation"
 /begin REF_CHARACTERISTIC EngPrt_facOvhtPrvAdd_CUR EngPrt_facOvhtPrvDown_C EngPrt_facOvhtPrvIATCor_C EngPrt_facOvhtPrvUp_C EngPrt_numAir_C EngPrt_swtOvhtPrvDyn_C EngPrt_tOvhtPrvAllwMax_C EngPrt_tOvhtPrvIATRef_CUR EngPrt_tOvhtPrvLowMapRef_C EngPrt_tOvhtPrvMinCalc_C EngPrt_trqOvhtPrvAdd_MAP /end REF_CHARACTERISTIC
 /begin REF_MEASUREMENT EngPrt_tOvhtPrvCalc_mp EngPrt_tOvhtPrvCor_mp EngPrt_tOvhtPrvDiff_mp EngPrt_tOvhtPrvFlt_mp EngPrt_tOvhtPrvIATCor_mp EngPrt_trqOvhtPrvDyn_mp /end REF_MEASUREMENT
/end GROUP
/begin GROUP S2_AirtFld_Selector "EngPrt_PrtLimOvht/Temperature Limitation/AirtFld_Selector" /begin REF_MEASUREMENT EngPrt_tAirDes_mp /end REF_MEASUREMENT /end GROUP
/begin GROUP EngPrt_TrqLimPTO "EngPrt_TrqLimPTO"
 /begin REF_CHARACTERISTIC EngPrt_facPTOLim0_CUR EngPrt_facPTOLim1_CUR EngPrt_facPTOLim2_CUR EngPrt_facPTOLim3_CUR EngPrt_facPTOLim4_CUR /end REF_CHARACTERISTIC
 /begin REF_MEASUREMENT EngPrt_facPTOLim_mp /end REF_MEASUREMENT
/end GROUP
/begin GROUP EngReq_SmkLimCalc "EngReq_SmkLimCalc" /begin SUB_GROUP Root_ramp Root_trqLim /end SUB_GROUP /end GROUP
/begin GROUP Root_ramp "EngReq_SmkLimCalc/ramp" /begin REF_CHARACTERISTIC EngReq_SlpLimNeg_C EngReq_SlpLimPos_C EngReq_nSlpLimMin_C /end REF_CHARACTERISTIC /end GROUP
/begin GROUP Root_trqLim "EngReq_SmkLimCalc/trqLim"
 /begin REF_CHARACTERISTIC EngReq_bSmkLimCnv_C EngReq_bSmkLimIntkP_C EngReq_facAFSFlt_C SmkLim_facSmkATSCor_CUR SmkLim_facSmkEnvPCor_CUR SmkLim_trqLimSmkAFSEnvPCor_MAP SmkLim_trqLimSmkAFS_MAP SmkLim_trqLimSmk_MAP /end REF_CHARACTERISTIC
 /begin REF_MEASUREMENT SmkLim_facSmkATSCor_mp SmkLim_facSmkEnvPCor_mp SmkLim_trqLimSmkAFSBase_mp SmkLim_trqLimSmkAFSEnvPCor_mp SmkLim_trqLimSmkBase_mp /end REF_MEASUREMENT
/end GROUP
/begin GROUP DrvDem_CalcState "DrvDem_CalcState" /begin SUB_GROUP Root_Calculation_of_ShutOff_conditions /end SUB_GROUP /end GROUP
/begin GROUP Root_Calculation_of_ShutOff_conditions "DrvDem_CalcState/Calculation of ShutOff conditions" /begin REF_CHARACTERISTIC DrvDem_stShOffCfg_C DrvDem_tiNormal_C DrvDem_vThres_C /end REF_CHARACTERISTIC /end GROUP
/begin GROUP DrvDem_SelectParameter "DrvDem_SelectParameter"
 /begin SUB_GROUP Root_DrvDem_KiStruct Root_DrvDem_KpStruct Root_Parameter_Correction Root_feedback_factors_Calculation Root_speed_gradient_Limitation /end SUB_GROUP
/end GROUP
/begin GROUP Root_DrvDem_KiStruct "DrvDem_SelectParameter/DrvDem_KiStruct"
 /begin REF_CHARACTERISTIC DrvDem_ParSetIKiLo_CUR DrvDem_ParSetIKiNegLo_CUR DrvDem_ParSetIKiPosLo_CUR DrvDem_ParSetIWinNegHi_C DrvDem_ParSetIWinNegLo_C DrvDem_ParSetIWinPosHi_C DrvDem_ParSetIWinPosLo_C /end REF_CHARACTERISTIC
/end GROUP
/begin GROUP Root_DrvDem_KpStruct "DrvDem_SelectParameter/DrvDem_KpStruct"
 /begin REF_CHARACTERISTIC DrvDem_ParSetPKpLo_CUR DrvDem_ParSetPKpNegLo_CUR DrvDem_ParSetPKpPosLo_CUR DrvDem_ParSetPWinNegHi_C DrvDem_ParSetPWinNegLo_C DrvDem_ParSetPWinPosHi_C DrvDem_ParSetPWinPosLo_C /end REF_CHARACTERISTIC
/end GROUP
/begin GROUP Root_Parameter_Correction "DrvDem_SelectParameter/Parameter_Correction" /begin SUB_GROUP S3_EngtFld_Selector /end SUB_GROUP
 /begin REF_CHARACTERISTIC DrvDem_KiCorTempFac_MAP DrvDem_KiCorTrqFac_MAP DrvDem_KpCorTempFac_MAP DrvDem_KpCorTrqFac_MAP DrvDem_facNAvrgPT1CorFac_C DrvDem_facTrqPT1CorFac_C DrvDem_swtTempSelParAdap_C DrvDem_swtTrqSelCorFac_C /end REF_CHARACTERISTIC
 /begin REF_MEASUREMENT DrvDem_KiCorFac_mp DrvDem_KiCorTempFac_mp DrvDem_KiCorTrqFac_mp DrvDem_KpCorFac_mp DrvDem_KpCorTempFac_mp DrvDem_KpCorTrqFac_mp DrvDem_nAvrgFlt_mp DrvDem_trqCorFacFlt_mp /end REF_MEASUREMENT
/end GROUP
/begin GROUP Root_feedback_factors_Calculation "DrvDem_SelectParameter/feedback_factors_Calculation"
 /begin REF_CHARACTERISTIC DrvDem_ParSetInrtVeh_CUR DrvDem_ParSetTiFltTrqLos_CUR DrvDem_facFdbkTrqLosHiParSet_CUR DrvDem_facFdbkTrqLosLoParSet_CUR /end REF_CHARACTERISTIC
/end GROUP
/begin GROUP Root_speed_gradient_Limitation "DrvDem_SelectParameter/speed_gradient_Limitation" /begin REF_CHARACTERISTIC DrvDem_dnAccLim_CUR DrvDem_dnDeclLim_CUR /end REF_CHARACTERISTIC /end GROUP
/begin GROUP S3_EngtFld_Selector "DrvDem_SelectParameter/Parameter_Correction/EngtFld_Selector" /begin REF_MEASUREMENT DrvDem_tParAdap_mp /end REF_MEASUREMENT /end GROUP
/begin GROUP DrvDem_SetPoint "DrvDem_SetPoint" /begin SUB_GROUP Root_DrvDem_SetPoint /end SUB_GROUP /end GROUP
/begin GROUP Root_DrvDem_SetPoint "DrvDem_SetPoint/DrvDem_SetPoint"
 /begin REF_CHARACTERISTIC DrvDem_facDrvSetPPT1_C DrvDem_nDrvSetPLo_CUR DrvDem_nSpdDem_C DrvDem_swtDrvNGovActv_C DrvDem_swtDrvNGovcfg_C /end REF_CHARACTERISTIC
 /begin REF_MEASUREMENT DrvDem_nDrvSetPBas_mp DrvDem_nDrvSetP_mp DrvDem_stDrvNGovActv_mp /end REF_MEASUREMENT
/end GROUP
/begin GROUP EISGov_Governor "EISGov_Governor"
 /begin SUB_GROUP Root_DT1 Root_DT1_Parameter Root_Filtering_the_controller_output Root_HIGov Root_LIGov /end SUB_GROUP
 /begin REF_CHARACTERISTIC EISGov_nDHypDenom_C EISGov_nDHypNum_C EISGov_stDTSlect_C /end REF_CHARACTERISTIC
 /begin REF_MEASUREMENT EISGov_facDT1Trq_mp EISGov_nDiffHi_mp EISGov_nDiffLo_mp EISGov_stCompDT1_mp EISGov_trqDT1_mp EISGov_trqD_mp EISGov_trqPISum_mp /end REF_MEASUREMENT
/end GROUP
/begin GROUP Root_DT1 "EISGov_Governor/DT1" /begin REF_MEASUREMENT EISGov_trqDRaw_mp /end REF_MEASUREMENT /end GROUP
/begin GROUP Root_DT1_Parameter "EISGov_Governor/DT1 Parameter" /begin SUB_GROUP S6_EngtFld_Selector /end SUB_GROUP
 /begin REF_CHARACTERISTIC EISGov_DKd_CUR EISGov_facDT1_CUR EISGov_tiDT1_CUR LIGov_numTempSel_C /end REF_CHARACTERISTIC
 /begin REF_MEASUREMENT EISGov_DKdCurr_mp EISGov_DT1Curr_mp /end REF_MEASUREMENT
/end GROUP
/begin GROUP Root_Filtering_the_controller_output "EISGov_Governor/Filtering the controller output"
 /begin REF_CHARACTERISTIC EISGov_facPT1DiffLoFlt_C EISGov_facPT1TrqFlt_CUR EISGov_swtTrqFltNeg_C /end REF_CHARACTERISTIC
 /begin REF_MEASUREMENT EISGov_facPT1TrqFlt EISGov_nDiffLoFlt_mp /end REF_MEASUREMENT
/end GROUP
/begin GROUP Root_HIGov "EISGov_Governor/HIGov" /begin SUB_GROUP S9_Freeze_High_Path /end SUB_GROUP
 /begin REF_CHARACTERISTIC EISGov_trqIHiLimMax_C EISGov_trqIHiLimMin_C EISGov_trqPIHiLimMax_C EISGov_trqPIHiLimMin_C /end REF_CHARACTERISTIC
 /begin REF_MEASUREMENT EISGov_trqIHi_mp EISGov_trqILtdHi_mp EISGov_trqPHi EISGov_trqPILtdHi_mp /end REF_MEASUREMENT
/end GROUP
/begin GROUP Root_LIGov "EISGov_Governor/LIGov" /begin SUB_GROUP S10_Freeze_Low_Path S10_Init_Low_Path /end SUB_GROUP
 /begin REF_CHARACTERISTIC EISGov_trqILoLimMax_C EISGov_trqILoLimMin_C EISGov_trqPILoLimMax_C EISGov_trqPILoLimMin_C /end REF_CHARACTERISTIC
 /begin REF_MEASUREMENT EISGov_trqILo_mp EISGov_trqILtdLo_mp EISGov_trqPILtdLo_mp /end REF_MEASUREMENT
/end GROUP
/begin GROUP S6_EngtFld_Selector "EISGov_Governor/DT1 Parameter/EngtFld_Selector" /begin REF_MEASUREMENT EISGov_tDT1_mp /end REF_MEASUREMENT /end GROUP
/begin GROUP S9_Freeze_High_Path "EISGov_Governor/HIGov/Freeze High Path" /begin REF_MEASUREMENT EISGov_stHiFrzI_mp /end REF_MEASUREMENT /end GROUP
/begin GROUP S10_Freeze_Low_Path "EISGov_Governor/LIGov/Freeze Low Path" /begin REF_MEASUREMENT EISGov_stLoFrzI_mp /end REF_MEASUREMENT /end GROUP
/begin GROUP S10_Init_Low_Path "EISGov_Governor/LIGov/Init Low Path"
 /begin REF_CHARACTERISTIC EISGov_bEngSPDropRestrainEN_C EISGov_dnDiffHi_C EISGov_dnDiffLo_C EISGov_nDiffHiLim_C EISGov_nDiffHi_C EISGov_nDiffLo_C EISGov_stIInitDemChange_C EISGov_tiTimeSPDropResActive_CUR EISGov_trqILoLimMax_C EISGov_trqILoLimMin_C /end REF_CHARACTERISTIC
 /begin REF_MEASUREMENT EISGov_stIdleLoadIncrease_mp EISGov_stIdleLoadReduce_mp EISGov_stInitIReq EISGov_trqInitI EISGov_trqLoadEstimate_mp /end REF_MEASUREMENT
/end GROUP
/begin GROUP EISGov_SelectParameter "EISGov_SelectParameter"
 /begin SUB_GROUP Root_EISGov_Parameter Root_prio1 Root_prio2 Root_prio3 Root_prio4 Root_prio5 /end SUB_GROUP
 /begin REF_CHARACTERISTIC EISGov_stPrio_CA /end REF_CHARACTERISTIC
/end GROUP
/begin GROUP Root_EISGov_Parameter "EISGov_SelectParameter/EISGov_Parameter" /begin REF_CHARACTERISTIC EISGov_SetPLoRmpSlopeNeg_C EISGov_SetPLoRmpSlopePos_C /end REF_CHARACTERISTIC /end GROUP
/begin GROUP Root_prio1 "EISGov_SelectParameter/prio1" /begin REF_CHARACTERISTIC EISGov_stPrio_CA /end REF_CHARACTERISTIC /end GROUP
/begin GROUP Root_prio2 "EISGov_SelectParameter/prio2" /begin REF_CHARACTERISTIC EISGov_stPrio_CA /end REF_CHARACTERISTIC /end GROUP
/begin GROUP Root_prio3 "EISGov_SelectParameter/prio3" /begin REF_CHARACTERISTIC EISGov_stPrio_CA /end REF_CHARACTERISTIC /end GROUP
/begin GROUP Root_prio4 "EISGov_SelectParameter/prio4" /begin REF_CHARACTERISTIC EISGov_stPrio_CA /end REF_CHARACTERISTIC /end GROUP
/begin GROUP Root_prio5 "EISGov_SelectParameter/prio5" /begin REF_CHARACTERISTIC EISGov_stPrio_CA /end REF_CHARACTERISTIC /end GROUP
/begin GROUP EISGov_SelectTrqLim "EISGov_SelectTrqLim" /begin SUB_GROUP Root_Calculation_of_torque_control_limits /end SUB_GROUP /end GROUP
/begin GROUP Root_Calculation_of_torque_control_limits "EISGov_SelectTrqLim/Calculation of torque control limits" /begin REF_CHARACTERISTIC EISGov_trqRedHiLimMin_C /end REF_CHARACTERISTIC /end GROUP
/begin GROUP EISGov_TrqLosEst "EISGov_TrqLosEst" /begin SUB_GROUP Root_EISGov_InrtVehCurr Root_EISGov_dn /end SUB_GROUP
 /begin REF_CHARACTERISTIC EISGov_dnEngFltIni_C EISGov_facEngDnFlt_CUR EISGov_titrqLosFlt_C EISGov_trqLosEstSlect_C EISGov_trqLossLimMax_C /end REF_CHARACTERISTIC
 /begin REF_MEASUREMENT EISGov_trqAcc_mp EISGov_trqInrSetFlt_mp EISGov_trqLosFlt_mp Epm_dnEngFlt_mp /end REF_MEASUREMENT
/end GROUP
/begin GROUP Root_EISGov_InrtVehCurr "EISGov_TrqLosEst/EISGov_InrtVehCurr" /begin REF_MEASUREMENT EISGov_InrtVehCurr /end REF_MEASUREMENT /end GROUP
/begin GROUP Root_EISGov_dn "EISGov_TrqLosEst/EISGov_dn"
 /begin REF_CHARACTERISTIC EISGov_facdnAccDecLim_CUR EISGov_swtTempSel_C EISGov_tiSetTimeAccDecLim_CUR /end REF_CHARACTERISTIC
/end GROUP
/begin GROUP ExtDem_CalcState "ExtDem_CalcState" /begin SUB_GROUP Root_ExtDem_CalcState /end SUB_GROUP /end GROUP
/begin GROUP Root_ExtDem_CalcState "ExtDem_CalcState/ExtDem_CalcState" /begin SUB_GROUP S1_06_EISGov_st6_interface_ /end SUB_GROUP /end GROUP
/begin GROUP S1_06_EISGov_st6_interface_ "ExtDem_CalcState/ExtDem_CalcState/06_EISGov_st6 interface " /begin SUB_GROUP S2_EISGov_st6_bit0 /end SUB_GROUP /begin REF_CHARACTERISTIC ExtDem_swtAct_C /end REF_CHARACTERISTIC /end GROUP
/begin GROUP S2_EISGov_st6_bit0 "ExtDem_CalcState/ExtDem_CalcState/06_EISGov_st6 interface /EISGov_st6_bit0" /begin REF_CHARACTERISTIC ExtDem_rAPPThresTrqDem_C ExtDem_stMskFrzRls_C /end REF_CHARACTERISTIC /end GROUP
/begin GROUP ExtDem_SelectParameter "ExtDem_SelectParameter"
 /begin SUB_GROUP Root_01_Correction_factor_Calculations_ Root_02_Parameter_Set_Selection Root_03_Feedback_Factor_ Root_04_Limitation_of_the_engine_speed_gradient_ Root_05_Con__xFB01_guration_mode_ /end SUB_GROUP
/end GROUP
/begin GROUP Root_01_Correction_factor_Calculations_ "ExtDem_SelectParameter/01_Correction factor Calculations "
 /begin REF_CHARACTERISTIC ExtDem_KiCorTempFac_MAP ExtDem_KiCorTrqFac_MAP ExtDem_KpCorTempFac_MAP ExtDem_KpCorTrqFac_MAP ExtDem_facNAvrgPT1CorFac_C ExtDem_facTrqPT1CorFac_C ExtDem_swtNSelCorFac_C ExtDem_swtTempSel_C ExtDem_swtTrqSelCorFac_C /end REF_CHARACTERISTIC
 /begin REF_MEASUREMENT ExtDem_KiCorTempFac_mp ExtDem_KiCorTrqFac_mp ExtDem_KpCorTempFac_mp ExtDem_KpCorTrqFac_mp ExtDem_nSelCorFac_mp ExtDem_nSetP_mp ExtDem_tParAdap_mp /end REF_MEASUREMENT
/end GROUP
/begin GROUP Root_02_Parameter_Set_Selection "ExtDem_SelectParameter/02_Parameter Set Selection" /begin SUB_GROUP S2_Ki_Calculation S2_Kp_Calculation_ /end SUB_GROUP /end GROUP
/begin GROUP Root_03_Feedback_Factor_ "ExtDem_SelectParameter/03_Feedback Factor " /begin SUB_GROUP S3__inner_feedback_factors__ S3_outer_feedback_factor_ /end SUB_GROUP /end GROUP
/begin GROUP Root_04_Limitation_of_the_engine_speed_gradient_ "ExtDem_SelectParameter/04_Limitation of the engine speed gradient " /begin SUB_GROUP S4_dnAccLim S4_dnDecLim /end SUB_GROUP /end GROUP
/begin GROUP Root_05_Con__xFB01_guration_mode_ "ExtDem_SelectParameter/05_Con&#xFB01;guration mode "
 /begin REF_CHARACTERISTIC ExtDem_Par0Cfg_C ExtDem_Par1Cfg_C ExtDem_Par2Cfg_C ExtDem_Par3Cfg_C ExtDem_Par4Cfg_C ExtDem_Par5Cfg_C ExtDem_Par6Cfg_C ExtDem_Par7Cfg_C /end REF_CHARACTERISTIC
/end GROUP
/begin GROUP S2_Ki_Calculation "ExtDem_SelectParameter/02_Parameter Set Selection/Ki Calculation"
 /begin SUB_GROUP S10_ExtDem_ParXIKiNeg_mp S10_ExtDem_ParXIKiPos_mp S10_ExtDem_ParXIKi_mp S10_ExtDem_ParXnIWinNeg_mp S10_ExtDem_ParXnIWinPos_mp /end SUB_GROUP
 /begin REF_CHARACTERISTIC ExtDem_swtParCorActv_C /end REF_CHARACTERISTIC
/end GROUP
/begin GROUP S2_Kp_Calculation_ "ExtDem_SelectParameter/02_Parameter Set Selection/Kp Calculation "
 /begin SUB_GROUP S11_ExtDem_PWinNeg S11_ExtDem_PWinPos S11_ExtDem_ParXPKpNeg_mp S11_ExtDem_ParXPKpPos_mp S11_ExtDem_ParXPKp_mp /end SUB_GROUP
 /begin REF_CHARACTERISTIC ExtDem_swtParCorActv_C /end REF_CHARACTERISTIC
/end GROUP
/begin GROUP S3__inner_feedback_factors__ "ExtDem_SelectParameter/03_Feedback Factor / inner feedback factors  "
 /begin SUB_GROUP S26_InrtVehCurr S26_facFdbkTrqLosHi S26_facFdbkTrqLosLo S26_tiFltTrqLosEstCurr /end SUB_GROUP
/end GROUP
/begin GROUP S3_outer_feedback_factor_ "ExtDem_SelectParameter/03_Feedback Factor /outer feedback factor " /begin SUB_GROUP S27_ExtDem_ParXPKp_mp /end SUB_GROUP
 /begin REF_CHARACTERISTIC ExtDem_facFdbkLimit_C ExtDem_facFdbk_CUR ExtDem_swtCANActv_C ExtDem_swtFacFdbkSel_C /end REF_CHARACTERISTIC
/end GROUP
/begin GROUP S4_dnAccLim "ExtDem_SelectParameter/04_Limitation of the engine speed gradient /dnAccLim"
 /begin REF_CHARACTERISTIC ExtDem_Par0dnAccLim_C ExtDem_Par1dnAccLim_C ExtDem_Par2dnAccLim_C ExtDem_Par3dnAccLim_C ExtDem_Par4dnAccLim_C ExtDem_Par5dnAccLim_C ExtDem_Par6dnAccLim_C ExtDem_Par7dnAccLim_C /end REF_CHARACTERISTIC
/end GROUP
/begin GROUP S4_dnDecLim "ExtDem_SelectParameter/04_Limitation of the engine speed gradient /dnDecLim" /begin SUB_GROUP S36_ExtDem_stBrkTrq /end SUB_GROUP
 /begin REF_CHARACTERISTIC ExtDem_Par0dnDeclLimBrk_C ExtDem_Par0dnDeclLim_C ExtDem_Par1dnDeclLimBrk_C ExtDem_Par1dnDeclLim_C ExtDem_Par2dnDeclLimBrk_C ExtDem_Par2dnDeclLim_C ExtDem_Par3dnDeclLimBrk_C ExtDem_Par3dnDeclLim_C ExtDem_Par4dnDeclLimBrk_C ExtDem_Par4dnDeclLim_C ExtDem_Par5dnDeclLimBrk_C ExtDem_Par5dnDeclLim_C ExtDem_Par6dnDeclLimBrk_C ExtDem_Par6dnDeclLim_C ExtDem_Par7dnDeclLimBrk_C ExtDem_Par7dnDeclLim_C /end REF_CHARACTERISTIC
/end GROUP
/begin GROUP S10_ExtDem_ParXIKiNeg_mp "ExtDem_SelectParameter/02_Parameter Set Selection/Ki Calculation/ExtDem_ParXIKiNeg_mp"
 /begin REF_CHARACTERISTIC ExtDem_Par0IKiNeg_C ExtDem_Par1IKiNeg_C ExtDem_Par2IKiNeg_C ExtDem_Par3IKiNeg_C ExtDem_Par4IKiNeg_C ExtDem_Par5IKiNeg_C ExtDem_Par6IKiNeg_C ExtDem_Par7IKiNeg_C /end REF_CHARACTERISTIC
 /begin REF_MEASUREMENT ExtDem_KiNegCurr_mp /end REF_MEASUREMENT
/end GROUP
/begin GROUP S10_ExtDem_ParXIKiPos_mp "ExtDem_SelectParameter/02_Parameter Set Selection/Ki Calculation/ExtDem_ParXIKiPos_mp"
 /begin REF_CHARACTERISTIC ExtDem_Par0IKiPos_C ExtDem_Par1IKiPos_C ExtDem_Par2IKiPos_C ExtDem_Par3IKiPos_C ExtDem_Par4IKiPos_C ExtDem_Par5IKiPos_C ExtDem_Par6IKiPos_C ExtDem_Par7IKiPos_C /end REF_CHARACTERISTIC
 /begin REF_MEASUREMENT ExtDem_KiPosCurr_mp /end REF_MEASUREMENT
/end GROUP
/begin GROUP S10_ExtDem_ParXIKi_mp "ExtDem_SelectParameter/02_Parameter Set Selection/Ki Calculation/ExtDem_ParXIKi_mp"
 /begin REF_CHARACTERISTIC ExtDem_Par0IKi_C ExtDem_Par1IKi_C ExtDem_Par2IKi_C ExtDem_Par3IKi_C ExtDem_Par4IKi_C ExtDem_Par5IKi_C ExtDem_Par6IKi_C ExtDem_Par7IKi_C /end REF_CHARACTERISTIC
 /begin REF_MEASUREMENT ExtDem_KiCurr_mp /end REF_MEASUREMENT
/end GROUP
/begin GROUP S10_ExtDem_ParXnIWinNeg_mp "ExtDem_SelectParameter/02_Parameter Set Selection/Ki Calculation/ExtDem_ParXnIWinNeg_mp"
 /begin REF_CHARACTERISTIC ExtDem_Par0nIWinNeg_C ExtDem_Par1nIWinNeg_C ExtDem_Par2nIWinNeg_C ExtDem_Par3nIWinNeg_C ExtDem_Par4nIWinNeg_C ExtDem_Par5nIWinNeg_C ExtDem_Par6nIWinNeg_C ExtDem_Par7nIWinNeg_C /end REF_CHARACTERISTIC
 /begin REF_MEASUREMENT ExtDem_IWinNegCurr /end REF_MEASUREMENT
/end GROUP
/begin GROUP S10_ExtDem_ParXnIWinPos_mp "ExtDem_SelectParameter/02_Parameter Set Selection/Ki Calculation/ExtDem_ParXnIWinPos_mp"
 /begin REF_CHARACTERISTIC ExtDem_Par0nIWinPos_C ExtDem_Par1nIWinPos_C ExtDem_Par2nIWinPos_C ExtDem_Par3nIWinPos_C ExtDem_Par4nIWinPos_C ExtDem_Par5nIWinPos_C ExtDem_Par6nIWinPos_C ExtDem_Par7nIWinPos_C /end REF_CHARACTERISTIC
 /begin REF_MEASUREMENT ExtDem_IWinPosCurr /end REF_MEASUREMENT
/end GROUP
/begin GROUP S11_ExtDem_PWinNeg "ExtDem_SelectParameter/02_Parameter Set Selection/Kp Calculation /ExtDem_PWinNeg"
 /begin REF_CHARACTERISTIC ExtDem_Par0nPWinNeg_C ExtDem_Par1nPWinNeg_C ExtDem_Par2nPWinNeg_C ExtDem_Par3nPWinNeg_C ExtDem_Par4nPWinNeg_C ExtDem_Par5nPWinNeg_C ExtDem_Par6nPWinNeg_C ExtDem_Par7nPWinNeg_C /end REF_CHARACTERISTIC
 /begin REF_MEASUREMENT ExtDem_PWinNegCurr /end REF_MEASUREMENT
/end GROUP
/begin GROUP S11_ExtDem_PWinPos "ExtDem_SelectParameter/02_Parameter Set Selection/Kp Calculation /ExtDem_PWinPos"
 /begin REF_CHARACTERISTIC ExtDem_Par0nPWinPos_C ExtDem_Par1nPWinPos_C ExtDem_Par2nPWinPos_C ExtDem_Par3nPWinPos_C ExtDem_Par4nPWinPos_C ExtDem_Par5nPWinPos_C ExtDem_Par6nPWinPos_C ExtDem_Par7nPWinPos_C /end REF_CHARACTERISTIC
 /begin REF_MEASUREMENT ExtDem_PWinPosCurr /end REF_MEASUREMENT
/end GROUP
/begin GROUP S11_ExtDem_ParXPKpNeg_mp "ExtDem_SelectParameter/02_Parameter Set Selection/Kp Calculation /ExtDem_ParXPKpNeg_mp"
 /begin REF_CHARACTERISTIC ExtDem_Par0PKpNeg_C ExtDem_Par1PKpNeg_C ExtDem_Par2PKpNeg_C ExtDem_Par3PKpNeg_C ExtDem_Par4PKpNeg_C ExtDem_Par5PKpNeg_C ExtDem_Par6PKpNeg_C ExtDem_Par7PKpNeg_C /end REF_CHARACTERISTIC
 /begin REF_MEASUREMENT ExtDem_KpNegCurr_mp /end REF_MEASUREMENT
/end GROUP
/begin GROUP S11_ExtDem_ParXPKpPos_mp "ExtDem_SelectParameter/02_Parameter Set Selection/Kp Calculation /ExtDem_ParXPKpPos_mp"
 /begin REF_CHARACTERISTIC ExtDem_Par0PKpPos_C ExtDem_Par1PKpPos_C ExtDem_Par2PKpPos_C ExtDem_Par3PKpPos_C ExtDem_Par4PKpPos_C ExtDem_Par5PKpPos_C ExtDem_Par6PKpPos_C ExtDem_Par7PKpPos_C /end REF_CHARACTERISTIC
 /begin REF_MEASUREMENT ExtDem_KpPosCurr_mp /end REF_MEASUREMENT
/end GROUP
/begin GROUP S11_ExtDem_ParXPKp_mp "ExtDem_SelectParameter/02_Parameter Set Selection/Kp Calculation /ExtDem_ParXPKp_mp"
 /begin REF_CHARACTERISTIC ExtDem_Par0PKp_C ExtDem_Par1PKp_C ExtDem_Par2PKp_C ExtDem_Par3PKp_C ExtDem_Par4PKp_C ExtDem_Par5PKp_C ExtDem_Par6PKp_C ExtDem_Par7PKp_C /end REF_CHARACTERISTIC
 /begin REF_MEASUREMENT ExtDem_KpCurr_mp /end REF_MEASUREMENT
/end GROUP
/begin GROUP S26_InrtVehCurr "ExtDem_SelectParameter/03_Feedback Factor / inner feedback factors  /InrtVehCurr"
 /begin REF_CHARACTERISTIC ExtDem_Par0InrtVeh_C ExtDem_Par1InrtVeh_C ExtDem_Par2InrtVeh_C ExtDem_Par3InrtVeh_C ExtDem_Par4InrtVeh_C ExtDem_Par5InrtVeh_C ExtDem_Par6InrtVeh_C ExtDem_Par7InrtVeh_C /end REF_CHARACTERISTIC
/end GROUP
/begin GROUP S26_facFdbkTrqLosHi "ExtDem_SelectParameter/03_Feedback Factor / inner feedback factors  /facFdbkTrqLosHi"
 /begin REF_CHARACTERISTIC ExtDem_Par0FacFdbkTrqLosHi_C ExtDem_Par1FacFdbkTrqLosHi_C ExtDem_Par2FacFdbkTrqLosHi_C ExtDem_Par3FacFdbkTrqLosHi_C ExtDem_Par4FacFdbkTrqLosHi_C ExtDem_Par5FacFdbkTrqLosHi_C ExtDem_Par6FacFdbkTrqLosHi_C ExtDem_Par7FacFdbkTrqLosHi_C /end REF_CHARACTERISTIC
/end GROUP
/begin GROUP S26_facFdbkTrqLosLo "ExtDem_SelectParameter/03_Feedback Factor / inner feedback factors  /facFdbkTrqLosLo"
 /begin REF_CHARACTERISTIC ExtDem_Par0FacFdbkTrqLosLo_C ExtDem_Par1FacFdbkTrqLosLo_C ExtDem_Par2FacFdbkTrqLosLo_C ExtDem_Par3FacFdbkTrqLosLo_C ExtDem_Par4FacFdbkTrqLosLo_C ExtDem_Par5FacFdbkTrqLosLo_C ExtDem_Par6FacFdbkTrqLosLo_C ExtDem_Par7FacFdbkTrqLosLo_C /end REF_CHARACTERISTIC
/end GROUP
/begin GROUP S26_tiFltTrqLosEstCurr "ExtDem_SelectParameter/03_Feedback Factor / inner feedback factors  /tiFltTrqLosEstCurr"
 /begin REF_CHARACTERISTIC ExtDem_Par0TiFltTrqLosEst_C ExtDem_Par1TiFltTrqLosEst_C ExtDem_Par2TiFltTrqLosEst_C ExtDem_Par3TiFltTrqLosEst_C ExtDem_Par4TiFltTrqLosEst_C ExtDem_Par5TiFltTrqLosEst_C ExtDem_Par6TiFltTrqLosEst_C ExtDem_Par7TiFltTrqLosEst_C /end REF_CHARACTERISTIC
/end GROUP
/begin GROUP S27_ExtDem_ParXPKp_mp "ExtDem_SelectParameter/03_Feedback Factor /outer feedback factor /ExtDem_ParXPKp_mp"
 /begin REF_CHARACTERISTIC ExtDem_facFdbkParSet0_C ExtDem_facFdbkParSet1_C ExtDem_facFdbkParSet2_C ExtDem_facFdbkParSet3_C ExtDem_facFdbkParSet4_C ExtDem_facFdbkParSet5_C ExtDem_facFdbkParSet6_C ExtDem_facFdbkParSet7_C /end REF_CHARACTERISTIC
 /begin REF_MEASUREMENT ExtDem_facFdbkParSet_mp /end REF_MEASUREMENT
/end GROUP
/begin GROUP S36_ExtDem_stBrkTrq "ExtDem_SelectParameter/04_Limitation of the engine speed gradient /dnDecLim/ExtDem_stBrkTrq" /begin REF_CHARACTERISTIC ExtDem_trqThresNTC_C /end REF_CHARACTERISTIC /begin REF_MEASUREMENT ExtDem_stBrkTrq_mp /end REF_MEASUREMENT /end GROUP
/begin GROUP ExtDem_SetPoint "ExtDem_SetPoint" /begin SUB_GROUP Root__correction_value /end SUB_GROUP /end GROUP
/begin GROUP Root__correction_value "ExtDem_SetPoint/ correction value" /begin REF_CHARACTERISTIC ExtDem_swtTrqSel_C ExtDem_tiTrqPT1_C /end REF_CHARACTERISTIC /begin REF_MEASUREMENT ExtDem_trqFdbkFlt_mp /end REF_MEASUREMENT /end GROUP
/begin GROUP HLSDem_CalcState "HLSDem_CalcState" /begin SUB_GROUP Root_HLSDem_CalcState /end SUB_GROUP /end GROUP
/begin GROUP Root_HLSDem_CalcState "HLSDem_CalcState/HLSDem_CalcState"
 /begin SUB_GROUP S1_DT1_activation S1_Underbraking S1_freezing_integrator S1_no_grip S1_prectrl_not_locked S1_torque_demand S1_torque_initialization /end SUB_GROUP
/end GROUP
/begin GROUP S1_DT1_activation "HLSDem_CalcState/HLSDem_CalcState/DT1 activation"
 /begin REF_CHARACTERISTIC EISGov_nOfsPreCtlActvFall_C EISGov_nOfsPreCtlActvFall_CUR EISGov_nOfsPreCtlINActvFall_C EISGov_nOfsPreCtlPrepFall_C EISGov_nPreCtlPrepFalloffset_C /end REF_CHARACTERISTIC
/end GROUP
/begin GROUP S1_Underbraking "HLSDem_CalcState/HLSDem_CalcState/Underbraking"
 /begin REF_CHARACTERISTIC HLSDem_nOfsUndrBrk_C HLSDem_rGripUndrBrkThres_C HLSDem_vThresUndrBrk_C /end REF_CHARACTERISTIC
 /begin REF_MEASUREMENT HLSDem_stUnderBrk /end REF_MEASUREMENT
/end GROUP
/begin GROUP S1_freezing_integrator "HLSDem_CalcState/HLSDem_CalcState/freezing integrator"
 /begin REF_CHARACTERISTIC HLSDem_rAPPThresFrzI_C HLSDem_stIFrzInhib_C HLSDem_swtAPPFrzI_C /end REF_CHARACTERISTIC
 /begin REF_MEASUREMENT HLSDem_stFrzI /end REF_MEASUREMENT
/end GROUP
/begin GROUP S1_no_grip "HLSDem_CalcState/HLSDem_CalcState/no grip" /begin REF_CHARACTERISTIC HLSDem_rNoGripThres_C /end REF_CHARACTERISTIC /end GROUP
/begin GROUP S1_prectrl_not_locked "HLSDem_CalcState/HLSDem_CalcState/prectrl not locked" /begin REF_CHARACTERISTIC LIGov_nOffsetPreCtltrqDem_C /end REF_CHARACTERISTIC /begin REF_MEASUREMENT HLSDem_stPreCtlNotLock /end REF_MEASUREMENT /end GROUP
/begin GROUP S1_torque_demand "HLSDem_CalcState/HLSDem_CalcState/torque demand" /begin REF_CHARACTERISTIC HLSDem_rAPPThresTrqDem_C HLSDem_swtAPPTrqDem_C /end REF_CHARACTERISTIC /end GROUP
/begin GROUP S1_torque_initialization "HLSDem_CalcState/HLSDem_CalcState/torque initialization"
 /begin SUB_GROUP S40_Calculation_of_predefined_torque_after_start S40_EngtFld_Selector /end SUB_GROUP
 /begin REF_CHARACTERISTIC HLSDem_nOfsPredef_C HLSDem_numTempSelConv_C HLSDem_swtPredef_C HLSDem_trqReqStrt_CUR /end REF_CHARACTERISTIC
 /begin REF_MEASUREMENT HLSDem_stTrqInitReq HLSDem_trqReqStrt /end REF_MEASUREMENT
/end GROUP
/begin GROUP S40_Calculation_of_predefined_torque_after_start "HLSDem_CalcState/HLSDem_CalcState/torque initialization/Calculation of predefined torque after start" /begin SUB_GROUP S45_EngtFld_Selector /end SUB_GROUP
 /begin REF_CHARACTERISTIC HLSDem_GripPredef_CUR HLSDem_NoGripPredef_C HLSDem_facGripPredef_CUR HLSDem_facNoGripPredef_CUR HLSDem_numTempSelConv_C HLSDem_rNoGripThres_C /end REF_CHARACTERISTIC
 /begin REF_MEASUREMENT HLSDem_trqGripPredef_mp HLSDem_trqNoGripPredef_mp HLSDem_trqPredef_mp /end REF_MEASUREMENT
/end GROUP
/begin GROUP S40_EngtFld_Selector "HLSDem_CalcState/HLSDem_CalcState/torque initialization/EngtFld_Selector" /begin REF_MEASUREMENT HLSDem_tTrqReqStrt_mp /end REF_MEASUREMENT /end GROUP
/begin GROUP S45_EngtFld_Selector "HLSDem_CalcState/HLSDem_CalcState/torque initialization/Calculation of predefined torque after start/EngtFld_Selector" /begin REF_MEASUREMENT HLSDem_tConv_mp /end REF_MEASUREMENT /end GROUP
/begin GROUP HLSDem_SelectParameter "HLSDem_SelectParameter" /begin SUB_GROUP Root_HLSDem_Parameter_Selection /end SUB_GROUP /end GROUP
/begin GROUP Root_HLSDem_Parameter_Selection "HLSDem_SelectParameter/HLSDem_Parameter_Selection" /begin SUB_GROUP S1_Parameter_Correction S1_Parameter_Selection /end SUB_GROUP /end GROUP
/begin GROUP S1_Parameter_Correction "HLSDem_SelectParameter/HLSDem_Parameter_Selection/Parameter_Correction" /begin SUB_GROUP S2_EngtFld_Selector /end SUB_GROUP
 /begin REF_CHARACTERISTIC HLSDem_KiCorFac_MAP HLSDem_KiCorTrqFac_MAP HLSDem_KpCorFac_MAP HLSDem_KpCorTrqFac_MAP HLSDem_facNAvrgPT1_C HLSDem_facTrqPT1CorFac_C HLSDem_swtTempSelParAdap_C HLSDem_swtTrqSelCorFac_C /end REF_CHARACTERISTIC
 /begin REF_MEASUREMENT HLSDem_KiCorFac_mp HLSDem_KiCorTempFac_mp HLSDem_KiCorTrqFac_mp HLSDem_KpCorFac_mp HLSDem_KpCorTempFac_mp HLSDem_KpCorTrqFac_mp HLSDem_nAvrgFlt_mp HLSDem_trqCorFacFlt_mp /end REF_MEASUREMENT
/end GROUP
/begin GROUP S1_Parameter_Selection "HLSDem_SelectParameter/HLSDem_Parameter_Selection/Parameter_Selection"
 /begin SUB_GROUP S3_Limitation_of_the_speed_gradient S3_Parameter_Set S3_Selection_of__outer_feedback_factor S3_Selection_of_inner_feedback_factor /end SUB_GROUP
/end GROUP
/begin GROUP S2_EngtFld_Selector "HLSDem_SelectParameter/HLSDem_Parameter_Selection/Parameter_Correction/EngtFld_Selector" /begin REF_MEASUREMENT HLSDem_tParAdap_mp /end REF_MEASUREMENT /end GROUP
/begin GROUP S3_Limitation_of_the_speed_gradient "HLSDem_SelectParameter/HLSDem_Parameter_Selection/Parameter_Selection/Limitation of the speed gradient"
 /begin REF_CHARACTERISTIC HLSDem_NoGripdnAccLim_C HLSDem_NoGripdnDeclLimBrk_C HLSDem_NoGripdnDeclLim_C HLSDem_stBrkTrq_C /end REF_CHARACTERISTIC
/end GROUP
/begin GROUP S3_Parameter_Set "HLSDem_SelectParameter/HLSDem_Parameter_Selection/Parameter_Selection/Parameter Set" /begin SUB_GROUP S8_Parameter_set_Grip S8_Parameter_set_NoGrip_ /end SUB_GROUP /begin REF_CHARACTERISTIC HLSDem_rNoGripThres_C /end REF_CHARACTERISTIC /end GROUP
/begin GROUP S3_Selection_of__outer_feedback_factor "HLSDem_SelectParameter/HLSDem_Parameter_Selection/Parameter_Selection/Selection of  outer feedback factor"
 /begin REF_CHARACTERISTIC HLSDem_facFdbkLoGrip_C HLSDem_facFdbkLoNoGrip_C HLSDem_rNoGripThres_C /end REF_CHARACTERISTIC
/end GROUP
/begin GROUP S3_Selection_of_inner_feedback_factor "HLSDem_SelectParameter/HLSDem_Parameter_Selection/Parameter_Selection/Selection of inner feedback factor"
 /begin REF_CHARACTERISTIC HLSDem_InrtVehGrip_CUR HLSDem_InrtVehNoGrip_C HLSDem_facFdbkTrqLosHiGrip_CUR HLSDem_facFdbkTrqLosHiNoGrip_C HLSDem_facFdbkTrqLosLoGrip_CUR HLSDem_facFdbkTrqLosLoNoGrip_C HLSDem_rNoGripThres_C HLSDem_tiFltTrqLosGrip_CUR HLSDem_tiFltTrqLosNoGrip_C /end REF_CHARACTERISTIC
/end GROUP
/begin GROUP S8_Parameter_set_Grip "HLSDem_SelectParameter/HLSDem_Parameter_Selection/Parameter_Selection/Parameter Set/Parameter set Grip"
 /begin SUB_GROUP S11_Ki_calculation_parameter_set_Grip S11_Kp_calculation_parameter_set_Grip /end SUB_GROUP
/end GROUP
/begin GROUP S8_Parameter_set_NoGrip_ "HLSDem_SelectParameter/HLSDem_Parameter_Selection/Parameter_Selection/Parameter Set/Parameter set NoGrip "
 /begin SUB_GROUP S12_Ki_calculation_parameter_set_NoGrip S12_Kp_calculation_parameter_set_NoGrip /end SUB_GROUP
/end GROUP
/begin GROUP S11_Ki_calculation_parameter_set_Grip "HLSDem_SelectParameter/HLSDem_Parameter_Selection/Parameter_Selection/Parameter Set/Parameter set Grip/Ki calculation parameter set Grip"
 /begin REF_CHARACTERISTIC HLSDem_GripIKiHi_CUR HLSDem_GripIKiLo_CUR HLSDem_GripIKiNegHi_CUR HLSDem_GripIKiNegLo_CUR HLSDem_GripIKiPosHi_CUR HLSDem_GripIKiPosLo_CUR HLSDem_GripIWinNegHi_C HLSDem_GripIWinNegLo_C HLSDem_GripIWinPosHi_C HLSDem_GripIWinPosLo_C /end REF_CHARACTERISTIC
 /begin REF_MEASUREMENT HLSDem_IWinNegHiCurrGrip_mp HLSDem_IWinNegLoCurrGrip_mp HLSDem_IWinPosHiCurrGrip_mp HLSDem_IWinPosLoCurrGrip_mp HLSDem_KiHiCurrGrip_mp HLSDem_KiLoCurrGrip_mp HLSDem_KiNegHiCurrGrip_mp HLSDem_KiNegLoCurrGrip_mp HLSDem_KiPosHiCurrGrip_mp HLSDem_KiPosLoCurrGrip_mp /end REF_MEASUREMENT
/end GROUP
/begin GROUP S11_Kp_calculation_parameter_set_Grip "HLSDem_SelectParameter/HLSDem_Parameter_Selection/Parameter_Selection/Parameter Set/Parameter set Grip/Kp calculation parameter set Grip"
 /begin REF_CHARACTERISTIC HLSDem_GripPKpHi_CUR HLSDem_GripPKpLo_CUR HLSDem_GripPKpNegHi_CUR HLSDem_GripPKpNegLo_CUR HLSDem_GripPKpPosHi_CUR HLSDem_GripPKpPosLo_CUR HLSDem_GripPWinNegHi_C HLSDem_GripPWinNegLo_C HLSDem_GripPWinPosHi_C HLSDem_GripPWinPosLo_C /end REF_CHARACTERISTIC
 /begin REF_MEASUREMENT HLSDem_KpHiCurrGrip_mp HLSDem_KpLoCurrGrip_mp HLSDem_KpNegHiCurrGrip_mp HLSDem_KpNegLoCurrGrip_mp HLSDem_KpPosHiCurrGrip_mp HLSDem_KpPosLoCurrGrip_mp HLSDem_PWinNegHiCurrGrip_mp HLSDem_PWinNegLoCurrGrip_mp HLSDem_PWinPosHiCurrGrip_mp HLSDem_PWinPosLoCurrGrip_mp /end REF_MEASUREMENT
/end GROUP
/begin GROUP S12_Ki_calculation_parameter_set_NoGrip "HLSDem_SelectParameter/HLSDem_Parameter_Selection/Parameter_Selection/Parameter Set/Parameter set NoGrip /Ki calculation parameter set NoGrip"
 /begin REF_CHARACTERISTIC HLSDem_NoGripIKiHi_C HLSDem_NoGripIKiLo_C HLSDem_NoGripIKiNegHi_C HLSDem_NoGripIKiNegLo_C HLSDem_NoGripIKiPosHi_C HLSDem_NoGripIKiPosLo_C HLSDem_NoGripIWinNegHi_C HLSDem_NoGripIWinNegLo_C HLSDem_NoGripIWinPosHi_C HLSDem_NoGripIWinPosLo_C /end REF_CHARACTERISTIC
 /begin REF_MEASUREMENT HLSDem_IWinNegHiCurrNoGrip_mp HLSDem_IWinNegLoCurrNoGrip_mp HLSDem_IWinPosHiCurrNoGrip_mp HLSDem_IWinPosLoCurrNoGrip_mp HLSDem_KiHiCurrNoGrip_mp HLSDem_KiLoCurrNoGrip_mp HLSDem_KiNegHiCurrNoGrip_mp HLSDem_KiNegLoCurrNoGrip_mp HLSDem_KiPosHiCurrNoGrip_mp HLSDem_KiPosLoCurrNoGrip_mp /end REF_MEASUREMENT
/end GROUP
/begin GROUP S12_Kp_calculation_parameter_set_NoGrip "HLSDem_SelectParameter/HLSDem_Parameter_Selection/Parameter_Selection/Parameter Set/Parameter set NoGrip /Kp calculation parameter set NoGrip"
 /begin REF_CHARACTERISTIC HLSDem_NoGripPKpHi_C HLSDem_NoGripPKpLo_C HLSDem_NoGripPKpNegHi_C HLSDem_NoGripPKpNegLo_C HLSDem_NoGripPKpPosHi_C HLSDem_NoGripPKpPosLo_C HLSDem_NoGripPWinNegHi_C HLSDem_NoGripPWinNegLo_C HLSDem_NoGripPWinPosHi_C HLSDem_NoGripPWinPosLo_C /end REF_CHARACTERISTIC
 /begin REF_MEASUREMENT HLSDem_KpHiCurrNoGrip_mp HLSDem_KpLoCurrNoGrip_mp HLSDem_KpNegHiCurrNoGrip_mp HLSDem_KpNegLoCurrNoGrip_mp HLSDem_KpPosHiCurrNoGrip_mp HLSDem_KpPosLoCurrNoGrip_mp HLSDem_PWinNegHiCurrNoGrip_mp HLSDem_PWinNegLoCurrNoGrip_mp HLSDem_PWinPosHiCurrNoGrip_mp HLSDem_PWinPosLoCurrNoGrip_mp /end REF_MEASUREMENT
/end GROUP
/begin GROUP HLSDem_SetPoint "HLSDem_SetPoint" /begin SUB_GROUP Root_HLSDem_SetPointHi Root_HLSDem_SetPointLo /end SUB_GROUP /begin REF_CHARACTERISTIC HndBrk_stDebVal_C /end REF_CHARACTERISTIC /end GROUP
/begin GROUP Root_HLSDem_SetPointHi "HLSDem_SetPoint/HLSDem_SetPointHi" /begin SUB_GROUP S1_HLSDem_FacSelect S1_HLSDem_SetPointBaseHi /end SUB_GROUP /begin REF_CHARACTERISTIC HLSDem_facTrqHiPT1_C HLSDem_swtTrqHiSel_C /end REF_CHARACTERISTIC /begin REF_MEASUREMENT HLSDem_nSetPHiCorVal_mp HLSDem_trqFdbkFltHi_mp /end REF_MEASUREMENT /end GROUP
/begin GROUP Root_HLSDem_SetPointLo "HLSDem_SetPoint/HLSDem_SetPointLo" /begin SUB_GROUP S2_HLSDem_SetPointBaseLo /end SUB_GROUP
 /begin REF_CHARACTERISTIC HLSDem_facTrqLoPT1_C HLSDem_nSetPLoOfsMoF_C HLSDem_swtTrqLoSel_C /end REF_CHARACTERISTIC
 /begin REF_MEASUREMENT HLSDem_nSetPLoCorVal_mp HLSDem_nSetPLoMoF HLSDem_trqFdbkFltLo_mp /end REF_MEASUREMENT
/end GROUP
/begin GROUP S1_HLSDem_FacSelect "HLSDem_SetPoint/HLSDem_SetPointHi/HLSDem_FacSelect" /begin SUB_GROUP S3_Selection_of_system_degradation_feedback_factor /end SUB_GROUP
 /begin REF_CHARACTERISTIC HLSDem_facFdbkCANKick_C HLSDem_facFdbkDrvKick_C HLSDem_facFdbkHGG_C HLSDem_facFdbkLGG_C HLSDem_facFdbkMaxAcs_C HLSDem_facFdbkMaxSysErr_C HLSDem_facFdbkMaxTra_C HLSDem_facFdbkRed1_C HLSDem_facFdbkRed2_C HLSDem_facFdbkRed3_C HLSDem_facFdbkStrt_C HLSDem_stSpdSel_C /end REF_CHARACTERISTIC
 /begin REF_MEASUREMENT HLSDem_facFdbk /end REF_MEASUREMENT
/end GROUP
/begin GROUP S1_HLSDem_SetPointBaseHi "HLSDem_SetPoint/HLSDem_SetPointHi/HLSDem_SetPointBaseHi"
 /begin SUB_GROUP S4_Reduced_maximum_engine_setpoint_speed_during_start S4_Release_of_reduction /end SUB_GROUP
 /begin REF_CHARACTERISTIC HLSDem_SetPHiRmpSlopeNeg_C HLSDem_SetPHiRmpSlopePos_C HLSDem_nHGGSetPHi_C HLSDem_nKDSetPHi_C HLSDem_nLGGSetPHi_C HLSDem_nRed1SetPHi_C HLSDem_nRed2SetPHi_C HLSDem_nRed3SetPHi_C HLSDem_nStrtSetPHi_C HLSDem_nSysDgrtSetPHi_C HLSDem_rTrqSwt_C HLSDem_swtDisblVehIfcSetPHi_C SigTst_nSetPHi_C SigTst_swtSetPHi_C /end REF_CHARACTERISTIC
 /begin REF_MEASUREMENT HLSDem_nGear_mp HLSDem_nKD_mp HLSDem_nRedSetPHi_mp HLSDem_nSetPHiBas_mp HLSDem_nSetPHiRaw_mp HLSDem_nStrtLub_mp /end REF_MEASUREMENT
/end GROUP
/begin GROUP S2_HLSDem_SetPointBaseLo "HLSDem_SetPoint/HLSDem_SetPointLo/HLSDem_SetPointBaseLo"
 /begin SUB_GROUP S16_Basic_low_idle_setpoint_calculation S16_Basic_low_idle_setpoint_raw_calculation S16_Select_temperature S16_Suppressing_low_idle_increase_after_start /end SUB_GROUP
/end GROUP
/begin GROUP S3_Selection_of_system_degradation_feedback_factor "HLSDem_SetPoint/HLSDem_SetPointHi/HLSDem_FacSelect/Selection of system degradation feedback factor"
 /begin REF_CHARACTERISTIC HLSDem_facFdbkSysDgrt1_C HLSDem_facFdbkSysDgrt2_C HLSDem_facFdbkSysDgrt3_C HLSDem_stSysDgrtSetPHi_C /end REF_CHARACTERISTIC
 /begin REF_MEASUREMENT HLSDem_facFdbkSysDgrt /end REF_MEASUREMENT
/end GROUP
/begin GROUP HndBrk_DD "HndBrk_DD" /begin REF_CHARACTERISTIC HndBrk_stDebVal_C /end REF_CHARACTERISTIC /end GROUP
/begin RECORD_LAYOUT Scalar_BOOLEAN FNC_VALUES 1 UBYTE COLUMN_DIR DIRECT /end RECORD_LAYOUT
/begin RECORD_LAYOUT Scalar_UBYTE FNC_VALUES 1 UBYTE COLUMN_DIR DIRECT /end RECORD_LAYOUT
/begin RECORD_LAYOUT Scalar_UWORD FNC_VALUES 1 UWORD COLUMN_DIR DIRECT /end RECORD_LAYOUT
/begin RECORD_LAYOUT Scalar_SWORD FNC_VALUES 1 SWORD COLUMN_DIR DIRECT /end RECORD_LAYOUT
/begin RECORD_LAYOUT Scalar_ULONG FNC_VALUES 1 ULONG COLUMN_DIR DIRECT /end RECORD_LAYOUT
/begin RECORD_LAYOUT Scalar_LONG FNC_VALUES 1 SLONG COLUMN_DIR DIRECT /end RECORD_LAYOUT
/begin RECORD_LAYOUT Lookup1D_X_BOOLEAN AXIS_PTS_X 1 UBYTE INDEX_INCR DIRECT /end RECORD_LAYOUT
/begin RECORD_LAYOUT Lookup1D_UWORD FNC_VALUES 1 UWORD COLUMN_DIR DIRECT /end RECORD_LAYOUT
/begin RECORD_LAYOUT Lookup1D_WORD FNC_VALUES 1 SWORD COLUMN_DIR DIRECT /end RECORD_LAYOUT
/begin RECORD_LAYOUT Lookup1D_X_WORD AXIS_PTS_X 1 SWORD INDEX_INCR DIRECT /end RECORD_LAYOUT
/begin RECORD_LAYOUT Lookup1D_SLONG FNC_VALUES 1 SLONG COLUMN_DIR DIRECT /end RECORD_LAYOUT
/begin RECORD_LAYOUT Lookup2D_WORD FNC_VALUES 1 SWORD COLUMN_DIR DIRECT /end RECORD_LAYOUT
/begin RECORD_LAYOUT Lookup2D_X_WORD AXIS_PTS_X 1 SWORD INDEX_INCR DIRECT /end RECORD_LAYOUT
/end MODULE
/end PROJECT
