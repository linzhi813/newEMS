ASAP2_VERSION 1 51
/begin PROJECT XCPDemo ""
/begin MODULE XCP ""
/begin MOD_COMMON "" BYTE_ORDER MSB_FIRST ALIGNMENT_BYTE 1 ALIGNMENT_WORD 1 ALIGNMENT_LONG 1 ALIGNMENT_FLOAT32_IEEE 1 ALIGNMENT_FLOAT64_IEEE 1 /end MOD_COMMON
/begin CHARACTERISTIC HLSDem_tiStrtCEngDsT_CUR "Transformation curve to convert coolant dowmstream temperature to time" CURVE 0x38A594 Lookup1D_ULONG 0 EngTime_ms 0.0 4.294967295E+10
 /begin AXIS_DESCR COM_AXIS CEngDsT_t Temp_deg 8 -50.0 150.0 AXIS_PTS_REF HLSDem_tiStrtCEngDsT_CURX /end AXIS_DESCR
/end CHARACTERISTIC
/begin CHARACTERISTIC HLSDem_tiStrtEngOil_CUR "Transformation curve to convert oil temperature to time" CURVE 0x38A5C4 Lookup1D_ULONG 0 EngTime_ms 0.0 4.294967295E+10
 /begin AXIS_DESCR COM_AXIS Oil_tSwmp Temp_deg 8 -50.0 150.0 AXIS_PTS_REF HLSDem_tiStrtEngOil_CURX /end AXIS_DESCR
/end CHARACTERISTIC
/begin CHARACTERISTIC HLSDem_nSetPLoIni_CUR "Curve for determination of the lower setpoint engine speed based on the temperature " CURVE 0x38A4C4 Lookup1D_WORD 0 EngSpeed_rpm 0.0 6000.0
 /begin AXIS_DESCR COM_AXIS HLSDem_tSetPLo_mp Temp_deg 19 -200.0 200.0 AXIS_PTS_REF HLSDem_nSetPLoIni_CURX /end AXIS_DESCR
/end CHARACTERISTIC
/begin CHARACTERISTIC HLSDem_nSpdLowBattUAdd_CUR "Curve for determination of the lower setpoint engine speed Add based on the BattU" CURVE 0x38A51A Lookup1D_WORD 0 EngSpeed_rpm 0.0 500.0
 /begin AXIS_DESCR COM_AXIS BattU_u Battery_mv 10 0.0 50000.0 AXIS_PTS_REF HLSDem_nSpdLowBattUAdd_CURX /end AXIS_DESCR
/end CHARACTERISTIC
/begin CHARACTERISTIC HLSDem_tiMaxIncrSetPLo_C "Maximum time for increased low-idle setpoint speed" VALUE 0x38A58C Scalar_ULONG 0 EngTime_ms 0.0 4.294967295E+10 /end CHARACTERISTIC
/begin CHARACTERISTIC HLSDem_tiSpdLowBattUAdd_C "Idle setpoint add time based on LowBattU since Engine Start" VALUE 0x38A590 Scalar_ULONG 0 EngTime_ms 0.0 4.294967295E+10 /end CHARACTERISTIC
/begin CHARACTERISTIC HLSDem_volSpdAddHi_C "parameter for hysteresis function of Hi BattU" VALUE 0x38A632 Scalar_UWORD 0 Battery_mv 0.0 50000.0 /end CHARACTERISTIC
/begin CHARACTERISTIC HLSDem_volSpdAddLo_C "parameter for hysteresis function of Lo BattU" VALUE 0x38A634 Scalar_UWORD 0 Battery_mv 0.0 50000.0 /end CHARACTERISTIC
/begin CHARACTERISTIC HLSDem_tDflSetPLo_C "Default value in case of defective coolant or oil temperature sensor" VALUE 0x38A564 Scalar_SWORD 0 Temp_deg -200.0 200.0 /end CHARACTERISTIC
/begin CHARACTERISTIC HLSDem_tThresDisbl_C "Setpoint temperature threshold for disabling the increased low-idle setpoint speed" VALUE 0x38A566 Scalar_SWORD 0 Temp_deg -200.0 200.0 /end CHARACTERISTIC
/begin CHARACTERISTIC HLSDem_tThresEna_C "Setpoint temperature threshold for enabling the increased low-idle setpoint speed" VALUE 0x38A568 Scalar_SWORD 0 Temp_deg -200.0 200.0 /end CHARACTERISTIC
/begin CHARACTERISTIC HLSDem_SetPLoRmpSlopeNeg_C "Ramp parameter set for lower setpoint speed / Negative ramp step" VALUE 0x38A3D0 Scalar_SWORD 0 EngSpeed_rpm_s 0.0 6000.0 /end CHARACTERISTIC
/begin CHARACTERISTIC HLSDem_SetPLoRmpSlopePos_C "Ramp parameter set for lower setpoint speed / Positive ramp step " VALUE 0x38A3D2 Scalar_SWORD 0 EngSpeed_rpm_s 0.0 6000.0 /end CHARACTERISTIC
/begin CHARACTERISTIC HLSDem_SetPLoTipInRmpSlopeNeg_C "Ramp slope (only for Tipin) of the lower setpoint speed / Negative ramp step width" VALUE 0x38A3D4 Scalar_SWORD 0 EngSpeed_rpm_s 0.0 6000.0 /end CHARACTERISTIC
/begin CHARACTERISTIC HLSDem_SetPLoTipInRmpSlopePos_C "Ramp slope (only for Tipin) of the lower setpoint speed / Positive ramp step width" VALUE 0x38A3D6 Scalar_SWORD 0 EngSpeed_rpm_s 0.0 6000.0 /end CHARACTERISTIC
/begin CHARACTERISTIC HLSDem_dnSetPLoLimHiTrm_C "Upper limit for the adjustment value of the lower low-idle setpoint speed" VALUE 0x38A3D8 Scalar_SWORD 0 EngSpeed_rpm -6000.0 6000.0 /end CHARACTERISTIC
/begin CHARACTERISTIC HLSDem_dnSetPLoLimLoTrm_C "Lower limit for the adjustment value of the lower low-idle setpoint speed" VALUE 0x38A3DA Scalar_SWORD 0 EngSpeed_rpm -6000.0 6000.0 /end CHARACTERISTIC
/begin CHARACTERISTIC HLSDem_nSel1SetPLo_C "Low idle speed setpoint when Multi state switch is in state 1" VALUE 0x38A4BA Scalar_SWORD 0 EngSpeed_rpm 0.0 6000.0 /end CHARACTERISTIC
/begin CHARACTERISTIC HLSDem_nSel2SetPLo_C "Low idle speed setpoint when Multi state switch is in state 2" VALUE 0x38A4BC Scalar_SWORD 0 EngSpeed_rpm 0.0 6000.0 /end CHARACTERISTIC
/begin CHARACTERISTIC HLSDem_nSel3SetPLo_C "Low idle speed setpoint when multistate switch is state 3" VALUE 0x38A4BE Scalar_SWORD 0 EngSpeed_rpm 0.0 6000.0 /end CHARACTERISTIC
/begin CHARACTERISTIC HLSDem_nSetPLoDia_C "Lower setpoint speed value of HLSDem via the diagnostic interface" VALUE 0x38A4C0 Scalar_SWORD 0 EngSpeed_rpm 0.0 6000.0 /end CHARACTERISTIC
/begin CHARACTERISTIC HLSDem_nSetPLoDrvAwy_C "Low idle setpoint speed selected when the vehicle is driven and no speed recording error " VALUE 0x38A4C2 Scalar_SWORD 0 EngSpeed_rpm 0.0 6000.0 /end CHARACTERISTIC
/begin CHARACTERISTIC HLSDem_nSetPLoMaxOfs_C "Negative offset of the maximum lower engine speed" VALUE 0x38A510 Scalar_SWORD 0 EngSpeed_rpm 0.0 6000.0 /end CHARACTERISTIC
/begin CHARACTERISTIC HLSDem_nSetPLoMax_C "Upper engine speed limit for HLSDem" VALUE 0x38A512 Scalar_SWORD 0 EngSpeed_rpm 0.0 6000.0 /end CHARACTERISTIC
/begin CHARACTERISTIC HLSDem_nSetPLoWrm_C "Lower low-idle setpoint speed for vehicle standstill/engine warm" VALUE 0x38A516 Scalar_SWORD 0 EngSpeed_rpm 0.0 6000.0 /end CHARACTERISTIC
/begin CHARACTERISTIC HLSDem_nSpdLowBattUAddLim_C "limation of Idle setpoint add value" VALUE 0x38A518 Scalar_SWORD 0 EngSpeed_rpm 0.0 500.0 /end CHARACTERISTIC
/begin CHARACTERISTIC SigTst_nSetPLo_C "Set SetPoint low idle speed by hand" VALUE 0x39803C Scalar_SWORD 0 EngSpeed_rpm 0.0 6000.0 /end CHARACTERISTIC
/begin CHARACTERISTIC HLSDem_facSetPLoFlt_C "Time constant PT1-filter for low-idle setpoint speed" VALUE 0x38A4A2 Scalar_UWORD 0 PT_fac 0.0 99.9985 /end CHARACTERISTIC
/begin CHARACTERISTIC HLSDem_stSetPLoFlt_C "Type of filtering of the lower engine speed setpoint" VALUE 0x38A554 Scalar_UBYTE 0 State_uint8 0.0 255.0 /end CHARACTERISTIC
/begin CHARACTERISTIC HLSDem_swtEnaPTO_C "Switch to enable the Power Take Off in low idle speed setpoint calculation" VALUE 0x38A55C Scalar_UBYTE 0 State_uint8 0.0 255.0 /end CHARACTERISTIC
/begin CHARACTERISTIC HLSDem_swtMode_C "Switch to select different modes of increased low-idle setpoint speed" VALUE 0x38A55D Scalar_UBYTE 0 State_uint8 0.0 255.0 /end CHARACTERISTIC
/begin CHARACTERISTIC HLSDem_swtTempSel_C "Temperature selection switch for gear dependant maximum engine speed" VALUE 0x38A560 Scalar_UBYTE 0 State_uint8 0.0 255.0 /end CHARACTERISTIC
/begin CHARACTERISTIC SigTst_swtSetPLo_C "Switch for enable Set SetPoint low idle speed by hand" VALUE 0x398093 Scalar_UBYTE 0 Switch_conv 0 1 /end CHARACTERISTIC
/begin AXIS_PTS HLSDem_tiStrtCEngDsT_CURX "Transformation aixs to convert coolant dowmstream temperature to time" 0x38A5B4 CEngDsT_t Lookup1D_X_WORD 0 Temp_deg 8 -50.0 150.0 /end AXIS_PTS
/begin AXIS_PTS HLSDem_tiStrtEngOil_CURX "Transformation aixs to convert oil temperature to time" 0x38A5E4 Oil_tSwmp Lookup1D_X_WORD 0 Temp_deg 8 -50.0 150.0 /end AXIS_PTS
/begin AXIS_PTS HLSDem_nSetPLoIni_CURX "HLSDem_tSetPLo" 0x38A4EA HLSDem_tSetPLo_mp Lookup1D_X_WORD 0 Temp_deg 19 -200.0 200.0 /end AXIS_PTS
/begin AXIS_PTS HLSDem_nSpdLowBattUAdd_CURX "BattU for determination of the lower setpoint engine speed Add" 0x38A52E BattU_u Lookup1D_X_UWORD 0 Battery_mv 10 0.0 50000.0 /end AXIS_PTS
/begin CHARACTERISTIC PhyMod_trq2qBas_MAP "Engine basic map for conversion of torque/quantity" MAP 0x395798 Lookup2D_WORD 0 FuelMass_mg_hub -319.0 319.0
 /begin AXIS_DESCR COM_AXIS Epm_nEng EngSpeed_rpm 16 -12000.0 12000.0 AXIS_PTS_REF PhyMod_trq2qBas_MAPX /end AXIS_DESCR
 /begin AXIS_DESCR COM_AXIS PthLead_trqInrCurr Trq_Nm 16 -3276.8 3276.7 AXIS_PTS_REF PhyMod_trq2qBas_MAPY /end AXIS_DESCR
/end CHARACTERISTIC
/begin CHARACTERISTIC CnvLead_facRmpVal_CUR "curve of ramp-factor for switch over ramp" CURVE 0x386652 Lookup1D_WORD 0 Factor -31.0 31.0
 /begin AXIS_DESCR COM_AXIS CoEOM_facRmpVal Factor 11 -31.0 31.0 AXIS_PTS_REF CnvLead_facRmpVal_CURX /end AXIS_DESCR
/end CHARACTERISTIC
/begin AXIS_PTS PhyMod_trq2qBas_MAPY "AxisY of the MAP" 0x3959B8 PthLead_trqInrCurr Lookup2D_X_WORD 0 Trq_Nm 16 -3276.8 3276.7 /end AXIS_PTS
/begin AXIS_PTS PhyMod_trq2qBas_MAPX "AxisX of the MAP" 0x395998 Epm_nEng Lookup2D_X_WORD 0 EngSpeed_rpm 16 -12000.0 12000.0 /end AXIS_PTS
/begin AXIS_PTS CnvLead_facRmpVal_CURX "Axis X of the CUR" 0x386668 CoEOM_facRmpVal Lookup1D_X_WORD 0 Factor 11 -31.0 31.0 /end AXIS_PTS
/begin CHARACTERISTIC CnvSet_facRmpVal_CUR "Curve of ramp-factor for switch over ramp" CURVE 0x386684 Lookup1D_WORD 0 Factor -31.0 31.0
 /begin AXIS_DESCR COM_AXIS CoEOM_facRmpVal Factor 11 -31.0 31.0 AXIS_PTS_REF CnvSet_facRmpVal_CURX /end AXIS_DESCR
/end CHARACTERISTIC
/begin CHARACTERISTIC CnvSet_eta0_C "Conversion efficiency during start" VALUE 0x38667E Scalar_SWORD 0 TrqEta_Nm_mg_hub -255.0 255.0 /end CHARACTERISTIC
/begin CHARACTERISTIC CnvSet_etaMax_C "Current conversion efficiency min limation" VALUE 0x386680 Scalar_SWORD 0 TrqEta_Nm_mg_hub -255.0 255.0 /end CHARACTERISTIC
/begin CHARACTERISTIC CnvSet_etaMin_C "Current conversion efficiency max limation" VALUE 0x386682 Scalar_SWORD 0 TrqEta_Nm_mg_hub -255.0 255.0 /end CHARACTERISTIC
/begin AXIS_PTS CnvSet_facRmpVal_CURX "AxisX of the Curve" 0x38669A CoEOM_facRmpVal Lookup1D_X_WORD 0 Factor 11 -31.0 31.0 /end AXIS_PTS
/begin CHARACTERISTIC ActMod_swtStrtQntEna_C "switch to select the torque between the starting torque StSys_trqStrt (when applicated to 1) or the actual current torque ActMod_trqCurr_mp (when applicated to 1) during start condition." VALUE 0x38248E Scalar_UBYTE 0 Switch_conv 0 1 /end CHARACTERISTIC
/begin CHARACTERISTIC CoEOM_facRmpVal_C "Central ramp value for operation mode change" VALUE 0x3866B2 Scalar_SWORD 0 Factor -31.0 31.0 /end CHARACTERISTIC
/begin CHARACTERISTIC PhyMod_facEtaCorNxt_C "next efficiency correction factor" VALUE 0x39578E Scalar_SWORD 0 Factor -31.0 31.0 /end CHARACTERISTIC
/begin CHARACTERISTIC PhyMod_facEtaCor_C "Current efficiency correction factor" VALUE 0x395790 Scalar_SWORD 0 Factor -30.0 30.0 /end CHARACTERISTIC
/begin CHARACTERISTIC PhyMod_qCorNxt_C "next correction quantity" VALUE 0x395792 Scalar_SWORD 0 FuelMass_mg_hub -319.0 319.0 /end CHARACTERISTIC
/begin CHARACTERISTIC PhyMod_qCor_C "Correction quantity" VALUE 0x395794 Scalar_SWORD 0 FuelMass_mg_hub -319.0 319.0 /end CHARACTERISTIC
/begin CHARACTERISTIC PhyMod_stNxt_C "Next operating mode for the torque structure" VALUE 0x395796 Scalar_UBYTE 0 State_uint8 0.0 255.0 /end CHARACTERISTIC
/begin CHARACTERISTIC PhyMod_stPrs_C "Current operating mode for the torque structure" VALUE 0x395797 Scalar_UBYTE 0 State_uint8 0.0 255.0 /end CHARACTERISTIC
/begin CHARACTERISTIC RngMod_trqDiffAdap_C "Adapted difference torque loss" VALUE 0x397D60 Scalar_SWORD 0 Trq_Nm -3276.8 3276.7 /end CHARACTERISTIC
/begin CHARACTERISTIC RngMod_trqFrc_MAP "friction torque map" MAP 0x397D62 Lookup2D_WORD 0 Trq_Nm -3267.8 3267.7
 /begin AXIS_DESCR COM_AXIS Epm_nEng EngSpeed_rpm 16 -12000.0 12000.0 AXIS_PTS_REF RngMod_trqFrc_MAPX /end AXIS_DESCR
 /begin AXIS_DESCR COM_AXIS RngMod_tTrqFrc_mp Temp_deg 16 -3000.0 3000.0 AXIS_PTS_REF RngMod_trqFrc_MAPY /end AXIS_DESCR
/end CHARACTERISTIC
/begin CHARACTERISTIC RngMod_trqLossComp_C "compensation for torque" VALUE 0x397FA2 Scalar_SWORD 0 Trq_Nm -3267.8 3267.7 /end CHARACTERISTIC
/begin CHARACTERISTIC RngMod_numTrqFrc_C "Parameter for selection of input temperature" VALUE 0x397CFA Scalar_UBYTE 0 EngTempFldSel_conv 0 2 /end CHARACTERISTIC
/begin AXIS_PTS RngMod_trqFrc_MAPY "EngDa_tFld" 0x397F82 RngMod_tTrqFrc_mp Lookup2D_X_WORD 0 Temp_deg 16 -3000.0 3000.0 /end AXIS_PTS
/begin AXIS_PTS RngMod_trqFrc_MAPX "Epm_nEng" 0x397F62 Epm_nEng Lookup2D_X_WORD 0 EngSpeed_rpm 16 -12000.0 12000.0 /end AXIS_PTS
/begin CHARACTERISTIC RngMod_trqCrSMax_CUR "Speed-dependent curve for determining the maximal crankshaft torque" CURVE 0x397CFC Lookup1D_WORD 0 Trq_Nm -3276.8 3276.7
 /begin AXIS_DESCR COM_AXIS Epm_nEng EngSpeed_rpm 25 0.0 6000.0 AXIS_PTS_REF RngMod_trqCrSMax_CURX /end AXIS_DESCR
/end CHARACTERISTIC
/begin CHARACTERISTIC RngMod_trqMax_CUR "Speed-dependent curve for determining the Maximum of torque interval" CURVE 0x397FA4 Lookup1D_WORD 0 Trq_Nm -3276.8 3276.7
 /begin AXIS_DESCR COM_AXIS Epm_nEng EngSpeed_rpm 25 0.0 6000.0 AXIS_PTS_REF RngMod_trqMax_CURX /end AXIS_DESCR
/end CHARACTERISTIC
/begin AXIS_PTS RngMod_trqCrSMax_CURX "Epm_nEng" 0x397D2E Epm_nEng Lookup1D_X_WORD 0 EngSpeed_rpm 25 0.0 6000.0 /end AXIS_PTS
/begin AXIS_PTS RngMod_trqMax_CURX "Epm_nEng" 0x397FD6 Epm_nEng Lookup1D_X_WORD 0 EngSpeed_rpm 25 0.0 6000.0 /end AXIS_PTS
/begin CHARACTERISTIC EngDa_trqEngMax_C "Maximum engine output torque" VALUE 0x387750 Scalar_SWORD 0 Trq_Nm -3276.8 3276.7 /end CHARACTERISTIC
/begin CHARACTERISTIC EngTrqPtd_trqLim_C "Set path torque limitation from ECU monitoring" VALUE 0x38939A Scalar_SWORD 0 Trq_Nm -3276.0 3276.0 /end CHARACTERISTIC
/begin CHARACTERISTIC EngTrqPtd_stPthLim_C "State of engine torque limitation from ECU monitoring" VALUE 0x389398 Scalar_UBYTE 0 State_uint8 0.0 255.0 /end CHARACTERISTIC
/begin CHARACTERISTIC ASMod_facEGRCor_MAP "Exhaust gas recirculation correction factor" MAP 0x380E52 Lookup2D_WORD 0 Fact8192 -4.0 3.9999
 /begin AXIS_DESCR COM_AXIS EGRVlv_r Prc_100_rate 20 -100.0 100.0 AXIS_PTS_REF ASMod_facEGRCor_MAPX /end AXIS_DESCR
 /begin AXIS_DESCR COM_AXIS Epm_nEng EngSpeed_rpm 20 0.0 6000.0 AXIS_PTS_REF ASMod_facEGRCor_MAPY /end AXIS_DESCR
/end CHARACTERISTIC
/begin CHARACTERISTIC ASMod_facVolEffBas_MAP "base value of the volumetric efficiency" MAP 0x3811C4 Lookup2D_WORD 0 Fact8192 -4.0 3.9999
 /begin AXIS_DESCR COM_AXIS InjCtl_qSetUnBal FuelMass_mg_hub 20 -319.0 319.0 AXIS_PTS_REF ASMod_facVolEffBas_MAPX /end AXIS_DESCR
 /begin AXIS_DESCR COM_AXIS Epm_nEng EngSpeed_rpm 20 0.0 6000.0 AXIS_PTS_REF ASMod_facVolEffBas_MAPY /end AXIS_DESCR
/end CHARACTERISTIC
/begin CHARACTERISTIC ASMod_tIntMnfDsRef_MAP "reference gas temperature downstream of the intake manifold" MAP 0x381538 Lookup2D_WORD 0 TempDiff_Kelv 0.0 1000.0
 /begin AXIS_DESCR COM_AXIS InjCtl_qSetUnBal FuelMass_mg_hub 20 -319.0 319.0 AXIS_PTS_REF ASMod_tIntMnfDsRef_MAPX /end AXIS_DESCR
 /begin AXIS_DESCR COM_AXIS Epm_nEng EngSpeed_rpm 20 0.0 6000.0 AXIS_PTS_REF ASMod_tIntMnfDsRef_MAPY /end AXIS_DESCR
/end CHARACTERISTIC
/begin CHARACTERISTIC ASMod_volEng_C "Engine displacement" VALUE 0x3818A8 Scalar_LONG 0 Vol_L 0.0 100.0 /end CHARACTERISTIC
/begin CHARACTERISTIC ASMod_nThresDwn_C "Engine speed threshold value for the detection of engine standstill" VALUE 0x381534 Scalar_SWORD 0 EngSpeed_rpm 0.0 6000.0 /end CHARACTERISTIC
/begin CHARACTERISTIC ASMod_facIntMnfDsTempCor_C "Correction factor for the compensation of the dependency of the volumetric efficiency of the gas temperature downstream of the intake manifold" VALUE 0x3811C2 Scalar_SWORD 0 Fact8192 -4.0 3.9999 /end CHARACTERISTIC
/begin CHARACTERISTIC ASMod_numBnk_C "Number of engine banks" VALUE 0x381536 Scalar_UBYTE 0 State_uint8 0.0 255.0 /end CHARACTERISTIC
/begin CHARACTERISTIC Epm_numCyl_C "Real number of cylinder" VALUE 0x389479 Scalar_UBYTE 0 State_uint8 0.0 255.0 /end CHARACTERISTIC
/begin AXIS_PTS ASMod_facEGRCor_MAPY "Engine speed" 0x38119A Epm_nEng Lookup2D_X_WORD 0 EngSpeed_rpm 20 0.0 6000.0 /end AXIS_PTS
/begin AXIS_PTS ASMod_facEGRCor_MAPX "Commanded value from application SW" 0x381172 EGRVlv_r Lookup2D_X_WORD 0 Prc_100_rate 20 -100.0 100.0 /end AXIS_PTS
/begin AXIS_PTS ASMod_facVolEffBas_MAPY "Engine speed" 0x38150C Epm_nEng Lookup2D_X_WORD 0 EngSpeed_rpm 20 0.0 6000.0 /end AXIS_PTS
/begin AXIS_PTS ASMod_facVolEffBas_MAPX "Current injection quantity" 0x3814E4 InjCtl_qSetUnBal Lookup2D_X_WORD 0 FuelMass_mg_hub 20 -319.0 319.0 /end AXIS_PTS
/begin AXIS_PTS ASMod_tIntMnfDsRef_MAPY "Engine speed" 0x381880 Epm_nEng Lookup2D_X_WORD 0 EngSpeed_rpm 20 0.0 6000.0 /end AXIS_PTS
/begin AXIS_PTS ASMod_tIntMnfDsRef_MAPX "Current injection quantity" 0x381858 InjCtl_qSetUnBal Lookup2D_X_WORD 0 FuelMass_mg_hub 20 -319.0 319.0 /end AXIS_PTS
/begin CHARACTERISTIC PFltLd_resFlw_C "Flow resistance of the particulate filter" VALUE 0x395718 Scalar_LONG 0 FlowRes_kPa_m3_h -0.3 0.3 /end CHARACTERISTIC
/begin CHARACTERISTIC ASMod_dvolPFltEG_C "Calculated exhaust-gas volume flow in the particulate filter" VALUE 0x380E50 Scalar_SWORD 0 AirVol_m3_h 0.0 100.0 /end CHARACTERISTIC
/begin CHARACTERISTIC AirCtl_swtTypCor_C "Switch for selection of Injection quantity/ torque correction out of FMA/FMO" VALUE 0x385B8D Scalar_UBYTE 0 State_uint8 0.0 255.0 /end CHARACTERISTIC
/begin CHARACTERISTIC AirCtl_facCtlAirTempCorEOM0_CUR "Air temperature correction factor in EOM0 (normal mode)." CURVE 0x382614 Lookup1D_WORD 0 Factor -30.0 30.0
 /begin AXIS_DESCR COM_AXIS AirCtl_tAirCtlVal_mp Temp_deg 16 -1000.0 1000.0 AXIS_PTS_REF AirCtl_facCtlAirTempCorEOM0_CURX /end AXIS_DESCR
/end CHARACTERISTIC
/begin CHARACTERISTIC AirCtl_facCtlEngTempCorEOM0_CUR "Engine temperature correction factor in EOM0 (normal mode)." CURVE 0x382654 Lookup1D_WORD 0 Factor -30.0 30.0
 /begin AXIS_DESCR COM_AXIS AirCtl_tEngCtlVal_mp Temp_deg 16 -1000.0 1000.0 AXIS_PTS_REF AirCtl_facCtlEngTempCorEOM0_CURX /end AXIS_DESCR
/end CHARACTERISTIC
/begin CHARACTERISTIC AirCtl_rCtlAirTempCorEOM0_MAP "Air temperature correction in EOM0 (normal mode)" MAP 0x383D8A Lookup2D_WORD 0 Prc_100_rate -100.0 100.0
 /begin AXIS_DESCR COM_AXIS Epm_nEng EngSpeed_rpm 16 -6000.0 6000.0 AXIS_PTS_REF AirCtl_rCtlAirTempCorEOM0_MAPX /end AXIS_DESCR
 /begin AXIS_DESCR COM_AXIS InjCtl_qSetUnBal FuelMass_mg_hub 16 -300.0 300.0 AXIS_PTS_REF AirCtl_rCtlAirTempCorEOM0_MAPY /end AXIS_DESCR
/end CHARACTERISTIC
/begin CHARACTERISTIC AirCtl_rCtlCorBasEOM0_MAP "Engine operating point correction value in EOM0 (normal mode)" MAP 0x383FCA Lookup2D_WORD 0 Prc_100_rate -100.0 100.0
 /begin AXIS_DESCR COM_AXIS Epm_nEng EngSpeed_rpm 16 -6000.0 6000.0 AXIS_PTS_REF AirCtl_rCtlCorBasEOM0_MAPX /end AXIS_DESCR
 /begin AXIS_DESCR COM_AXIS InjCtl_qSetUnBal FuelMass_mg_hub 16 -300.0 300.0 AXIS_PTS_REF AirCtl_rCtlCorBasEOM0_MAPY /end AXIS_DESCR
/end CHARACTERISTIC
/begin CHARACTERISTIC AirCtl_rCtlEngTempCorEOM0_MAP "Engine temperature correction in EOM0 (normal mode)" MAP 0x38420A Lookup2D_WORD 0 Prc_100_rate -100.0 100.0
 /begin AXIS_DESCR COM_AXIS Epm_nEng EngSpeed_rpm 16 -6000.0 6000.0 AXIS_PTS_REF AirCtl_rCtlEngTempCorEOM0_MAPX /end AXIS_DESCR
 /begin AXIS_DESCR COM_AXIS InjCtl_qSetUnBal FuelMass_mg_hub 16 -300.0 300.0 AXIS_PTS_REF AirCtl_rCtlEngTempCorEOM0_MAPY /end AXIS_DESCR
/end CHARACTERISTIC
/begin CHARACTERISTIC AirCtl_rCtlEnvPresCorEOM0_MAP "Environment pressure based correction in EOM0 (normal mode)" MAP 0x38444A Lookup2D_WORD 0 Prc_100_rate -100.0 100.0
 /begin AXIS_DESCR COM_AXIS EnvP_p AirPressure_kPa 16 -3000.0 3000.0 AXIS_PTS_REF AirCtl_rCtlEnvPresCorEOM0_MAPX /end AXIS_DESCR
 /begin AXIS_DESCR COM_AXIS NO_INPUT_QUANTITY AirMass_mg_hub 16 -15000.0 15000.0 AXIS_PTS_REF AirCtl_rCtlEnvPresCorEOM0_MAPY /end AXIS_DESCR
/end CHARACTERISTIC
/begin CHARACTERISTIC AirCtl_rCtlValBasEOM0_MAP "Basic EGR Control value in EOM0 (normal mode)" MAP 0x38468A Lookup2D_WORD 0 Prc_100_rate -100.0 100.0
 /begin AXIS_DESCR COM_AXIS Epm_nEng EngSpeed_rpm 16 -6000.0 6000.0 AXIS_PTS_REF AirCtl_rCtlValBasEOM0_MAPX /end AXIS_DESCR
 /begin AXIS_DESCR COM_AXIS InjCtl_qSetUnBal FuelMass_mg_hub 16 -300.0 300.0 AXIS_PTS_REF AirCtl_rCtlValBasEOM0_MAPY /end AXIS_DESCR
/end CHARACTERISTIC
/begin CHARACTERISTIC AirCtl_facEnvPresCtlVal_CUR "open loop EGR control value Curve for environment pressure." CURVE 0x382812 Lookup1D_WORD 0 Factor -30.0 30.0
 /begin AXIS_DESCR COM_AXIS EnvP_p AirPressure_kPa 16 -3000.0 3000.0 AXIS_PTS_REF AirCtl_facEnvPresCtlVal_CURX /end AXIS_DESCR
/end CHARACTERISTIC
/begin CHARACTERISTIC AirCtl_facWrmUpCtlVal_CUR "Curve of EGR refreshing (Control) factor during engine warm up based on coolant temperature" CURVE 0x382B20 Lookup1D_WORD 0 Factor -30.0 30.0
 /begin AXIS_DESCR COM_AXIS AirCtl_tEngCtlVal_mp Temp_deg 16 -200.0 200.0 AXIS_PTS_REF AirCtl_facWrmUpCtlVal_CURX /end AXIS_DESCR
/end CHARACTERISTIC
/begin CHARACTERISTIC AirCtl_rEnvPresCtlVal_MAP "open loop EGR control value Map for environment pressure." MAP 0x384ED6 Lookup2D_WORD 0 Prc_100_rate -100.0 100.0
 /begin AXIS_DESCR COM_AXIS Epm_nEng EngSpeed_rpm 16 -6000.0 6000.0 AXIS_PTS_REF AirCtl_rEnvPresCtlVal_MAPX /end AXIS_DESCR
 /begin AXIS_DESCR COM_AXIS InjCtl_qSetUnBal FuelMass_mg_hub 16 -300.0 300.0 AXIS_PTS_REF AirCtl_rEnvPresCtlVal_MAPY /end AXIS_DESCR
/end CHARACTERISTIC
/begin CHARACTERISTIC AirCtl_rWrmUpCtlVal_MAP "Map of EGR refreshing (Control) value during engine warm up" MAP 0x385928 Lookup2D_WORD 0 Prc_100_rate -100.0 100.0
 /begin AXIS_DESCR COM_AXIS Epm_nEng EngSpeed_rpm 16 -6000.0 6000.0 AXIS_PTS_REF AirCtl_rWrmUpCtlVal_MAPX /end AXIS_DESCR
 /begin AXIS_DESCR COM_AXIS InjCtl_qSetUnBal FuelMass_mg_hub 16 -300.0 300.0 AXIS_PTS_REF AirCtl_rWrmUpCtlVal_MAPY /end AXIS_DESCR
/end CHARACTERISTIC
/begin CHARACTERISTIC AirCtl_drCtlValDec_CUR "Ramp down slope for open loop EGR control value" CURVE 0x3824C8 Lookup1D_WORD 0 DutyCycle_rate_s -200.0 200.0
 /begin AXIS_DESCR COM_AXIS Epm_nEng EngSpeed_rpm 16 -6000.0 6000.0 AXIS_PTS_REF AirCtl_drCtlValDec_CURX /end AXIS_DESCR
/end CHARACTERISTIC
/begin CHARACTERISTIC AirCtl_drCtlValInc_CUR "Ramp up slope for open loop EGR control value" CURVE 0x38250A Lookup1D_WORD 0 DutyCycle_rate_s -200.0 200.0
 /begin AXIS_DESCR COM_AXIS Epm_nEng EngSpeed_rpm 16 -6000.0 6000.0 AXIS_PTS_REF AirCtl_drCtlValInc_CURX /end AXIS_DESCR
/end CHARACTERISTIC
/begin CHARACTERISTIC AirCtl_facEngTempSmkDynCor_CUR "Correction factor of dynamic smoke control value for engnine temperature" CURVE 0x38275A Lookup1D_WORD 0 Factor -30.0 30.0
 /begin AXIS_DESCR COM_AXIS AirCtl_tEngCtlVal_mp Temp_deg 16 -1000.0 1000.0 AXIS_PTS_REF AirCtl_facEngTempSmkDynCor_CURX /end AXIS_DESCR
/end CHARACTERISTIC
/begin CHARACTERISTIC AirCtl_facEngTempSmkStatCor_CUR "Correction factor of state smoke control value for engnine temperature" CURVE 0x3827C2 Lookup1D_WORD 0 Factor -30.0 30.0
 /begin AXIS_DESCR COM_AXIS AirCtl_tEngCtlVal_mp Temp_deg 16 -1000.0 1000.0 AXIS_PTS_REF AirCtl_facEngTempSmkStatCor_CURX /end AXIS_DESCR
/end CHARACTERISTIC
/begin CHARACTERISTIC AirCtl_rEngTempSmkDynCor_MAP "Map for Dynamic smoke control value of engine temperature correction" MAP 0x384A56 Lookup2D_WORD 0 Prc_100_rate -100.0 100.0
 /begin AXIS_DESCR COM_AXIS Epm_nEng EngSpeed_rpm 16 -6000.0 6000.0 AXIS_PTS_REF AirCtl_rEngTempSmkDynCor_MAPX /end AXIS_DESCR
 /begin AXIS_DESCR COM_AXIS InjCtl_qSetUnBal FuelMass_mg_hub 16 -300.0 300.0 AXIS_PTS_REF AirCtl_rEngTempSmkDynCor_MAPY /end AXIS_DESCR
/end CHARACTERISTIC
/begin CHARACTERISTIC AirCtl_rEngTempSmkStatCor_MAP "Map for state smoke control value of engine temperature correction" MAP 0x384C96 Lookup2D_WORD 0 Prc_100_rate -100.0 100.0
 /begin AXIS_DESCR COM_AXIS Epm_nEng EngSpeed_rpm 16 -6000.0 6000.0 AXIS_PTS_REF AirCtl_rEngTempSmkStatCor_MAPX /end AXIS_DESCR
 /begin AXIS_DESCR COM_AXIS InjCtl_qSetUnBal FuelMass_mg_hub 16 -300.0 300.0 AXIS_PTS_REF AirCtl_rEngTempSmkStatCor_MAPY /end AXIS_DESCR
/end CHARACTERISTIC
/begin CHARACTERISTIC AirCtl_rSmkDyn_MAP "Map for Dynamic smoke control value based on engine operating point" MAP 0x38511E Lookup2D_WORD 0 Prc_100_rate -100.0 100.0
 /begin AXIS_DESCR COM_AXIS Epm_nEng EngSpeed_rpm 16 -6000.0 6000.0 AXIS_PTS_REF AirCtl_rSmkDyn_MAPX /end AXIS_DESCR
 /begin AXIS_DESCR COM_AXIS InjCtl_qSetUnBal FuelMass_mg_hub 16 -300.0 300.0 AXIS_PTS_REF AirCtl_rSmkDyn_MAPY /end AXIS_DESCR
/end CHARACTERISTIC
/begin CHARACTERISTIC AirCtl_rSmkStat_MAP "Map for state smoke control value based on engine operating point" MAP 0x38535E Lookup2D_WORD 0 Prc_100_rate -100.0 100.0
 /begin AXIS_DESCR COM_AXIS Epm_nEng EngSpeed_rpm 16 -6000.0 6000.0 AXIS_PTS_REF AirCtl_rSmkStat_MAPX /end AXIS_DESCR
 /begin AXIS_DESCR COM_AXIS InjCtl_qSetUnBal FuelMass_mg_hub 16 -300.0 300.0 AXIS_PTS_REF AirCtl_rSmkStat_MAPY /end AXIS_DESCR
/end CHARACTERISTIC
/begin CHARACTERISTIC AirCtl_drCtlValDwn_C "Negative slope for switching control value." VALUE 0x382508 Scalar_SWORD 0 DutyCycle_rate_s -200.0 200.0 /end CHARACTERISTIC
/begin CHARACTERISTIC AirCtl_drCtlValUp_C "Positive slope for switching control value." VALUE 0x38254A Scalar_SWORD 0 DutyCycle_rate_s -200.0 200.0 /end CHARACTERISTIC
/begin CHARACTERISTIC AirCtl_numAirTempCtlVal_C "index to select the air temperature for control value calculation from Induction System temperature field" VALUE 0x3835F4 Scalar_UBYTE 0 AirTempFldSel_conv 0 3 /end CHARACTERISTIC
/begin CHARACTERISTIC AirCtl_numEngTempCtlVal_C "index to select the engine temperature for control value calculation" VALUE 0x3835F7 Scalar_UBYTE 0 EngTempFldSel_conv 0 2 /end CHARACTERISTIC
/begin CHARACTERISTIC AirCtl_swtAirMs_C "Switch to select between the base value of air mass and desired value of air mass." VALUE 0x385B8A Scalar_UBYTE 0 Switch_conv 0 1 /end CHARACTERISTIC
/begin AXIS_PTS AirCtl_facCtlAirTempCorEOM0_CURX "air temperature" 0x382634 AirCtl_tAirCtlVal_mp Lookup1D_X_WORD 0 Temp_deg 16 -1000.0 1000.0 /end AXIS_PTS
/begin AXIS_PTS AirCtl_facCtlEngTempCorEOM0_CURX "Engine temperature" 0x382674 AirCtl_tEngCtlVal_mp Lookup1D_X_WORD 0 Temp_deg 16 -1000.0 1000.0 /end AXIS_PTS
/begin AXIS_PTS AirCtl_rCtlAirTempCorEOM0_MAPY "Current injection quantity" 0x383FAA InjCtl_qSetUnBal Lookup2D_X_WORD 0 FuelMass_mg_hub 16 -300.0 300.0 /end AXIS_PTS
/begin AXIS_PTS AirCtl_rCtlAirTempCorEOM0_MAPX "Engine speed" 0x383F8A Epm_nEng Lookup2D_X_WORD 0 EngSpeed_rpm 16 -6000.0 6000.0 /end AXIS_PTS
/begin AXIS_PTS AirCtl_rCtlCorBasEOM0_MAPY "Current injection quantity" 0x3841EA InjCtl_qSetUnBal Lookup2D_X_WORD 0 FuelMass_mg_hub 16 -300.0 300.0 /end AXIS_PTS
/begin AXIS_PTS AirCtl_rCtlCorBasEOM0_MAPX "engine speed" 0x3841CA Epm_nEng Lookup2D_X_WORD 0 EngSpeed_rpm 16 -6000.0 6000.0 /end AXIS_PTS
/begin AXIS_PTS AirCtl_rCtlEngTempCorEOM0_MAPY "Current injection quantity" 0x38442A InjCtl_qSetUnBal Lookup2D_X_WORD 0 FuelMass_mg_hub 16 -300.0 300.0 /end AXIS_PTS
/begin AXIS_PTS AirCtl_rCtlEngTempCorEOM0_MAPX "Engine speed" 0x38440A Epm_nEng Lookup2D_X_WORD 0 EngSpeed_rpm 16 -6000.0 6000.0 /end AXIS_PTS
/begin AXIS_PTS AirCtl_rCtlEnvPresCorEOM0_MAPY "Desired air mass set point value" 0x38466A NO_INPUT_QUANTITY Lookup2D_X_WORD 0 AirMass_mg_hub 16 -15000.0 15000.0 /end AXIS_PTS
/begin AXIS_PTS AirCtl_rCtlEnvPresCorEOM0_MAPX "Barometric pressure" 0x38464A EnvP_p Lookup2D_X_WORD 0 AirPressure_kPa 16 -3000.0 3000.0 /end AXIS_PTS
/begin AXIS_PTS AirCtl_rCtlValBasEOM0_MAPY "Current injection quantity" 0x3848AA InjCtl_qSetUnBal Lookup2D_X_WORD 0 FuelMass_mg_hub 16 -300.0 300.0 /end AXIS_PTS
/begin AXIS_PTS AirCtl_rCtlValBasEOM0_MAPX "Engine speed" 0x38488A Epm_nEng Lookup2D_X_WORD 0 EngSpeed_rpm 16 -6000.0 6000.0 /end AXIS_PTS
/begin AXIS_PTS AirCtl_facEnvPresCtlVal_CURX "Barometric pressure" 0x382832 EnvP_p Lookup1D_X_WORD 0 AirPressure_kPa 16 -3000.0 3000.0 /end AXIS_PTS
/begin AXIS_PTS AirCtl_facWrmUpCtlVal_CURX "engine temperature" 0x382B40 AirCtl_tEngCtlVal_mp Lookup1D_X_WORD 0 Temp_deg 16 -200.0 200.0 /end AXIS_PTS
/begin AXIS_PTS AirCtl_rEnvPresCtlVal_MAPY "Current injection quantity" 0x3850F6 InjCtl_qSetUnBal Lookup2D_X_WORD 0 FuelMass_mg_hub 16 -300.0 300.0 /end AXIS_PTS
/begin AXIS_PTS AirCtl_rEnvPresCtlVal_MAPX "engine speed" 0x3850D6 Epm_nEng Lookup2D_X_WORD 0 EngSpeed_rpm 16 -6000.0 6000.0 /end AXIS_PTS
/begin AXIS_PTS AirCtl_rWrmUpCtlVal_MAPY "Current injection quantity" 0x385B48 InjCtl_qSetUnBal Lookup2D_X_WORD 0 FuelMass_mg_hub 16 -300.0 300.0 /end AXIS_PTS
/begin AXIS_PTS AirCtl_rWrmUpCtlVal_MAPX "engine speed" 0x385B28 Epm_nEng Lookup2D_X_WORD 0 EngSpeed_rpm 16 -6000.0 6000.0 /end AXIS_PTS
/begin AXIS_PTS AirCtl_drCtlValDec_CURX "Engine speed" 0x3824E8 Epm_nEng Lookup1D_X_WORD 0 EngSpeed_rpm 16 -6000.0 6000.0 /end AXIS_PTS
/begin AXIS_PTS AirCtl_drCtlValInc_CURX "Engine speed" 0x38252A Epm_nEng Lookup1D_X_WORD 0 EngSpeed_rpm 16 -6000.0 6000.0 /end AXIS_PTS
/begin AXIS_PTS AirCtl_facEngTempSmkDynCor_CURX "Engine temperature" 0x38277A AirCtl_tEngCtlVal_mp Lookup1D_X_WORD 0 Temp_deg 16 -1000.0 1000.0 /end AXIS_PTS
/begin AXIS_PTS AirCtl_facEngTempSmkStatCor_CURX "Engine temperature" 0x3827E2 AirCtl_tEngCtlVal_mp Lookup1D_X_WORD 0 Temp_deg 16 -1000.0 1000.0 /end AXIS_PTS
/begin AXIS_PTS AirCtl_rEngTempSmkDynCor_MAPY "Current injection quantity" 0x384C76 InjCtl_qSetUnBal Lookup2D_X_WORD 0 FuelMass_mg_hub 16 -300.0 300.0 /end AXIS_PTS
/begin AXIS_PTS AirCtl_rEngTempSmkDynCor_MAPX "Engine speed" 0x384C56 Epm_nEng Lookup2D_X_WORD 0 EngSpeed_rpm 16 -6000.0 6000.0 /end AXIS_PTS
/begin AXIS_PTS AirCtl_rEngTempSmkStatCor_MAPY "Engine temperature" 0x384EB6 InjCtl_qSetUnBal Lookup2D_X_WORD 0 FuelMass_mg_hub 16 -300.0 300.0 /end AXIS_PTS
/begin AXIS_PTS AirCtl_rEngTempSmkStatCor_MAPX "Correction factor of state smoke control value for engnine temperature" 0x384E96 Epm_nEng Lookup2D_X_WORD 0 EngSpeed_rpm 16 -6000.0 6000.0 /end AXIS_PTS
/begin AXIS_PTS AirCtl_rSmkDyn_MAPY "Current injection quantity" 0x38533E InjCtl_qSetUnBal Lookup2D_X_WORD 0 FuelMass_mg_hub 16 -300.0 300.0 /end AXIS_PTS
/begin AXIS_PTS AirCtl_rSmkDyn_MAPX "Engine speed" 0x38531E Epm_nEng Lookup2D_X_WORD 0 EngSpeed_rpm 16 -6000.0 6000.0 /end AXIS_PTS
/begin AXIS_PTS AirCtl_rSmkStat_MAPY "Current injection quantity" 0x38557E InjCtl_qSetUnBal Lookup2D_X_WORD 0 FuelMass_mg_hub 16 -300.0 300.0 /end AXIS_PTS
/begin AXIS_PTS AirCtl_rSmkStat_MAPX "Engine speed" 0x38555E Epm_nEng Lookup2D_X_WORD 0 EngSpeed_rpm 16 -6000.0 6000.0 /end AXIS_PTS
/begin CHARACTERISTIC AirCtl_facAirTempCorEOM0_MAP "Correction factor for the base value of the air temperature correction" MAP 0x38254E Lookup2D_WORD 0 Factor -30.0 30.0
 /begin AXIS_DESCR COM_AXIS Epm_nEng EngSpeed_rpm 9 -6000.0 6000.0 AXIS_PTS_REF AirCtl_facAirTempCorEOM0_MAPX /end AXIS_DESCR
 /begin AXIS_DESCR COM_AXIS AirCtl_tAirDesVal_mp Temp_deg 9 -1000.0 1000.0 AXIS_PTS_REF AirCtl_facAirTempCorEOM0_MAPY /end AXIS_DESCR
/end CHARACTERISTIC
/begin CHARACTERISTIC AirCtl_facEngTempCorEOM0_MAP "Correction factor for the base value of the air temperature correction" MAP 0x382694 Lookup2D_WORD 0 Factor -30.0 30.0
 /begin AXIS_DESCR COM_AXIS Epm_nEng EngSpeed_rpm 9 -6000.0 6000.0 AXIS_PTS_REF AirCtl_facEngTempCorEOM0_MAPX /end AXIS_DESCR
 /begin AXIS_DESCR COM_AXIS AirCtl_tEngDesVal_mp Temp_deg 9 -1000.0 1000.0 AXIS_PTS_REF AirCtl_facEngTempCorEOM0_MAPY /end AXIS_DESCR
/end CHARACTERISTIC
/begin CHARACTERISTIC AirCtl_mAirTempCorBasEOM0_MAP "Basic map for the air temperature correction" MAP 0x382B60 Lookup2D_WORD 0 AirMass_mg_hub -15000.0 15000.0
 /begin AXIS_DESCR COM_AXIS Epm_nEng EngSpeed_rpm 16 -6000.0 6000.0 AXIS_PTS_REF AirCtl_mAirTempCorBasEOM0_MAPX /end AXIS_DESCR
 /begin AXIS_DESCR COM_AXIS AirCtl_qDesVal FuelMass_mg_hub 16 -300.0 300.0 AXIS_PTS_REF AirCtl_mAirTempCorBasEOM0_MAPY /end AXIS_DESCR
/end CHARACTERISTIC
/begin CHARACTERISTIC AirCtl_mEngTempCorBasEOM0_MAP "Base air mass setpoint value of the engine temperature correction" MAP 0x383220 Lookup2D_WORD 0 AirMass_mg_hub -15000.0 15000.0
 /begin AXIS_DESCR COM_AXIS Epm_nEng EngSpeed_rpm 16 -6000.0 6000.0 AXIS_PTS_REF AirCtl_mEngTempCorBasEOM0_MAPX /end AXIS_DESCR
 /begin AXIS_DESCR COM_AXIS AirCtl_qDesVal FuelMass_mg_hub 16 -300.0 300.0 AXIS_PTS_REF AirCtl_mEngTempCorBasEOM0_MAPY /end AXIS_DESCR
/end CHARACTERISTIC
/begin CHARACTERISTIC AirCtl_pBstPresRef_MAP "Reference boost pressure" MAP 0x3835FE Lookup2D_WORD 0 AirPressure_kPa -3000.0 3000.0
 /begin AXIS_DESCR COM_AXIS Epm_nEng EngSpeed_rpm 9 -6000.0 6000.0 AXIS_PTS_REF AirCtl_pBstPresRef_MAPX /end AXIS_DESCR
 /begin AXIS_DESCR COM_AXIS AirCtl_qDesVal FuelMass_mg_hub 9 -300.0 300.0 AXIS_PTS_REF AirCtl_pBstPresRef_MAPY /end AXIS_DESCR
/end CHARACTERISTIC
/begin CHARACTERISTIC AirCtl_facEnvPresCorEOM0_CUR "Curve for the atmospheric correction" CURVE 0x382802 Lookup1D_WORD 0 Factor -30.0 30.0
 /begin AXIS_DESCR COM_AXIS EnvP_p AirPressure_kPa 4 -3000.0 3000.0 AXIS_PTS_REF AirCtl_facEnvPresCorEOM0_CURX /end AXIS_DESCR
/end CHARACTERISTIC
/begin CHARACTERISTIC AirCtl_mDesBasEOM0_MAP "Base air mass setpoint value from the basic map" MAP 0x382DA0 Lookup2D_WORD 0 AirMass_mg_hub -15000.0 15000.0
 /begin AXIS_DESCR COM_AXIS Epm_nEng EngSpeed_rpm 16 -6000.0 6000.0 AXIS_PTS_REF AirCtl_mDesBasEOM0_MAPX /end AXIS_DESCR
 /begin AXIS_DESCR COM_AXIS AirCtl_qDesVal FuelMass_mg_hub 16 -300.0 300.0 AXIS_PTS_REF AirCtl_mDesBasEOM0_MAPY /end AXIS_DESCR
/end CHARACTERISTIC
/begin CHARACTERISTIC AirCtl_mDesBasHiAltdEOM0_MAP "Base air mass setpoint value in normal mode at high altitude" MAP 0x382FE0 Lookup2D_WORD 0 AirMass_mg_hub -15000.0 15000.0
 /begin AXIS_DESCR COM_AXIS Epm_nEng EngSpeed_rpm 16 -6000.0 6000.0 AXIS_PTS_REF AirCtl_mDesBasHiAltdEOM0_MAPX /end AXIS_DESCR
 /begin AXIS_DESCR COM_AXIS AirCtl_qDesVal FuelMass_mg_hub 16 -300.0 300.0 AXIS_PTS_REF AirCtl_mDesBasHiAltdEOM0_MAPY /end AXIS_DESCR
/end CHARACTERISTIC
/begin CHARACTERISTIC AirCtl_mMaxDesVal_C "Maximum air mass setpoint value" VALUE 0x383460 Scalar_SWORD 0 AirMass_mg_hub -15000.0 15000.0 /end CHARACTERISTIC
/begin CHARACTERISTIC AirCtl_mMinDesVal_C "Minimum air mass setpoint value" VALUE 0x383528 Scalar_SWORD 0 AirMass_mg_hub -15000.0 15000.0 /end CHARACTERISTIC
/begin CHARACTERISTIC AirCtl_facIndPresCorr_C "Factor of air pressure correction" VALUE 0x38287A Scalar_SWORD 0 Factor -30.0 30.0 /end CHARACTERISTIC
/begin CHARACTERISTIC AirCtl_swtIndPresSel_C "Switch for the  air pressure correction" VALUE 0x385B8C Scalar_BOOLEAN 0 boolean 0.0 1.0 /end CHARACTERISTIC
/begin CHARACTERISTIC AirCtl_ctAirTempSel_C "Air_tCACDs=0,Air_tAFS=1,Air_tEnvT=2,Air_tIntkVUS=3" VALUE 0x3824BE Scalar_UBYTE 0 AirTempFldSel_conv 0 3 /end CHARACTERISTIC
/begin CHARACTERISTIC AirCtl_ctEngTempSel_C "Coolant_Temperature(0),Oil_Temperature(1),Eng_Temperature(2)" VALUE 0x3824BF Scalar_UBYTE 0 EngTempFldSel_conv 0 2 /end CHARACTERISTIC
/begin AXIS_PTS AirCtl_facAirTempCorEOM0_MAPY "Selected air temperature " 0x382602 AirCtl_tAirDesVal_mp Lookup2D_X_WORD 0 Temp_deg 9 -1000.0 1000.0 /end AXIS_PTS
/begin AXIS_PTS AirCtl_facAirTempCorEOM0_MAPX "Engine speed" 0x3825F0 Epm_nEng Lookup2D_X_WORD 0 EngSpeed_rpm 9 -6000.0 6000.0 /end AXIS_PTS
/begin AXIS_PTS AirCtl_facEngTempCorEOM0_MAPY "Selected engine temperature " 0x382748 AirCtl_tEngDesVal_mp Lookup2D_X_WORD 0 Temp_deg 9 -1000.0 1000.0 /end AXIS_PTS
/begin AXIS_PTS AirCtl_facEngTempCorEOM0_MAPX "Engine speed" 0x382736 Epm_nEng Lookup2D_X_WORD 0 EngSpeed_rpm 9 -6000.0 6000.0 /end AXIS_PTS
/begin AXIS_PTS AirCtl_mAirTempCorBasEOM0_MAPY "Injection quantity for the setpoint value formation of the exhaust-gas recirculation control" 0x382D80 AirCtl_qDesVal Lookup2D_X_WORD 0 FuelMass_mg_hub 16 -300.0 300.0 /end AXIS_PTS
/begin AXIS_PTS AirCtl_mAirTempCorBasEOM0_MAPX "Engine speed" 0x382D60 Epm_nEng Lookup2D_X_WORD 0 EngSpeed_rpm 16 -6000.0 6000.0 /end AXIS_PTS
/begin AXIS_PTS AirCtl_mEngTempCorBasEOM0_MAPY "Injection quantity for the setpoint value formation of the exhaust-gas recirculation control" 0x383440 AirCtl_qDesVal Lookup2D_X_WORD 0 FuelMass_mg_hub 16 -300.0 300.0 /end AXIS_PTS
/begin AXIS_PTS AirCtl_mEngTempCorBasEOM0_MAPX "Engine speed" 0x383420 Epm_nEng Lookup2D_X_WORD 0 EngSpeed_rpm 16 -6000.0 6000.0 /end AXIS_PTS
/begin AXIS_PTS AirCtl_pBstPresRef_MAPY "Injection quantity for the setpoint value formation of the exhaust-gas recirculation control" 0x3836B2 AirCtl_qDesVal Lookup2D_X_WORD 0 FuelMass_mg_hub 9 -300.0 300.0 /end AXIS_PTS
/begin AXIS_PTS AirCtl_pBstPresRef_MAPX "Engine speed" 0x3836A0 Epm_nEng Lookup2D_X_WORD 0 EngSpeed_rpm 9 -6000.0 6000.0 /end AXIS_PTS
/begin AXIS_PTS AirCtl_facEnvPresCorEOM0_CURX "Barometric pressure" 0x38280A EnvP_p Lookup1D_X_WORD 0 AirPressure_kPa 4 -3000.0 3000.0 /end AXIS_PTS
/begin AXIS_PTS AirCtl_mDesBasEOM0_MAPY "Injection quantity for the setpoint value formation of the exhaust-gas recirculation control" 0x382FC0 AirCtl_qDesVal Lookup2D_X_WORD 0 FuelMass_mg_hub 16 -300.0 300.0 /end AXIS_PTS
/begin AXIS_PTS AirCtl_mDesBasEOM0_MAPX "Engine speed" 0x382FA0 Epm_nEng Lookup2D_X_WORD 0 EngSpeed_rpm 16 -6000.0 6000.0 /end AXIS_PTS
/begin AXIS_PTS AirCtl_mDesBasHiAltdEOM0_MAPY "Injection quantity for the setpoint value formation of the exhaust-gas recirculation control" 0x383200 AirCtl_qDesVal Lookup2D_X_WORD 0 FuelMass_mg_hub 16 -300.0 300.0 /end AXIS_PTS
/begin AXIS_PTS AirCtl_mDesBasHiAltdEOM0_MAPX "Engine speed" 0x3831E0 Epm_nEng Lookup2D_X_WORD 0 EngSpeed_rpm 16 -6000.0 6000.0 /end AXIS_PTS
/begin CHARACTERISTIC AirCtl_rEGR_MAP "Controller correcting variable for the exhaust-gas recirculation valve in normal operation" MAP 0x384906 Lookup2D_WORD 0 Prc_100_rate -100.0 100.0
 /begin AXIS_DESCR COM_AXIS Epm_nEng EngSpeed_rpm 12 -6000.0 6000.0 AXIS_PTS_REF AirCtl_rEGR_MAPX /end AXIS_DESCR
 /begin AXIS_DESCR COM_AXIS AirCtl_rGovOut_mp Prc_100_rate 12 -100.0 100.0 AXIS_PTS_REF AirCtl_rEGR_MAPY /end AXIS_DESCR
/end CHARACTERISTIC
/begin CHARACTERISTIC AirCtl_rTVA_MAP "Controller correcting variable for the throttle valve in normal operation" MAP 0x3855DA Lookup2D_WORD 0 Prc_100_rate -100.0 100.0
 /begin AXIS_DESCR COM_AXIS Epm_nEng EngSpeed_rpm 12 -6000.0 6000.0 AXIS_PTS_REF AirCtl_rTVA_MAPX /end AXIS_DESCR
 /begin AXIS_DESCR COM_AXIS AirCtl_rGovOut_mp Prc_100_rate 12 -100.0 100.0 AXIS_PTS_REF AirCtl_rTVA_MAPY /end AXIS_DESCR
/end CHARACTERISTIC
/begin CHARACTERISTIC AirCtl_rTransCor_MAP "Engine operating map for correction factor of precontrol value of AirCtl governor" MAP 0x38572A Lookup2D_WORD 0 Prc_100_rate -100.0 100.0
 /begin AXIS_DESCR COM_AXIS Epm_nEng EngSpeed_rpm 15 -6000.0 6000.0 AXIS_PTS_REF AirCtl_rTransCor_MAPX /end AXIS_DESCR
 /begin AXIS_DESCR COM_AXIS InjCtl_qSetUnBal FuelMass_mg_hub 15 -300.0 300.0 AXIS_PTS_REF AirCtl_rTransCor_MAPY /end AXIS_DESCR
/end CHARACTERISTIC
/begin CHARACTERISTIC AirCtl_facParAirTemp_CUR "Air-temperature-dependent correction factor for parameter adaptation" CURVE 0x38287C Lookup1D_WORD 0 Fact1 -200.0 200.0
 /begin AXIS_DESCR COM_AXIS AirCtl_tAirGov_mp Temp_deg 25 -1000.0 1000.0 AXIS_PTS_REF AirCtl_facParAirTemp_CURX /end AXIS_DESCR
/end CHARACTERISTIC
/begin CHARACTERISTIC AirCtl_facParBas_MAP "Basic map for the controller parameter adaptation " MAP 0x3828E0 Lookup2D_WORD 0 Fact1 -200.0 200.0
 /begin AXIS_DESCR COM_AXIS Epm_nEng EngSpeed_rpm 16 -6000.0 6000.0 AXIS_PTS_REF AirCtl_facParBas_MAPX /end AXIS_DESCR
 /begin AXIS_DESCR COM_AXIS AirCtl_qGov FuelMass_mg_hub 16 -300.0 300.0 AXIS_PTS_REF AirCtl_facParBas_MAPY /end AXIS_DESCR
/end CHARACTERISTIC
/begin CHARACTERISTIC AirCtl_KIconv_C "Ki Conversion for Airctrl parameter" VALUE 0x3824A4 Scalar_UWORD 0 Freq_q1p0 0.0 65535.0 /end CHARACTERISTIC
/begin CHARACTERISTIC AirCtl_T1Nrm_C "Current parameter T1 for AirCtl for the AirCtl governor" VALUE 0x3824BC Scalar_UWORD 0 RailDT1_ms 0.0 65535.0 /end CHARACTERISTIC
/begin CHARACTERISTIC AirCtl_KiWinNegNrm_C "I component negative window  for the AirCtl governor" VALUE 0x3824AE Scalar_SWORD 0 AirMass_mg_hub -15000.0 15000.0 /end CHARACTERISTIC
/begin CHARACTERISTIC AirCtl_KiWinPosNrm_C "I component Positive window  for the AirCtl governor" VALUE 0x3824B0 Scalar_SWORD 0 AirMass_mg_hub -15000.0 15000.0 /end CHARACTERISTIC
/begin CHARACTERISTIC AirCtl_KpWinNegNrm_C "P component negative window for the AirCtl governor" VALUE 0x3824B8 Scalar_SWORD 0 AirMass_mg_hub -15000.0 15000.0 /end CHARACTERISTIC
/begin CHARACTERISTIC AirCtl_KpWinPosNrm_C "P component Positive window for the AirCtl governor" VALUE 0x3824BA Scalar_SWORD 0 AirMass_mg_hub -15000.0 15000.0 /end CHARACTERISTIC
/begin CHARACTERISTIC AirCtl_rGovMax_C "Maximum permissible governor output in Normal mode." VALUE 0x385116 Scalar_SWORD 0 Prc_100_rate -100.0 100.0 /end CHARACTERISTIC
/begin CHARACTERISTIC AirCtl_rGovMin_C "Minimum permissible governor output in Normal mode." VALUE 0x385118 Scalar_SWORD 0 Prc_100_rate -100.0 100.0 /end CHARACTERISTIC
/begin CHARACTERISTIC AirCtl_rIGovLimHi_C "Minimum I component" VALUE 0x38511A Scalar_SWORD 0 Prc_100_rate -100.0 100.0 /end CHARACTERISTIC
/begin CHARACTERISTIC AirCtl_rIGovLimLo_C "Maximum I component" VALUE 0x38511C Scalar_SWORD 0 Prc_100_rate -100.0 100.0 /end CHARACTERISTIC
/begin CHARACTERISTIC AirCtl_KdNrm_C "Current parameter Kd for AirCtl for the AirCtl governor" VALUE 0x3824A6 Scalar_UWORD 0 Pid_Kp_Kd 0.0 15.0 /end CHARACTERISTIC
/begin CHARACTERISTIC AirCtl_KpNegNrm_C "P-gain below lower window border for the AirCtl governor" VALUE 0x3824B2 Scalar_SWORD 0 VlvCtl_Kp -64.0 63.0 /end CHARACTERISTIC
/begin CHARACTERISTIC AirCtl_KpNrm_C "P-Gain within the window for the AirCtl governor" VALUE 0x3824B4 Scalar_SWORD 0 VlvCtl_Kp -64.0 63.0 /end CHARACTERISTIC
/begin CHARACTERISTIC AirCtl_KpPosNrm_C "P-gain above upper window border for the AirCtl governor" VALUE 0x3824B6 Scalar_SWORD 0 VlvCtl_Kp -64.0 63.0 /end CHARACTERISTIC
/begin CHARACTERISTIC AirCtl_KiNegNrm_C "I-gain below lower window border for the AirCtl governor" VALUE 0x3824A8 Scalar_SWORD 0 VlvCtl_Ki -32.0 31.0 /end CHARACTERISTIC
/begin CHARACTERISTIC AirCtl_KiNrm_C "I-Gain within the window for the AirCtl governor" VALUE 0x3824AA Scalar_SWORD 0 VlvCtl_Ki -32.0 31.0 /end CHARACTERISTIC
/begin CHARACTERISTIC AirCtl_KiPosNrm_C "I-gain above upper window border for the AirCtl governor" VALUE 0x3824AC Scalar_SWORD 0 VlvCtl_Ki -32.0 31.0 /end CHARACTERISTIC
/begin CHARACTERISTIC AirCtl_stGov_C "state to chose Open loop or close loop of airctl,1 and 5 will choose close loop." VALUE 0x385B68 Scalar_UBYTE 0 State_uint8 1.0 5.0 /end CHARACTERISTIC
/begin CHARACTERISTIC AirCtl_numAirTempGov_C "index to select the air temperature for control value calculation from Induction System temperature field" VALUE 0x3835F5 Scalar_UBYTE 0 AirTempFldSel_conv 0 3 /end CHARACTERISTIC
/begin AXIS_PTS AirCtl_rEGR_MAPY "Controller correcting variable" 0x384A3E AirCtl_rGovOut_mp Lookup2D_X_WORD 0 Prc_100_rate 12 -100.0 100.0 /end AXIS_PTS
/begin AXIS_PTS AirCtl_rEGR_MAPX "engine speed" 0x384A26 Epm_nEng Lookup2D_X_WORD 0 EngSpeed_rpm 12 -6000.0 6000.0 /end AXIS_PTS
/begin AXIS_PTS AirCtl_rTVA_MAPY "Controller correcting variable" 0x385712 AirCtl_rGovOut_mp Lookup2D_X_WORD 0 Prc_100_rate 12 -100.0 100.0 /end AXIS_PTS
/begin AXIS_PTS AirCtl_rTVA_MAPX "engine speed" 0x3856FA Epm_nEng Lookup2D_X_WORD 0 EngSpeed_rpm 12 -6000.0 6000.0 /end AXIS_PTS
/begin AXIS_PTS AirCtl_rTransCor_MAPY "Current injection quantity" 0x38590A InjCtl_qSetUnBal Lookup2D_X_WORD 0 FuelMass_mg_hub 15 -300.0 300.0 /end AXIS_PTS
/begin AXIS_PTS AirCtl_rTransCor_MAPX "engine speed" 0x3858EC Epm_nEng Lookup2D_X_WORD 0 EngSpeed_rpm 15 -6000.0 6000.0 /end AXIS_PTS
/begin AXIS_PTS AirCtl_facParAirTemp_CURX "axis point for Air-temperature-dependent correction factor for parameter adaptation" 0x3828AE AirCtl_tAirGov_mp Lookup1D_X_WORD 0 Temp_deg 25 -1000.0 1000.0 /end AXIS_PTS
/begin AXIS_PTS AirCtl_facParBas_MAPY "Current injection quantity" 0x382B00 AirCtl_qGov Lookup2D_X_WORD 0 FuelMass_mg_hub 16 -300.0 300.0 /end AXIS_PTS
/begin AXIS_PTS AirCtl_facParBas_MAPX "engine speed" 0x382AE0 Epm_nEng Lookup2D_X_WORD 0 EngSpeed_rpm 16 -6000.0 6000.0 /end AXIS_PTS
/begin CHARACTERISTIC AirCtl_tiCldStrt_CUR "Time curve for period during which control remains shut off following starting cut-out" CURVE 0x385BA0 Lookup1D_ULONG 0 EngTime_ms 0.0 655350.0
 /begin AXIS_DESCR COM_AXIS AirCtl_tEngMon_mp Temp_deg 16 -1000.0 1000.0 AXIS_PTS_REF AirCtl_tiCldStrt_CURX /end AXIS_DESCR
/end CHARACTERISTIC
/begin CHARACTERISTIC AirCtl_facEngTempSmkHysCor_CUR "Curve for correction factor to determine band width for smoke limitation." CURVE 0x38279A Lookup1D_WORD 0 Fact1 -200.0 200.0
 /begin AXIS_DESCR COM_AXIS AirCtl_tEngMon_mp Temp_deg 10 -1000.0 1000.0 AXIS_PTS_REF AirCtl_facEngTempSmkHysCor_CURX /end AXIS_DESCR
/end CHARACTERISTIC
/begin CHARACTERISTIC AirCtl_facEnvPresSmkHysCor_CUR "Curve for correction factor based on environment pressure to determine band width for smoke limitation" CURVE 0x382852 Lookup1D_WORD 0 Fact1 -200.0 200.0
 /begin AXIS_DESCR COM_AXIS EnvP_p AirPressure_kPa 10 -3000.0 3000.0 AXIS_PTS_REF AirCtl_facEnvPresSmkHysCor_CURX /end AXIS_DESCR
/end CHARACTERISTIC
/begin CHARACTERISTIC AirCtl_qEngTempSmkHysCor_MAP "Map of correction quantity to determine band width for smoke limitation" MAP 0x3836C4 Lookup2D_WORD 0 FuelMass_mg_hub -300.0 300.0
 /begin AXIS_DESCR COM_AXIS Epm_nEng EngSpeed_rpm 16 -6000.0 6000.0 AXIS_PTS_REF AirCtl_qEngTempSmkHysCor_MAPX /end AXIS_DESCR
 /begin AXIS_DESCR COM_AXIS InjCtl_qSetUnBal FuelMass_mg_hub 16 -300.0 300.0 AXIS_PTS_REF AirCtl_qEngTempSmkHysCor_MAPY /end AXIS_DESCR
/end CHARACTERISTIC
/begin CHARACTERISTIC AirCtl_qEnvPresSmkHysCor_MAP "Map of correction quantity based on environment pressure to determine band width for smoke limitation" MAP 0x383904 Lookup2D_WORD 0 FuelMass_mg_hub -300.0 300.0
 /begin AXIS_DESCR COM_AXIS Epm_nEng EngSpeed_rpm 16 -6000.0 6000.0 AXIS_PTS_REF AirCtl_qEnvPresSmkHysCor_MAPX /end AXIS_DESCR
 /begin AXIS_DESCR COM_AXIS InjCtl_qSetUnBal FuelMass_mg_hub 16 -300.0 300.0 AXIS_PTS_REF AirCtl_qEnvPresSmkHysCor_MAPY /end AXIS_DESCR
/end CHARACTERISTIC
/begin CHARACTERISTIC AirCtl_qSmkHys_MAP "Map of basic offset quantity to determine band width for Smoke limitation." MAP 0x383B46 Lookup2D_WORD 0 FuelMass_mg_hub -300.0 300.0
 /begin AXIS_DESCR COM_AXIS Epm_nEng EngSpeed_rpm 16 -6000.0 6000.0 AXIS_PTS_REF AirCtl_qSmkHys_MAPX /end AXIS_DESCR
 /begin AXIS_DESCR COM_AXIS InjCtl_qSetUnBal FuelMass_mg_hub 16 -300.0 300.0 AXIS_PTS_REF AirCtl_qSmkHys_MAPY /end AXIS_DESCR
/end CHARACTERISTIC
/begin CHARACTERISTIC AirCtl_mMaxDvt_MAP "Map of the upper limit for the detection of a permanent control deviation" MAP 0x383462 Lookup2D_WORD 0 AirMass_mg_hub -15000.0 15000.0
 /begin AXIS_DESCR COM_AXIS Epm_nEng EngSpeed_rpm 9 -6000.0 6000.0 AXIS_PTS_REF AirCtl_mMaxDvt_MAPX /end AXIS_DESCR
 /begin AXIS_DESCR COM_AXIS AirCtl_qMon FuelMass_mg_hub 9 -300.0 300.0 AXIS_PTS_REF AirCtl_mMaxDvt_MAPY /end AXIS_DESCR
/end CHARACTERISTIC
/begin CHARACTERISTIC AirCtl_mMinDvt_MAP "Map of the lower limit for the detection of a permanent control deviation" MAP 0x38352A Lookup2D_WORD 0 AirMass_mg_hub -15000.0 15000.0
 /begin AXIS_DESCR COM_AXIS Epm_nEng EngSpeed_rpm 9 -6000.0 6000.0 AXIS_PTS_REF AirCtl_mMinDvt_MAPX /end AXIS_DESCR
 /begin AXIS_DESCR COM_AXIS AirCtl_qMon FuelMass_mg_hub 9 -300.0 300.0 AXIS_PTS_REF AirCtl_mMinDvt_MAPY /end AXIS_DESCR
/end CHARACTERISTIC
/begin CHARACTERISTIC AirCtl_tiClth_C "Maximum period for gear shift detection" VALUE 0x385C00 Scalar_ULONG 0 Debounce_ms 0.0 65535.0 /end CHARACTERISTIC
/begin CHARACTERISTIC AirCtl_tiDynSmkDly_C "Even if there is no input, the dynamic limit stilll shake violently; therefore, increase the delay time" VALUE 0x385C04 Scalar_ULONG 0 Debounce_ms 0.0 65535.0 /end CHARACTERISTIC
/begin CHARACTERISTIC AirCtl_tiGovDvtMaxDebDef_C "Debounce time of GovDvtMaxDef" VALUE 0x385C08 Scalar_ULONG 0 Debounce_ms 0.0 65535.0 /end CHARACTERISTIC
/begin CHARACTERISTIC AirCtl_tiGovDvtMaxDebOk_C "Debounce time of GovDvtMaxOk" VALUE 0x385C0C Scalar_ULONG 0 Debounce_ms 0.0 65535.0 /end CHARACTERISTIC
/begin CHARACTERISTIC AirCtl_tiGovDvtMinDebDef_C "Debounce time of GovDvtMinDef" VALUE 0x385C10 Scalar_ULONG 0 Debounce_ms 0.0 65535.0 /end CHARACTERISTIC
/begin CHARACTERISTIC AirCtl_tiGovDvtMinDebOk_C "Debounce time of GovDvtMinOk" VALUE 0x385C14 Scalar_ULONG 0 Debounce_ms 0.0 65535.0 /end CHARACTERISTIC
/begin CHARACTERISTIC AirCtl_tiLoIdl_C "Delay time for idle detection" VALUE 0x385C18 Scalar_ULONG 0 Debounce_ms 0.0 65535.0 /end CHARACTERISTIC
/begin CHARACTERISTIC AirCtl_tiStatSmkDly_C "Delay time for static smoke (EGR) switch on" VALUE 0x385C1C Scalar_ULONG 0 Debounce_ms 0.0 65535.0 /end CHARACTERISTIC
/begin CHARACTERISTIC AirCtl_tiTransDly_C "Delay time for dynamic smoke (EGR) switch on" VALUE 0x385C20 Scalar_ULONG 0 Debounce_ms 0.0 65535.0 /end CHARACTERISTIC
/begin CHARACTERISTIC AirCtl_drAPPTrans_C "Limit for accelerator pedal position value. (For dynamic EGR switching )" VALUE 0x3824C4 Scalar_LONG 0 Accpedal_rate_s -100000.0 100000.0 /end CHARACTERISTIC
/begin CHARACTERISTIC AirCtl_uBattThres_C "threshold for battery voltage monitoring" VALUE 0x385C24 Scalar_UWORD 0 Battery_mv 0.0 50000.0 /end CHARACTERISTIC
/begin CHARACTERISTIC AirCtl_dnEngTrans_C "Limit for engine acceleration value. (For dynamic EGR switching )" VALUE 0x3824C0 Scalar_SWORD 0 EngSpeed_rpm_s -12000.0 12000.0 /end CHARACTERISTIC
/begin CHARACTERISTIC AirCtl_nLoIdl_C "Engine speed limit for idle detection" VALUE 0x3835F0 Scalar_SWORD 0 EngSpeed_rpm -6000.0 6000.0 /end CHARACTERISTIC
/begin CHARACTERISTIC AirCtl_nOvrRun_C "Engine speed for Overrun condition" VALUE 0x3835F2 Scalar_SWORD 0 EngSpeed_rpm -6000.0 6000.0 /end CHARACTERISTIC
/begin CHARACTERISTIC AirCtl_dqLeadTrans_C "Limit for change in injection quantity.(For dynamic EGR switching )" VALUE 0x3824C2 Scalar_SWORD 0 FuelMass_mg_hub_s -300.0 300.0 /end CHARACTERISTIC
/begin CHARACTERISTIC AirCtl_qOvrRun_C "Limiting value for overrun operation" VALUE 0x383B44 Scalar_SWORD 0 FuelMass_mg_hub -300.0 300.0 /end CHARACTERISTIC
/begin CHARACTERISTIC AirCtl_qSwtSmkHi_C "Upper hysteresis limit for monitoring of EOM close to smoke limit" VALUE 0x383D86 Scalar_SWORD 0 FuelMass_mg_hub -300.0 300.0 /end CHARACTERISTIC
/begin CHARACTERISTIC AirCtl_qSwtSmkLo_C "Lower hysteresis limit for monitoring of EOM close to smoke limit" VALUE 0x383D88 Scalar_SWORD 0 FuelMass_mg_hub -300.0 300.0 /end CHARACTERISTIC
/begin CHARACTERISTIC AirCtl_pAirHi_C "Higher hysteresis limit for atmospheric pressure monitoring" VALUE 0x3835FA Scalar_SWORD 0 AirPressure_kPa -3000.0 3000.0 /end CHARACTERISTIC
/begin CHARACTERISTIC AirCtl_pAirLo_C "Lower hysteresis limit for atmospheric pressure monitoring" VALUE 0x3835FC Scalar_SWORD 0 AirPressure_kPa -3000.0 3000.0 /end CHARACTERISTIC
/begin CHARACTERISTIC AirCtl_facActDesVal_C "Safety factor for air mass flow to be implemented" VALUE 0x38254C Scalar_SWORD 0 Fact1 -200.0 200.0 /end CHARACTERISTIC
/begin CHARACTERISTIC AirCtl_rEGRDflVal_CA "Field of the default values for the exhaust-gas recirculation valve" VAL_BLK 0x3848CA Scalar_SWORD 0 Prc_100_rate -100.0 100.0 NUMBER 30 /end CHARACTERISTIC
/begin CHARACTERISTIC AirCtl_rTVADflVal_CA "Field of the default values for the TVA" VAL_BLK 0x38559E Scalar_SWORD 0 Prc_100_rate -100.0 100.0 NUMBER 30 /end CHARACTERISTIC
/begin CHARACTERISTIC AirCtl_tAirCldHi_C "Upper hysteresis limit for too low a temperature from the temperature field of the induction system" VALUE 0x385B8E Scalar_SWORD 0 Temp_deg -1000.0 1000.0 /end CHARACTERISTIC
/begin CHARACTERISTIC AirCtl_tAirCldLo_C "Lower hysteresis limit for too low a temperature from the temperature field of the induction system" VALUE 0x385B90 Scalar_SWORD 0 Temp_deg -1000.0 1000.0 /end CHARACTERISTIC
/begin CHARACTERISTIC AirCtl_tAirWrmHi_C "Upper hysteresis limit for too high a temperature from the temperature field of the induction system" VALUE 0x385B92 Scalar_SWORD 0 Temp_deg -1000.0 1000.0 /end CHARACTERISTIC
/begin CHARACTERISTIC AirCtl_tAirWrmLo_C "Lower hysteresis limit for too high a temperature from the temperature field of the induction system" VALUE 0x385B94 Scalar_SWORD 0 Temp_deg -1000.0 1000.0 /end CHARACTERISTIC
/begin CHARACTERISTIC AirCtl_tClntCldHi_C "Upper hysteresis limit for low coolant temperature monitoring" VALUE 0x385B96 Scalar_SWORD 0 Temp_deg -1000.0 1000.0 /end CHARACTERISTIC
/begin CHARACTERISTIC AirCtl_tClntCldLo_C "Lower hysteresis limit for low coolant temperature monitoring" VALUE 0x385B98 Scalar_SWORD 0 Temp_deg -1000.0 1000.0 /end CHARACTERISTIC
/begin CHARACTERISTIC AirCtl_tClntWrmHi_C "Upper hysteresis limit for high coolant temperature monitoring" VALUE 0x385B9A Scalar_SWORD 0 Temp_deg -1000.0 1000.0 /end CHARACTERISTIC
/begin CHARACTERISTIC AirCtl_tClntWrmLo_C "Lower hysteresis limit for high coolant temperature monitoring" VALUE 0x385B9C Scalar_SWORD 0 Temp_deg -1000.0 1000.0 /end CHARACTERISTIC
/begin CHARACTERISTIC AirCtl_stPrioMon_CA "Field of priorities" VAL_BLK 0x385B6C Scalar_UBYTE 0 State_uint8 0.0 255.0 NUMBER 30 /end CHARACTERISTIC
/begin CHARACTERISTIC AirCtl_numAirTempMon_C "Selected temperature from temperature field of the induction system for the monitoring" VALUE 0x3835F6 Scalar_UBYTE 0 AirTempFldSel_conv 0 3 /end CHARACTERISTIC
/begin CHARACTERISTIC AirCtl_numEngTempMon_C "Selected temperature from the engine temperature field for the monitoring" VALUE 0x3835F8 Scalar_UBYTE 0 EngTempFldSel_conv 0 2 /end CHARACTERISTIC
/begin CHARACTERISTIC AirCtl_swtGovDvtMonEna_C "Switch for deviation of air mass check" VALUE 0x385B8B Scalar_UBYTE 0 Switch_conv 0 1 /end CHARACTERISTIC
/begin AXIS_PTS AirCtl_tiCldStrt_CURX "Engine temperature" 0x385BE0 AirCtl_tEngMon_mp Lookup1D_X_WORD 0 Temp_deg 16 -1000.0 1000.0 /end AXIS_PTS
/begin AXIS_PTS AirCtl_facEngTempSmkHysCor_CURX "engine temperature" 0x3827AE AirCtl_tEngMon_mp Lookup1D_X_WORD 0 Temp_deg 10 -1000.0 1000.0 /end AXIS_PTS
/begin AXIS_PTS AirCtl_facEnvPresSmkHysCor_CURX "Barometric pressure" 0x382866 EnvP_p Lookup1D_X_WORD 0 AirPressure_kPa 10 -3000.0 3000.0 /end AXIS_PTS
/begin AXIS_PTS AirCtl_qEngTempSmkHysCor_MAPY "Current injection quantity" 0x3838E4 InjCtl_qSetUnBal Lookup2D_X_WORD 0 FuelMass_mg_hub 16 -300.0 300.0 /end AXIS_PTS
/begin AXIS_PTS AirCtl_qEngTempSmkHysCor_MAPX "engine speed" 0x3838C4 Epm_nEng Lookup2D_X_WORD 0 EngSpeed_rpm 16 -6000.0 6000.0 /end AXIS_PTS
/begin AXIS_PTS AirCtl_qEnvPresSmkHysCor_MAPY "Current injection quantity" 0x383B24 InjCtl_qSetUnBal Lookup2D_X_WORD 0 FuelMass_mg_hub 16 -300.0 300.0 /end AXIS_PTS
/begin AXIS_PTS AirCtl_qEnvPresSmkHysCor_MAPX "engine speed" 0x383B04 Epm_nEng Lookup2D_X_WORD 0 EngSpeed_rpm 16 -6000.0 6000.0 /end AXIS_PTS
/begin AXIS_PTS AirCtl_qSmkHys_MAPY "Current injection quantity" 0x383D66 InjCtl_qSetUnBal Lookup2D_X_WORD 0 FuelMass_mg_hub 16 -300.0 300.0 /end AXIS_PTS
/begin AXIS_PTS AirCtl_qSmkHys_MAPX "engine speed" 0x383D46 Epm_nEng Lookup2D_X_WORD 0 EngSpeed_rpm 16 -6000.0 6000.0 /end AXIS_PTS
/begin AXIS_PTS AirCtl_mMaxDvt_MAPY "Current injectin quantity" 0x383516 AirCtl_qMon Lookup2D_X_WORD 0 FuelMass_mg_hub 9 -300.0 300.0 /end AXIS_PTS
/begin AXIS_PTS AirCtl_mMaxDvt_MAPX "Engine speed" 0x383504 Epm_nEng Lookup2D_X_WORD 0 EngSpeed_rpm 9 -6000.0 6000.0 /end AXIS_PTS
/begin AXIS_PTS AirCtl_mMinDvt_MAPY "Current injectin quantity" 0x3835DE AirCtl_qMon Lookup2D_X_WORD 0 FuelMass_mg_hub 9 -300.0 300.0 /end AXIS_PTS
/begin AXIS_PTS AirCtl_mMinDvt_MAPX "Engine speed" 0x3835CC Epm_nEng Lookup2D_X_WORD 0 EngSpeed_rpm 9 -6000.0 6000.0 /end AXIS_PTS
/begin CHARACTERISTIC AirHt_tiCrankHt_MAP "Cranking with heating phase duration curve" MAP 0x385C38 Lookup2D_ULONG 0 Debounce_ms 0.0 655350.0
 /begin AXIS_DESCR COM_AXIS AirHt_tRefair_mp Temp_deg 10 -60.0 200.0 AXIS_PTS_REF AirHt_tiCrankHt_MAPX /end AXIS_DESCR
 /begin AXIS_DESCR COM_AXIS AirHt_tRef_mp Temp_deg 10 -60.0 200.0 AXIS_PTS_REF AirHt_tiCrankHt_MAPY /end AXIS_DESCR
/end CHARACTERISTIC
/begin CHARACTERISTIC AirHt_tiPostHt_MAP "Post-Heating phase duration curve" MAP 0x385DF4 Lookup2D_ULONG 0 Debounce_ms 0.0 655350.0
 /begin AXIS_DESCR COM_AXIS AirHt_tRefair_mp Temp_deg 10 -60.0 200.0 AXIS_PTS_REF AirHt_tiPostHt_MAPX /end AXIS_DESCR
 /begin AXIS_DESCR COM_AXIS AirHt_tRef_mp Temp_deg 10 -60.0 200.0 AXIS_PTS_REF AirHt_tiPostHt_MAPY /end AXIS_DESCR
/end CHARACTERISTIC
/begin CHARACTERISTIC AirHt_tiPreHt_MAP "Pre-Heating phase duration curve" MAP 0x385FAC Lookup2D_ULONG 0 Debounce_ms 0.0 655350.0
 /begin AXIS_DESCR COM_AXIS AirHt_tRefair_mp Temp_deg 10 -60.0 200.0 AXIS_PTS_REF AirHt_tiPreHt_MAPX /end AXIS_DESCR
 /begin AXIS_DESCR COM_AXIS AirHt_tRef_mp Temp_deg 10 -60.0 200.0 AXIS_PTS_REF AirHt_tiPreHt_MAPY /end AXIS_DESCR
/end CHARACTERISTIC
/begin CHARACTERISTIC AirHt_tiStByHt_MAP "Stand-By with heating phase duration curve" MAP 0x386164 Lookup2D_ULONG 0 Debounce_ms 0.0 655350.0
 /begin AXIS_DESCR COM_AXIS AirHt_tRefair_mp Temp_deg 10 -60.0 200.0 AXIS_PTS_REF AirHt_tiStByHt_MAPX /end AXIS_DESCR
 /begin AXIS_DESCR COM_AXIS AirHt_tRef_mp Temp_deg 10 -60.0 200.0 AXIS_PTS_REF AirHt_tiStByHt_MAPY /end AXIS_DESCR
/end CHARACTERISTIC
/begin CHARACTERISTIC AirHt_tiBlink_C "ON/OFF duration for blinking mode" VALUE 0x385C34 Scalar_ULONG 0 Debounce_ms 0.0 65535.0 /end CHARACTERISTIC
/begin CHARACTERISTIC AirHt_tiLowBattThr_C "Application parameter for minimum low battery period for disabling air heating procedure" VALUE 0x385DF0 Scalar_ULONG 0 Debounce_ms 0.0 65535.0 /end CHARACTERISTIC
/begin CHARACTERISTIC AirHt_tiStDelay_C "time of Heating phase duration wait for sensor value" VALUE 0x38631C Scalar_ULONG 0 Debounce_ms 0.0 65535.0 /end CHARACTERISTIC
/begin CHARACTERISTIC AirHt_uLowBattThr_C "Battery threshold for disabling air heating procedure" VALUE 0x386320 Scalar_UWORD 0 Battery_mv 0.0 50000.0 /end CHARACTERISTIC
/begin CHARACTERISTIC AirHt_nMin_C "Minimum engine speed to transit to cranking phase" VALUE 0x385C2E Scalar_SWORD 0 EngSpeed_rpm 0.0 6000.0 /end CHARACTERISTIC
/begin CHARACTERISTIC AirHt_referencetemp_C "reference temp" VALUE 0x385C30 Scalar_SWORD 0 Temp_deg 0.0 100.0 /end CHARACTERISTIC
/begin CHARACTERISTIC AirHt_bCEngDsT_C "select CEngDsT_t or not" VALUE 0x385C26 Scalar_BOOLEAN 0 boolean 0.0 1.0 /end CHARACTERISTIC
/begin CHARACTERISTIC AirHt_bEnvT_C "select EnvT or not" VALUE 0x385C27 Scalar_BOOLEAN 0 boolean 0.0 1.0 /end CHARACTERISTIC
/begin CHARACTERISTIC AirHt_bFuelT_C "select FuelT or not" VALUE 0x385C28 Scalar_BOOLEAN 0 boolean 0.0 1.0 /end CHARACTERISTIC
/begin CHARACTERISTIC AirHt_bOilT_C "select OilT or not" VALUE 0x385C29 Scalar_BOOLEAN 0 boolean 0.0 1.0 /end CHARACTERISTIC
/begin CHARACTERISTIC AirHt_btAFS_C "select AFS temp or not" VALUE 0x385C2A Scalar_BOOLEAN 0 boolean 0.0 1.0 /end CHARACTERISTIC
/begin CHARACTERISTIC AirHt_btCACDs_C "select after intercooler temp" VALUE 0x385C2B Scalar_BOOLEAN 0 boolean 0.0 1.0 /end CHARACTERISTIC
/begin CHARACTERISTIC AirHt_btIntkVUs_C "select intake air temp or not" VALUE 0x385C2C Scalar_BOOLEAN 0 boolean 0.0 1.0 /end CHARACTERISTIC
/begin AXIS_PTS AirHt_tiCrankHt_MAPY "AirHt_tRef_mp" 0x385DDC AirHt_tRef_mp Lookup2D_X_WORD 0 Temp_deg 10 -60.0 200.0 /end AXIS_PTS
/begin AXIS_PTS AirHt_tiCrankHt_MAPX "AirHt_tRefair_mp" 0x385DC8 AirHt_tRefair_mp Lookup2D_X_WORD 0 Temp_deg 10 -60.0 200.0 /end AXIS_PTS
/begin AXIS_PTS AirHt_tiPostHt_MAPY "AirHt_tRef_mp" 0x385F98 AirHt_tRef_mp Lookup2D_X_WORD 0 Temp_deg 10 -60.0 200.0 /end AXIS_PTS
/begin AXIS_PTS AirHt_tiPostHt_MAPX "AirHt_tRefair_mp" 0x385F84 AirHt_tRefair_mp Lookup2D_X_WORD 0 Temp_deg 10 -60.0 200.0 /end AXIS_PTS
/begin AXIS_PTS AirHt_tiPreHt_MAPY "AirHt_tRef_mp" 0x386150 AirHt_tRef_mp Lookup2D_X_WORD 0 Temp_deg 10 -60.0 200.0 /end AXIS_PTS
/begin AXIS_PTS AirHt_tiPreHt_MAPX "AirHt_tRefair_mp" 0x38613C AirHt_tRefair_mp Lookup2D_X_WORD 0 Temp_deg 10 -60.0 200.0 /end AXIS_PTS
/begin AXIS_PTS AirHt_tiStByHt_MAPY "AirHt_tRef_mp" 0x386308 AirHt_tRef_mp Lookup2D_X_WORD 0 Temp_deg 10 -60.0 200.0 /end AXIS_PTS
/begin AXIS_PTS AirHt_tiStByHt_MAPX "AirHt_tRefair_mp" 0x3862F4 AirHt_tRefair_mp Lookup2D_X_WORD 0 Temp_deg 10 -60.0 200.0 /end AXIS_PTS
/begin CHARACTERISTIC CoAS_stEGRVlv_C "State  of EGR control enable" VALUE 0x3866B0 Scalar_UBYTE 0 State_uint8 0.0 255.0 /end CHARACTERISTIC
/begin CHARACTERISTIC CoAS_stThrVlv_C "State  of TVA control enable" VALUE 0x3866B1 Scalar_UBYTE 0 State_uint8 0.0 255.0 /end CHARACTERISTIC
/begin CHARACTERISTIC TCPrt_nSpdMax_CUR "Curve to determine the maximun speed against Turbocharger speed" CURVE 0x39AAE6 Lookup1D_WORD 0 Turbo_rpm -327679.0 327671.0
 /begin AXIS_DESCR COM_AXIS Epm_nEng EngSpeed_rpm 16 0.0 6000.0 AXIS_PTS_REF TCPrt_nSpdMax_CURX /end AXIS_DESCR
/end CHARACTERISTIC
/begin CHARACTERISTIC TCPrt_trqMax_CUR "Curve to determine maximum quantity" CURVE 0x39AB30 Lookup1D_WORD 0 Trq_Nm -3276.8 3276.7
 /begin AXIS_DESCR COM_AXIS Epm_nEng EngSpeed_rpm 16 0.0 6000.0 AXIS_PTS_REF TCPrt_trqMax_CURX /end AXIS_DESCR
/end CHARACTERISTIC
/begin CHARACTERISTIC TCPrt_trqOpnLop_MAP "Desired fuel quantity map for open loop logic" MAP 0x39AB70 Lookup2D_WORD 0 Trq_Nm -3276.8 3276.7
 /begin AXIS_DESCR COM_AXIS EnvP_p AirPressure_kPa 16 0.0 350.0 AXIS_PTS_REF TCPrt_trqOpnLop_MAPX /end AXIS_DESCR
 /begin AXIS_DESCR COM_AXIS Epm_nEng EngSpeed_rpm 16 0.0 6000.0 AXIS_PTS_REF TCPrt_trqOpnLop_MAPY /end AXIS_DESCR
/end CHARACTERISTIC
/begin CHARACTERISTIC TCPrt_tiOvrSpdDebDef_C "Duration of defect debouncing for check DFC_TrbChOvrSpd" VALUE 0x39AB28 Scalar_ULONG 0 Debounce_ms 0.0 65535.0 /end CHARACTERISTIC
/begin CHARACTERISTIC TCPrt_tiOvrSpdDebOk_C "Duration of healing debouncing for check DFC_TrbChOvrSpd" VALUE 0x39AB2C Scalar_ULONG 0 Debounce_ms 0.0 65535.0 /end CHARACTERISTIC
/begin AXIS_PTS TCPrt_nSpdMax_CURX "Epm_nEng" 0x39AB06 Epm_nEng Lookup1D_X_WORD 0 EngSpeed_rpm 16 0.0 6000.0 /end AXIS_PTS
/begin AXIS_PTS TCPrt_trqMax_CURX "Epm_nEng" 0x39AB50 Epm_nEng Lookup1D_X_WORD 0 EngSpeed_rpm 16 0.0 6000.0 /end AXIS_PTS
/begin AXIS_PTS TCPrt_trqOpnLop_MAPY "Epm_nEng" 0x39AD90 Epm_nEng Lookup2D_X_WORD 0 EngSpeed_rpm 16 0.0 6000.0 /end AXIS_PTS
/begin AXIS_PTS TCPrt_trqOpnLop_MAPX "EnvP_p" 0x39AD70 EnvP_p Lookup2D_X_WORD 0 AirPressure_kPa 16 0.0 350.0 /end AXIS_PTS
/begin CHARACTERISTIC SmkLim_swtAirMs_C "switch for selecting airmass" VALUE 0x39975C Scalar_BOOLEAN 0 boolean 0.0 1.0 /end CHARACTERISTIC
/begin CHARACTERISTIC SmkLim_facEnvPCor_CUR "Correction factor output based on the atmosphericpressure" CURVE 0x3980BC Lookup1D_WORD 0 Factor -10.0 10.0
 /begin AXIS_DESCR COM_AXIS EnvP_p AirPressure_kPa 16 0.0 3276.0 AXIS_PTS_REF SmkLim_facEnvPCor_CURX /end AXIS_DESCR
/end CHARACTERISTIC
/begin CHARACTERISTIC SmkLim_facLamEGRCor_CUR "EGR correction factor MAP" CURVE 0x3980FC Lookup1D_WORD 0 Factor -10.0 10.0
 /begin AXIS_DESCR COM_AXIS EGRVlv_r Prc_100_rate 16 -100.0 100.0 AXIS_PTS_REF SmkLim_facLamEGRCor_CURX /end AXIS_DESCR
/end CHARACTERISTIC
/begin CHARACTERISTIC SmkLim_facStrtCor_CUR "Correction factor output based on Engine starting temperature" CURVE 0x39819C Lookup1D_WORD 0 Factor -10.0 10.0
 /begin AXIS_DESCR COM_AXIS EngDa_tStrt Temp_deg 16 -200.0 200.0 AXIS_PTS_REF SmkLim_facStrtCor_CURX /end AXIS_DESCR
/end CHARACTERISTIC
/begin CHARACTERISTIC SmkLim_rLamEGRCor_MAP "Lambda EGR uncorrected ratio" MAP 0x3981DE Lookup2D_WORD 0 Prc_100_rate -100.0 100.0
 /begin AXIS_DESCR COM_AXIS InjCtl_qSetUnBal FuelMass_mg_hub 25 -319.0 319.0 AXIS_PTS_REF SmkLim_rLamEGRCor_MAPX /end AXIS_DESCR
 /begin AXIS_DESCR COM_AXIS Epm_nEng EngSpeed_rpm 25 0.0 6000.0 AXIS_PTS_REF SmkLim_rLamEGRCor_MAPY /end AXIS_DESCR
/end CHARACTERISTIC
/begin CHARACTERISTIC SmkLim_rLamEnvPCor_MAP "Lambda value output based on the atmospheric pressure" MAP 0x398724 Lookup2D_WORD 0 Prc_100_rate -100.0 100.0
 /begin AXIS_DESCR COM_AXIS SmkLim_mAirPerCyl AirMass_mg_hub 25 0.0 16383.0 AXIS_PTS_REF SmkLim_rLamEnvPCor_MAPX /end AXIS_DESCR
 /begin AXIS_DESCR COM_AXIS Epm_nEng EngSpeed_rpm 25 0.0 6000.0 AXIS_PTS_REF SmkLim_rLamEnvPCor_MAPY /end AXIS_DESCR
/end CHARACTERISTIC
/begin CHARACTERISTIC SmkLim_rLamFullLd_MAP "The correction value dependent on the averaged engine speed and temperature" MAP 0x398C6A Lookup2D_WORD 0 Prc_100_rate -100.0 100.0
 /begin AXIS_DESCR COM_AXIS SmkLim_tLamFullLdMapIn_mp Temp_deg 25 -200.0 200.0 AXIS_PTS_REF SmkLim_rLamFullLd_MAPX /end AXIS_DESCR
 /begin AXIS_DESCR COM_AXIS Epm_nEng EngSpeed_rpm 25 0.0 6000.0 AXIS_PTS_REF SmkLim_rLamFullLd_MAPY /end AXIS_DESCR
/end CHARACTERISTIC
/begin CHARACTERISTIC SmkLim_rLamSmkEOM0_MAP "The correction value which is added to the base lambda value" MAP 0x3991B4 Lookup2D_WORD 0 Prc_100_rate -100.0 100.0
 /begin AXIS_DESCR COM_AXIS SmkLim_mAirPerCyl AirMass_mg_hub 25 0.0 16383.0 AXIS_PTS_REF SmkLim_rLamSmkEOM0_MAPX /end AXIS_DESCR
 /begin AXIS_DESCR COM_AXIS Epm_nEng EngSpeed_rpm 25 0.0 6000.0 AXIS_PTS_REF SmkLim_rLamSmkEOM0_MAPY /end AXIS_DESCR
/end CHARACTERISTIC
/begin CHARACTERISTIC SmkLim_rLamStrtCor_CUR "Lambda value output based on the startdone time" CURVE 0x3996FA Lookup1D_WORD 0 Prc_100_rate -100.0 100.0
 /begin AXIS_DESCR COM_AXIS StSys_tiAftStrtDone_mp Time_s 16 0.0 65535.0 AXIS_PTS_REF SmkLim_rLamStrtCor_CURX /end AXIS_DESCR
/end CHARACTERISTIC
/begin CHARACTERISTIC SmkLim_EGRfacRmpSlopeNeg_C "EGR correction factor ramp step" VALUE 0x3980B8 Scalar_SWORD 0 Factor 0.0 10.0 /end CHARACTERISTIC
/begin CHARACTERISTIC SmkLim_EGRfacRmpSlopePos_C "EGR correction factor ramp step" VALUE 0x3980BA Scalar_SWORD 0 Factor 0.0 10.0 /end CHARACTERISTIC
/begin CHARACTERISTIC SmkLim_rLamMaxEOM_C "maximum allowed lambdavalues" VALUE 0x3991B0 Scalar_SWORD 0 Prc_100_rate 0.012207 100.0 /end CHARACTERISTIC
/begin CHARACTERISTIC SmkLim_rLamMinEOM_C "minimum allowed lambdavalues" VALUE 0x3991B2 Scalar_SWORD 0 Prc_100_rate 0.012207 100.0 /end CHARACTERISTIC
/begin CHARACTERISTIC SmkLim_numSmkLim_C "Index for selecting the engine temperature" VALUE 0x3981DC Scalar_UBYTE 0 State_uint8 0.0 255.0 /end CHARACTERISTIC
/begin AXIS_PTS SmkLim_facEnvPCor_CURX "Barometric pressure" 0x3980DC EnvP_p Lookup1D_X_WORD 0 AirPressure_kPa 16 0.0 3276.0 /end AXIS_PTS
/begin AXIS_PTS SmkLim_facLamEGRCor_CURX "duty cycle of EGR Valve " 0x39811C EGRVlv_r Lookup1D_X_WORD 0 Prc_100_rate 16 -100.0 100.0 /end AXIS_PTS
/begin AXIS_PTS SmkLim_facStrtCor_CURX "Engine starting temperature" 0x3981BC EngDa_tStrt Lookup1D_X_WORD 0 Temp_deg 16 -200.0 200.0 /end AXIS_PTS
/begin AXIS_PTS SmkLim_rLamEGRCor_MAPY "engine speed" 0x3986F2 Epm_nEng Lookup2D_X_WORD 0 EngSpeed_rpm 25 0.0 6000.0 /end AXIS_PTS
/begin AXIS_PTS SmkLim_rLamEGRCor_MAPX "Current injection quantity" 0x3986C0 InjCtl_qSetUnBal Lookup2D_X_WORD 0 FuelMass_mg_hub 25 -319.0 319.0 /end AXIS_PTS
/begin AXIS_PTS SmkLim_rLamEnvPCor_MAPY "engine speed" 0x398C38 Epm_nEng Lookup2D_X_WORD 0 EngSpeed_rpm 25 0.0 6000.0 /end AXIS_PTS
/begin AXIS_PTS SmkLim_rLamEnvPCor_MAPX "Air mass for smoke limitation" 0x398C06 SmkLim_mAirPerCyl Lookup2D_X_WORD 0 AirMass_mg_hub 25 0.0 16383.0 /end AXIS_PTS
/begin AXIS_PTS SmkLim_rLamFullLd_MAPY "engine speed" 0x39917E Epm_nEng Lookup2D_X_WORD 0 EngSpeed_rpm 25 0.0 6000.0 /end AXIS_PTS
/begin AXIS_PTS SmkLim_rLamFullLd_MAPX "selected engine temperature" 0x39914C SmkLim_tLamFullLdMapIn_mp Lookup2D_X_WORD 0 Temp_deg 25 -200.0 200.0 /end AXIS_PTS
/begin AXIS_PTS SmkLim_rLamSmkEOM0_MAPY "engine speed" 0x3996C8 Epm_nEng Lookup2D_X_WORD 0 EngSpeed_rpm 25 0.0 6000.0 /end AXIS_PTS
/begin AXIS_PTS SmkLim_rLamSmkEOM0_MAPX "Air mass for smoke limitation" 0x399696 SmkLim_mAirPerCyl Lookup2D_X_WORD 0 AirMass_mg_hub 25 0.0 16383.0 /end AXIS_PTS
/begin AXIS_PTS SmkLim_rLamStrtCor_CURX "Timer to indicate the time elapsed after the start is done" 0x39971C StSys_tiAftStrtDone_mp Lookup1D_X_LONG 0 Time_s 16 0.0 65535.0 /end AXIS_PTS
/begin CHARACTERISTIC FlSys_rhoFl_CUR "Fuel density coefficient" CURVE 0x389CE6 Lookup1D_WORD 0 Fuel_Rho_kg_m3 0.0 3276.0
 /begin AXIS_DESCR COM_AXIS FuelT_t Temp_deg 8 -50.0 150.0 AXIS_PTS_REF FlSys_rhoFl_CURX /end AXIS_DESCR
/end CHARACTERISTIC
/begin CHARACTERISTIC FlSys_facStoich_C "stochiometric fuel factor" VALUE 0x389CE0 Scalar_SWORD 0 Factor -32.0 31.0 /end CHARACTERISTIC
/begin CHARACTERISTIC FlSys_rhoFlCnvFac_C "customer specific fuel conversion factor" VALUE 0x389CE2 Scalar_SWORD 0 Fuel_Rho_kg_m3 0.0 3276.0 /end CHARACTERISTIC
/begin CHARACTERISTIC FlSys_rhoFl_C "set value of fuel density coefficient" VALUE 0x389CE4 Scalar_SWORD 0 Fuel_Rho_kg_m3 0.0 3276.0 /end CHARACTERISTIC
/begin CHARACTERISTIC FlSys_swtRhoFlCnv_C "switch for customer specific fuel conversion factor" VALUE 0x389D07 Scalar_UBYTE 0 Switch_conv 0 1 /end CHARACTERISTIC
/begin AXIS_PTS FlSys_rhoFl_CURX "Fuel temperature" 0x389CF6 FuelT_t Lookup1D_X_WORD 0 Temp_deg 8 -50.0 150.0 /end AXIS_PTS
/begin CHARACTERISTIC InjCrv_phiMI1Max1EOM0_MAP "Base value for MI1 start of energizing with no pilot injections" MAP 0x38C0AA Lookup2D_WORD 0 Angle_CA -10.0 40.0
 /begin AXIS_DESCR COM_AXIS Epm_nEng EngSpeed_rpm 20 0.0 12799.0 AXIS_PTS_REF InjCrv_phiMI1Max1EOM0_MAPX /end AXIS_DESCR
 /begin AXIS_DESCR COM_AXIS InjCtl_qSetUnBal FuelMass_mg_hub 20 -300.0 319.0 AXIS_PTS_REF InjCrv_phiMI1Max1EOM0_MAPY /end AXIS_DESCR
/end CHARACTERISTIC
/begin CHARACTERISTIC InjCrv_phiMI1Max2EOM0_MAP "Base value for MI1 start of energizing with PiI1" MAP 0x38C41A Lookup2D_WORD 0 Angle_CA -10.0 40.0
 /begin AXIS_DESCR COM_AXIS Epm_nEng EngSpeed_rpm 20 0.0 12799.0 AXIS_PTS_REF InjCrv_phiMI1Max2EOM0_MAPX /end AXIS_DESCR
 /begin AXIS_DESCR COM_AXIS InjCtl_qSetUnBal FuelMass_mg_hub 20 -300.0 319.0 AXIS_PTS_REF InjCrv_phiMI1Max2EOM0_MAPY /end AXIS_DESCR
/end CHARACTERISTIC
/begin CHARACTERISTIC InjCrv_phiMI1Bas1EOM0_MAP "Base value for MI1 start of energizing with no pilot injections" MAP 0x38B8FE Lookup2D_WORD 0 Angle_CA -10.0 40.0
 /begin AXIS_DESCR COM_AXIS Epm_nEng EngSpeed_rpm 16 0.0 12799.0 AXIS_PTS_REF InjCrv_phiMI1Bas1EOM0_MAPX /end AXIS_DESCR
 /begin AXIS_DESCR COM_AXIS InjCtl_qSetUnBal FuelMass_mg_hub 15 -300.0 319.0 AXIS_PTS_REF InjCrv_phiMI1Bas1EOM0_MAPY /end AXIS_DESCR
/end CHARACTERISTIC
/begin CHARACTERISTIC InjCrv_phiMI1Bas2EOM0_MAP "Base value for MI1 start of energizing with PiI1" MAP 0x38BB1C Lookup2D_WORD 0 Angle_CA -10.0 40.0
 /begin AXIS_DESCR COM_AXIS Epm_nEng EngSpeed_rpm 16 0.0 12799.0 AXIS_PTS_REF InjCrv_phiMI1Bas2EOM0_MAPX /end AXIS_DESCR
 /begin AXIS_DESCR COM_AXIS InjCtl_qSetUnBal FuelMass_mg_hub 15 -300.0 319.0 AXIS_PTS_REF InjCrv_phiMI1Bas2EOM0_MAPY /end AXIS_DESCR
/end CHARACTERISTIC
/begin CHARACTERISTIC InjCrv_phiMI1StrtBase_MAP "Base value for MI1 start of energizing when engine start" MAP 0x38C78C Lookup2D_WORD 0 Angle_CA -10.0 40.0
 /begin AXIS_DESCR COM_AXIS Epm_nEng EngSpeed_rpm 16 0.0 12799.0 AXIS_PTS_REF InjCrv_phiMI1StrtBase_MAPX /end AXIS_DESCR
 /begin AXIS_DESCR COM_AXIS InjCtl_qSetUnBal FuelMass_mg_hub 16 -300.0 319.0 AXIS_PTS_REF InjCrv_phiMI1StrtBase_MAPY /end AXIS_DESCR
/end CHARACTERISTIC
/begin CHARACTERISTIC InjCrv_qMI1MinPiIDiff_C "mininum value between MI1 and Pil quantity" VALUE 0x38F184 Scalar_SWORD 0 FuelMass_mg_hub -300.0 319.0 /end CHARACTERISTIC
/begin CHARACTERISTIC InjCrv_qMI1MinPoIDiff_C "mininum value between MI1 and PoI quantity" VALUE 0x38F186 Scalar_SWORD 0 FuelMass_mg_hub -300.0 319.0 /end CHARACTERISTIC
/begin CHARACTERISTIC InjCrv_qMI1Min_C "mininum value for MI1 quantity" VALUE 0x38F188 Scalar_SWORD 0 FuelMass_mg_hub -300.0 319.0 /end CHARACTERISTIC
/begin CHARACTERISTIC SigTst_qMI1_C "signal test Replacement value" VALUE 0x39804C Scalar_SWORD 0 FuelMass_mg_hub -300.0 319.0 /end CHARACTERISTIC
/begin CHARACTERISTIC InjCrv_phiMI1Min_C "mininum value for MI1 angle" VALUE 0x38C78A Scalar_SWORD 0 Angle_CA -10.0 40.0 /end CHARACTERISTIC
/begin CHARACTERISTIC SigTst_phiMI1_C "signal test Replacement value" VALUE 0x398046 Scalar_SWORD 0 Angle_CA -10.0 40.0 /end CHARACTERISTIC
/begin CHARACTERISTIC InjCrv_stInjCharSetVal_C "Injection characteristic setpoint (speed synchronous) switch" VALUE 0x391CAE Scalar_UBYTE 0 State_uint8 0.0 255.0 /end CHARACTERISTIC
/begin CHARACTERISTIC SigTst_swtMI1Phi_C "signal test switch" VALUE 0x39807F Scalar_UBYTE 0 Switch_conv 0 1 /end CHARACTERISTIC
/begin CHARACTERISTIC SigTst_swtMI1Q_C "signal test switch" VALUE 0x398080 Scalar_UBYTE 0 Switch_conv 0 1 /end CHARACTERISTIC
/begin AXIS_PTS InjCrv_phiMI1Max1EOM0_MAPY "Base value for MI1 start of energizing with no pilot injections Y axis" 0x38C3F2 InjCtl_qSetUnBal Lookup2D_X_WORD 0 FuelMass_mg_hub 20 -300.0 319.0 /end AXIS_PTS
/begin AXIS_PTS InjCrv_phiMI1Max1EOM0_MAPX "Base value for MI1 start of energizing with no pilot injections X axis" 0x38C3CA Epm_nEng Lookup2D_X_WORD 0 EngSpeed_rpm 20 0.0 12799.0 /end AXIS_PTS
/begin AXIS_PTS InjCrv_phiMI1Max2EOM0_MAPY "Base value for MI1 start of energizing with PiI1 Y axis" 0x38C762 InjCtl_qSetUnBal Lookup2D_X_WORD 0 FuelMass_mg_hub 20 -300.0 319.0 /end AXIS_PTS
/begin AXIS_PTS InjCrv_phiMI1Max2EOM0_MAPX "Base value for MI1 start of energizing with PiI1 X axis" 0x38C73A Epm_nEng Lookup2D_X_WORD 0 EngSpeed_rpm 20 0.0 12799.0 /end AXIS_PTS
/begin AXIS_PTS InjCrv_phiMI1Bas1EOM0_MAPY "Base value for MI1 start of energizing with no pilot injections Y axis" 0x38BAFE InjCtl_qSetUnBal Lookup2D_X_WORD 0 FuelMass_mg_hub 15 -300.0 319.0 /end AXIS_PTS
/begin AXIS_PTS InjCrv_phiMI1Bas1EOM0_MAPX "Base value for MI1 start of energizing with no pilot injections X axis" 0x38BADE Epm_nEng Lookup2D_X_WORD 0 EngSpeed_rpm 16 0.0 12799.0 /end AXIS_PTS
/begin AXIS_PTS InjCrv_phiMI1Bas2EOM0_MAPY "Base value for MI1 start of energizing with PiI1 Y axis" 0x38BD1C InjCtl_qSetUnBal Lookup2D_X_WORD 0 FuelMass_mg_hub 15 -300.0 319.0 /end AXIS_PTS
/begin AXIS_PTS InjCrv_phiMI1Bas2EOM0_MAPX "Base value for MI1 start of energizing with PiI1 X axis" 0x38BCFC Epm_nEng Lookup2D_X_WORD 0 EngSpeed_rpm 16 0.0 12799.0 /end AXIS_PTS
/begin AXIS_PTS InjCrv_phiMI1StrtBase_MAPY "Base value for MI1 start of energizing when engine start  Y axis" 0x38C9AC InjCtl_qSetUnBal Lookup2D_X_WORD 0 FuelMass_mg_hub 16 -300.0 319.0 /end AXIS_PTS
/begin AXIS_PTS InjCrv_phiMI1StrtBase_MAPX "Base value for MI1 start of energizing when engine start  X axis" 0x38C98C Epm_nEng Lookup2D_X_WORD 0 EngSpeed_rpm 16 0.0 12799.0 /end AXIS_PTS
/begin CHARACTERISTIC InjCrv_phiMI1APSCor1EOM_MAP "Map for correction of angle of MI1 due to atmospheric pressure  " MAP 0x38B21E Lookup2D_WORD 0 Angle_CA -10.0 40.0
 /begin AXIS_DESCR COM_AXIS Epm_nEng EngSpeed_rpm 20 0.0 12799.0 AXIS_PTS_REF InjCrv_phiMI1APSCor1EOM_MAPX /end AXIS_DESCR
 /begin AXIS_DESCR COM_AXIS InjCtl_qSetUnBal FuelMass_mg_hub 20 0.0 319.0 AXIS_PTS_REF InjCrv_phiMI1APSCor1EOM_MAPY /end AXIS_DESCR
/end CHARACTERISTIC
/begin CHARACTERISTIC InjCrv_phiMI1ATSCor1EOM_MAP "Map for correction of angle of MI1 due to air temperature" MAP 0x38B58E Lookup2D_WORD 0 Angle_CA -10.0 40.0
 /begin AXIS_DESCR COM_AXIS Epm_nEng EngSpeed_rpm 20 0.0 12799.0 AXIS_PTS_REF InjCrv_phiMI1ATSCor1EOM_MAPX /end AXIS_DESCR
 /begin AXIS_DESCR COM_AXIS InjCtl_qSetUnBal FuelMass_mg_hub 20 0.0 319.0 AXIS_PTS_REF InjCrv_phiMI1ATSCor1EOM_MAPY /end AXIS_DESCR
/end CHARACTERISTIC
/begin CHARACTERISTIC InjCrv_phiMI1ETSCor1EOM_MAP "Map for correction of angle of MI1 due to engine temperature" MAP 0x38BD3A Lookup2D_WORD 0 Angle_CA -10.0 40.0
 /begin AXIS_DESCR COM_AXIS Epm_nEng EngSpeed_rpm 20 0.0 12799.0 AXIS_PTS_REF InjCrv_phiMI1ETSCor1EOM_MAPX /end AXIS_DESCR
 /begin AXIS_DESCR COM_AXIS InjCtl_qSetUnBal FuelMass_mg_hub 20 0.0 319.0 AXIS_PTS_REF InjCrv_phiMI1ETSCor1EOM_MAPY /end AXIS_DESCR
/end CHARACTERISTIC
/begin CHARACTERISTIC InjCrv_facMI1APSSOECor_CUR "Start of energizing correction curve for MI1  based on atmospheric pressure " CURVE 0x38A8E4 Lookup1D_WORD 0 Factor -4.0 4.0
 /begin AXIS_DESCR COM_AXIS EnvP_p AirPressure_kPa 19 0.0 3276.0 AXIS_PTS_REF InjCrv_facMI1APSSOECor_CURX /end AXIS_DESCR
/end CHARACTERISTIC
/begin CHARACTERISTIC InjCrv_facMI1ATSSOECor_CUR "Start of energizing correction curve for MI1  based on intake air temperature" CURVE 0x38A930 Lookup1D_WORD 0 Factor -4.0 4.0
 /begin AXIS_DESCR COM_AXIS InjCrv_tAirMI1 Temp_deg 19 -50.0 150.0 AXIS_PTS_REF InjCrv_facMI1ATSSOECor_CURX /end AXIS_DESCR
/end CHARACTERISTIC
/begin CHARACTERISTIC InjCrv_facMI1ETSSOECor_CUR "Start of energizing correction curve for MI1  based on engine temperature" CURVE 0x38A97C Lookup1D_WORD 0 Factor -4.0 4.0
 /begin AXIS_DESCR COM_AXIS InjSys_tEng Temp_deg 19 -50.0 150.0 AXIS_PTS_REF InjCrv_facMI1ETSSOECor_CURX /end AXIS_DESCR
/end CHARACTERISTIC
/begin AXIS_PTS InjCrv_phiMI1APSCor1EOM_MAPY "Map for correction of angle of MI1 due to atmospheric pressure Y axis" 0x38B566 InjCtl_qSetUnBal Lookup2D_X_WORD 0 FuelMass_mg_hub 20 0.0 319.0 /end AXIS_PTS
/begin AXIS_PTS InjCrv_phiMI1APSCor1EOM_MAPX "Map for correction of angle of MI1 due to atmospheric pressure X axis" 0x38B53E Epm_nEng Lookup2D_X_WORD 0 EngSpeed_rpm 20 0.0 12799.0 /end AXIS_PTS
/begin AXIS_PTS InjCrv_phiMI1ATSCor1EOM_MAPY "Map for correction of angle of MI1 due to air temperature Y axis" 0x38B8D6 InjCtl_qSetUnBal Lookup2D_X_WORD 0 FuelMass_mg_hub 20 0.0 319.0 /end AXIS_PTS
/begin AXIS_PTS InjCrv_phiMI1ATSCor1EOM_MAPX "Map for correction of angle of MI1 due to air temperature X axis" 0x38B8AE Epm_nEng Lookup2D_X_WORD 0 EngSpeed_rpm 20 0.0 12799.0 /end AXIS_PTS
/begin AXIS_PTS InjCrv_phiMI1ETSCor1EOM_MAPY "Map for correction of angle of MI1 due to engine temperature Y axis" 0x38C082 InjCtl_qSetUnBal Lookup2D_X_WORD 0 FuelMass_mg_hub 20 0.0 319.0 /end AXIS_PTS
/begin AXIS_PTS InjCrv_phiMI1ETSCor1EOM_MAPX "Map for correction of angle of MI1 due to engine temperature X axis" 0x38C05A Epm_nEng Lookup2D_X_WORD 0 EngSpeed_rpm 20 0.0 12799.0 /end AXIS_PTS
/begin AXIS_PTS InjCrv_facMI1APSSOECor_CURX "Start of energizing correction curve for MI1  based on atmospheric pressure X axis" 0x38A90A EnvP_p Lookup1D_X_WORD 0 AirPressure_kPa 19 0.0 3276.0 /end AXIS_PTS
/begin AXIS_PTS InjCrv_facMI1ATSSOECor_CURX "Start of energizing correction curve for MI1  based on intake air temperature X axis" 0x38A956 InjCrv_tAirMI1 Lookup1D_X_WORD 0 Temp_deg 19 -50.0 150.0 /end AXIS_PTS
/begin AXIS_PTS InjCrv_facMI1ETSSOECor_CURX "Start of energizing correction curve for MI1  based on engine temperature X axis" 0x38A9A2 InjSys_tEng Lookup1D_X_WORD 0 Temp_deg 19 -50.0 150.0 /end AXIS_PTS
/begin CHARACTERISTIC InjCrv_qPiI1Max1_MAP "Maximum value map 1 for PiI1 injection quantity" MAP 0x38FBBA Lookup2D_WORD 0 FuelMass_mg_hub -319.0 319.0
 /begin AXIS_DESCR COM_AXIS Epm_nEng EngSpeed_rpm 16 0.0 6000.0 AXIS_PTS_REF InjCrv_qPiI1Max1_MAPX /end AXIS_DESCR
 /begin AXIS_DESCR COM_AXIS InjCtl_qSetUnBal FuelMass_mg_hub 16 -319.0 319.0 AXIS_PTS_REF InjCrv_qPiI1Max1_MAPY /end AXIS_DESCR
/end CHARACTERISTIC
/begin CHARACTERISTIC SigTst_qPiI1_C "test value of the PiI1 injection quantity" VALUE 0x39804E Scalar_SWORD 0 FuelMass_mg_hub -319.0 319.0 /end CHARACTERISTIC
/begin CHARACTERISTIC SigTst_tiPiI1_C "test value of PiI1 start of energizing (time component)" VALUE 0x3980AC Scalar_SWORD 0 InjTime_us -13107.0 13106.0 /end CHARACTERISTIC
/begin CHARACTERISTIC InjCrv_phiPiI1Max_C "Earliest absolute start of energizing of a PiI(phi)" VALUE 0x38D2CC Scalar_SWORD 0 Angle_CA -78.0 78.0 /end CHARACTERISTIC
/begin CHARACTERISTIC SigTst_phiPiI1_C "test value of PiI1 start of energizing (angular component)" VALUE 0x398048 Scalar_SWORD 0 Angle_CA -719.0 719.0 /end CHARACTERISTIC
/begin CHARACTERISTIC SigTst_swtPiI1Phi_C "Switch for the test value of the PiI1 start of energizing (time component)" VALUE 0x398089 Scalar_UBYTE 0 Switch_conv 0 1 /end CHARACTERISTIC
/begin CHARACTERISTIC SigTst_swtPiI1Q_C "Switch for the test value of the PiI1 injection quantity" VALUE 0x39808A Scalar_UBYTE 0 Switch_conv 0 1 /end CHARACTERISTIC
/begin CHARACTERISTIC SigTst_swtPiI1Ti_C "Switch for the test value of the PiI1 start of energizing (time component)" VALUE 0x39808B Scalar_UBYTE 0 Switch_conv 0 1 /end CHARACTERISTIC
/begin AXIS_PTS InjCrv_qPiI1Max1_MAPY "Maximum value map 1 for PiI2 injection quantity(breakpoint1)" 0x38FDDA InjCtl_qSetUnBal Lookup2D_X_WORD 0 FuelMass_mg_hub 16 -319.0 319.0 /end AXIS_PTS
/begin AXIS_PTS InjCrv_qPiI1Max1_MAPX "Maximum value map 1 for PiI1 injection quantity(breakpoint2)" 0x38FDBA Epm_nEng Lookup2D_X_WORD 0 EngSpeed_rpm 16 0.0 6000.0 /end AXIS_PTS
/begin CHARACTERISTIC InjCrv_qPiI1StrtBase_MAP "Base starting map for quantity of PiI1" MAP 0x38FDFA Lookup2D_WORD 0 FuelMass_mg_hub -319.0 319.0
 /begin AXIS_DESCR COM_AXIS Epm_nEng EngSpeed_rpm 16 0.0 6000.0 AXIS_PTS_REF InjCrv_qPiI1StrtBase_MAPX /end AXIS_DESCR
 /begin AXIS_DESCR COM_AXIS InjCtl_qSetUnBal FuelMass_mg_hub 16 -319.0 319.0 AXIS_PTS_REF InjCrv_qPiI1StrtBase_MAPY /end AXIS_DESCR
/end CHARACTERISTIC
/begin CHARACTERISTIC InjCrv_phiPiI1StrtBase_MAP "Map for base angular component of PiI1 during start" MAP 0x38D2CE Lookup2D_WORD 0 Angle_CA -719.0 719.0
 /begin AXIS_DESCR COM_AXIS Epm_nEng EngSpeed_rpm 16 0.0 6000.0 AXIS_PTS_REF InjCrv_phiPiI1StrtBase_MAPX /end AXIS_DESCR
 /begin AXIS_DESCR COM_AXIS InjCtl_qSetUnBal FuelMass_mg_hub 16 -319.0 319.0 AXIS_PTS_REF InjCrv_phiPiI1StrtBase_MAPY /end AXIS_DESCR
/end CHARACTERISTIC
/begin CHARACTERISTIC InjCrv_tiPiI1StrtBase_MAP "Map for base time component of PiI1 during start" MAP 0x3925BA Lookup2D_WORD 0 InjTime_us -13107.0 13106.0
 /begin AXIS_DESCR COM_AXIS Epm_nEng EngSpeed_rpm 16 0.0 6000.0 AXIS_PTS_REF InjCrv_tiPiI1StrtBase_MAPX /end AXIS_DESCR
 /begin AXIS_DESCR COM_AXIS InjCtl_qSetUnBal FuelMass_mg_hub 16 -319.0 319.0 AXIS_PTS_REF InjCrv_tiPiI1StrtBase_MAPY /end AXIS_DESCR
/end CHARACTERISTIC
/begin AXIS_PTS InjCrv_qPiI1StrtBase_MAPY "Base starting map for quantity of PiI1(breakpoint1)" 0x39001A InjCtl_qSetUnBal Lookup2D_X_WORD 0 FuelMass_mg_hub 16 -319.0 319.0 /end AXIS_PTS
/begin AXIS_PTS InjCrv_qPiI1StrtBase_MAPX "Base starting map for quantity of PiI1(breakpoint2)" 0x38FFFA Epm_nEng Lookup2D_X_WORD 0 EngSpeed_rpm 16 0.0 6000.0 /end AXIS_PTS
/begin AXIS_PTS InjCrv_phiPiI1StrtBase_MAPY "Map for base angular component of PiI1 during start(breakpoint1)" 0x38D4EE InjCtl_qSetUnBal Lookup2D_X_WORD 0 FuelMass_mg_hub 16 -319.0 319.0 /end AXIS_PTS
/begin AXIS_PTS InjCrv_phiPiI1StrtBase_MAPX "Map for base angular component of PiI1 during start(breakpoint2)" 0x38D4CE Epm_nEng Lookup2D_X_WORD 0 EngSpeed_rpm 16 0.0 6000.0 /end AXIS_PTS
/begin AXIS_PTS InjCrv_tiPiI1StrtBase_MAPY "Map for base time component of PiI1 during start(breakpoint1)" 0x3927DA InjCtl_qSetUnBal Lookup2D_X_WORD 0 FuelMass_mg_hub 16 -319.0 319.0 /end AXIS_PTS
/begin AXIS_PTS InjCrv_tiPiI1StrtBase_MAPX "Map for base time component of PiI1 during start(breakpoint2)" 0x3927BA Epm_nEng Lookup2D_X_WORD 0 EngSpeed_rpm 16 0.0 6000.0 /end AXIS_PTS
/begin CHARACTERISTIC InjCrv_qPiI1APSCor1EOM0_MAP "Map for correction based on ambient pressure" MAP 0x38F18A Lookup2D_WORD 0 FuelMass_mg_hub -319.0 319.0
 /begin AXIS_DESCR COM_AXIS Epm_nEng EngSpeed_rpm 16 0.0 6000.0 AXIS_PTS_REF InjCrv_qPiI1APSCor1EOM0_MAPX /end AXIS_DESCR
 /begin AXIS_DESCR COM_AXIS InjCtl_qSetUnBal FuelMass_mg_hub 16 -319.0 319.0 AXIS_PTS_REF InjCrv_qPiI1APSCor1EOM0_MAPY /end AXIS_DESCR
/end CHARACTERISTIC
/begin CHARACTERISTIC InjCrv_qPiI1ATSCor1EOM0_MAP "Map for correction based on air temperature" MAP 0x38F3CA Lookup2D_WORD 0 FuelMass_mg_hub -319.0 319.0
 /begin AXIS_DESCR COM_AXIS Epm_nEng EngSpeed_rpm 16 0.0 6000.0 AXIS_PTS_REF InjCrv_qPiI1ATSCor1EOM0_MAPX /end AXIS_DESCR
 /begin AXIS_DESCR COM_AXIS InjCtl_qSetUnBal FuelMass_mg_hub 16 -319.0 319.0 AXIS_PTS_REF InjCrv_qPiI1ATSCor1EOM0_MAPY /end AXIS_DESCR
/end CHARACTERISTIC
/begin CHARACTERISTIC InjCrv_qPiI1ETSCor1EOM0_MAP "Map for correction based on engine temperature" MAP 0x38F97A Lookup2D_WORD 0 FuelMass_mg_hub -319.0 319.0
 /begin AXIS_DESCR COM_AXIS Epm_nEng EngSpeed_rpm 16 0.0 6000.0 AXIS_PTS_REF InjCrv_qPiI1ETSCor1EOM0_MAPX /end AXIS_DESCR
 /begin AXIS_DESCR COM_AXIS InjCtl_qSetUnBal FuelMass_mg_hub 16 -319.0 319.0 AXIS_PTS_REF InjCrv_qPiI1ETSCor1EOM0_MAPY /end AXIS_DESCR
/end CHARACTERISTIC
/begin CHARACTERISTIC InjCrv_facPiI1APSQCor1EOM0_CUR "Start of fuel quantity correction curve for PiI1 in EOM0 based on air pressure" CURVE 0x38A9C8 Lookup1D_WORD 0 Factor -10.0 10.0
 /begin AXIS_DESCR COM_AXIS EnvP_p AirPressure_kPa 16 0.0 1200.0 AXIS_PTS_REF InjCrv_facPiI1APSQCor1EOM0_CURX /end AXIS_DESCR
/end CHARACTERISTIC
/begin CHARACTERISTIC InjCrv_facPiI1ATSQCor1EOM0_CUR "Start of fuel quantity correction curve for PiI1 in EOM0 based on air temperature" CURVE 0x38AA48 Lookup1D_WORD 0 Factor -10.0 10.0
 /begin AXIS_DESCR COM_AXIS InjCrv_tAir Temp_deg 16 -3000.0 3000.0 AXIS_PTS_REF InjCrv_facPiI1ATSQCor1EOM0_CURX /end AXIS_DESCR
/end CHARACTERISTIC
/begin CHARACTERISTIC InjCrv_facPiI1ETSQCor1EOM0_CUR "Start of fuel quantity correction curve for PiI1 in EOM0 based on engine temperature" CURVE 0x38AAC8 Lookup1D_WORD 0 Factor -10.0 10.0
 /begin AXIS_DESCR COM_AXIS InjSys_tEng Temp_deg 16 -3000.0 3000.0 AXIS_PTS_REF InjCrv_facPiI1ETSQCor1EOM0_CURX /end AXIS_DESCR
/end CHARACTERISTIC
/begin CHARACTERISTIC InjCrv_phiPiI1APSCor1EOM0_MAP "Map for angular component correction based on ambient pressure" MAP 0x38C9CC Lookup2D_WORD 0 Angle_CA -719.0 719.0
 /begin AXIS_DESCR COM_AXIS Epm_nEng EngSpeed_rpm 16 0.0 6000.0 AXIS_PTS_REF InjCrv_phiPiI1APSCor1EOM0_MAPX /end AXIS_DESCR
 /begin AXIS_DESCR COM_AXIS InjCtl_qSetUnBal FuelMass_mg_hub 16 -319.0 319.0 AXIS_PTS_REF InjCrv_phiPiI1APSCor1EOM0_MAPY /end AXIS_DESCR
/end CHARACTERISTIC
/begin CHARACTERISTIC InjCrv_phiPiI1ATSCor1EOM0_MAP "Map for angular component correction based on air temperature" MAP 0x38CC0C Lookup2D_WORD 0 Angle_CA -719.0 719.0
 /begin AXIS_DESCR COM_AXIS Epm_nEng EngSpeed_rpm 16 0.0 6000.0 AXIS_PTS_REF InjCrv_phiPiI1ATSCor1EOM0_MAPX /end AXIS_DESCR
 /begin AXIS_DESCR COM_AXIS InjCtl_qSetUnBal FuelMass_mg_hub 16 -319.0 319.0 AXIS_PTS_REF InjCrv_phiPiI1ATSCor1EOM0_MAPY /end AXIS_DESCR
/end CHARACTERISTIC
/begin CHARACTERISTIC InjCrv_phiPiI1ETSCor1EOM0_MAP "Map for angular component correction based on engine temperature" MAP 0x38D08C Lookup2D_WORD 0 Angle_CA -719.0 719.0
 /begin AXIS_DESCR COM_AXIS Epm_nEng EngSpeed_rpm 16 0.0 6000.0 AXIS_PTS_REF InjCrv_phiPiI1ETSCor1EOM0_MAPX /end AXIS_DESCR
 /begin AXIS_DESCR COM_AXIS InjCtl_qSetUnBal FuelMass_mg_hub 16 -319.0 319.0 AXIS_PTS_REF InjCrv_phiPiI1ETSCor1EOM0_MAPY /end AXIS_DESCR
/end CHARACTERISTIC
/begin CHARACTERISTIC InjCrv_tiPiI1APSCor1EOM0_MAP "Map for time component correction based on ambient pressure" MAP 0x391CBA Lookup2D_WORD 0 InjTime_us -13107.0 13106.0
 /begin AXIS_DESCR COM_AXIS Epm_nEng EngSpeed_rpm 16 0.0 6000.0 AXIS_PTS_REF InjCrv_tiPiI1APSCor1EOM0_MAPX /end AXIS_DESCR
 /begin AXIS_DESCR COM_AXIS InjCtl_qSetUnBal FuelMass_mg_hub 16 -319.0 319.0 AXIS_PTS_REF InjCrv_tiPiI1APSCor1EOM0_MAPY /end AXIS_DESCR
/end CHARACTERISTIC
/begin CHARACTERISTIC InjCrv_tiPiI1ATSCor1EOM0_MAP "Map for time component correction based on air temperature" MAP 0x391EFA Lookup2D_WORD 0 InjTime_us -13107.0 13106.0
 /begin AXIS_DESCR COM_AXIS Epm_nEng EngSpeed_rpm 16 0.0 6000.0 AXIS_PTS_REF InjCrv_tiPiI1ATSCor1EOM0_MAPX /end AXIS_DESCR
 /begin AXIS_DESCR COM_AXIS InjCtl_qSetUnBal FuelMass_mg_hub 16 -319.0 319.0 AXIS_PTS_REF InjCrv_tiPiI1ATSCor1EOM0_MAPY /end AXIS_DESCR
/end CHARACTERISTIC
/begin CHARACTERISTIC InjCrv_tiPiI1ETSCor1EOM0_MAP "Map for time component correction based on engine temperature" MAP 0x39237A Lookup2D_WORD 0 InjTime_us -13107.0 13106.0
 /begin AXIS_DESCR COM_AXIS Epm_nEng EngSpeed_rpm 16 0.0 6000.0 AXIS_PTS_REF InjCrv_tiPiI1ETSCor1EOM0_MAPX /end AXIS_DESCR
 /begin AXIS_DESCR COM_AXIS InjCtl_qSetUnBal FuelMass_mg_hub 16 -319.0 319.0 AXIS_PTS_REF InjCrv_tiPiI1ETSCor1EOM0_MAPY /end AXIS_DESCR
/end CHARACTERISTIC
/begin AXIS_PTS InjCrv_qPiI1APSCor1EOM0_MAPY "Map for correction based on ambient pressure(breakpoint1)" 0x38F3AA InjCtl_qSetUnBal Lookup2D_X_WORD 0 FuelMass_mg_hub 16 -319.0 319.0 /end AXIS_PTS
/begin AXIS_PTS InjCrv_qPiI1APSCor1EOM0_MAPX "Map for correction based on ambient pressure(breakpoint2)" 0x38F38A Epm_nEng Lookup2D_X_WORD 0 EngSpeed_rpm 16 0.0 6000.0 /end AXIS_PTS
/begin AXIS_PTS InjCrv_qPiI1ATSCor1EOM0_MAPY "Map for correction based on air temperature(breakpoint1)" 0x38F5EA InjCtl_qSetUnBal Lookup2D_X_WORD 0 FuelMass_mg_hub 16 -319.0 319.0 /end AXIS_PTS
/begin AXIS_PTS InjCrv_qPiI1ATSCor1EOM0_MAPX "Map for correction based on air temperature(breakpoint2)" 0x38F5CA Epm_nEng Lookup2D_X_WORD 0 EngSpeed_rpm 16 0.0 6000.0 /end AXIS_PTS
/begin AXIS_PTS InjCrv_qPiI1ETSCor1EOM0_MAPY "Map for correction based on engine temperature(breakpoint1)" 0x38FB9A InjCtl_qSetUnBal Lookup2D_X_WORD 0 FuelMass_mg_hub 16 -319.0 319.0 /end AXIS_PTS
/begin AXIS_PTS InjCrv_qPiI1ETSCor1EOM0_MAPX "Map for correction based on engine temperature(breakpoint2)" 0x38FB7A Epm_nEng Lookup2D_X_WORD 0 EngSpeed_rpm 16 0.0 6000.0 /end AXIS_PTS
/begin AXIS_PTS InjCrv_facPiI1APSQCor1EOM0_CURX "Start of fuel quantity correction curve axis for PiI1 in EOM0 based on air pressure" 0x38A9E8 EnvP_p Lookup1D_X_WORD 0 AirPressure_kPa 16 0.0 1200.0 /end AXIS_PTS
/begin AXIS_PTS InjCrv_facPiI1ATSQCor1EOM0_CURX "Start of fuel quantity correction curve axis for PiI1 in EOM0 based on air temperature" 0x38AA68 InjCrv_tAir Lookup1D_X_WORD 0 Temp_deg 16 -3000.0 3000.0 /end AXIS_PTS
/begin AXIS_PTS InjCrv_facPiI1ETSQCor1EOM0_CURX "Start of fuel quantity correction curve axis for PiI1 in EOM0 based on engine temperature" 0x38AAE8 InjSys_tEng Lookup1D_X_WORD 0 Temp_deg 16 -3000.0 3000.0 /end AXIS_PTS
/begin AXIS_PTS InjCrv_phiPiI1APSCor1EOM0_MAPY "Map for angular component correction based on ambient pressure(breakpoint1)" 0x38CBEC InjCtl_qSetUnBal Lookup2D_X_WORD 0 FuelMass_mg_hub 16 -319.0 319.0 /end AXIS_PTS
/begin AXIS_PTS InjCrv_phiPiI1APSCor1EOM0_MAPX "Map for angular component  correction based on ambient pressure(breakpoint2)" 0x38CBCC Epm_nEng Lookup2D_X_WORD 0 EngSpeed_rpm 16 0.0 6000.0 /end AXIS_PTS
/begin AXIS_PTS InjCrv_phiPiI1ATSCor1EOM0_MAPY "Map for angular component correction based on air temperature(breakpoint1)" 0x38CE2C InjCtl_qSetUnBal Lookup2D_X_WORD 0 FuelMass_mg_hub 16 -319.0 319.0 /end AXIS_PTS
/begin AXIS_PTS InjCrv_phiPiI1ATSCor1EOM0_MAPX "Map for angular component correction based on air temperature(breakpoint2)" 0x38CE0C Epm_nEng Lookup2D_X_WORD 0 EngSpeed_rpm 16 0.0 6000.0 /end AXIS_PTS
/begin AXIS_PTS InjCrv_phiPiI1ETSCor1EOM0_MAPY "Map for angular component correction based on engine temperature(breakpoint1)" 0x38D2AC InjCtl_qSetUnBal Lookup2D_X_WORD 0 FuelMass_mg_hub 16 -319.0 319.0 /end AXIS_PTS
/begin AXIS_PTS InjCrv_phiPiI1ETSCor1EOM0_MAPX "Map for angular component correction based on engine temperature(breakpoint2)" 0x38D28C Epm_nEng Lookup2D_X_WORD 0 EngSpeed_rpm 16 0.0 6000.0 /end AXIS_PTS
/begin AXIS_PTS InjCrv_tiPiI1APSCor1EOM0_MAPY "Map for time component correction based on ambient pressure(breakpoint1)" 0x391EDA InjCtl_qSetUnBal Lookup2D_X_WORD 0 FuelMass_mg_hub 16 -319.0 319.0 /end AXIS_PTS
/begin AXIS_PTS InjCrv_tiPiI1APSCor1EOM0_MAPX "Map for time component  correction based on ambient pressure(breakpoint2)" 0x391EBA Epm_nEng Lookup2D_X_WORD 0 EngSpeed_rpm 16 0.0 6000.0 /end AXIS_PTS
/begin AXIS_PTS InjCrv_tiPiI1ATSCor1EOM0_MAPY "Map for time component correction based on air temperature(breakpoint1)" 0x39211A InjCtl_qSetUnBal Lookup2D_X_WORD 0 FuelMass_mg_hub 16 -319.0 319.0 /end AXIS_PTS
/begin AXIS_PTS InjCrv_tiPiI1ATSCor1EOM0_MAPX "Map for time component correction based on air temperature(breakpoint2)" 0x3920FA Epm_nEng Lookup2D_X_WORD 0 EngSpeed_rpm 16 0.0 6000.0 /end AXIS_PTS
/begin AXIS_PTS InjCrv_tiPiI1ETSCor1EOM0_MAPY "Map for time component correction based on engine temperature(breakpoint1)" 0x39259A InjCtl_qSetUnBal Lookup2D_X_WORD 0 FuelMass_mg_hub 16 -319.0 319.0 /end AXIS_PTS
/begin AXIS_PTS InjCrv_tiPiI1ETSCor1EOM0_MAPX "Map for time component correction based on engine temperature(breakpoint2)" 0x39257A Epm_nEng Lookup2D_X_WORD 0 EngSpeed_rpm 16 0.0 6000.0 /end AXIS_PTS
/begin MEASUREMENT HLSDem_tiStrtCEngDsT_mp "Time after start based on coolant and oil temperatures ( ms )" ULONG EngTime_ms 0 0 0.0 4.294967295E+10 ECU_ADDRESS 0x40022DF8 /end MEASUREMENT
/begin MEASUREMENT HLSDem_tiStrtEngOil_mp "Time after start based on coolant and oil temperatures ( ms )" ULONG EngTime_ms 0 0 0.0 4.294967295E+10 ECU_ADDRESS 0x40022DFC /end MEASUREMENT
/begin MEASUREMENT HLSDem_tiStrt_mp "Time after start based on coolant and oil temperatures ( ms )" ULONG EngTime_ms 0 0 0.0 4.294967295E+10 ECU_ADDRESS 0x40022E00 /end MEASUREMENT
/begin MEASUREMENT HLSDem_tSetPLo_mp "Selected temperature value for calculation of the lower setpoint speed" SWORD Temp_deg 0 0 -200.0 200.0 ECU_ADDRESS 0x40022E08 /end MEASUREMENT
/begin MEASUREMENT HLSDem_tFrzSetPLo_mp "Frozen value of setpoint temperature when the engine state changes" SWORD Temp_deg 0 0 -200.0 200.0 ECU_ADDRESS 0x40022E0A /end MEASUREMENT
/begin MEASUREMENT HLSDem_nSelSetPLo_mp "Selected low idle speed setpoint based on MSS selection (rpm )" SWORD EngSpeed_rpm 0 0 0.0 6000.0 ECU_ADDRESS 0x40022E1A /end MEASUREMENT
/begin MEASUREMENT HLSDem_nSetPLoTemp "Lower low-idle speed during the starting phase (t > HLSDem_tiSetPLoWrm)" SWORD EngSpeed_rpm 0 0 0.0 6000.0 ECU_ADDRESS 0x40022E1C /end MEASUREMENT
/begin MEASUREMENT HLSDem_nSetPLoCo_mp "Coordinated lower engine setpoint" SWORD EngSpeed_rpm 0 0 0.0 6000.0 ECU_ADDRESS 0x40022E1E /end MEASUREMENT
/begin MEASUREMENT HLSDem_nSetPLoTrm "Adjustment value of lower setpoint speed" SWORD EngSpeed_rpm 0 0 0.0 6000.0 ECU_ADDRESS 0x40022E20 /end MEASUREMENT
/begin MEASUREMENT HLSDem_nSpdLowBattUAdd_mp "Idle setpoint add value based on the LowBattU" SWORD EngSpeed_rpm 0 0 0.0 500.0 ECU_ADDRESS 0x40022E22 /end MEASUREMENT
/begin MEASUREMENT HLSDem_nSetPLoRaw_mp "Low idle speed selection based on raw value ( rpm )" SWORD EngSpeed_rpm 0 0 0.0 6000.0 ECU_ADDRESS 0x40022E24 /end MEASUREMENT
/begin MEASUREMENT HLSDem_stSetPLoFlt_mp "Type of filtering of the lower engine speed setpoint" UBYTE State_uint8 0 0 0.0 255.0 ECU_ADDRESS 0x40022E2E /end MEASUREMENT
/begin MEASUREMENT HLSDem_stStrt_mp "Status of time delay after start" UBYTE boolean 0 0 0.0 1.0 ECU_ADDRESS 0x40022E2F /end MEASUREMENT
/begin MEASUREMENT HLSDem_stNoRmp "Switch to force no ramp in maximum engine setpoint calculation" UBYTE boolean 0 0 0.0 1.0 ECU_ADDRESS 0x40022E30 /end MEASUREMENT
/begin MEASUREMENT HLSDem_stStrtTemp_mp "Status of setpoint temperature based on low-idle speed increase" UBYTE boolean 0 0 0.0 1.0 ECU_ADDRESS 0x40022E31 /end MEASUREMENT
/begin MEASUREMENT CnvSet_qSetOptNxt_mp "Setpoint injection quantity without corrections next operation mode" SWORD FuelMass_mg_hub 0 0 -319.0 319.0 ECU_ADDRESS 0x400221B6 /end MEASUREMENT
/begin MEASUREMENT CnvSet_qSetOpt_mp "Setpoint injection quantity without corrections" SWORD FuelMass_mg_hub 0 0 -319.0 319.0 ECU_ADDRESS 0x400221B8 /end MEASUREMENT
/begin MEASUREMENT ActMod_trqCurr_mp "current, back-calculated inner torque without starting torque" SWORD Trq_Nm 0 0 -3276.8 3276.7 ECU_ADDRESS 0x40021EB6 /end MEASUREMENT
/begin MEASUREMENT RngMod_trqFrcT_mp "Temperature-dependent friction torque [Nm]" SWORD Trq_Nm 0 0 -3276.8 3276.7 ECU_ADDRESS 0x4002324C /end MEASUREMENT
/begin MEASUREMENT RngMod_tTrqFrc_mp "Input temperature in the map for determining the current friction torque" SWORD Temp_deg 0 0 -3000.0 3000.0 ECU_ADDRESS 0x4002324E /end MEASUREMENT
/begin MEASUREMENT EngDa_tiEngOnEEP "" SLONG int32 0 0 -2147483648 2147483647 ECU_ADDRESS 0x4002FBD8 /end MEASUREMENT
/begin MEASUREMENT ASMod_facEGRCor_mp "correction factor when EGR Valve is closed" SWORD Fact8192 0 0 -4.0 3.9999 ECU_ADDRESS 0x400220F4 /end MEASUREMENT
/begin MEASUREMENT ASMod_facVolEffBas_mp "Basic value for the volumetric efficiency of the engine" SWORD Fact8192 0 0 -4.0 3.9999 ECU_ADDRESS 0x400220F6 /end MEASUREMENT
/begin MEASUREMENT ASMod_facVolEffTempCor_mp "Correction factor for the volumetric efficiency based on the gas temperature downstream of the intake manifold" SWORD Fact8192 0 0 -4.0 3.9999 ECU_ADDRESS 0x400220F8 /end MEASUREMENT
/begin MEASUREMENT AirCtl_tAirCtlVal_mp "Intake air temperature for air system control" SWORD Temp_deg 0 0 -200.0 200.0 ECU_ADDRESS 0x40021F46 /end MEASUREMENT
/begin MEASUREMENT AirCtl_tEngCtlVal_mp "Engine temperature for air system control" SWORD Temp_deg 0 0 -200.0 200.0 ECU_ADDRESS 0x40021F48 /end MEASUREMENT
/begin MEASUREMENT AirCtl_rCtlValBasEOM0_mp "Basic EGR Control value in EOM0 (normal mode)" SWORD Prc_100_rate 0 0 -100.0 100.0 ECU_ADDRESS 0x40021F4A /end MEASUREMENT
/begin MEASUREMENT AirCtl_rCtlCorBasEOM0_mp "Engine operating point correction value in EOM0 (normal mode)" SWORD Prc_100_rate 0 0 -100.0 100.0 ECU_ADDRESS 0x40021F4C /end MEASUREMENT
/begin MEASUREMENT AirCtl_rCtlEngTempCorEOM0_mp "Engine temperature correction in EOM0 (normal mode)." SWORD Prc_100_rate 0 0 -100.0 100.0 ECU_ADDRESS 0x40021F4E /end MEASUREMENT
/begin MEASUREMENT AirCtl_rCtlValEngTempCorEOM0_mp "Engine temperature correction value in EOM0 (normal mode)." SWORD Prc_100_rate 0 0 -100.0 100.0 ECU_ADDRESS 0x40021F50 /end MEASUREMENT
/begin MEASUREMENT AirCtl_rCtlValCor1EOM0_mp "Correction value 1 applied for control value calculation in EOM0 (normal mode)" SWORD Prc_100_rate 0 0 -100.0 100.0 ECU_ADDRESS 0x40021F52 /end MEASUREMENT
/begin MEASUREMENT AirCtl_rCtlAirTempCorEOM0_mp "Air temperature correction in EOM0 (normal mode)" SWORD Prc_100_rate 0 0 -100.0 100.0 ECU_ADDRESS 0x40021F54 /end MEASUREMENT
/begin MEASUREMENT AirCtl_rCtlValAirTempCorEOM0_mp "Air temperature correction value in EOM0 (normal mode)." SWORD Prc_100_rate 0 0 -100.0 100.0 ECU_ADDRESS 0x40021F56 /end MEASUREMENT
/begin MEASUREMENT AirCtl_rCtlValCor2EOM0_mp "Correction value 2 applied for control value calculation in EOM0 (normal mode)" SWORD Prc_100_rate 0 0 -100.0 100.0 ECU_ADDRESS 0x40021F58 /end MEASUREMENT
/begin MEASUREMENT AirCtl_rCtlEnvPresCorEOM0_mp "Environment pressure based correction in EOM0 (normal mode)" SWORD Prc_100_rate 0 0 -100.0 100.0 ECU_ADDRESS 0x40021F5A /end MEASUREMENT
/begin MEASUREMENT AirCtl_rCtlValCor3EOM0_mp "Correction value 3 applied for control value calculation in EOM0 (normal mode)" SWORD Prc_100_rate 0 0 -100.0 100.0 ECU_ADDRESS 0x40021F5C /end MEASUREMENT
/begin MEASUREMENT AirCtl_rCtlValEOM0_mp "Substitute value for setpoint during regeneration" SWORD Prc_100_rate 0 0 -100.0 100.0 ECU_ADDRESS 0x40021F5E /end MEASUREMENT
/begin MEASUREMENT AirCtl_rWrmUpCtlVal_mp "Open loop EGR control during engine warm-up condition." SWORD Prc_100_rate 0 0 -100.0 100.0 ECU_ADDRESS 0x40021F60 /end MEASUREMENT
/begin MEASUREMENT AirCtl_rEnvPresCtlVal_mp "Environmental pressure based control value" SWORD Prc_100_rate 0 0 -100.0 100.0 ECU_ADDRESS 0x40021F62 /end MEASUREMENT
/begin MEASUREMENT AirCtl_rEngTempSmkDynCorVal_mp "Coolant temperature based correction for control value, for smoke limitation based on engine dynamic conditions." SWORD Prc_100_rate 0 0 -100.0 100.0 ECU_ADDRESS 0x40021F64 /end MEASUREMENT
/begin MEASUREMENT AirCtl_rSmkDyn_mp "Control value for smoke limitation during engine dynamic conditions." SWORD Prc_100_rate 0 0 -100.0 100.0 ECU_ADDRESS 0x40021F66 /end MEASUREMENT
/begin MEASUREMENT AirCtl_rEngTempSmkStatCorVal_mp "Coolant temperature based correction for control value, for smoke limitation based on engine Static conditions." SWORD Prc_100_rate 0 0 -100.0 100.0 ECU_ADDRESS 0x40021F68 /end MEASUREMENT
/begin MEASUREMENT AirCtl_rSmkStat_mp "Control value for smoke limitation during engine static conditions." SWORD Prc_100_rate 0 0 -100.0 100.0 ECU_ADDRESS 0x40021F6A /end MEASUREMENT
/begin MEASUREMENT AirCtl_rSmkCtlVal_mp "EGR Control value in case of smoke limitation" SWORD Prc_100_rate 0 0 -100.0 100.0 ECU_ADDRESS 0x40021F6C /end MEASUREMENT
/begin MEASUREMENT AirCtl_rNrmCtlVal_mp "Open loop EGR control with out smoke limitation." SWORD Prc_100_rate 0 0 -100.0 100.0 ECU_ADDRESS 0x40021F6E /end MEASUREMENT
/begin MEASUREMENT AirCtl_rCtlValLast_mp "Last control value" SWORD Prc_100_rate 0 0 -100.0 100.0 ECU_ADDRESS 0x40021F70 /end MEASUREMENT
/begin MEASUREMENT AirCtl_rRmpCtlVal_mp "Ramped open loop EGR control value after smoke limitation" SWORD Prc_100_rate 0 0 -100.0 100.0 ECU_ADDRESS 0x40021F72 /end MEASUREMENT
/begin MEASUREMENT AirCtl_facCtlEngTempCorEOM0_mp "Engine temperature correction factor in EOM0 (normal mode)." SWORD Factor 0 0 -30.0 30.0 ECU_ADDRESS 0x40021F74 /end MEASUREMENT
/begin MEASUREMENT AirCtl_facCtlAirTempCorEOM0_mp "Air temperature correction factor in EOM0 (normal mode)." SWORD Factor 0 0 -30.0 30.0 ECU_ADDRESS 0x40021F76 /end MEASUREMENT
/begin MEASUREMENT AirCtl_drCtlValInc_mp "Ramp up slope for open loop EGR control value" SWORD DutyCycle_rate_s 0 0 -200.0 200.0 ECU_ADDRESS 0x40021F78 /end MEASUREMENT
/begin MEASUREMENT AirCtl_drCtlValDec_mp "Ramp down slope for open loop EGR control value" SWORD DutyCycle_rate_s 0 0 -200.0 200.0 ECU_ADDRESS 0x40021F7A /end MEASUREMENT
/begin MEASUREMENT AirCtl_bSmkStatLim "Status of regeneration demand" UBYTE boolean 0 0 0.0 1.0 ECU_ADDRESS 0x40021F7C /end MEASUREMENT
/begin MEASUREMENT AirCtl_bSmkDynLim "Status of regeneration demand" UBYTE boolean 0 0 0.0 1.0 ECU_ADDRESS 0x40021F7D /end MEASUREMENT
/begin MEASUREMENT AirCtl_mDesBasHiAltdEOM0_mp "Base air mass setpoint value in normal mode at high altitude" SWORD AirMass_mg_hub 0 0 -15000.0 15000.0 ECU_ADDRESS 0x40021F82 /end MEASUREMENT
/begin MEASUREMENT AirCtl_mDesVal1EOM0_mp "Base air mass setpoint value after Atmospheric-pressure correction" SWORD AirMass_mg_hub 0 0 -15000.0 15000.0 ECU_ADDRESS 0x40021F84 /end MEASUREMENT
/begin MEASUREMENT AirCtl_mAirTempCorBasEOM0_mp "Base air mass setpoint value of the air temperature correction" SWORD AirMass_mg_hub 0 0 -15000.0 15000.0 ECU_ADDRESS 0x40021F86 /end MEASUREMENT
/begin MEASUREMENT AirCtl_mAirTempCorEOM0_mp "Base air mass setpoint value of the air temperature correction" SWORD AirMass_mg_hub 0 0 -15000.0 15000.0 ECU_ADDRESS 0x40021F88 /end MEASUREMENT
/begin MEASUREMENT AirCtl_mDesVal3EOM0_mp "Base air mass setpoint value after Atmospheric-pressure and air temperature correction" SWORD AirMass_mg_hub 0 0 -15000.0 15000.0 ECU_ADDRESS 0x40021F8A /end MEASUREMENT
/begin MEASUREMENT AirCtl_mEngTempCorBasEOM0_mp "Base air mass setpoint value of the engine temperature correction" SWORD AirMass_mg_hub 0 0 -15000.0 15000.0 ECU_ADDRESS 0x40021F8C /end MEASUREMENT
/begin MEASUREMENT AirCtl_mEngTempCorEOM0_mp "Base air mass setpoint value after the engine temperature correction" SWORD AirMass_mg_hub 0 0 -15000.0 15000.0 ECU_ADDRESS 0x40021F8E /end MEASUREMENT
/begin MEASUREMENT AirCtl_mDesVal4EOM0_mp "Base air mass setpoint value after Atmospheric-pressure and air temperature and engine temperature correction" SWORD AirMass_mg_hub 0 0 -15000.0 15000.0 ECU_ADDRESS 0x40021F90 /end MEASUREMENT
/begin MEASUREMENT AirCtl_mDesValEOM0_mp "Air mass setpoint value in normal operation" SWORD AirMass_mg_hub 0 0 -15000.0 15000.0 ECU_ADDRESS 0x40021F92 /end MEASUREMENT
/begin MEASUREMENT AirCtl_pBstPresRef_mp "Reference boost pressure" SWORD AirPressure_kPa 0 0 -3000.0 3000.0 ECU_ADDRESS 0x40021F94 /end MEASUREMENT
/begin MEASUREMENT AirCtl_tAirDesVal_mp "Intake air temperature for air system control" SWORD Temp_deg 0 0 -200.0 200.0 ECU_ADDRESS 0x40021F96 /end MEASUREMENT
/begin MEASUREMENT AirCtl_tEngDesVal_mp "Engine temperature for air system control" SWORD Temp_deg 0 0 -1000.0 1000.0 ECU_ADDRESS 0x40021F98 /end MEASUREMENT
/begin MEASUREMENT AirCtl_facEnvPresCorEOM0_mp "Atmospheric-pressure-dependent correction factor" SWORD Factor 0 0 -30.0 30.0 ECU_ADDRESS 0x40021F9A /end MEASUREMENT
/begin MEASUREMENT AirCtl_facAirTempCorEOM0_mp "Correction factor for the base value of the air temperature correction" SWORD Factor 0 0 -30.0 30.0 ECU_ADDRESS 0x40021F9C /end MEASUREMENT
/begin MEASUREMENT AirCtl_facEngTempCorEOM0_mp "Correction factor for the base value of the engine temperature correction" SWORD Factor 0 0 -30.0 30.0 ECU_ADDRESS 0x40021F9E /end MEASUREMENT
/begin MEASUREMENT AirCtl_facBstPresCor_mp "On boost pressure referenced airmass setpoint weighting factor" SWORD Factor 0 0 -30.0 30.0 ECU_ADDRESS 0x40021FA0 /end MEASUREMENT
/begin MEASUREMENT AirCtl_T1Nrm_mp "Current parameter T1 for AirCtl in normal mode" UWORD RailDT1_ms 0 0 0.0 65535.0 ECU_ADDRESS 0x40021FA2 /end MEASUREMENT
/begin MEASUREMENT AirCtl_T1Val_mp "Current parameter Kd for AirCtl for the AirCtl governor" UWORD RailDT1_ms 0 0 0.0 65535.0 ECU_ADDRESS 0x40021FA4 /end MEASUREMENT
/begin MEASUREMENT AirCtl_mActVal_mp "Actual air mass value for the exhaust-gas recirculation control" SWORD AirMass_mg_hub 0 0 -15000.0 15000.0 ECU_ADDRESS 0x40021FA6 /end MEASUREMENT
/begin MEASUREMENT AirCtl_KpWinPosVal_mp "P component Positive window for the AirCtl governor" SWORD AirMass_mg_hub 0 0 -15000.0 15000.0 ECU_ADDRESS 0x40021FA8 /end MEASUREMENT
/begin MEASUREMENT AirCtl_KpWinNegVal_mp "P component negative window for the AirCtl governor" SWORD AirMass_mg_hub 0 0 -15000.0 15000.0 ECU_ADDRESS 0x40021FAA /end MEASUREMENT
/begin MEASUREMENT AirCtl_KiWinPosVal_mp "I component Positive window  for the AirCtl governor" SWORD AirMass_mg_hub 0 0 -15000.0 15000.0 ECU_ADDRESS 0x40021FAC /end MEASUREMENT
/begin MEASUREMENT AirCtl_KiWinNegVal_mp "I component negative window  for the AirCtl governor" SWORD AirMass_mg_hub 0 0 -15000.0 15000.0 ECU_ADDRESS 0x40021FAE /end MEASUREMENT
/begin MEASUREMENT AirCtl_rOutP_mp "output of P-governor of EGR " SWORD Prc_100_rate 0 0 -100.0 100.0 ECU_ADDRESS 0x40021FB0 /end MEASUREMENT
/begin MEASUREMENT AirCtl_rOutI_mp "Controller I-channel output at EGR" SWORD Prc_100_rate 0 0 -100.0 100.0 ECU_ADDRESS 0x40021FB2 /end MEASUREMENT
/begin MEASUREMENT AirCtl_rTransUnCor_mp "Uncorrected factor for dynamic correction precontrol value for AirCtl governor" SWORD Prc_100_rate 0 0 -100.0 100.0 ECU_ADDRESS 0x40021FB4 /end MEASUREMENT
/begin MEASUREMENT AirCtl_rTransCor_mp "Corrected factor for AirCtl govenor" SWORD Prc_100_rate 0 0 -100.0 100.0 ECU_ADDRESS 0x40021FB6 /end MEASUREMENT
/begin MEASUREMENT AirCtl_rTransCorVal_mp "Correction value for AirCtl governor" SWORD Prc_100_rate 0 0 -100.0 100.0 ECU_ADDRESS 0x40021FB8 /end MEASUREMENT
/begin MEASUREMENT AirCtl_rPIDCtl_mp "Unlimited corrected correcting variable of the exhaust-gas recirculation control" SWORD Prc_100_rate 0 0 -100.0 100.0 ECU_ADDRESS 0x40021FBA /end MEASUREMENT
/begin MEASUREMENT AirCtl_rGovOut_mp "Limited correcting variable of the exhaust-gas recirculation control" SWORD Prc_100_rate 0 0 -100.0 100.0 ECU_ADDRESS 0x40021FBC /end MEASUREMENT
/begin MEASUREMENT AirCtl_rOutD_mp "Dynamic control signal - output DT1-element for EGR" SWORD Prc_100_rate 0 0 -100.0 100.0 ECU_ADDRESS 0x40021FBE /end MEASUREMENT
/begin MEASUREMENT AirCtl_tAirGov_mp "Selected air temperature for the exhaust-gas recirculation control" SWORD Temp_deg 0 0 -1000.0 1000.0 ECU_ADDRESS 0x40021FC0 /end MEASUREMENT
/begin MEASUREMENT AirCtl_facParBas_mp "Base factor of the parameter adaptation" SWORD Fact1 0 0 -200.0 200.0 ECU_ADDRESS 0x40021FC2 /end MEASUREMENT
/begin MEASUREMENT AirCtl_facParAirTemp_mp "Air-temperature-dependent correction factor for the parameter adaptation" SWORD Fact1 0 0 -200.0 200.0 ECU_ADDRESS 0x40021FC4 /end MEASUREMENT
/begin MEASUREMENT AirCtl_facParNrm_mp "Parameter adaptation factor in normal operation" SWORD Fact1 0 0 -200.0 200.0 ECU_ADDRESS 0x40021FC6 /end MEASUREMENT
/begin MEASUREMENT AirCtl_KdNrm_mp "Current parameter Kd for AirCtl in normal mode" UWORD Pid_Kp_Kd 0 0 0.0 15.0 ECU_ADDRESS 0x40021FC8 /end MEASUREMENT
/begin MEASUREMENT AirCtl_KdVal_mp "Current parameter T1 for AirCtl for the AirCtl governor" UWORD Pid_Kp_Kd 0 0 0.0 15.0 ECU_ADDRESS 0x40021FCA /end MEASUREMENT
/begin MEASUREMENT AirCtl_KpNrm_mp "P-Gain within the window in normal mode" SWORD VlvCtl_Kp 0 0 -64.0 63.0 ECU_ADDRESS 0x40021FCC /end MEASUREMENT
/begin MEASUREMENT AirCtl_KpVal_mp "P-Gain within the window for the AirCtl governor" SWORD VlvCtl_Kp 0 0 -64.0 63.0 ECU_ADDRESS 0x40021FCE /end MEASUREMENT
/begin MEASUREMENT AirCtl_KpPosNrm_mp "P-gain above upper window border in normal mode" SWORD VlvCtl_Kp 0 0 -64.0 63.0 ECU_ADDRESS 0x40021FD0 /end MEASUREMENT
/begin MEASUREMENT AirCtl_KpPosVal_mp "P-gain above upper window border for the AirCtl governor" SWORD VlvCtl_Kp 0 0 -64.0 63.0 ECU_ADDRESS 0x40021FD2 /end MEASUREMENT
/begin MEASUREMENT AirCtl_KpNegNrm_mp "P-gain below lower window border in normal mode" SWORD VlvCtl_Kp 0 0 -64.0 63.0 ECU_ADDRESS 0x40021FD4 /end MEASUREMENT
/begin MEASUREMENT AirCtl_KpNegVal_mp "P-gain below lower window border for the AirCtl governor" SWORD VlvCtl_Kp 0 0 -64.0 63.0 ECU_ADDRESS 0x40021FD6 /end MEASUREMENT
/begin MEASUREMENT AirCtl_KiNrm_mp "I-Gain within the window in normal mode" SWORD VlvCtl_Ki 0 0 -32.0 31.0 ECU_ADDRESS 0x40021FD8 /end MEASUREMENT
/begin MEASUREMENT AirCtl_KiVal_mp "I-Gain within the window for the AirCtl governor" SWORD VlvCtl_Ki 0 0 -32.0 31.0 ECU_ADDRESS 0x40021FDA /end MEASUREMENT
/begin MEASUREMENT AirCtl_KiPosNrm_mp "I-gain above upper window border in normal mode" SWORD VlvCtl_Ki 0 0 -32.0 31.0 ECU_ADDRESS 0x40021FDC /end MEASUREMENT
/begin MEASUREMENT AirCtl_KiPosVal_mp "I-gain above upper window border for the AirCtl governor" SWORD VlvCtl_Ki 0 0 -32.0 31.0 ECU_ADDRESS 0x40021FDE /end MEASUREMENT
/begin MEASUREMENT AirCtl_KiPNegNrm_mp "I-gain below lower window border in normal mode" SWORD VlvCtl_Ki 0 0 -32.0 31.0 ECU_ADDRESS 0x40021FE0 /end MEASUREMENT
/begin MEASUREMENT AirCtl_KiNegVal_mp "I-gain below lower window border for the AirCtl governor" SWORD VlvCtl_Ki 0 0 -32.0 31.0 ECU_ADDRESS 0x40021FE2 /end MEASUREMENT
/begin MEASUREMENT AirCtl_stFrzI_mp "Status information of freeze I part" UBYTE boolean 0 0 0.0 1.0 ECU_ADDRESS 0x40021FE4 /end MEASUREMENT
/begin MEASUREMENT AirCtl_swtGovEna "Switch for the air-mass control" UBYTE boolean 0 0 0.0 1.0 ECU_ADDRESS 0x40021FE5 /end MEASUREMENT
/begin MEASUREMENT AirCtl_tiCldStrt_mp "Period during which regulation ramains switched off after starting cut-out ms" ULONG EngTime_ms 0 0 0.0 655350.0 ECU_ADDRESS 0x40021FEC /end MEASUREMENT
/begin MEASUREMENT AirCtl_mMaxDvt "Upper limit for the detection of a permanent control deviation" SWORD AirMass_mg_hub 0 0 -15000.0 15000.0 ECU_ADDRESS 0x40021FF0 /end MEASUREMENT
/begin MEASUREMENT AirCtl_mMinDvt "Lower limit for the detection of a permanent control deviation" SWORD AirMass_mg_hub 0 0 -15000.0 15000.0 ECU_ADDRESS 0x40021FF2 /end MEASUREMENT
/begin MEASUREMENT AirCtl_mDesMax_mp "Calculated air mass flow for closed EGR" SWORD AirMass_mg_hub 0 0 -15000.0 15000.0 ECU_ADDRESS 0x40021FF4 /end MEASUREMENT
/begin MEASUREMENT AirCtl_qInrLimSmk "Smoke limitation inner quantity" SWORD FuelMass_mg_hub 0 0 -300.0 300.0 ECU_ADDRESS 0x40021FF6 /end MEASUREMENT
/begin MEASUREMENT AirCtl_qDiff_mp "Deviation of smoke limitation quantity and setpoint quantity" SWORD FuelMass_mg_hub 0 0 -300.0 300.0 ECU_ADDRESS 0x40021FF8 /end MEASUREMENT
/begin MEASUREMENT AirCtl_qSmkHys_mp "Basic quantity for adjusting the (hysterisis) band width between current and smoke limitation quantity, to trigger (static) EGR shut-off." SWORD FuelMass_mg_hub 0 0 -300.0 300.0 ECU_ADDRESS 0x40021FFA /end MEASUREMENT
/begin MEASUREMENT AirCtl_qEngTempSmkHysCor_mp "Cololant temperature based correction quantity for adjusting (hysterisis) band width between current and smoke limitation quantity, to trigger (static) EGR shut-off" SWORD FuelMass_mg_hub 0 0 -300.0 300.0 ECU_ADDRESS 0x40021FFC /end MEASUREMENT
/begin MEASUREMENT AirCtl_qEngTempSmkHysCorVal_mp "Cololant temperature based correction Value for adjusting (hysterisis) band width between current and smoke limitation quantity, to trigger (static) EGR shut-off" SWORD FuelMass_mg_hub 0 0 -300.0 300.0 ECU_ADDRESS 0x40021FFE /end MEASUREMENT
/begin MEASUREMENT AirCtl_qEnvPresSmkHysCor_mp "Environment pressure based correction quantity for adjusting (hysterisis) band width between current and smoke limitation quantity, to trigger (static) EGR shut-off" SWORD FuelMass_mg_hub 0 0 -300.0 300.0 ECU_ADDRESS 0x40022000 /end MEASUREMENT
/begin MEASUREMENT AirCtl_qEnvPresSmkHysCorVal_mp "Environment pressure based correction quantity for adjusting (hysterisis) band width between current and smoke limitation quantity, to trigger(static) EGR shut-off" SWORD FuelMass_mg_hub 0 0 -300.0 300.0 ECU_ADDRESS 0x40022002 /end MEASUREMENT
/begin MEASUREMENT AirCtl_qSmkHysCorVal_mp "Correction quantity for adjusting the (hysterisis) band width between current and smoke limitation quantity, to trigger (static) EGR shut-off" SWORD FuelMass_mg_hub 0 0 -300.0 300.0 ECU_ADDRESS 0x40022004 /end MEASUREMENT
/begin MEASUREMENT AirCtl_qSmkHysVal_mp "Quantity value for adjusting the (hysterisis) band width between current and smoke limitation quantity, to trigger (static) EGR shut-off" SWORD FuelMass_mg_hub 0 0 -300.0 300.0 ECU_ADDRESS 0x40022006 /end MEASUREMENT
/begin MEASUREMENT AirCtl_qSmkDiff_mp "Difference between the output of the smoke map and AirCtl_qDiff_mp" SWORD FuelMass_mg_hub 0 0 -300.0 300.0 ECU_ADDRESS 0x40022008 /end MEASUREMENT
/begin MEASUREMENT AirCtl_facEngTempSmkHysCor_mp "Cololant temperature based correction factor for adjusting (hysterisis) band width between current and smoke limitation quantity, to trigger (static) EGR shut-off" SWORD Fact1 0 0 -200.0 200.0 ECU_ADDRESS 0x4002200A /end MEASUREMENT
/begin MEASUREMENT AirCtl_facEnvPresSmkHysCor_mp "Environment pressure based correction factor for adjusting (hysterisis) band width between current and smoke limitation quantity, to trigger (static) EGR shut-off" SWORD Fact1 0 0 -200.0 200.0 ECU_ADDRESS 0x4002200C /end MEASUREMENT
/begin MEASUREMENT AirCtl_tEngMon_mp "Selected temperature from the temperature field of the induction system for the monitoring" SWORD Temp_deg 0 0 -1000.0 1000.0 ECU_ADDRESS 0x4002200E /end MEASUREMENT
/begin MEASUREMENT AirCtl_tAirMon_mp "Selected temperature from the engine temperature field for the monitoring" SWORD Temp_deg 0 0 -1000.0 1000.0 ECU_ADDRESS 0x40022010 /end MEASUREMENT
/begin MEASUREMENT AirCtl_stStatSwtSmk_mp "Status of static shut off request" UBYTE boolean 0 0 0.0 1.0 ECU_ADDRESS 0x40022012 /end MEASUREMENT
/begin MEASUREMENT AirCtl_stDynSwtSmk_mp "Status of dynamic shut off request" UBYTE boolean 0 0 0.0 1.0 ECU_ADDRESS 0x40022013 /end MEASUREMENT
/begin MEASUREMENT AirCtl_stMaxDvt_mp "Status indicating whether the upper limit for the detection of a permanent control deviation has been exceeded" UBYTE boolean 0 0 0.0 1.0 ECU_ADDRESS 0x40022014 /end MEASUREMENT
/begin MEASUREMENT AirCtl_stMinDvt_mp "Status indicating whether the lower limit for the detection of a permanent control deviation has been fallen short of" UBYTE boolean 0 0 0.0 1.0 ECU_ADDRESS 0x40022015 /end MEASUREMENT
/begin MEASUREMENT AirCtl_stDesChk_mp "Status of checking the air mass set point value" UBYTE boolean 0 0 0.0 1.0 ECU_ADDRESS 0x40022016 /end MEASUREMENT
/begin MEASUREMENT AirCtl_stGovDvtMonEna_mp "State of governer deviation monitor enable" UBYTE boolean 0 0 0.0 1.0 ECU_ADDRESS 0x40022017 /end MEASUREMENT
/begin MEASUREMENT AirCtl_stGovDvtMonNrmHeal_mp "status, which shows wether EGR control is working in normal or healing range" UBYTE boolean 0 0 0.0 1.0 ECU_ADDRESS 0x40022018 /end MEASUREMENT
/begin MEASUREMENT AirCtl_stDebDef "Status of monitoring for permanent control deviation" UBYTE boolean 0 0 0.0 1.0 ECU_ADDRESS 0x40022019 /end MEASUREMENT
/begin MEASUREMENT AirHt_tiCrankHt_mp "Cranking with heating phase duration" ULONG Debounce_ms 0 0 0.0 655350.0 ECU_ADDRESS 0x4002201C /end MEASUREMENT
/begin MEASUREMENT AirHt_tiPostHt_mp "Post heating phase duration" ULONG Debounce_ms 0 0 0.0 655350.0 ECU_ADDRESS 0x40022020 /end MEASUREMENT
/begin MEASUREMENT AirHt_tiPreHt_mp "Preheating phase duration" ULONG Debounce_ms 0 0 0.0 655350.0 ECU_ADDRESS 0x40022024 /end MEASUREMENT
/begin MEASUREMENT AirHt_tiStByHt_mp "stand by with Heating phase duration" ULONG Debounce_ms 0 0 0.0 655350.0 ECU_ADDRESS 0x40022028 /end MEASUREMENT
/begin MEASUREMENT AirHt_tRefMin_mp "MInimum Logic for Air Heater temperature updation" SWORD Temp_deg 0 0 -50.0 200.0 ECU_ADDRESS 0x4002202C /end MEASUREMENT
/begin MEASUREMENT AirHt_tRef_mp "Reference Temperature calculated value" SWORD Temp_deg 0 0 -50.0 200.0 ECU_ADDRESS 0x4002202E /end MEASUREMENT
/begin MEASUREMENT AirHt_tRefMinair_mp "MInimum Logic for Air Heater temperature updation(inlet air)" SWORD Temp_deg 0 0 -50.0 200.0 ECU_ADDRESS 0x40022030 /end MEASUREMENT
/begin MEASUREMENT AirHt_tRefair_mp "Reference Temperature calculated value(Envt and AirSys_t)" SWORD Temp_deg 0 0 -50.0 200.0 ECU_ADDRESS 0x40022032 /end MEASUREMENT
/begin MEASUREMENT AirHt_stLowBatt_mp "low battery monitoring status" UBYTE boolean 0 0 0.0 1.0 ECU_ADDRESS 0x40022034 /end MEASUREMENT
/begin MEASUREMENT AirHt_stOld "status of AirHeater last period" UBYTE AirHtState_conv 0 0 0 8 ECU_ADDRESS 0x40022035 /end MEASUREMENT
/begin MEASUREMENT AirHt_tiCrankHtElapsed "Cranking with heating phase duration" ULONG Debounce_ms 0 0 0.0 655350.0 ECU_ADDRESS 0x40022038 /end MEASUREMENT
/begin MEASUREMENT AirHt_tiStByHtElapsed "stand -by with Heating phase duration" ULONG Debounce_ms 0 0 0.0 655350.0 ECU_ADDRESS 0x4002203C /end MEASUREMENT
/begin MEASUREMENT AirHt_tiPostHtElapsed "Post heating phase duration" ULONG Debounce_ms 0 0 0.0 655350.0 ECU_ADDRESS 0x40022040 /end MEASUREMENT
/begin MEASUREMENT AirHt_tiPreHtElapsed "Preheating phase duration" ULONG Debounce_ms 0 0 0.0 655350.0 ECU_ADDRESS 0x40022044 /end MEASUREMENT
/begin MEASUREMENT AirHt_tiStDelay "stand -by with Heating phase duration wait for sensor value" ULONG Debounce_ms 0 0 0.0 655350.0 ECU_ADDRESS 0x40022048 /end MEASUREMENT
/begin MEASUREMENT TCPrt_trqPrtLim_mp "Desired fuel quantity for turbocharger protection" SWORD Trq_Nm 0 0 -3276.8 3276.7 ECU_ADDRESS 0x40023408 /end MEASUREMENT
/begin MEASUREMENT TCPrt_bTrbChOvrSpd "Overspeed flag from VGT Nm" UBYTE boolean 0 0 0.0 1.0 ECU_ADDRESS 0x4002340A /end MEASUREMENT
/begin MEASUREMENT StSys_tiAftStrtDone_mp "measuring point for Timer to indicate the time elapsed after the start is done" SLONG Time_s 0 0 0.0 2.1474836E+7 ECU_ADDRESS 0x40023264 /end MEASUREMENT
/begin MEASUREMENT SmkLim_tLamFullLdMapIn_mp "selected engine temperature from field EngDa_tFld" SWORD Temp_deg 0 0 -200.0 200.0 ECU_ADDRESS 0x40023268 /end MEASUREMENT
/begin MEASUREMENT SmkLim_facStrtCor_mp "Correction factor output based on the start phasefrom the curve SmkLim_facStrtCor_CUR" SWORD Factor 0 0 -10.0 10.0 ECU_ADDRESS 0x4002326A /end MEASUREMENT
/begin MEASUREMENT SmkLim_facEnvPCor_mp "Correction factor output based on the atmosphericpressure from the curve SmkLim_facEnvPCorCUR" SWORD Factor 0 0 -10.0 10.0 ECU_ADDRESS 0x4002326C /end MEASUREMENT
/begin MEASUREMENT SmkLim_facLamEGRCor_mp "Measurement Point for EGR correction factor" SWORD Factor 0 0 -10.0 10.0 ECU_ADDRESS 0x4002326E /end MEASUREMENT
/begin MEASUREMENT SmkLim_rLamStrtCorCUR_mp "Lambda value output based on the start phasefrom the curve SmkLim_rLamStrtCor_CUR" SWORD Prc_100_rate 0 0 -100.0 100.0 ECU_ADDRESS 0x40023270 /end MEASUREMENT
/begin MEASUREMENT SmkLim_rLamStrtCor_mp "Start phase dependent correction of lambda value" SWORD Prc_100_rate 0 0 -100.0 100.0 ECU_ADDRESS 0x40023272 /end MEASUREMENT
/begin MEASUREMENT SmkLim_rLamEnvPCorMAP_mp "Measurement Point for Lambda value output based on the atmosphericpressure from the MAP SmkLim_rLamEnvPCorMAP" SWORD Prc_100_rate 0 0 -100.0 100.0 ECU_ADDRESS 0x40023274 /end MEASUREMENT
/begin MEASUREMENT SmkLim_rLamEnvPCor_mp "Measurement Point for Output of the Altitudelambda correction MAP" SWORD Prc_100_rate 0 0 -100.0 100.0 ECU_ADDRESS 0x40023276 /end MEASUREMENT
/begin MEASUREMENT SmkLim_rLamEGRUnCor_mp "Measurement Point for Lambda EGR uncorrected ratio" SWORD Prc_100_rate 0 0 -100.0 100.0 ECU_ADDRESS 0x40023278 /end MEASUREMENT
/begin MEASUREMENT SmkLim_rLamEGRCor_mp "Measurement Point for Lambda EGR correction ratio" SWORD Prc_100_rate 0 0 -100.0 100.0 ECU_ADDRESS 0x4002327A /end MEASUREMENT
/begin MEASUREMENT SmkLim_rLamSmkPrsLamCor_mp "Lambda value output after coorection" SWORD Prc_100_rate 0 0 -100.0 100.0 ECU_ADDRESS 0x4002327C /end MEASUREMENT
/begin MEASUREMENT SmkLim_rLamSetPrs_mp "measuring point for limited lambda value in currentopmode" SWORD Prc_100_rate 0 0 -100.0 100.0 ECU_ADDRESS 0x4002327E /end MEASUREMENT
/begin MEASUREMENT FlSys_rhoFlSel_mp "selected fuel factor" SWORD Fuel_Rho_kg_m3 0 0 0.0 3276.0 ECU_ADDRESS 0x40022CF8 /end MEASUREMENT
/begin MEASUREMENT FlSys_dvolPerSecond "Maximum supply volume through the metering unit" SWORD FuelVol_mm3_s 0 0 0.0 50000.0 ECU_ADDRESS 0x40022CFA /end MEASUREMENT
/begin MEASUREMENT FlSys_volFlConsTotEEP "" ULONG Fl_Half_L 0 0 0 2.1474836475E+9 ECU_ADDRESS 0x4002FBE8 /end MEASUREMENT
/begin MEASUREMENT FlSys_volFlConsHiResTotEEP "" ULONG FlConsum_L 0 0 0 4.294967295E+6 ECU_ADDRESS 0x4002FBE4 /end MEASUREMENT
/begin MEASUREMENT InjCrv_qMI1Bas_mp "injection quantities for MI1" SWORD FuelMass_mg_hub 0 0 -319.0 319.0 ECU_ADDRESS 0x40022E5A /end MEASUREMENT
/begin MEASUREMENT InjCrv_qMI1Set_mp "injection quantities for MI1 affer correcion" SWORD FuelMass_mg_hub 0 0 -319.0 319.0 ECU_ADDRESS 0x40022E5C /end MEASUREMENT
/begin MEASUREMENT InjCrv_phiMI1Bas1EOM0_mp "Start of energizing for MI1" SWORD Angle_CA 0 0 -40.0 40.0 ECU_ADDRESS 0x40022E5E /end MEASUREMENT
/begin MEASUREMENT InjCrv_phiMI1Bas2EOM0_mp "Start of energizing for MI1" SWORD Angle_CA 0 0 -40.0 40.0 ECU_ADDRESS 0x40022E60 /end MEASUREMENT
/begin MEASUREMENT InjCrv_phiMI1Bas_mp "Start of energizing for MI1" SWORD Angle_CA 0 0 -40.0 40.0 ECU_ADDRESS 0x40022E62 /end MEASUREMENT
/begin MEASUREMENT InjCrv_phiMI1CorIn_mp "Start of energizing for MI1 after environment correction and intake air correction" SWORD Angle_CA 0 0 -40.0 40.0 ECU_ADDRESS 0x40022E64 /end MEASUREMENT
/begin MEASUREMENT InjCrv_phiMI1StrtBase_mp "Start of energizing for MI1 when engine start" SWORD Angle_CA 0 0 -40.0 40.0 ECU_ADDRESS 0x40022E66 /end MEASUREMENT
/begin MEASUREMENT InjCrv_phiMI1Strt_mp "Start of energizing for MI1 when engine start" SWORD Angle_CA 0 0 -40.0 40.0 ECU_ADDRESS 0x40022E68 /end MEASUREMENT
/begin MEASUREMENT InjCrv_phiMI1CorOut_mp "Start of energizing for MI1 before saturation" SWORD Angle_CA 0 0 -40.0 40.0 ECU_ADDRESS 0x40022E6A /end MEASUREMENT
/begin MEASUREMENT InjCrv_phiMI1Max1EOM0_mp "max start of energizing for MI1" SWORD Angle_CA 0 0 -40.0 40.0 ECU_ADDRESS 0x40022E6C /end MEASUREMENT
/begin MEASUREMENT InjCrv_phiMI1Max2EOM0_mp "max start of energizing for MI1" SWORD Angle_CA 0 0 -40.0 40.0 ECU_ADDRESS 0x40022E6E /end MEASUREMENT
/begin MEASUREMENT InjCrv_phiMI1MaxEOM0_mp "max start of energizing for MI1" SWORD Angle_CA 0 0 -40.0 40.0 ECU_ADDRESS 0x40022E70 /end MEASUREMENT
/begin MEASUREMENT InjCrv_phiMI1Lim_mp "Start of energizing for MI1 before saturation" SWORD Angle_CA 0 0 -40.0 40.0 ECU_ADDRESS 0x40022E72 /end MEASUREMENT
/begin MEASUREMENT InjCrv_phiMI1APSCor1_mp "Start of energizing correction for MI1 based on atmospheric pressure" SWORD Angle_CA 0 0 -40.0 40.0 ECU_ADDRESS 0x40022E74 /end MEASUREMENT
/begin MEASUREMENT InjCrv_phiMI1ETSCor1_mp "Start of energizing correction for MI1 based on engine temperature " SWORD Angle_CA 0 0 -40.0 40.0 ECU_ADDRESS 0x40022E76 /end MEASUREMENT
/begin MEASUREMENT InjCrv_phiMI1ATSCor1_mp "Start of energizing correction for MI1 based on air temperature " SWORD Angle_CA 0 0 -40.0 40.0 ECU_ADDRESS 0x40022E78 /end MEASUREMENT
/begin MEASUREMENT InjCrv_facMI1APSSOECor1 "Start of energizing correction factor for MI1 based on atmospheric pressure" SWORD Factor 0 0 -10.0 10.0 ECU_ADDRESS 0x40022E7A /end MEASUREMENT
/begin MEASUREMENT InjCrv_facMI1ETSSOECor1 "Start of energizing correction factor for MI1 based on engine temperature" SWORD Factor 0 0 -10.0 10.0 ECU_ADDRESS 0x40022E7C /end MEASUREMENT
/begin MEASUREMENT InjCrv_facMI1ATSSOECor1 "Start of energizing correction factor for MI1 based on air temperature" SWORD Factor 0 0 -10.0 10.0 ECU_ADDRESS 0x40022E7E /end MEASUREMENT
/begin MEASUREMENT InjCrv_qPiI1Max_mp "Maximum injection quantity for PiI1" SWORD FuelMass_mg_hub 0 0 -319.0 319.0 ECU_ADDRESS 0x40022E80 /end MEASUREMENT
/begin MEASUREMENT InjCrv_qPiI1SetLim_mp "PiI1 quantity during with unlimitation" SWORD FuelMass_mg_hub 0 0 -319.0 319.0 ECU_ADDRESS 0x40022E82 /end MEASUREMENT
/begin MEASUREMENT InjCrv_tiPiI1Min_mp "Minimum time component for PiI1 start of energizing" SWORD InjTime_us 0 0 -13107.0 13106.0 ECU_ADDRESS 0x40022E84 /end MEASUREMENT
/begin MEASUREMENT InjCrv_tiMI1Des "Time component of MI1 start of energizing" SWORD InjTime_us 0 0 -13107.0 13106.0 ECU_ADDRESS 0x40022E86 /end MEASUREMENT
/begin MEASUREMENT InjCrv_tiPiI1SetUnLim_mp "unlinited time component for PiI1 start of energizing" SWORD InjTime_us 0 0 -13107.0 13106.0 ECU_ADDRESS 0x40022E88 /end MEASUREMENT
/begin MEASUREMENT InjCrv_tiPiI1Abs_mp "absolute time component for PiI1 start of energizing" SWORD InjTime_us 0 0 -13107.0 13106.0 ECU_ADDRESS 0x40022E8A /end MEASUREMENT
/begin MEASUREMENT InjCrv_phiPiI1Min_mp "Minimum angular component for PiI1 start of energizing" SWORD Angle_CA 0 0 -719.0 719.0 ECU_ADDRESS 0x40022E8C /end MEASUREMENT
/begin MEASUREMENT InjCrv_phiPiI1SetUnLim_mp "unlimited angular component for PiI1 start of energizing" SWORD Angle_CA 0 0 -719.0 719.0 ECU_ADDRESS 0x40022E8E /end MEASUREMENT
/begin MEASUREMENT InjCrv_phiPiI1Abs_mp "absolute angular component for PiI1 start of energizing" SWORD Angle_CA 0 0 -719.0 719.0 ECU_ADDRESS 0x40022E90 /end MEASUREMENT
/begin MEASUREMENT InjCrv_qPiI1StrtBase_mp "Basic PiI1 quantity during starting time" SWORD FuelMass_mg_hub 0 0 -319.0 319.0 ECU_ADDRESS 0x40022E9C /end MEASUREMENT
/begin MEASUREMENT InjCrv_qPiI1Strt_mp "PiI1 quantity during starting time" SWORD FuelMass_mg_hub 0 0 -319.0 319.0 ECU_ADDRESS 0x40022E9E /end MEASUREMENT
/begin MEASUREMENT InjCrv_phiPiI1StrtBase_mp "Basic PiI1 start of energizing during starting time(phi)" SWORD Angle_CA 0 0 -719.0 719.0 ECU_ADDRESS 0x40022EA0 /end MEASUREMENT
/begin MEASUREMENT InjCrv_phiPiI1Strt_mp "PiI1 start of energizing during starting time(phi)" SWORD Angle_CA 0 0 -719.0 719.0 ECU_ADDRESS 0x40022EA2 /end MEASUREMENT
/begin MEASUREMENT InjCrv_tiPiI1StrtBase_mp "Basic PiI1 start of energizing during starting time(ti)" SWORD InjTime_us 0 0 -13107.0 13106.0 ECU_ADDRESS 0x40022EA4 /end MEASUREMENT
/begin MEASUREMENT InjCrv_tiPiI1Strt_mp "PiI1 start of energizing during starting time(ti)" SWORD InjTime_us 0 0 -13107.0 13106.0 ECU_ADDRESS 0x40022EA6 /end MEASUREMENT
/begin MEASUREMENT InjCrv_qPiI1ETSCor1_mp "PiI1 quantity correction due to engine temperature" SWORD FuelMass_mg_hub 0 0 -319.0 319.0 ECU_ADDRESS 0x40022EA8 /end MEASUREMENT
/begin MEASUREMENT InjCrv_qPiI1ATSCor1_mp "PiI1 quantity correction due to air temperature" SWORD FuelMass_mg_hub 0 0 -319.0 319.0 ECU_ADDRESS 0x40022EAA /end MEASUREMENT
/begin MEASUREMENT InjCrv_qPiI1APSCor1_mp "PiI1 quantity correction due to atmospheric pressure" SWORD FuelMass_mg_hub 0 0 -319.0 319.0 ECU_ADDRESS 0x40022EAC /end MEASUREMENT
/begin MEASUREMENT InjCrv_facPiI1QETSCor1 "PiI1 quantity correction factor due to engine temperature" SWORD Factor 0 0 -4.0 4.0 ECU_ADDRESS 0x40022EAE /end MEASUREMENT
/begin MEASUREMENT InjCrv_facPiI1QATSCor1 "PiI1 quantity correction factor due to air temperature" SWORD Factor 0 0 -4.0 4.0 ECU_ADDRESS 0x40022EB0 /end MEASUREMENT
/begin MEASUREMENT InjCrv_facPiI1QAPSCor1 "PiI1 quantity correction factor due to atmospheric pressure" SWORD Factor 0 0 -4.0 4.0 ECU_ADDRESS 0x40022EB2 /end MEASUREMENT
/begin MEASUREMENT InjCrv_phiPiI1ETSCor1_mp "PiI1 start of energizing correction due to engine temperature(phi)" SWORD Angle_CA 0 0 -719.0 719.0 ECU_ADDRESS 0x40022EBA /end MEASUREMENT
/begin MEASUREMENT InjCrv_phiPiI1ATSCor1_mp "PiI1 start of energizing correction due to air temperature(phi)" SWORD Angle_CA 0 0 -719.0 719.0 ECU_ADDRESS 0x40022EBC /end MEASUREMENT
/begin MEASUREMENT InjCrv_phiPiI1APSCor1_mp "PiI1 start of energizing correction due to atmospheric pressure(phi)" SWORD Angle_CA 0 0 -719.0 719.0 ECU_ADDRESS 0x40022EBE /end MEASUREMENT
/begin MEASUREMENT InjCrv_tiPiI1ETSCor1_mp "PiI1 start of energizing correction due to engine temperature(ti)" SWORD InjTime_us 0 0 -13107.0 13106.0 ECU_ADDRESS 0x40022EC0 /end MEASUREMENT
/begin MEASUREMENT InjCrv_tiPiI1ATSCor1_mp "PiI1 start of energizing correction due to air temperature(ti)" SWORD InjTime_us 0 0 -13107.0 13106.0 ECU_ADDRESS 0x40022EC2 /end MEASUREMENT
/begin MEASUREMENT InjCrv_tiPiI1APSCor1_mp "PiI1 start of energizing correction due to atmospheric pressure(ti)" SWORD InjTime_us 0 0 -13107.0 13106.0 ECU_ADDRESS 0x40022EC4 /end MEASUREMENT
/begin COMPU_METHOD EngSpeed_rpm "f(x)=(c1*X*X+c2*X+c3)/(c4*X*X+c5*X+c6)" RAT_FUNC "%6.1" "rpm" COEFFS 0 2.000 0.000 0 0 1.000 /end COMPU_METHOD
/begin COMPU_METHOD State_uint8 "f(x)=(c1*X*X+c2*X+c3)/(c4*X*X+c5*X+c6)" RAT_FUNC "%3.0" "" COEFFS 0 1 0 0 0 1 /end COMPU_METHOD
/begin COMPU_METHOD Trq_Nm "f(x)=(c1*X*X+c2*X+c3)/(c4*X*X+c5*X+c6)" RAT_FUNC "%0.3" "Nm" COEFFS 0 10.000 0.000 0 0 1.000 /end COMPU_METHOD
/begin COMPU_METHOD FuelMass_mg_hub "f(x)=(c1*X*X+c2*X+c3)/(c4*X*X+c5*X+c6)" RAT_FUNC "%0.3" "mg/hub" COEFFS 0 102.400 0.000 0 0 1.000 /end COMPU_METHOD
/begin COMPU_METHOD AirPressure_kPa "f(x)=(c1*X*X+c2*X+c3)/(c4*X*X+c5*X+c6)" RAT_FUNC "%0.3" "kPa" COEFFS 0 10.000 0.000 0 0 1.000 /end COMPU_METHOD
/begin COMPU_METHOD boolean "f(x)=(c1*X*X+c2*X+c3)/(c4*X*X+c5*X+c6)" RAT_FUNC "%1.0" "" COEFFS 0 1 0 0 0 1 /end COMPU_METHOD
/begin COMPU_METHOD EngTime_ms "f(x)=(c1*X*X+c2*X+c3)/(c4*X*X+c5*X+c6)" RAT_FUNC "%0.3" "ms" COEFFS 0 1.000 0.000 0 0 10.000 /end COMPU_METHOD
/begin COMPU_METHOD Prc_100_rate "f(x)=(c1*X*X+c2*X+c3)/(c4*X*X+c5*X+c6)" RAT_FUNC "%0.3" "%" COEFFS 0 81.920 0.000 0 0 1.000 /end COMPU_METHOD
/begin COMPU_METHOD InjTime_us "f(x)=(c1*X*X+c2*X+c3)/(c4*X*X+c5*X+c6)" RAT_FUNC "%0.3" "us" COEFFS 0 2.500 0.000 0 0 1.000 /end COMPU_METHOD
/begin COMPU_METHOD Debounce_ms "f(x)=(c1*X*X+c2*X+c3)/(c4*X*X+c5*X+c6)" RAT_FUNC "%10.0" "ms" COEFFS 0 1 0 0 0 1 /end COMPU_METHOD
/begin COMPU_METHOD Accpedal_rate_s "f(x)=(c1*X*X+c2*X+c3)/(c4*X*X+c5*X+c6)" RAT_FUNC "%0.3" "%/s" COEFFS 0 81.920 0.000 0 0 1.000 /end COMPU_METHOD
/begin COMPU_METHOD FlowRes_kPa_m3_h "f(x)=(c1*X*X+c2*X+c3)/(c4*X*X+c5*X+c6)" RAT_FUNC "%0.3" "kPa/(m^3/h)" COEFFS 0 100000.000 0.000 0 0 1.000 /end COMPU_METHOD
/begin COMPU_METHOD Time_s "f(x)=(c1*X*X+c2*X+c3)/(c4*X*X+c5*X+c6)" RAT_FUNC "%0.3" "s" COEFFS 0 100.000 0.000 0 0 1.000 /end COMPU_METHOD
/begin COMPU_METHOD FlConsum_L "f(x)=(c1*X*X+c2*X+c3)/(c4*X*X+c5*X+c6)" RAT_FUNC "%0.3" "L" COEFFS 0 1000.000 0.000 0 0 1.000 /end COMPU_METHOD
/begin COMPU_METHOD Fl_Half_L "f(x)=(c1*X*X+c2*X+c3)/(c4*X*X+c5*X+c6)" RAT_FUNC "%11.1" "L" COEFFS 0 2.000 0.000 0 0 1.000 /end COMPU_METHOD
/begin COMPU_METHOD Battery_mv "f(x)=(c1*X*X+c2*X+c3)/(c4*X*X+c5*X+c6)" RAT_FUNC "%5.0" "mv" COEFFS 0 1 0 0 0 1 /end COMPU_METHOD
/begin COMPU_METHOD Freq_q1p0 "f(x)=(c1*X*X+c2*X+c3)/(c4*X*X+c5*X+c6)" RAT_FUNC "%5.0" "Hz" COEFFS 0 1 0 0 0 1 /end COMPU_METHOD
/begin COMPU_METHOD RailDT1_ms "f(x)=(c1*X*X+c2*X+c3)/(c4*X*X+c5*X+c6)" RAT_FUNC "%5.0" "ms" COEFFS 0 1 0 0 0 1 /end COMPU_METHOD
/begin COMPU_METHOD Fuel_Rho_kg_m3 "f(x)=(c1*X*X+c2*X+c3)/(c4*X*X+c5*X+c6)" RAT_FUNC "%0.3" "kg/m^3" COEFFS 0 10.000 0.000 0 0 1.000 /end COMPU_METHOD
/begin COMPU_METHOD AirMass_mg_hub "f(x)=(c1*X*X+c2*X+c3)/(c4*X*X+c5*X+c6)" RAT_FUNC "%6.1" "mg/hub" COEFFS 0 2.000 0.000 0 0 1.000 /end COMPU_METHOD
/begin COMPU_METHOD EngSpeed_rpm_s "f(x)=(c1*X*X+c2*X+c3)/(c4*X*X+c5*X+c6)" RAT_FUNC "%6.1" "rpm/s" COEFFS 0 2.000 0.000 0 0 1.000 /end COMPU_METHOD
/begin COMPU_METHOD Temp_deg "f(x)=(c1*X*X+c2*X+c3)/(c4*X*X+c5*X+c6)" RAT_FUNC "%0.3" "deg" COEFFS 0 10.000 2731.400 0 0 1.000 /end COMPU_METHOD
/begin COMPU_METHOD Fact8192 "f(x)=(c1*X*X+c2*X+c3)/(c4*X*X+c5*X+c6)" RAT_FUNC "%14.6" "" COEFFS 0 8192.000 0.000 0 0 1.000 /end COMPU_METHOD
/begin COMPU_METHOD PT_fac "f(x)=(c1*X*X+c2*X+c3)/(c4*X*X+c5*X+c6)" RAT_FUNC "%0.3" "" COEFFS 0 655.360 0.000 0 0 1.000 /end COMPU_METHOD
/begin COMPU_METHOD Factor "f(x)=(c1*X*X+c2*X+c3)/(c4*X*X+c5*X+c6)" RAT_FUNC "%12.6" "" COEFFS 0 1024.000 0.000 0 0 1.000 /end COMPU_METHOD
/begin COMPU_METHOD Pid_Kp_Kd "f(x)=(c1*X*X+c2*X+c3)/(c4*X*X+c5*X+c6)" RAT_FUNC "%0.3" "" COEFFS 0 1000.000 0.000 0 0 1.000 /end COMPU_METHOD
/begin COMPU_METHOD AirVol_m3_h "f(x)=(c1*X*X+c2*X+c3)/(c4*X*X+c5*X+c6)" RAT_FUNC "%0.3" "m^3/h" COEFFS 0 5.000 0.000 0 0 1.000 /end COMPU_METHOD
/begin COMPU_METHOD TrqEta_Nm_mg_hub "f(x)=(c1*X*X+c2*X+c3)/(c4*X*X+c5*X+c6)" RAT_FUNC "%10.6" "Nm/(mg/hub)" COEFFS 0 128.000 0.000 0 0 1.000 /end COMPU_METHOD
/begin COMPU_METHOD Turbo_rpm "f(x)=(c1*X*X+c2*X+c3)/(c4*X*X+c5*X+c6)" RAT_FUNC "%0.3" "rpm" COEFFS 0 1.000 0.000 0 0 10.000 /end COMPU_METHOD
/begin COMPU_METHOD FuelVol_mm3_s "f(x)=(c1*X*X+c2*X+c3)/(c4*X*X+c5*X+c6)" RAT_FUNC "%0.3" "mm^3/s" COEFFS 0 1.000 0.000 0 0 10.000 /end COMPU_METHOD
/begin COMPU_METHOD Angle_CA "f(x)=(c1*X*X+c2*X+c3)/(c4*X*X+c5*X+c6)" RAT_FUNC "%0.3" "CA" COEFFS 0 45.511 0.000 0 0 1.000 /end COMPU_METHOD
/begin COMPU_METHOD Switch_conv "Enumerated data type: Switch_conv" TAB_VERB "%0.3" "" COMPU_TAB_REF VTAB_FOR_Switch_conv /end COMPU_METHOD
/begin COMPU_METHOD AirHtState_conv "Enumerated data type: AirHtState_conv" TAB_VERB "%0.3" "" COMPU_TAB_REF VTAB_FOR_AirHtState_conv /end COMPU_METHOD
/begin COMPU_METHOD EngTempFldSel_conv "Enumerated data type: EngTempFldSel_conv" TAB_VERB "%0.3" "" COMPU_TAB_REF VTAB_FOR_EngTempFldSel_conv /end COMPU_METHOD
/begin COMPU_METHOD AirTempFldSel_conv "Enumerated data type: AirTempFldSel_conv" TAB_VERB "%0.3" "" COMPU_TAB_REF VTAB_FOR_AirTempFldSel_conv /end COMPU_METHOD
/begin COMPU_METHOD int32 "f(x)=(c1*X*X+c2*X+c3)/(c4*X*X+c5*X+c6)" RAT_FUNC "%10.0" "" COEFFS 0 1 0 0 0 1 /end COMPU_METHOD
/begin COMPU_METHOD TempDiff_Kelv "f(x)=(c1*X*X+c2*X+c3)/(c4*X*X+c5*X+c6)" RAT_FUNC "%0.3" "K" COEFFS 0 10.000 0.000 0 0 1.000 /end COMPU_METHOD
/begin COMPU_METHOD Vol_L "f(x)=(c1*X*X+c2*X+c3)/(c4*X*X+c5*X+c6)" RAT_FUNC "%0.3" "L" COEFFS 0 50.000 0.000 0 0 1.000 /end COMPU_METHOD
/begin COMPU_METHOD DutyCycle_rate_s "f(x)=(c1*X*X+c2*X+c3)/(c4*X*X+c5*X+c6)" RAT_FUNC "%0.3" "%/s" COEFFS 0 100.000 0.000 0 0 1.000 /end COMPU_METHOD
/begin COMPU_METHOD Fact1 "f(x)=(c1*X*X+c2*X+c3)/(c4*X*X+c5*X+c6)" RAT_FUNC "%10.6" "" COEFFS 0 128.000 0.000 0 0 1.000 /end COMPU_METHOD
/begin COMPU_METHOD VlvCtl_Kp "f(x)=(c1*X*X+c2*X+c3)/(c4*X*X+c5*X+c6)" RAT_FUNC "%12.6" "%/(mg/hub)" COEFFS 0 512.000 0.000 0 0 1.000 /end COMPU_METHOD
/begin COMPU_METHOD VlvCtl_Ki "f(x)=(c1*X*X+c2*X+c3)/(c4*X*X+c5*X+c6)" RAT_FUNC "%12.6" "%/(mg/hub)/s" COEFFS 0 1024.000 0.000 0 0 1.000 /end COMPU_METHOD
/begin COMPU_METHOD FuelMass_mg_hub_s "f(x)=(c1*X*X+c2*X+c3)/(c4*X*X+c5*X+c6)" RAT_FUNC "%0.3" "(mg/hub)/s" COEFFS 0 102.400 0.000 0 0 1.000 /end COMPU_METHOD
/begin COMPU_VTAB VTAB_FOR_Switch_conv "Enumerated data type: Switch_conv" TAB_VERB 2 0 "OFF" 1 "ON" /end COMPU_VTAB
/begin COMPU_VTAB VTAB_FOR_AirHtState_conv "Enumerated data type: AirHtState_conv" TAB_VERB 9 0 "AIRHT_READING" 1 "AIRHT_PREHTR" 2 "AIRHT_STBHTR" 3 "AIRHT_STB" 4 "AIRHT_CRKHTR" 5 "AIRHT_CRK" 6 "AIRHT_POSTHTR" 7 "AIRHT_END" 8 "AIRHT_AFTERRUN" /end COMPU_VTAB
/begin COMPU_VTAB VTAB_FOR_EngTempFldSel_conv "Enumerated data type: EngTempFldSel_conv" TAB_VERB 3 0 "Coolant_Temperature" 1 "Oil_Temperature" 2 "Eng_Temperature" /end COMPU_VTAB
/begin COMPU_VTAB VTAB_FOR_AirTempFldSel_conv "Enumerated data type: AirTempFldSel_conv" TAB_VERB 4 0 "Air_tCACDs" 1 "Air_tAFS" 2 "Air_tEnvT" 3 "Air_tIntkVUS" /end COMPU_VTAB
/begin GROUP S4_Reduced_maximum_engine_setpoint_speed_during_start "HLSDem_SetPoint/HLSDem_SetPointHi/HLSDem_SetPointBaseHi/Reduced maximum engine setpoint speed during start" /begin REF_CHARACTERISTIC HLSDem_tiStrtCEngDsT_CUR HLSDem_tiStrtEngOil_CUR /end REF_CHARACTERISTIC
 /begin REF_MEASUREMENT HLSDem_stStrt_mp HLSDem_tiStrtCEngDsT_mp HLSDem_tiStrtEngOil_mp HLSDem_tiStrt_mp /end REF_MEASUREMENT
/end GROUP
/begin GROUP S4_Release_of_reduction "HLSDem_SetPoint/HLSDem_SetPointHi/HLSDem_SetPointBaseHi/Release of reduction" /begin REF_MEASUREMENT HLSDem_stNoRmp /end REF_MEASUREMENT /end GROUP
/begin GROUP S16_Basic_low_idle_setpoint_calculation "HLSDem_SetPoint/HLSDem_SetPointLo/HLSDem_SetPointBaseLo/Basic low idle setpoint calculation" /begin SUB_GROUP S18_Fiter_state_determination /end SUB_GROUP
 /begin REF_CHARACTERISTIC HLSDem_SetPLoRmpSlopeNeg_C HLSDem_SetPLoRmpSlopePos_C HLSDem_SetPLoTipInRmpSlopeNeg_C HLSDem_SetPLoTipInRmpSlopePos_C HLSDem_facSetPLoFlt_C SigTst_nSetPLo_C SigTst_swtSetPLo_C /end REF_CHARACTERISTIC
/end GROUP
/begin GROUP S16_Basic_low_idle_setpoint_raw_calculation "HLSDem_SetPoint/HLSDem_SetPointLo/HLSDem_SetPointBaseLo/Basic low idle setpoint raw calculation"
 /begin REF_CHARACTERISTIC HLSDem_dnSetPLoLimHiTrm_C HLSDem_dnSetPLoLimLoTrm_C HLSDem_nSel1SetPLo_C HLSDem_nSel2SetPLo_C HLSDem_nSel3SetPLo_C HLSDem_nSetPLoDia_C HLSDem_nSetPLoDrvAwy_C HLSDem_nSetPLoIni_CUR HLSDem_nSetPLoMaxOfs_C HLSDem_nSetPLoMax_C HLSDem_nSetPLoWrm_C HLSDem_nSpdLowBattUAddLim_C HLSDem_nSpdLowBattUAdd_CUR HLSDem_swtEnaPTO_C HLSDem_tiMaxIncrSetPLo_C HLSDem_tiSpdLowBattUAdd_C HLSDem_volSpdAddHi_C HLSDem_volSpdAddLo_C /end REF_CHARACTERISTIC
 /begin REF_MEASUREMENT HLSDem_nSelSetPLo_mp HLSDem_nSetPLoCo_mp HLSDem_nSetPLoRaw_mp HLSDem_nSetPLoTemp HLSDem_nSetPLoTrm HLSDem_nSpdLowBattUAdd_mp /end REF_MEASUREMENT
/end GROUP
/begin GROUP S16_Select_temperature "HLSDem_SetPoint/HLSDem_SetPointLo/HLSDem_SetPointBaseLo/Select temperature"
 /begin REF_CHARACTERISTIC HLSDem_swtTempSel_C HLSDem_tDflSetPLo_C HLSDem_tiMaxIncrSetPLo_C /end REF_CHARACTERISTIC
 /begin REF_MEASUREMENT HLSDem_tFrzSetPLo_mp HLSDem_tSetPLo_mp /end REF_MEASUREMENT
/end GROUP
/begin GROUP S16_Suppressing_low_idle_increase_after_start "HLSDem_SetPoint/HLSDem_SetPointLo/HLSDem_SetPointBaseLo/Suppressing low idle increase after start" /begin REF_CHARACTERISTIC HLSDem_swtMode_C HLSDem_tThresDisbl_C HLSDem_tThresEna_C /end REF_CHARACTERISTIC /begin REF_MEASUREMENT HLSDem_stStrtTemp_mp /end REF_MEASUREMENT /end GROUP
/begin GROUP S18_Fiter_state_determination "HLSDem_SetPoint/HLSDem_SetPointLo/HLSDem_SetPointBaseLo/Basic low idle setpoint calculation/Fiter state determination" /begin REF_CHARACTERISTIC HLSDem_stSetPLoFlt_C /end REF_CHARACTERISTIC /begin REF_MEASUREMENT HLSDem_stSetPLoFlt_mp /end REF_MEASUREMENT /end GROUP
/begin GROUP CnvLead_Trq2Q "CnvLead_Trq2Q" /begin SUB_GROUP Root_Curr Root_Lead Root_facRmpOP_Switch /end SUB_GROUP /end GROUP
/begin GROUP Root_Curr "CnvLead_Trq2Q/Curr" /begin REF_CHARACTERISTIC PhyMod_trq2qBas_MAP /end REF_CHARACTERISTIC /end GROUP
/begin GROUP Root_Lead "CnvLead_Trq2Q/Lead" /begin REF_CHARACTERISTIC PhyMod_trq2qBas_MAP /end REF_CHARACTERISTIC /end GROUP
/begin GROUP Root_facRmpOP_Switch "CnvLead_Trq2Q/facRmpOP Switch" /begin REF_CHARACTERISTIC CnvLead_facRmpVal_CUR /end REF_CHARACTERISTIC /end GROUP
/begin GROUP CnvSet_Trq2Q "CnvSet_Trq2Q"
 /begin SUB_GROUP Root_etaCurrRmp Root_facRmpVal Root_qSetNxtRaw Root_qSetPrsRaw Root_qStrt /end SUB_GROUP
/end GROUP
/begin GROUP Root_etaCurrRmp "CnvSet_Trq2Q/etaCurrRmp" /begin REF_CHARACTERISTIC CnvSet_etaMax_C CnvSet_etaMin_C /end REF_CHARACTERISTIC /end GROUP
/begin GROUP Root_facRmpVal "CnvSet_Trq2Q/facRmpVal" /begin REF_CHARACTERISTIC CnvSet_facRmpVal_CUR /end REF_CHARACTERISTIC /end GROUP
/begin GROUP Root_qSetNxtRaw "CnvSet_Trq2Q/qSetNxtRaw" /begin REF_CHARACTERISTIC CnvSet_etaMax_C CnvSet_etaMin_C PhyMod_trq2qBas_MAP /end REF_CHARACTERISTIC /begin REF_MEASUREMENT CnvSet_qSetOptNxt_mp /end REF_MEASUREMENT /end GROUP
/begin GROUP Root_qSetPrsRaw "CnvSet_Trq2Q/qSetPrsRaw" /begin REF_CHARACTERISTIC CnvSet_etaMax_C CnvSet_etaMin_C PhyMod_trq2qBas_MAP /end REF_CHARACTERISTIC /begin REF_MEASUREMENT CnvSet_qSetOpt_mp /end REF_MEASUREMENT /end GROUP
/begin GROUP Root_qStrt "CnvSet_Trq2Q/qStrt" /begin REF_CHARACTERISTIC CnvSet_eta0_C /end REF_CHARACTERISTIC /end GROUP
/begin GROUP ActMod_Q2Trq "ActMod_Q2Trq" /begin REF_CHARACTERISTIC ActMod_swtStrtQntEna_C /end REF_CHARACTERISTIC /begin REF_MEASUREMENT ActMod_trqCurr_mp /end REF_MEASUREMENT /end GROUP
/begin GROUP PhyMod_CalcCor "PhyMod_CalcCor"
 /begin REF_CHARACTERISTIC CoEOM_facRmpVal_C PhyMod_facEtaCorNxt_C PhyMod_facEtaCor_C PhyMod_qCorNxt_C PhyMod_qCor_C PhyMod_stNxt_C PhyMod_stPrs_C /end REF_CHARACTERISTIC
/end GROUP
/begin GROUP RngMod_TrqFrcAdpt "RngMod_TrqFrcAdpt" /begin REF_CHARACTERISTIC RngMod_trqDiffAdap_C /end REF_CHARACTERISTIC /end GROUP
/begin GROUP RngMod_TrqFrcCalc "RngMod_TrqFrcCalc" /begin SUB_GROUP Root_EngtFld_Selector /end SUB_GROUP /begin REF_CHARACTERISTIC RngMod_numTrqFrc_C RngMod_trqFrc_MAP RngMod_trqLossComp_C /end REF_CHARACTERISTIC /begin REF_MEASUREMENT RngMod_trqFrcT_mp /end REF_MEASUREMENT /end GROUP
/begin GROUP Root_EngtFld_Selector "RngMod_TrqFrcCalc/EngtFld_Selector" /begin REF_MEASUREMENT RngMod_tTrqFrc_mp /end REF_MEASUREMENT /end GROUP
/begin GROUP RngMod_TrqSpdCrv "RngMod_TrqSpdCrv" /begin REF_CHARACTERISTIC RngMod_trqCrSMax_CUR RngMod_trqMax_CUR /end REF_CHARACTERISTIC /end GROUP
/begin GROUP EngDa_PwrEng "EngDa_PwrEng" /begin REF_CHARACTERISTIC EngDa_trqEngMax_C /end REF_CHARACTERISTIC /end GROUP
/begin GROUP EngDa_tiEngOn "EngDa_tiEngOn" /begin REF_MEASUREMENT EngDa_tiEngOnEEP /end REF_MEASUREMENT /end GROUP
/begin GROUP EngTrqPtd_CoOfs "EngTrqPtd_CoOfs" /begin REF_CHARACTERISTIC EngTrqPtd_stPthLim_C EngTrqPtd_trqLim_C /end REF_CHARACTERISTIC /end GROUP
/begin GROUP ASMod_VolEff "ASMod_VolEff" /begin SUB_GROUP Root_VolEff Root_dmAirFlow Root_mAirPerCyl /end SUB_GROUP /end GROUP
/begin GROUP Root_VolEff "ASMod_VolEff/VolEff" /begin REF_CHARACTERISTIC ASMod_facEGRCor_MAP ASMod_facVolEffBas_MAP /end REF_CHARACTERISTIC /begin REF_MEASUREMENT ASMod_facEGRCor_mp ASMod_facVolEffBas_mp /end REF_MEASUREMENT /end GROUP
/begin GROUP Root_dmAirFlow "ASMod_VolEff/dmAirFlow" /begin SUB_GROUP S2_AirMassFlow S2_TempCorr /end SUB_GROUP /end GROUP
/begin GROUP Root_mAirPerCyl "ASMod_VolEff/mAirPerCyl" /begin REF_CHARACTERISTIC ASMod_nThresDwn_C Epm_numCyl_C /end REF_CHARACTERISTIC /end GROUP
/begin GROUP S2_AirMassFlow "ASMod_VolEff/dmAirFlow/AirMassFlow" /begin REF_CHARACTERISTIC ASMod_numBnk_C ASMod_volEng_C /end REF_CHARACTERISTIC /end GROUP
/begin GROUP S2_TempCorr "ASMod_VolEff/dmAirFlow/TempCorr" /begin REF_CHARACTERISTIC ASMod_facIntMnfDsTempCor_C ASMod_tIntMnfDsRef_MAP /end REF_CHARACTERISTIC /begin REF_MEASUREMENT ASMod_facVolEffTempCor_mp /end REF_MEASUREMENT /end GROUP
/begin GROUP ASMod_TempCatMod "ASMod_TempCatMod" /begin REF_CHARACTERISTIC ASMod_dvolPFltEG_C PFltLd_resFlw_C /end REF_CHARACTERISTIC /end GROUP
/begin GROUP AirCtl_Co "AirCtl_Co" /begin REF_CHARACTERISTIC AirCtl_swtTypCor_C /end REF_CHARACTERISTIC /end GROUP
/begin GROUP AirCtl_CtlValCalc "AirCtl_CtlValCalc" /begin SUB_GROUP Root_AirCtl_CtlValCalc /end SUB_GROUP /end GROUP
/begin GROUP Root_AirCtl_CtlValCalc "AirCtl_CtlValCalc/AirCtl_CtlValCalc"
 /begin SUB_GROUP S1_AirtFld_Selector S1_CtlValCalc S1_CtlValLim S1_EngtFld_Selector S1_NrmCtlValCalc S1_SmkLimCalc /end SUB_GROUP
 /begin REF_CHARACTERISTIC AirCtl_numAirTempCtlVal_C AirCtl_numEngTempCtlVal_C /end REF_CHARACTERISTIC
/end GROUP
/begin GROUP S1_AirtFld_Selector "AirCtl_CtlValCalc/AirCtl_CtlValCalc/AirtFld_Selector" /begin REF_MEASUREMENT AirCtl_tAirCtlVal_mp /end REF_MEASUREMENT /end GROUP
/begin GROUP S1_CtlValCalc "AirCtl_CtlValCalc/AirCtl_CtlValCalc/CtlValCalc"
 /begin REF_CHARACTERISTIC AirCtl_facCtlAirTempCorEOM0_CUR AirCtl_facCtlEngTempCorEOM0_CUR AirCtl_rCtlAirTempCorEOM0_MAP AirCtl_rCtlCorBasEOM0_MAP AirCtl_rCtlEngTempCorEOM0_MAP AirCtl_rCtlEnvPresCorEOM0_MAP AirCtl_rCtlValBasEOM0_MAP AirCtl_swtAirMs_C /end REF_CHARACTERISTIC
 /begin REF_MEASUREMENT AirCtl_facCtlAirTempCorEOM0_mp AirCtl_facCtlEngTempCorEOM0_mp AirCtl_rCtlAirTempCorEOM0_mp AirCtl_rCtlCorBasEOM0_mp AirCtl_rCtlEngTempCorEOM0_mp AirCtl_rCtlEnvPresCorEOM0_mp AirCtl_rCtlValAirTempCorEOM0_mp AirCtl_rCtlValBasEOM0_mp AirCtl_rCtlValCor1EOM0_mp AirCtl_rCtlValCor2EOM0_mp AirCtl_rCtlValCor3EOM0_mp AirCtl_rCtlValEOM0_mp AirCtl_rCtlValEngTempCorEOM0_mp /end REF_MEASUREMENT
/end GROUP
/begin GROUP S1_CtlValLim "AirCtl_CtlValCalc/AirCtl_CtlValCalc/CtlValLim"
 /begin REF_CHARACTERISTIC AirCtl_drCtlValDwn_C AirCtl_drCtlValUp_C AirCtl_facEnvPresCtlVal_CUR AirCtl_facWrmUpCtlVal_CUR AirCtl_rEnvPresCtlVal_MAP AirCtl_rWrmUpCtlVal_MAP /end REF_CHARACTERISTIC
 /begin REF_MEASUREMENT AirCtl_rCtlValLast_mp AirCtl_rEnvPresCtlVal_mp AirCtl_rRmpCtlVal_mp AirCtl_rWrmUpCtlVal_mp /end REF_MEASUREMENT
/end GROUP
/begin GROUP S1_EngtFld_Selector "AirCtl_CtlValCalc/AirCtl_CtlValCalc/EngtFld_Selector" /begin REF_MEASUREMENT AirCtl_tEngCtlVal_mp /end REF_MEASUREMENT /end GROUP
/begin GROUP S1_NrmCtlValCalc "AirCtl_CtlValCalc/AirCtl_CtlValCalc/NrmCtlValCalc" /begin REF_CHARACTERISTIC AirCtl_drCtlValDec_CUR AirCtl_drCtlValInc_CUR /end REF_CHARACTERISTIC
 /begin REF_MEASUREMENT AirCtl_drCtlValDec_mp AirCtl_drCtlValInc_mp AirCtl_rNrmCtlVal_mp /end REF_MEASUREMENT
/end GROUP
/begin GROUP S1_SmkLimCalc "AirCtl_CtlValCalc/AirCtl_CtlValCalc/SmkLimCalc" /begin SUB_GROUP S7_GetBit1 S7_GetBit2 /end SUB_GROUP
 /begin REF_CHARACTERISTIC AirCtl_facEngTempSmkDynCor_CUR AirCtl_facEngTempSmkStatCor_CUR AirCtl_rEngTempSmkDynCor_MAP AirCtl_rEngTempSmkStatCor_MAP AirCtl_rSmkDyn_MAP AirCtl_rSmkStat_MAP /end REF_CHARACTERISTIC
 /begin REF_MEASUREMENT AirCtl_rEngTempSmkDynCorVal_mp AirCtl_rEngTempSmkStatCorVal_mp AirCtl_rSmkCtlVal_mp AirCtl_rSmkDyn_mp AirCtl_rSmkStat_mp /end REF_MEASUREMENT
/end GROUP
/begin GROUP S7_GetBit1 "AirCtl_CtlValCalc/AirCtl_CtlValCalc/SmkLimCalc/GetBit1" /begin REF_MEASUREMENT AirCtl_bSmkDynLim /end REF_MEASUREMENT /end GROUP
/begin GROUP S7_GetBit2 "AirCtl_CtlValCalc/AirCtl_CtlValCalc/SmkLimCalc/GetBit2" /begin REF_MEASUREMENT AirCtl_bSmkStatLim /end REF_MEASUREMENT /end GROUP
/begin GROUP AirCtl_DesValCalc "AirCtl_DesValCalc" /begin SUB_GROUP Root_AirCtl_DesValCalc /end SUB_GROUP /end GROUP
/begin GROUP Root_AirCtl_DesValCalc "AirCtl_DesValCalc/AirCtl_DesValCalc" /begin SUB_GROUP S1_Compare S1_StatCalc /end SUB_GROUP /end GROUP
/begin GROUP S1_Compare "AirCtl_DesValCalc/AirCtl_DesValCalc/Compare" /begin REF_CHARACTERISTIC AirCtl_mMaxDesVal_C AirCtl_mMinDesVal_C /end REF_CHARACTERISTIC /end GROUP
/begin GROUP S1_StatCalc "AirCtl_DesValCalc/AirCtl_DesValCalc/StatCalc" /begin SUB_GROUP S3_AirtFld_Selector S3_BaseMap S3_EngtFld_Selector1 /end SUB_GROUP
 /begin REF_CHARACTERISTIC AirCtl_ctAirTempSel_C AirCtl_ctEngTempSel_C AirCtl_facAirTempCorEOM0_MAP AirCtl_facEngTempCorEOM0_MAP AirCtl_facIndPresCorr_C AirCtl_mAirTempCorBasEOM0_MAP AirCtl_mEngTempCorBasEOM0_MAP AirCtl_pBstPresRef_MAP AirCtl_swtIndPresSel_C /end REF_CHARACTERISTIC
 /begin REF_MEASUREMENT AirCtl_facAirTempCorEOM0_mp AirCtl_facBstPresCor_mp AirCtl_facEngTempCorEOM0_mp AirCtl_mAirTempCorBasEOM0_mp AirCtl_mAirTempCorEOM0_mp AirCtl_mDesVal3EOM0_mp AirCtl_mDesVal4EOM0_mp AirCtl_mDesValEOM0_mp AirCtl_mEngTempCorBasEOM0_mp AirCtl_mEngTempCorEOM0_mp AirCtl_pBstPresRef_mp /end REF_MEASUREMENT
/end GROUP
/begin GROUP S3_AirtFld_Selector "AirCtl_DesValCalc/AirCtl_DesValCalc/StatCalc/AirtFld_Selector" /begin REF_MEASUREMENT AirCtl_tAirDesVal_mp /end REF_MEASUREMENT /end GROUP
/begin GROUP S3_BaseMap "AirCtl_DesValCalc/AirCtl_DesValCalc/StatCalc/BaseMap"
 /begin REF_CHARACTERISTIC AirCtl_facEnvPresCorEOM0_CUR AirCtl_mDesBasEOM0_MAP AirCtl_mDesBasHiAltdEOM0_MAP /end REF_CHARACTERISTIC
 /begin REF_MEASUREMENT AirCtl_facEnvPresCorEOM0_mp AirCtl_mDesBasHiAltdEOM0_mp AirCtl_mDesVal1EOM0_mp /end REF_MEASUREMENT
/end GROUP
/begin GROUP S3_EngtFld_Selector1 "AirCtl_DesValCalc/AirCtl_DesValCalc/StatCalc/EngtFld_Selector" /begin REF_MEASUREMENT AirCtl_tEngDesVal_mp /end REF_MEASUREMENT /end GROUP
/begin GROUP AirCtl_Gov "AirCtl_Gov" /begin SUB_GROUP Root_AirCtl_Gov /end SUB_GROUP /end GROUP
/begin GROUP Root_AirCtl_Gov "AirCtl_Gov/AirCtl_Gov"
 /begin SUB_GROUP S1_AirtFld_Selector1 S1_DT1_S16 S1_Freeze_Low_Path S1_I_comp S1_ParAdap S1_SplitGovOut S1_Static_Correction_for_Open_Loop /end SUB_GROUP
 /begin REF_CHARACTERISTIC AirCtl_KIconv_C AirCtl_numAirTempGov_C AirCtl_rGovMax_C AirCtl_rGovMin_C AirCtl_rIGovLimHi_C AirCtl_rIGovLimLo_C /end REF_CHARACTERISTIC
 /begin REF_MEASUREMENT AirCtl_mActVal_mp AirCtl_rGovOut_mp AirCtl_rOutP_mp AirCtl_rPIDCtl_mp AirCtl_swtGovEna /end REF_MEASUREMENT
/end GROUP
/begin GROUP S1_AirtFld_Selector1 "AirCtl_Gov/AirCtl_Gov/AirtFld_Selector" /begin REF_MEASUREMENT AirCtl_tAirGov_mp /end REF_MEASUREMENT /end GROUP
/begin GROUP S1_DT1_S16 "AirCtl_Gov/AirCtl_Gov/DT1_S16" /begin SUB_GROUP S3_Function_Call_Subsystem1 /end SUB_GROUP /end GROUP
/begin GROUP S1_Freeze_Low_Path "AirCtl_Gov/AirCtl_Gov/Freeze Low Path" /begin REF_MEASUREMENT AirCtl_stFrzI_mp /end REF_MEASUREMENT /end GROUP
/begin GROUP S1_I_comp "AirCtl_Gov/AirCtl_Gov/I_comp" /begin REF_MEASUREMENT AirCtl_rOutI_mp /end REF_MEASUREMENT /end GROUP
/begin GROUP S1_ParAdap "AirCtl_Gov/AirCtl_Gov/ParAdap" /begin SUB_GROUP S8_CalcPar /end SUB_GROUP
 /begin REF_MEASUREMENT AirCtl_KdVal_mp AirCtl_KiNegVal_mp AirCtl_KiPosVal_mp AirCtl_KiVal_mp AirCtl_KiWinNegVal_mp AirCtl_KiWinPosVal_mp AirCtl_KpNegVal_mp AirCtl_KpPosVal_mp AirCtl_KpVal_mp AirCtl_KpWinNegVal_mp AirCtl_KpWinPosVal_mp AirCtl_T1Val_mp /end REF_MEASUREMENT
/end GROUP
/begin GROUP S1_SplitGovOut "AirCtl_Gov/AirCtl_Gov/SplitGovOut" /begin REF_CHARACTERISTIC AirCtl_rEGR_MAP AirCtl_rTVA_MAP AirCtl_stGov_C /end REF_CHARACTERISTIC /end GROUP
/begin GROUP S1_Static_Correction_for_Open_Loop "AirCtl_Gov/AirCtl_Gov/Static Correction for Open Loop" /begin REF_CHARACTERISTIC AirCtl_rTransCor_MAP /end REF_CHARACTERISTIC
 /begin REF_MEASUREMENT AirCtl_rTransCorVal_mp AirCtl_rTransCor_mp AirCtl_rTransUnCor_mp /end REF_MEASUREMENT
/end GROUP
/begin GROUP S3_Function_Call_Subsystem1 "AirCtl_Gov/AirCtl_Gov/DT1_S16/Function-Call Subsystem1" /begin REF_MEASUREMENT AirCtl_rOutD_mp /end REF_MEASUREMENT /end GROUP
/begin GROUP S8_CalcPar "AirCtl_Gov/AirCtl_Gov/ParAdap/CalcPar"
 /begin REF_CHARACTERISTIC AirCtl_KdNrm_C AirCtl_KiNegNrm_C AirCtl_KiNrm_C AirCtl_KiPosNrm_C AirCtl_KiWinNegNrm_C AirCtl_KiWinPosNrm_C AirCtl_KpNegNrm_C AirCtl_KpNrm_C AirCtl_KpPosNrm_C AirCtl_KpWinNegNrm_C AirCtl_KpWinPosNrm_C AirCtl_T1Nrm_C AirCtl_facParAirTemp_CUR AirCtl_facParBas_MAP /end REF_CHARACTERISTIC
 /begin REF_MEASUREMENT AirCtl_KdNrm_mp AirCtl_KiNrm_mp AirCtl_KiPNegNrm_mp AirCtl_KiPosNrm_mp AirCtl_KpNegNrm_mp AirCtl_KpNrm_mp AirCtl_KpPosNrm_mp AirCtl_T1Nrm_mp AirCtl_facParAirTemp_mp AirCtl_facParBas_mp AirCtl_facParNrm_mp /end REF_MEASUREMENT
/end GROUP
/begin GROUP AirCtl_Mon "AirCtl_Mon"
 /begin SUB_GROUP Root_AirtFld_Selector Root_CheckPrio Root_EngTemp_and_CldStrtMon Root_EngtFld_Selector1 Root_GovDvtMon Root_OvrRun_GearShft_LoIdl_Mon Root_SysMon Root_SysSmkMon Root_VarDflValCalc_inl9 /end SUB_GROUP
 /begin REF_CHARACTERISTIC AirCtl_numAirTempMon_C AirCtl_numEngTempMon_C /end REF_CHARACTERISTIC
/end GROUP
/begin GROUP Root_AirtFld_Selector "AirCtl_Mon/AirtFld_Selector" /begin REF_MEASUREMENT AirCtl_tAirMon_mp /end REF_MEASUREMENT /end GROUP
/begin GROUP Root_CheckPrio "AirCtl_Mon/CheckPrio"
 /begin SUB_GROUP S2_If_Action_Subsystem S2_If_Action_Subsystem1 S2_If_Action_Subsystem10 S2_If_Action_Subsystem11 S2_If_Action_Subsystem12 S2_If_Action_Subsystem13 S2_If_Action_Subsystem14 S2_If_Action_Subsystem15 S2_If_Action_Subsystem16 S2_If_Action_Subsystem17 S2_If_Action_Subsystem18 S2_If_Action_Subsystem19 S2_If_Action_Subsystem2 S2_If_Action_Subsystem20 S2_If_Action_Subsystem21 S2_If_Action_Subsystem22 S2_If_Action_Subsystem23 S2_If_Action_Subsystem24 S2_If_Action_Subsystem25 S2_If_Action_Subsystem26 S2_If_Action_Subsystem27 S2_If_Action_Subsystem28 S2_If_Action_Subsystem3 S2_If_Action_Subsystem4 S2_If_Action_Subsystem5 S2_If_Action_Subsystem6 S2_If_Action_Subsystem7 S2_If_Action_Subsystem8 S2_If_Action_Subsystem9 /end SUB_GROUP
/end GROUP
/begin GROUP Root_EngTemp_and_CldStrtMon "AirCtl_Mon/EngTemp and CldStrtMon"
 /begin REF_CHARACTERISTIC AirCtl_tClntCldHi_C AirCtl_tClntCldLo_C AirCtl_tClntWrmHi_C AirCtl_tClntWrmLo_C AirCtl_tiCldStrt_CUR /end REF_CHARACTERISTIC
 /begin REF_MEASUREMENT AirCtl_tiCldStrt_mp /end REF_MEASUREMENT
/end GROUP
/begin GROUP Root_EngtFld_Selector1 "AirCtl_Mon/EngtFld_Selector" /begin REF_MEASUREMENT AirCtl_tEngMon_mp /end REF_MEASUREMENT /end GROUP
/begin GROUP Root_GovDvtMon "AirCtl_Mon/GovDvtMon"
 /begin SUB_GROUP S5_DesValChk S5_VarDebSetDFC_inl6 S5_VarGovDvtLim_inl4 S5_VarGovDvtMonEna_inl8 /end SUB_GROUP
 /begin REF_MEASUREMENT AirCtl_stDebDef AirCtl_stGovDvtMonNrmHeal_mp AirCtl_stMaxDvt_mp AirCtl_stMinDvt_mp /end REF_MEASUREMENT
/end GROUP
/begin GROUP Root_OvrRun_GearShft_LoIdl_Mon "AirCtl_Mon/OvrRun_GearShft_LoIdl_Mon"
 /begin REF_CHARACTERISTIC AirCtl_nLoIdl_C AirCtl_nOvrRun_C AirCtl_qOvrRun_C AirCtl_tiClth_C AirCtl_tiLoIdl_C /end REF_CHARACTERISTIC
/end GROUP
/begin GROUP Root_SysMon "AirCtl_Mon/SysMon"
 /begin REF_CHARACTERISTIC AirCtl_pAirHi_C AirCtl_pAirLo_C AirCtl_tAirCldHi_C AirCtl_tAirCldLo_C AirCtl_tAirWrmHi_C AirCtl_tAirWrmLo_C AirCtl_uBattThres_C /end REF_CHARACTERISTIC
/end GROUP
/begin GROUP Root_SysSmkMon "AirCtl_Mon/SysSmkMon"
 /begin REF_CHARACTERISTIC AirCtl_dnEngTrans_C AirCtl_dqLeadTrans_C AirCtl_drAPPTrans_C AirCtl_facEngTempSmkHysCor_CUR AirCtl_facEnvPresSmkHysCor_CUR AirCtl_qEngTempSmkHysCor_MAP AirCtl_qEnvPresSmkHysCor_MAP AirCtl_qSmkHys_MAP AirCtl_qSwtSmkHi_C AirCtl_qSwtSmkLo_C AirCtl_tiDynSmkDly_C AirCtl_tiStatSmkDly_C AirCtl_tiTransDly_C /end REF_CHARACTERISTIC
 /begin REF_MEASUREMENT AirCtl_facEngTempSmkHysCor_mp AirCtl_facEnvPresSmkHysCor_mp AirCtl_qDiff_mp AirCtl_qEngTempSmkHysCorVal_mp AirCtl_qEngTempSmkHysCor_mp AirCtl_qEnvPresSmkHysCorVal_mp AirCtl_qEnvPresSmkHysCor_mp AirCtl_qInrLimSmk AirCtl_qSmkDiff_mp AirCtl_qSmkHysCorVal_mp AirCtl_qSmkHysVal_mp AirCtl_qSmkHys_mp AirCtl_stDynSwtSmk_mp AirCtl_stStatSwtSmk_mp /end REF_MEASUREMENT
/end GROUP
/begin GROUP Root_VarDflValCalc_inl9 "AirCtl_Mon/VarDflValCalc_inl9" /begin REF_CHARACTERISTIC AirCtl_rEGRDflVal_CA AirCtl_rTVADflVal_CA /end REF_CHARACTERISTIC /end GROUP
/begin GROUP S2_If_Action_Subsystem "AirCtl_Mon/CheckPrio/If Action Subsystem" /begin REF_CHARACTERISTIC AirCtl_stPrioMon_CA /end REF_CHARACTERISTIC /end GROUP
/begin GROUP S2_If_Action_Subsystem1 "AirCtl_Mon/CheckPrio/If Action Subsystem1" /begin REF_CHARACTERISTIC AirCtl_stPrioMon_CA /end REF_CHARACTERISTIC /end GROUP
/begin GROUP S2_If_Action_Subsystem10 "AirCtl_Mon/CheckPrio/If Action Subsystem10" /begin REF_CHARACTERISTIC AirCtl_stPrioMon_CA /end REF_CHARACTERISTIC /end GROUP
/begin GROUP S2_If_Action_Subsystem11 "AirCtl_Mon/CheckPrio/If Action Subsystem11" /begin REF_CHARACTERISTIC AirCtl_stPrioMon_CA /end REF_CHARACTERISTIC /end GROUP
/begin GROUP S2_If_Action_Subsystem12 "AirCtl_Mon/CheckPrio/If Action Subsystem12" /begin REF_CHARACTERISTIC AirCtl_stPrioMon_CA /end REF_CHARACTERISTIC /end GROUP
/begin GROUP S2_If_Action_Subsystem13 "AirCtl_Mon/CheckPrio/If Action Subsystem13" /begin REF_CHARACTERISTIC AirCtl_stPrioMon_CA /end REF_CHARACTERISTIC /end GROUP
/begin GROUP S2_If_Action_Subsystem14 "AirCtl_Mon/CheckPrio/If Action Subsystem14" /begin REF_CHARACTERISTIC AirCtl_stPrioMon_CA /end REF_CHARACTERISTIC /end GROUP
/begin GROUP S2_If_Action_Subsystem15 "AirCtl_Mon/CheckPrio/If Action Subsystem15" /begin REF_CHARACTERISTIC AirCtl_stPrioMon_CA /end REF_CHARACTERISTIC /end GROUP
/begin GROUP S2_If_Action_Subsystem16 "AirCtl_Mon/CheckPrio/If Action Subsystem16" /begin REF_CHARACTERISTIC AirCtl_stPrioMon_CA /end REF_CHARACTERISTIC /end GROUP
/begin GROUP S2_If_Action_Subsystem17 "AirCtl_Mon/CheckPrio/If Action Subsystem17" /begin REF_CHARACTERISTIC AirCtl_stPrioMon_CA /end REF_CHARACTERISTIC /end GROUP
/begin GROUP S2_If_Action_Subsystem18 "AirCtl_Mon/CheckPrio/If Action Subsystem18" /begin REF_CHARACTERISTIC AirCtl_stPrioMon_CA /end REF_CHARACTERISTIC /end GROUP
/begin GROUP S2_If_Action_Subsystem19 "AirCtl_Mon/CheckPrio/If Action Subsystem19" /begin REF_CHARACTERISTIC AirCtl_stPrioMon_CA /end REF_CHARACTERISTIC /end GROUP
/begin GROUP S2_If_Action_Subsystem2 "AirCtl_Mon/CheckPrio/If Action Subsystem2" /begin REF_CHARACTERISTIC AirCtl_stPrioMon_CA /end REF_CHARACTERISTIC /end GROUP
/begin GROUP S2_If_Action_Subsystem20 "AirCtl_Mon/CheckPrio/If Action Subsystem20" /begin REF_CHARACTERISTIC AirCtl_stPrioMon_CA /end REF_CHARACTERISTIC /end GROUP
/begin GROUP S2_If_Action_Subsystem21 "AirCtl_Mon/CheckPrio/If Action Subsystem21" /begin REF_CHARACTERISTIC AirCtl_stPrioMon_CA /end REF_CHARACTERISTIC /end GROUP
/begin GROUP S2_If_Action_Subsystem22 "AirCtl_Mon/CheckPrio/If Action Subsystem22" /begin REF_CHARACTERISTIC AirCtl_stPrioMon_CA /end REF_CHARACTERISTIC /end GROUP
/begin GROUP S2_If_Action_Subsystem23 "AirCtl_Mon/CheckPrio/If Action Subsystem23" /begin REF_CHARACTERISTIC AirCtl_stPrioMon_CA /end REF_CHARACTERISTIC /end GROUP
/begin GROUP S2_If_Action_Subsystem24 "AirCtl_Mon/CheckPrio/If Action Subsystem24" /begin REF_CHARACTERISTIC AirCtl_stPrioMon_CA /end REF_CHARACTERISTIC /end GROUP
/begin GROUP S2_If_Action_Subsystem25 "AirCtl_Mon/CheckPrio/If Action Subsystem25" /begin REF_CHARACTERISTIC AirCtl_stPrioMon_CA /end REF_CHARACTERISTIC /end GROUP
/begin GROUP S2_If_Action_Subsystem26 "AirCtl_Mon/CheckPrio/If Action Subsystem26" /begin REF_CHARACTERISTIC AirCtl_stPrioMon_CA /end REF_CHARACTERISTIC /end GROUP
/begin GROUP S2_If_Action_Subsystem27 "AirCtl_Mon/CheckPrio/If Action Subsystem27" /begin REF_CHARACTERISTIC AirCtl_stPrioMon_CA /end REF_CHARACTERISTIC /end GROUP
/begin GROUP S2_If_Action_Subsystem28 "AirCtl_Mon/CheckPrio/If Action Subsystem28" /begin REF_CHARACTERISTIC AirCtl_stPrioMon_CA /end REF_CHARACTERISTIC /end GROUP
/begin GROUP S2_If_Action_Subsystem3 "AirCtl_Mon/CheckPrio/If Action Subsystem3" /begin REF_CHARACTERISTIC AirCtl_stPrioMon_CA /end REF_CHARACTERISTIC /end GROUP
/begin GROUP S2_If_Action_Subsystem4 "AirCtl_Mon/CheckPrio/If Action Subsystem4" /begin REF_CHARACTERISTIC AirCtl_stPrioMon_CA /end REF_CHARACTERISTIC /end GROUP
/begin GROUP S2_If_Action_Subsystem5 "AirCtl_Mon/CheckPrio/If Action Subsystem5" /begin REF_CHARACTERISTIC AirCtl_stPrioMon_CA /end REF_CHARACTERISTIC /end GROUP
/begin GROUP S2_If_Action_Subsystem6 "AirCtl_Mon/CheckPrio/If Action Subsystem6" /begin REF_CHARACTERISTIC AirCtl_stPrioMon_CA /end REF_CHARACTERISTIC /end GROUP
/begin GROUP S2_If_Action_Subsystem7 "AirCtl_Mon/CheckPrio/If Action Subsystem7" /begin REF_CHARACTERISTIC AirCtl_stPrioMon_CA /end REF_CHARACTERISTIC /end GROUP
/begin GROUP S2_If_Action_Subsystem8 "AirCtl_Mon/CheckPrio/If Action Subsystem8" /begin REF_CHARACTERISTIC AirCtl_stPrioMon_CA /end REF_CHARACTERISTIC /end GROUP
/begin GROUP S2_If_Action_Subsystem9 "AirCtl_Mon/CheckPrio/If Action Subsystem9" /begin REF_CHARACTERISTIC AirCtl_stPrioMon_CA /end REF_CHARACTERISTIC /end GROUP
/begin GROUP S5_DesValChk "AirCtl_Mon/GovDvtMon/DesValChk" /begin REF_CHARACTERISTIC ASMod_numBnk_C AirCtl_facActDesVal_C Epm_numCyl_C /end REF_CHARACTERISTIC /begin REF_MEASUREMENT AirCtl_mDesMax_mp AirCtl_stDesChk_mp /end REF_MEASUREMENT /end GROUP
/begin GROUP S5_VarDebSetDFC_inl6 "AirCtl_Mon/GovDvtMon/VarDebSetDFC_inl6" /begin SUB_GROUP S113_MaxHeal1 /end SUB_GROUP /end GROUP
/begin GROUP S5_VarGovDvtLim_inl4 "AirCtl_Mon/GovDvtMon/VarGovDvtLim_inl4" /begin REF_CHARACTERISTIC AirCtl_mMaxDvt_MAP AirCtl_mMinDvt_MAP /end REF_CHARACTERISTIC /begin REF_MEASUREMENT AirCtl_mMaxDvt AirCtl_mMinDvt /end REF_MEASUREMENT /end GROUP
/begin GROUP S5_VarGovDvtMonEna_inl8 "AirCtl_Mon/GovDvtMon/VarGovDvtMonEna_inl8" /begin REF_CHARACTERISTIC AirCtl_swtGovDvtMonEna_C /end REF_CHARACTERISTIC /begin REF_MEASUREMENT AirCtl_stGovDvtMonEna_mp /end REF_MEASUREMENT /end GROUP
/begin GROUP S113_MaxHeal1 "AirCtl_Mon/GovDvtMon/VarDebSetDFC_inl6/MaxHeal1"
 /begin REF_CHARACTERISTIC AirCtl_tiGovDvtMaxDebDef_C AirCtl_tiGovDvtMaxDebOk_C AirCtl_tiGovDvtMinDebDef_C AirCtl_tiGovDvtMinDebOk_C /end REF_CHARACTERISTIC
/end GROUP
/begin GROUP AirHt_Ctl "AirHt_Ctl" /begin SUB_GROUP Root_AirHt_Ctl /end SUB_GROUP /end GROUP
/begin GROUP Root_AirHt_Ctl "AirHt_Ctl/AirHt_Ctl"
 /begin SUB_GROUP S1_AirHt_Battery_Monitoring S1_AirHt_State_Logic S1_AirHt_Status S1_Temperature_Reading_Phase /end SUB_GROUP
/end GROUP
/begin GROUP S1_AirHt_Battery_Monitoring "AirHt_Ctl/AirHt_Ctl/AirHt Battery Monitoring" /begin REF_CHARACTERISTIC AirHt_tiLowBattThr_C AirHt_uLowBattThr_C /end REF_CHARACTERISTIC /begin REF_MEASUREMENT AirHt_stLowBatt_mp /end REF_MEASUREMENT /end GROUP
/begin GROUP S1_AirHt_State_Logic "AirHt_Ctl/AirHt_Ctl/AirHt State Logic" /begin SUB_GROUP S3_AirHt_State_Calculation /end SUB_GROUP /end GROUP
/begin GROUP S1_AirHt_Status "AirHt_Ctl/AirHt_Ctl/AirHt Status" /begin REF_CHARACTERISTIC AirHt_tiBlink_C /end REF_CHARACTERISTIC /end GROUP
/begin GROUP S1_Temperature_Reading_Phase "AirHt_Ctl/AirHt_Ctl/Temperature Reading Phase" /begin SUB_GROUP S5_AirHt_Time S5_Minimum_Temp /end SUB_GROUP /end GROUP
/begin GROUP S3_AirHt_State_Calculation "AirHt_Ctl/AirHt_Ctl/AirHt State Logic/AirHt State Calculation" /begin REF_CHARACTERISTIC AirHt_nMin_C AirHt_tiStDelay_C /end REF_CHARACTERISTIC
 /begin REF_MEASUREMENT AirHt_stOld AirHt_tiCrankHtElapsed AirHt_tiPostHtElapsed AirHt_tiPreHtElapsed AirHt_tiStByHtElapsed AirHt_tiStDelay /end REF_MEASUREMENT
/end GROUP
/begin GROUP S5_AirHt_Time "AirHt_Ctl/AirHt_Ctl/Temperature Reading Phase/AirHt_Time"
 /begin REF_CHARACTERISTIC AirHt_tiCrankHt_MAP AirHt_tiPostHt_MAP AirHt_tiPreHt_MAP AirHt_tiStByHt_MAP /end REF_CHARACTERISTIC
 /begin REF_MEASUREMENT AirHt_tiCrankHt_mp AirHt_tiPostHt_mp AirHt_tiPreHt_mp AirHt_tiStByHt_mp /end REF_MEASUREMENT
/end GROUP
/begin GROUP S5_Minimum_Temp "AirHt_Ctl/AirHt_Ctl/Temperature Reading Phase/Minimum Temp" /begin SUB_GROUP S12_Minimum_Logic S12_inlet_air_Minimum_Logic1 /end SUB_GROUP /end GROUP
/begin GROUP S12_Minimum_Logic "AirHt_Ctl/AirHt_Ctl/Temperature Reading Phase/Minimum Temp/Minimum Logic"
 /begin REF_CHARACTERISTIC AirHt_bCEngDsT_C AirHt_bFuelT_C AirHt_bOilT_C AirHt_referencetemp_C /end REF_CHARACTERISTIC
 /begin REF_MEASUREMENT AirHt_tRefMin_mp AirHt_tRef_mp /end REF_MEASUREMENT
/end GROUP
/begin GROUP S12_inlet_air_Minimum_Logic1 "AirHt_Ctl/AirHt_Ctl/Temperature Reading Phase/Minimum Temp/inlet air Minimum Logic1"
 /begin REF_CHARACTERISTIC AirHt_bEnvT_C AirHt_btAFS_C AirHt_btCACDs_C AirHt_btIntkVUs_C AirHt_referencetemp_C /end REF_CHARACTERISTIC
 /begin REF_MEASUREMENT AirHt_tRefMinair_mp AirHt_tRefair_mp /end REF_MEASUREMENT
/end GROUP
/begin GROUP CoAS_RlsCmpn "CoAS_RlsCmpn" /begin REF_CHARACTERISTIC CoAS_stEGRVlv_C CoAS_stThrVlv_C /end REF_CHARACTERISTIC /end GROUP
/begin GROUP TCPrt_TrqLim "TCPrt_TrqLim" /begin SUB_GROUP Root_Debounce /end SUB_GROUP /begin REF_CHARACTERISTIC TCPrt_nSpdMax_CUR TCPrt_trqMax_CUR TCPrt_trqOpnLop_MAP /end REF_CHARACTERISTIC /begin REF_MEASUREMENT TCPrt_trqPrtLim_mp /end REF_MEASUREMENT /end GROUP
/begin GROUP Root_Debounce "TCPrt_TrqLim/Debounce" /begin REF_CHARACTERISTIC TCPrt_tiOvrSpdDebDef_C TCPrt_tiOvrSpdDebOk_C /end REF_CHARACTERISTIC /begin REF_MEASUREMENT TCPrt_bTrbChOvrSpd /end REF_MEASUREMENT /end GROUP
/begin GROUP SmkLim_AirMsSel "SmkLim_AirMsSel" /begin REF_CHARACTERISTIC SmkLim_swtAirMs_C /end REF_CHARACTERISTIC /end GROUP
/begin GROUP SmkLim_InjMassLim "SmkLim_InjMassLim" /begin SUB_GROUP Root_SmkLim_InjMassLim /end SUB_GROUP /end GROUP
/begin GROUP Root_SmkLim_InjMassLim "SmkLim_InjMassLim/SmkLim_InjMassLim" /begin SUB_GROUP S1_SmkLim_TimeAftStrtDone /end SUB_GROUP
 /begin REF_CHARACTERISTIC SmkLim_EGRfacRmpSlopeNeg_C SmkLim_EGRfacRmpSlopePos_C SmkLim_facEnvPCor_CUR SmkLim_facLamEGRCor_CUR SmkLim_facStrtCor_CUR SmkLim_numSmkLim_C SmkLim_rLamEGRCor_MAP SmkLim_rLamEnvPCor_MAP SmkLim_rLamFullLd_MAP SmkLim_rLamMaxEOM_C SmkLim_rLamMinEOM_C SmkLim_rLamSmkEOM0_MAP SmkLim_rLamStrtCor_CUR /end REF_CHARACTERISTIC
 /begin REF_MEASUREMENT SmkLim_facEnvPCor_mp SmkLim_facLamEGRCor_mp SmkLim_facStrtCor_mp SmkLim_rLamEGRCor_mp SmkLim_rLamEGRUnCor_mp SmkLim_rLamEnvPCorMAP_mp SmkLim_rLamEnvPCor_mp SmkLim_rLamSetPrs_mp SmkLim_rLamSmkPrsLamCor_mp SmkLim_rLamStrtCorCUR_mp SmkLim_rLamStrtCor_mp SmkLim_tLamFullLdMapIn_mp /end REF_MEASUREMENT
/end GROUP
/begin GROUP S1_SmkLim_TimeAftStrtDone "SmkLim_InjMassLim/SmkLim_InjMassLim/SmkLim_TimeAftStrtDone" /begin REF_MEASUREMENT StSys_tiAftStrtDone_mp /end REF_MEASUREMENT /end GROUP
/begin GROUP FlSys_CalcCnvFac "FlSys_CalcCnvFac"
 /begin REF_CHARACTERISTIC FlSys_facStoich_C FlSys_rhoFlCnvFac_C FlSys_rhoFl_C FlSys_rhoFl_CUR FlSys_swtRhoFlCnv_C /end REF_CHARACTERISTIC
/end GROUP
/begin GROUP FlSys_FlCons "FlSys_FlCons" /begin SUB_GROUP Root_q2dvol /end SUB_GROUP /begin REF_MEASUREMENT FlSys_rhoFlSel_mp /end REF_MEASUREMENT /end GROUP
/begin GROUP Root_q2dvol "FlSys_FlCons/q2dvol" /begin REF_CHARACTERISTIC Epm_numCyl_C /end REF_CHARACTERISTIC /begin REF_MEASUREMENT FlSys_dvolPerSecond /end REF_MEASUREMENT /end GROUP
/begin GROUP FlSys_FlConsTot "FlSys_FlConsTot" /begin REF_MEASUREMENT FlSys_volFlConsHiResTotEEP FlSys_volFlConsTotEEP /end REF_MEASUREMENT /end GROUP
/begin GROUP InjCrv_MI1 "InjCrv_MI1" /begin SUB_GROUP Root_InjCrv_MI1_Angle Root_InjCrv_MI1_Quantity /end SUB_GROUP /begin REF_CHARACTERISTIC InjCrv_stInjCharSetVal_C /end REF_CHARACTERISTIC /end GROUP
/begin GROUP Root_InjCrv_MI1_Angle "InjCrv_MI1/InjCrv_MI1_Angle" /begin SUB_GROUP S1_InjCrv_AgMI1Bas S1_InjCrv_MIStrt /end SUB_GROUP
 /begin REF_CHARACTERISTIC InjCrv_phiMI1Max1EOM0_MAP InjCrv_phiMI1Max2EOM0_MAP InjCrv_phiMI1Min_C SigTst_phiMI1_C SigTst_swtMI1Phi_C /end REF_CHARACTERISTIC
 /begin REF_MEASUREMENT InjCrv_phiMI1CorIn_mp InjCrv_phiMI1Lim_mp InjCrv_phiMI1Max1EOM0_mp InjCrv_phiMI1Max2EOM0_mp InjCrv_phiMI1MaxEOM0_mp /end REF_MEASUREMENT
/end GROUP
/begin GROUP Root_InjCrv_MI1_Quantity "InjCrv_MI1/InjCrv_MI1_Quantity" /begin SUB_GROUP S2_Check_residual_MI_quantity S2_InjCrv_MI1QntSet_Inl1 /end SUB_GROUP /begin REF_CHARACTERISTIC SigTst_qMI1_C SigTst_swtMI1Q_C /end REF_CHARACTERISTIC /end GROUP
/begin GROUP S1_InjCrv_AgMI1Bas "InjCrv_MI1/InjCrv_MI1_Angle/InjCrv_AgMI1Bas" /begin REF_CHARACTERISTIC InjCrv_phiMI1Bas1EOM0_MAP InjCrv_phiMI1Bas2EOM0_MAP /end REF_CHARACTERISTIC
 /begin REF_MEASUREMENT InjCrv_phiMI1Bas1EOM0_mp InjCrv_phiMI1Bas2EOM0_mp InjCrv_phiMI1Bas_mp /end REF_MEASUREMENT
/end GROUP
/begin GROUP S1_InjCrv_MIStrt "InjCrv_MI1/InjCrv_MI1_Angle/InjCrv_MIStrt" /begin REF_CHARACTERISTIC InjCrv_phiMI1StrtBase_MAP /end REF_CHARACTERISTIC
 /begin REF_MEASUREMENT InjCrv_phiMI1CorOut_mp InjCrv_phiMI1StrtBase_mp InjCrv_phiMI1Strt_mp /end REF_MEASUREMENT
/end GROUP
/begin GROUP S2_Check_residual_MI_quantity "InjCrv_MI1/InjCrv_MI1_Quantity/Check residual MI quantity"
 /begin REF_CHARACTERISTIC InjCrv_qMI1MinPiIDiff_C InjCrv_qMI1MinPoIDiff_C InjCrv_qMI1Min_C /end REF_CHARACTERISTIC
 /begin REF_MEASUREMENT InjCrv_qMI1Bas_mp /end REF_MEASUREMENT
/end GROUP
/begin GROUP S2_InjCrv_MI1QntSet_Inl1 "InjCrv_MI1/InjCrv_MI1_Quantity/InjCrv_MI1QntSet_Inl1" /begin REF_MEASUREMENT InjCrv_qMI1Set_mp /end REF_MEASUREMENT /end GROUP
/begin GROUP InjCrv_MI1Cor "InjCrv_MI1Cor" /begin SUB_GROUP Root_Correction_Calculation Root_Weight_Factor /end SUB_GROUP /end GROUP
/begin GROUP Root_Correction_Calculation "InjCrv_MI1Cor/Correction Calculation"
 /begin REF_CHARACTERISTIC InjCrv_phiMI1APSCor1EOM_MAP InjCrv_phiMI1ATSCor1EOM_MAP InjCrv_phiMI1ETSCor1EOM_MAP /end REF_CHARACTERISTIC
 /begin REF_MEASUREMENT InjCrv_phiMI1APSCor1_mp InjCrv_phiMI1ATSCor1_mp InjCrv_phiMI1ETSCor1_mp /end REF_MEASUREMENT
/end GROUP
/begin GROUP Root_Weight_Factor "InjCrv_MI1Cor/Weight Factor"
 /begin REF_CHARACTERISTIC InjCrv_facMI1APSSOECor_CUR InjCrv_facMI1ATSSOECor_CUR InjCrv_facMI1ETSSOECor_CUR /end REF_CHARACTERISTIC
 /begin REF_MEASUREMENT InjCrv_facMI1APSSOECor1 InjCrv_facMI1ATSSOECor1 InjCrv_facMI1ETSSOECor1 /end REF_MEASUREMENT
/end GROUP
/begin GROUP InjCrv_PiI1 "InjCrv_PiI1" /begin SUB_GROUP Root_InjCrv_PiIQntLim Root_InjCrv_PiISOELim /end SUB_GROUP /begin REF_CHARACTERISTIC InjCrv_stInjCharSetVal_C /end REF_CHARACTERISTIC /end GROUP
/begin GROUP Root_InjCrv_PiIQntLim "InjCrv_PiI1/InjCrv_PiIQntLim" /begin REF_CHARACTERISTIC InjCrv_qPiI1Max1_MAP SigTst_qPiI1_C SigTst_swtPiI1Q_C /end REF_CHARACTERISTIC /begin REF_MEASUREMENT InjCrv_qPiI1Max_mp InjCrv_qPiI1SetLim_mp /end REF_MEASUREMENT /end GROUP
/begin GROUP Root_InjCrv_PiISOELim "InjCrv_PiI1/InjCrv_PiISOELim" /begin SUB_GROUP S2_Angle2Time S2_Time2Angle /end SUB_GROUP
 /begin REF_CHARACTERISTIC InjCrv_phiPiI1Max_C SigTst_phiPiI1_C SigTst_swtPiI1Phi_C SigTst_swtPiI1Ti_C SigTst_tiPiI1_C /end REF_CHARACTERISTIC
 /begin REF_MEASUREMENT InjCrv_phiPiI1Abs_mp InjCrv_phiPiI1SetUnLim_mp InjCrv_tiPiI1Abs_mp InjCrv_tiPiI1Min_mp InjCrv_tiPiI1SetUnLim_mp /end REF_MEASUREMENT
/end GROUP
/begin GROUP S2_Angle2Time "InjCrv_PiI1/InjCrv_PiISOELim/Angle2Time" /begin REF_MEASUREMENT InjCrv_tiMI1Des /end REF_MEASUREMENT /end GROUP
/begin GROUP S2_Time2Angle "InjCrv_PiI1/InjCrv_PiISOELim/Time2Angle" /begin REF_MEASUREMENT InjCrv_phiPiI1Min_mp /end REF_MEASUREMENT /end GROUP
/begin GROUP InjCrv_PiI1AddCor "InjCrv_PiI1AddCor" /begin SUB_GROUP Root_InjCrv_PiIQntAddCorEOM Root_InjCrv_PiISOEAddCorEOM /end SUB_GROUP /end GROUP
/begin GROUP Root_InjCrv_PiIQntAddCorEOM "InjCrv_PiI1AddCor/InjCrv_PiIQntAddCorEOM" /begin SUB_GROUP S1_InjCrv_qPiI1Strt /end SUB_GROUP /begin REF_CHARACTERISTIC InjCrv_stInjCharSetVal_C /end REF_CHARACTERISTIC /end GROUP
/begin GROUP Root_InjCrv_PiISOEAddCorEOM "InjCrv_PiI1AddCor/InjCrv_PiISOEAddCorEOM" /begin SUB_GROUP S2_InjCrv_phiPiI1Strt S2_InjCrv_tiPiI1Strt /end SUB_GROUP /end GROUP
/begin GROUP S1_InjCrv_qPiI1Strt "InjCrv_PiI1AddCor/InjCrv_PiIQntAddCorEOM/InjCrv_qPiI1Strt" /begin REF_CHARACTERISTIC InjCrv_qPiI1StrtBase_MAP /end REF_CHARACTERISTIC /begin REF_MEASUREMENT InjCrv_qPiI1StrtBase_mp InjCrv_qPiI1Strt_mp /end REF_MEASUREMENT /end GROUP
/begin GROUP S2_InjCrv_phiPiI1Strt "InjCrv_PiI1AddCor/InjCrv_PiISOEAddCorEOM/InjCrv_phiPiI1Strt" /begin REF_CHARACTERISTIC InjCrv_phiPiI1StrtBase_MAP /end REF_CHARACTERISTIC /begin REF_MEASUREMENT InjCrv_phiPiI1StrtBase_mp InjCrv_phiPiI1Strt_mp /end REF_MEASUREMENT /end GROUP
/begin GROUP S2_InjCrv_tiPiI1Strt "InjCrv_PiI1AddCor/InjCrv_PiISOEAddCorEOM/InjCrv_tiPiI1Strt" /begin REF_CHARACTERISTIC InjCrv_tiPiI1StrtBase_MAP /end REF_CHARACTERISTIC /begin REF_MEASUREMENT InjCrv_tiPiI1StrtBase_mp InjCrv_tiPiI1Strt_mp /end REF_MEASUREMENT /end GROUP
/begin GROUP InjCrv_PiI1Cor "InjCrv_PiI1Cor" /begin SUB_GROUP Root_InjCrv_PiIQntCor Root_InjCrv_PiISOECor /end SUB_GROUP /end GROUP
/begin GROUP Root_InjCrv_PiIQntCor "InjCrv_PiI1Cor/InjCrv_PiIQntCor" /begin SUB_GROUP S1_Correction_Calculation S1_Weight_Factor /end SUB_GROUP /end GROUP
/begin GROUP Root_InjCrv_PiISOECor "InjCrv_PiI1Cor/InjCrv_PiISOECor" /begin SUB_GROUP S2_Correction_Calculation S2_Weight_Factor /end SUB_GROUP /end GROUP
/begin GROUP S1_Correction_Calculation "InjCrv_PiI1Cor/InjCrv_PiIQntCor/Correction Calculation"
 /begin REF_CHARACTERISTIC InjCrv_qPiI1APSCor1EOM0_MAP InjCrv_qPiI1ATSCor1EOM0_MAP InjCrv_qPiI1ETSCor1EOM0_MAP /end REF_CHARACTERISTIC
 /begin REF_MEASUREMENT InjCrv_qPiI1APSCor1_mp InjCrv_qPiI1ATSCor1_mp InjCrv_qPiI1ETSCor1_mp /end REF_MEASUREMENT
/end GROUP
/begin GROUP S1_Weight_Factor "InjCrv_PiI1Cor/InjCrv_PiIQntCor/Weight Factor"
 /begin REF_CHARACTERISTIC InjCrv_facPiI1APSQCor1EOM0_CUR InjCrv_facPiI1ATSQCor1EOM0_CUR InjCrv_facPiI1ETSQCor1EOM0_CUR /end REF_CHARACTERISTIC
 /begin REF_MEASUREMENT InjCrv_facPiI1QAPSCor1 InjCrv_facPiI1QATSCor1 InjCrv_facPiI1QETSCor1 /end REF_MEASUREMENT
/end GROUP
/begin GROUP S2_Correction_Calculation "InjCrv_PiI1Cor/InjCrv_PiISOECor/Correction Calculation"
 /begin REF_CHARACTERISTIC InjCrv_phiPiI1APSCor1EOM0_MAP InjCrv_phiPiI1ATSCor1EOM0_MAP InjCrv_phiPiI1ETSCor1EOM0_MAP InjCrv_tiPiI1APSCor1EOM0_MAP InjCrv_tiPiI1ATSCor1EOM0_MAP InjCrv_tiPiI1ETSCor1EOM0_MAP /end REF_CHARACTERISTIC
 /begin REF_MEASUREMENT InjCrv_phiPiI1APSCor1_mp InjCrv_phiPiI1ATSCor1_mp InjCrv_phiPiI1ETSCor1_mp InjCrv_tiPiI1APSCor1_mp InjCrv_tiPiI1ATSCor1_mp InjCrv_tiPiI1ETSCor1_mp /end REF_MEASUREMENT
/end GROUP
/begin GROUP InjCrv_PiI2 "InjCrv_PiI2" /begin REF_CHARACTERISTIC InjCrv_stInjCharSetVal_C /end REF_CHARACTERISTIC /end GROUP
/begin GROUP Root_InjCrv_PiIQntAddCorEOM1 "InjCrv_PiI2AddCor/InjCrv_PiIQntAddCorEOM" /begin REF_CHARACTERISTIC InjCrv_stInjCharSetVal_C /end REF_CHARACTERISTIC /end GROUP
/begin GROUP InjCrv_PoI2 "InjCrv_PoI2" /begin REF_CHARACTERISTIC InjCrv_stInjCharSetVal_C /end REF_CHARACTERISTIC /end GROUP
/begin GROUP InjCrv_PoI2AddCor "InjCrv_PoI2AddCor" /begin REF_CHARACTERISTIC InjCrv_stInjCharSetVal_C /end REF_CHARACTERISTIC /end GROUP
/begin GROUP Root_Leakage "Rail_PreCtlMeUn/Leakage" /begin REF_CHARACTERISTIC Epm_numCyl_C /end REF_CHARACTERISTIC /end GROUP
/begin GROUP S1_q2dvol "Rail_PreCtlMeUn/Governor_Precontrol/q2dvol" /begin REF_CHARACTERISTIC Epm_numCyl_C /end REF_CHARACTERISTIC /end GROUP
/begin GROUP S2_q2dvol "Rail_PreCtlMeUn/Injection_And_Control_Quantity/q2dvol" /begin REF_CHARACTERISTIC Epm_numCyl_C /end REF_CHARACTERISTIC /end GROUP
/begin GROUP S2_q2dvol1 "Rail_PreCtlMeUn/Injection_And_Control_Quantity/q2dvol1" /begin REF_CHARACTERISTIC Epm_numCyl_C /end REF_CHARACTERISTIC /end GROUP
/begin GROUP S1_AirPerCylCalc "AFS_VD/AFS_VD/AirPerCylCalc" /begin REF_CHARACTERISTIC Epm_numCyl_C /end REF_CHARACTERISTIC /end GROUP
/begin RECORD_LAYOUT Scalar_BOOLEAN FNC_VALUES 1 UBYTE COLUMN_DIR DIRECT /end RECORD_LAYOUT
/begin RECORD_LAYOUT Scalar_UBYTE FNC_VALUES 1 UBYTE COLUMN_DIR DIRECT /end RECORD_LAYOUT
/begin RECORD_LAYOUT Scalar_UWORD FNC_VALUES 1 UWORD COLUMN_DIR DIRECT /end RECORD_LAYOUT
/begin RECORD_LAYOUT Scalar_SWORD FNC_VALUES 1 SWORD COLUMN_DIR DIRECT /end RECORD_LAYOUT
/begin RECORD_LAYOUT Scalar_ULONG FNC_VALUES 1 ULONG COLUMN_DIR DIRECT /end RECORD_LAYOUT
/begin RECORD_LAYOUT Scalar_LONG FNC_VALUES 1 SLONG COLUMN_DIR DIRECT /end RECORD_LAYOUT
/begin RECORD_LAYOUT Lookup1D_BYTE FNC_VALUES 1 SBYTE COLUMN_DIR DIRECT /end RECORD_LAYOUT
/begin RECORD_LAYOUT Lookup1D_X_BYTE AXIS_PTS_X 1 SBYTE INDEX_INCR DIRECT /end RECORD_LAYOUT
/begin RECORD_LAYOUT Lookup1D_X_UWORD AXIS_PTS_X 1 UWORD INDEX_INCR DIRECT /end RECORD_LAYOUT
/begin RECORD_LAYOUT Lookup1D_WORD FNC_VALUES 1 SWORD COLUMN_DIR DIRECT /end RECORD_LAYOUT
/begin RECORD_LAYOUT Lookup1D_X_WORD AXIS_PTS_X 1 SWORD INDEX_INCR DIRECT /end RECORD_LAYOUT
/begin RECORD_LAYOUT Lookup1D_ULONG FNC_VALUES 1 ULONG COLUMN_DIR DIRECT /end RECORD_LAYOUT
/begin RECORD_LAYOUT Lookup1D_X_LONG AXIS_PTS_X 1 SLONG INDEX_INCR DIRECT /end RECORD_LAYOUT
/begin RECORD_LAYOUT Lookup2D_WORD FNC_VALUES 1 SWORD COLUMN_DIR DIRECT /end RECORD_LAYOUT
/begin RECORD_LAYOUT Lookup2D_X_WORD AXIS_PTS_X 1 SWORD INDEX_INCR DIRECT /end RECORD_LAYOUT
/begin RECORD_LAYOUT Lookup2D_ULONG FNC_VALUES 1 ULONG COLUMN_DIR DIRECT /end RECORD_LAYOUT
/end MODULE
/end PROJECT
