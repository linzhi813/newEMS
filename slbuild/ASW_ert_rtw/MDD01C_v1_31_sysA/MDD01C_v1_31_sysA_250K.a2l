ASAP2_VERSION 1 51
/begin PROJECT XCPDemo ""
/begin MODULE XCP ""
/begin MOD_COMMON "" BYTE_ORDER MSB_FIRST ALIGNMENT_BYTE 1 ALIGNMENT_WORD 1 ALIGNMENT_LONG 1 ALIGNMENT_FLOAT32_IEEE 1 ALIGNMENT_FLOAT64_IEEE 1 /end MOD_COMMON
/begin CHARACTERISTIC CoEng_tiNrml2Strt_C "Debounce time of engine state transition from NORMAL to START" VALUE 0x386720 Scalar_ULONG 0 EngTime_ms 0.0 65535.0 /end CHARACTERISTIC
/begin CHARACTERISTIC CoEng_nThresCranking_C "Threshold of engine speed for transition from COENG_REAND to COENG_CRANKING" VALUE 0x38671A Scalar_SWORD 0 EngSpeed_rpm 0.0 12799.0 /end CHARACTERISTIC
/begin CHARACTERISTIC CoEng_nThresNrml2Strt_C "Threshold of engine speed for transition from COENG_NORMAL to START" VALUE 0x38671C Scalar_SWORD 0 EngSpeed_rpm 0.0 12799.0 /end CHARACTERISTIC
/begin CHARACTERISTIC CoEng_stEngStop_C "Bit coded output message from engine stop function for low idle, egine shut off and crank control" VALUE 0x38671E Scalar_UBYTE 0 State_uint8 0.0 255.0 /end CHARACTERISTIC
/begin CHARACTERISTIC CoTemp_rClgDes_C "Cooling requirement of the combustion engine" VALUE 0x3867EE Scalar_SWORD 0 Prc_100_rate -300.0 300.0 /end CHARACTERISTIC
/begin CHARACTERISTIC CoTemp_tEngDes_C "Coolant temperature of combustion engine" VALUE 0x3867F0 Scalar_SWORD 0 Temp_deg -3549.0 3003.0 /end CHARACTERISTIC
/begin CHARACTERISTIC ASDdc_vLimIni_C "ASD disturbance compensator speed limit for initialisation / deactivation" VALUE 0x380C62 Scalar_SWORD 0 VehSpeed_km_h 0.0 250.0 /end CHARACTERISTIC
/begin CHARACTERISTIC ASDdc_trqLimMax_C "ASD disturbance compensator output limitation minximum" VALUE 0x380C5E Scalar_SWORD 0 Trq_Nm -3000.0 3000.0 /end CHARACTERISTIC
/begin CHARACTERISTIC ASDdc_trqLimMin_C "ASD disturbance compensator output limitation maximum" VALUE 0x380C60 Scalar_SWORD 0 Trq_Nm -3000.0 3000.0 /end CHARACTERISTIC
/begin CHARACTERISTIC PthSet_trqASDdcInit_C "Initialisation value for disturbance control when overridung overrun shut off" VALUE 0x395A44 Scalar_SWORD 0 Trq_Nm -3000.0 3000.0 /end CHARACTERISTIC
/begin CHARACTERISTIC ASDdc_DT1GovGear0_CUR "ASDrf gear 0 DT1 parameter" CURVE 0x380A7E Lookup1D_UWORD 0 RailDT1_ms 0.0 65535.0
 /begin AXIS_DESCR COM_AXIS Epm_nEng EngSpeed_rpm 10 -6000.0 6000.0 AXIS_PTS_REF ASDdc_DT1GovGear0_CURX /end AXIS_DESCR
/end CHARACTERISTIC
/begin CHARACTERISTIC ASDdc_DT1GovGear1_CUR "ASDrf gear 1 DT1 parameter" CURVE 0x380AA6 Lookup1D_UWORD 0 RailDT1_ms 0.0 65535.0
 /begin AXIS_DESCR COM_AXIS Epm_nEng EngSpeed_rpm 10 -6000.0 6000.0 AXIS_PTS_REF ASDdc_DT1GovGear1_CURX /end AXIS_DESCR
/end CHARACTERISTIC
/begin CHARACTERISTIC ASDdc_DT1GovGear2_CUR "ASDrf gear 2 DT1 parameter" CURVE 0x380ACE Lookup1D_UWORD 0 RailDT1_ms 0.0 65535.0
 /begin AXIS_DESCR COM_AXIS Epm_nEng EngSpeed_rpm 10 -6000.0 6000.0 AXIS_PTS_REF ASDdc_DT1GovGear2_CURX /end AXIS_DESCR
/end CHARACTERISTIC
/begin CHARACTERISTIC ASDdc_DT1GovGear3_CUR "ASDrf gear 3 DT1 parameter" CURVE 0x380AF6 Lookup1D_UWORD 0 RailDT1_ms 0.0 65535.0
 /begin AXIS_DESCR COM_AXIS Epm_nEng EngSpeed_rpm 10 -6000.0 6000.0 AXIS_PTS_REF ASDdc_DT1GovGear3_CURX /end AXIS_DESCR
/end CHARACTERISTIC
/begin CHARACTERISTIC ASDdc_DT1GovGear4_CUR "ASDrf gear 4DT1 parameter" CURVE 0x380B1E Lookup1D_UWORD 0 RailDT1_ms 0.0 65535.0
 /begin AXIS_DESCR COM_AXIS Epm_nEng EngSpeed_rpm 10 -6000.0 6000.0 AXIS_PTS_REF ASDdc_DT1GovGear4_CURX /end AXIS_DESCR
/end CHARACTERISTIC
/begin CHARACTERISTIC ASDdc_DT1GovGear5_CUR "ASDrf gear 5 DT1 parameter" CURVE 0x380B46 Lookup1D_UWORD 0 RailDT1_ms 0.0 65535.0
 /begin AXIS_DESCR COM_AXIS Epm_nEng EngSpeed_rpm 10 -6000.0 6000.0 AXIS_PTS_REF ASDdc_DT1GovGear5_CURX /end AXIS_DESCR
/end CHARACTERISTIC
/begin CHARACTERISTIC ASDdc_KdGovGear0_CUR "ASDrf gear 0 Kd  factor parameter" CURVE 0x380B6E Lookup1D_UWORD 0 Pid_Kp_Kd 0.0 15.0
 /begin AXIS_DESCR COM_AXIS Epm_nEng EngSpeed_rpm 10 -6000.0 6000.0 AXIS_PTS_REF ASDdc_KdGovGear0_CURX /end AXIS_DESCR
/end CHARACTERISTIC
/begin CHARACTERISTIC ASDdc_KdGovGear1_CUR "ASDrf gear 1 Kd  factor parameter" CURVE 0x380B96 Lookup1D_UWORD 0 Pid_Kp_Kd 0.0 15.0
 /begin AXIS_DESCR COM_AXIS Epm_nEng EngSpeed_rpm 10 -6000.0 6000.0 AXIS_PTS_REF ASDdc_KdGovGear1_CURX /end AXIS_DESCR
/end CHARACTERISTIC
/begin CHARACTERISTIC ASDdc_KdGovGear2_CUR "ASDrf gear 2 Kd  factor parameter" CURVE 0x380BBE Lookup1D_UWORD 0 Pid_Kp_Kd 0.0 15.0
 /begin AXIS_DESCR COM_AXIS Epm_nEng EngSpeed_rpm 10 -6000.0 6000.0 AXIS_PTS_REF ASDdc_KdGovGear2_CURX /end AXIS_DESCR
/end CHARACTERISTIC
/begin CHARACTERISTIC ASDdc_KdGovGear3_CUR "ASDrf gear 3 Kd  factor parameter" CURVE 0x380BE6 Lookup1D_UWORD 0 Pid_Kp_Kd 0.0 15.0
 /begin AXIS_DESCR COM_AXIS Epm_nEng EngSpeed_rpm 10 -6000.0 6000.0 AXIS_PTS_REF ASDdc_KdGovGear3_CURX /end AXIS_DESCR
/end CHARACTERISTIC
/begin CHARACTERISTIC ASDdc_KdGovGear4_CUR "ASDrf gear 4 Kd  factor parameter" CURVE 0x380C0E Lookup1D_UWORD 0 Pid_Kp_Kd 0.0 15.0
 /begin AXIS_DESCR COM_AXIS Epm_nEng EngSpeed_rpm 10 -6000.0 6000.0 AXIS_PTS_REF ASDdc_KdGovGear4_CURX /end AXIS_DESCR
/end CHARACTERISTIC
/begin CHARACTERISTIC ASDdc_KdGovGear5_CUR "ASDdc gear 5 Kd  factor parameter" CURVE 0x380C36 Lookup1D_UWORD 0 Pid_Kp_Kd 0.0 15.0
 /begin AXIS_DESCR COM_AXIS Epm_nEng EngSpeed_rpm 10 -6000.0 6000.0 AXIS_PTS_REF ASDdc_KdGovGear5_CURX /end AXIS_DESCR
/end CHARACTERISTIC
/begin AXIS_PTS ASDdc_DT1GovGear0_CURX "Group axis for engine speed" 0x380A92 Epm_nEng Lookup1D_X_WORD 0 EngSpeed_rpm 10 -6000.0 6000.0 /end AXIS_PTS
/begin AXIS_PTS ASDdc_DT1GovGear1_CURX "Group axis for engine speed" 0x380ABA Epm_nEng Lookup1D_X_WORD 0 EngSpeed_rpm 10 -6000.0 6000.0 /end AXIS_PTS
/begin AXIS_PTS ASDdc_DT1GovGear2_CURX "Group axis for engine speed" 0x380AE2 Epm_nEng Lookup1D_X_WORD 0 EngSpeed_rpm 10 -6000.0 6000.0 /end AXIS_PTS
/begin AXIS_PTS ASDdc_DT1GovGear3_CURX "Group axis for engine speed" 0x380B0A Epm_nEng Lookup1D_X_WORD 0 EngSpeed_rpm 10 -6000.0 6000.0 /end AXIS_PTS
/begin AXIS_PTS ASDdc_DT1GovGear4_CURX "Group axis for engine speed" 0x380B32 Epm_nEng Lookup1D_X_WORD 0 EngSpeed_rpm 10 -6000.0 6000.0 /end AXIS_PTS
/begin AXIS_PTS ASDdc_DT1GovGear5_CURX "Group axis for engine speed" 0x380B5A Epm_nEng Lookup1D_X_WORD 0 EngSpeed_rpm 10 -6000.0 6000.0 /end AXIS_PTS
/begin AXIS_PTS ASDdc_KdGovGear0_CURX "Group axis for engine speed" 0x380B82 Epm_nEng Lookup1D_X_WORD 0 EngSpeed_rpm 10 -6000.0 6000.0 /end AXIS_PTS
/begin AXIS_PTS ASDdc_KdGovGear1_CURX "Group axis for engine speed" 0x380BAA Epm_nEng Lookup1D_X_WORD 0 EngSpeed_rpm 10 -6000.0 6000.0 /end AXIS_PTS
/begin AXIS_PTS ASDdc_KdGovGear2_CURX "Group axis for engine speed" 0x380BD2 Epm_nEng Lookup1D_X_WORD 0 EngSpeed_rpm 10 -6000.0 6000.0 /end AXIS_PTS
/begin AXIS_PTS ASDdc_KdGovGear3_CURX "Group axis for engine speed" 0x380BFA Epm_nEng Lookup1D_X_WORD 0 EngSpeed_rpm 10 -6000.0 6000.0 /end AXIS_PTS
/begin AXIS_PTS ASDdc_KdGovGear4_CURX "Group axis for engine speed" 0x380C22 Epm_nEng Lookup1D_X_WORD 0 EngSpeed_rpm 10 -6000.0 6000.0 /end AXIS_PTS
/begin AXIS_PTS ASDdc_KdGovGear5_CURX "Group axis for engine speed" 0x380C4A Epm_nEng Lookup1D_X_WORD 0 EngSpeed_rpm 10 -6000.0 6000.0 /end AXIS_PTS
/begin CHARACTERISTIC ASDrf_trqSteepNeg_C "Threshold (pos.) for initialization of reference filter for steep input gradients" VALUE 0x380E48 Scalar_SWORD 0 Trq_Nm -3000.0 3000.0 /end CHARACTERISTIC
/begin CHARACTERISTIC ASDrf_trqSteepPos_C "Threshold (neg) for initialization of reference filter for steep input gradients" VALUE 0x380E4A Scalar_SWORD 0 Trq_Nm -3000.0 3000.0 /end CHARACTERISTIC
/begin CHARACTERISTIC ASDrf_trqThresNeg_C "ASD reference filter hsyteresis threshold torque gradient negative" VALUE 0x380E4C Scalar_SWORD 0 Trq_Nm -3000.0 3000.0 /end CHARACTERISTIC
/begin CHARACTERISTIC ASDrf_trqThresPos_C "ASD reference filter hsyteresis threshold torque gradient positive" VALUE 0x380E4E Scalar_SWORD 0 Trq_Nm -3000.0 3000.0 /end CHARACTERISTIC
/begin CHARACTERISTIC ASDrf_KpFltCurr_C "Configuration of input condition \"gearswitch activ\"" VALUE 0x380C64 Scalar_UWORD 0 Pid_Kp_Kd 0.0 15.0 /end CHARACTERISTIC
/begin CHARACTERISTIC ASDrf_swtLim_C "Switch to choose limitation of ASDrf_trqInr to CoETS_trqInrLtd" VALUE 0x380E46 Scalar_UBYTE 0 State_uint8 0.0 255.0 /end CHARACTERISTIC
/begin CHARACTERISTIC ASDrf_swtSpdGovCor_C "Switch for activation/deactivation of Speed Governor compensation " VALUE 0x380E47 Scalar_UBYTE 0 State_uint8 0.0 255.0 /end CHARACTERISTIC
/begin CHARACTERISTIC ASDrf_facGovNegGear0_CUR "ASDrf gear 0 negative  factor parameter" CURVE 0x380C66 Lookup1D_UWORD 0 PT_fac 0.0 99.9
 /begin AXIS_DESCR COM_AXIS Epm_nEng EngSpeed_rpm 10 -6000.0 6000.0 AXIS_PTS_REF ASDrf_facGovNegGear0_CURX /end AXIS_DESCR
/end CHARACTERISTIC
/begin CHARACTERISTIC ASDrf_facGovNegGear1_CUR "ASDrf gear 1 negative  factor parameter" CURVE 0x380C8E Lookup1D_UWORD 0 PT_fac 0.0 99.9
 /begin AXIS_DESCR COM_AXIS Epm_nEng EngSpeed_rpm 10 -6000.0 6000.0 AXIS_PTS_REF ASDrf_facGovNegGear1_CURX /end AXIS_DESCR
/end CHARACTERISTIC
/begin CHARACTERISTIC ASDrf_facGovNegGear2_CUR "ASDrf gear 2 negative  factor parameter" CURVE 0x380CB6 Lookup1D_UWORD 0 PT_fac 0.0 99.9
 /begin AXIS_DESCR COM_AXIS Epm_nEng EngSpeed_rpm 10 -6000.0 6000.0 AXIS_PTS_REF ASDrf_facGovNegGear2_CURX /end AXIS_DESCR
/end CHARACTERISTIC
/begin CHARACTERISTIC ASDrf_facGovNegGear3_CUR "ASDrf gear 3 negative  factor parameter" CURVE 0x380CDE Lookup1D_UWORD 0 PT_fac 0.0 99.9
 /begin AXIS_DESCR COM_AXIS Epm_nEng EngSpeed_rpm 10 -6000.0 6000.0 AXIS_PTS_REF ASDrf_facGovNegGear3_CURX /end AXIS_DESCR
/end CHARACTERISTIC
/begin CHARACTERISTIC ASDrf_facGovNegGear4_CUR "ASDrf gear 4 negative  factor parameter" CURVE 0x380D06 Lookup1D_UWORD 0 PT_fac 0.0 99.9
 /begin AXIS_DESCR COM_AXIS Epm_nEng EngSpeed_rpm 10 -6000.0 6000.0 AXIS_PTS_REF ASDrf_facGovNegGear4_CURX /end AXIS_DESCR
/end CHARACTERISTIC
/begin CHARACTERISTIC ASDrf_facGovNegGear5_CUR "ASDrf gear 5 negative  factor parameter" CURVE 0x380D2E Lookup1D_UWORD 0 PT_fac 0.0 99.9
 /begin AXIS_DESCR COM_AXIS Epm_nEng EngSpeed_rpm 10 -6000.0 6000.0 AXIS_PTS_REF ASDrf_facGovNegGear5_CURX /end AXIS_DESCR
/end CHARACTERISTIC
/begin CHARACTERISTIC ASDrf_facGovPosGear0_CUR "ASDrf gear 0 negative  factor parameter" CURVE 0x380D56 Lookup1D_UWORD 0 PT_fac 0.0 99.9
 /begin AXIS_DESCR COM_AXIS Epm_nEng EngSpeed_rpm 10 -6000.0 6000.0 AXIS_PTS_REF ASDrf_facGovPosGear0_CURX /end AXIS_DESCR
/end CHARACTERISTIC
/begin CHARACTERISTIC ASDrf_facGovPosGear1_CUR "ASDrf gear 1 negative  factor parameter" CURVE 0x380D7E Lookup1D_UWORD 0 PT_fac 0.0 99.9
 /begin AXIS_DESCR COM_AXIS Epm_nEng EngSpeed_rpm 10 -6000.0 6000.0 AXIS_PTS_REF ASDrf_facGovPosGear1_CURX /end AXIS_DESCR
/end CHARACTERISTIC
/begin CHARACTERISTIC ASDrf_facGovPosGear2_CUR "ASDrf gear 2 negative  factor parameter" CURVE 0x380DA6 Lookup1D_UWORD 0 PT_fac 0.0 99.9
 /begin AXIS_DESCR COM_AXIS Epm_nEng EngSpeed_rpm 10 -6000.0 6000.0 AXIS_PTS_REF ASDrf_facGovPosGear2_CURX /end AXIS_DESCR
/end CHARACTERISTIC
/begin CHARACTERISTIC ASDrf_facGovPosGear3_CUR "ASDrf gear 3 negative  factor parameter" CURVE 0x380DCE Lookup1D_UWORD 0 PT_fac 0.0 99.9
 /begin AXIS_DESCR COM_AXIS Epm_nEng EngSpeed_rpm 10 -6000.0 6000.0 AXIS_PTS_REF ASDrf_facGovPosGear3_CURX /end AXIS_DESCR
/end CHARACTERISTIC
/begin CHARACTERISTIC ASDrf_facGovPosGear4_CUR "ASDrf gear 4 negative  factor parameter" CURVE 0x380DF6 Lookup1D_UWORD 0 PT_fac 0.0 99.9
 /begin AXIS_DESCR COM_AXIS Epm_nEng EngSpeed_rpm 10 -6000.0 6000.0 AXIS_PTS_REF ASDrf_facGovPosGear4_CURX /end AXIS_DESCR
/end CHARACTERISTIC
/begin CHARACTERISTIC ASDrf_facGovPosGear5_CUR "ASDrf gear 5 negative  factor parameter" CURVE 0x380E1E Lookup1D_UWORD 0 PT_fac 0.0 99.9
 /begin AXIS_DESCR COM_AXIS Epm_nEng EngSpeed_rpm 10 -6000.0 6000.0 AXIS_PTS_REF ASDrf_facGovPosGear5_CURX /end AXIS_DESCR
/end CHARACTERISTIC
/begin AXIS_PTS ASDrf_facGovNegGear0_CURX "Group axis for engine speed" 0x380C7A Epm_nEng Lookup1D_X_WORD 0 EngSpeed_rpm 10 -6000.0 6000.0 /end AXIS_PTS
/begin AXIS_PTS ASDrf_facGovNegGear1_CURX "Group axis for engine speed" 0x380CA2 Epm_nEng Lookup1D_X_WORD 0 EngSpeed_rpm 10 -6000.0 6000.0 /end AXIS_PTS
/begin AXIS_PTS ASDrf_facGovNegGear2_CURX "Group axis for engine speed" 0x380CCA Epm_nEng Lookup1D_X_WORD 0 EngSpeed_rpm 10 -6000.0 6000.0 /end AXIS_PTS
/begin AXIS_PTS ASDrf_facGovNegGear3_CURX "Group axis for engine speed" 0x380CF2 Epm_nEng Lookup1D_X_WORD 0 EngSpeed_rpm 10 -6000.0 6000.0 /end AXIS_PTS
/begin AXIS_PTS ASDrf_facGovNegGear4_CURX "Group axis for engine speed" 0x380D1A Epm_nEng Lookup1D_X_WORD 0 EngSpeed_rpm 10 -6000.0 6000.0 /end AXIS_PTS
/begin AXIS_PTS ASDrf_facGovNegGear5_CURX "Group axis for engine speed" 0x380D42 Epm_nEng Lookup1D_X_WORD 0 EngSpeed_rpm 10 -6000.0 6000.0 /end AXIS_PTS
/begin AXIS_PTS ASDrf_facGovPosGear0_CURX "Group axis for engine speed" 0x380D6A Epm_nEng Lookup1D_X_WORD 0 EngSpeed_rpm 10 -6000.0 6000.0 /end AXIS_PTS
/begin AXIS_PTS ASDrf_facGovPosGear1_CURX "Group axis for engine speed" 0x380D92 Epm_nEng Lookup1D_X_WORD 0 EngSpeed_rpm 10 -6000.0 6000.0 /end AXIS_PTS
/begin AXIS_PTS ASDrf_facGovPosGear2_CURX "Group axis for engine speed" 0x380DBA Epm_nEng Lookup1D_X_WORD 0 EngSpeed_rpm 10 -6000.0 6000.0 /end AXIS_PTS
/begin AXIS_PTS ASDrf_facGovPosGear3_CURX "Group axis for engine speed" 0x380DE2 Epm_nEng Lookup1D_X_WORD 0 EngSpeed_rpm 10 -6000.0 6000.0 /end AXIS_PTS
/begin AXIS_PTS ASDrf_facGovPosGear4_CURX "Group axis for engine speed" 0x380E0A Epm_nEng Lookup1D_X_WORD 0 EngSpeed_rpm 10 -6000.0 6000.0 /end AXIS_PTS
/begin AXIS_PTS ASDrf_facGovPosGear5_CURX "Group axis for engine speed" 0x380E32 Epm_nEng Lookup1D_X_WORD 0 EngSpeed_rpm 10 -6000.0 6000.0 /end AXIS_PTS
/begin CHARACTERISTIC CoETS_trqNTCInrAct_C "Actual braking torque" VALUE 0x386714 Scalar_SWORD 0 Trq_Nm -3276.8 3276.7 /end CHARACTERISTIC
/begin CHARACTERISTIC CoETS_trqNTCInrMax_C "Maximum available braking torque" VALUE 0x386716 Scalar_SWORD 0 Trq_Nm -3276.8 3276.7 /end CHARACTERISTIC
/begin CHARACTERISTIC CoETS_trqNTCLim_C "NTC torque limitation (0 in braking, ramped to max in braked to fired" VALUE 0x386718 Scalar_SWORD 0 Trq_Nm 0.0 1000.0 /end CHARACTERISTIC
/begin CHARACTERISTIC CoETS_trqDiffMaxLim_C "Maximum difference allowable, between active and second lowest torque limitation to validate the active limitation" VALUE 0x38670C Scalar_SWORD 0 Trq_Nm -3276.8 3276.7 /end CHARACTERISTIC
/begin CHARACTERISTIC CoETS_trqInrCurrMinLim_C "current inner minimum limitation torque" VALUE 0x38670E Scalar_SWORD 0 Trq_Nm -3276.8 3276.7 /end CHARACTERISTIC
/begin CHARACTERISTIC CoETS_nTrqRatMin_C "Threshold for calculation of torque ratio" VALUE 0x3866C0 Scalar_SWORD 0 EngSpeed_rpm -12000.0 12000.0 /end CHARACTERISTIC
/begin CHARACTERISTIC Rail_stLimDetSetPoint_C "State of rail pressure control" VALUE 0x39776D Scalar_UBYTE 0 State_uint8 0.0 255.0 /end CHARACTERISTIC
/begin CHARACTERISTIC CoETS_tiSetTimeTSEReq_CUR "Time threshold to act  EngSpdn correction" CURVE 0x3866DC Lookup1D_SLONG 0 TimeEngOn_s 0.0 2.14748E+9
 /begin AXIS_DESCR COM_AXIS NO_INPUT_QUANTITY Temp_deg 8 -45.0 200.0 AXIS_PTS_REF CoETS_tiSetTimeTSEReq_CURX /end AXIS_DESCR
/end CHARACTERISTIC
/begin CHARACTERISTIC CoETS_tiEngEmgcyRunTime_C "Time threshold to act  Engine emergency running" VALUE 0x3866D0 Scalar_LONG 0 TimeEngOn_s 0.0 2.14748E+9 /end CHARACTERISTIC
/begin CHARACTERISTIC CoETS_tiEngEmgcyStartTime_C "Time threshold to act  Engine emergency start" VALUE 0x3866D4 Scalar_LONG 0 TimeEngOn_s 0.0 2.14748E+9 /end CHARACTERISTIC
/begin CHARACTERISTIC CoETS_tiEngLockTime_C "Time threshold to act  EngSp limit" VALUE 0x3866D8 Scalar_LONG 0 TimeEngOn_s 0.0 2.14748E+9 /end CHARACTERISTIC
/begin CHARACTERISTIC CoETS_ctEngEmgcyRunCnt_C "Engine emergency running count limit" VALUE 0x3866B8 Scalar_ULONG 0 Counter_num 0.0 1000.0 /end CHARACTERISTIC
/begin CHARACTERISTIC CoETS_nTSCRmpSlopeNeg_C "Ramp parameter set for  TSC1 Engspeed  / Negative ramp step " VALUE 0x3866BC Scalar_SWORD 0 EngSpeed_rpm_s 0.0 2000.0 /end CHARACTERISTIC
/begin CHARACTERISTIC CoETS_nTSCRmpSlopePos_C "Ramp parameter set for  TSC1 Engspeed  / Positive ramp step " VALUE 0x3866BE Scalar_SWORD 0 EngSpeed_rpm_s 0.0 2000.0 /end CHARACTERISTIC
/begin CHARACTERISTIC EngPrt_nRateSp_C "rated engine speed" VALUE 0x387FBA Scalar_SWORD 0 EngSpeed_rpm 0.0 6000.0 /end CHARACTERISTIC
/begin CHARACTERISTIC Gps_nSpdLmt_C "Requested speed / speed limit by Tbox message bypass" VALUE 0x389E38 Scalar_SWORD 0 EngSpeed_rpm 0.0 6000.0 /end CHARACTERISTIC
/begin CHARACTERISTIC TSC_nAEDes_C "Requested speed / speed limit by TSC1-AE message" VALUE 0x39ADF0 Scalar_SWORD 0 EngSpeed_rpm 0.0 6000.0 /end CHARACTERISTIC
/begin CHARACTERISTIC TSC_nDEDes_C "Requested speed / speed limit by TSC1-DE message" VALUE 0x39ADF2 Scalar_SWORD 0 EngSpeed_rpm 0.0 6000.0 /end CHARACTERISTIC
/begin CHARACTERISTIC TSC_nPEDes_C "Requested speed / speed limit by TSC1-PE message" VALUE 0x39ADF4 Scalar_SWORD 0 EngSpeed_rpm 0.0 6000.0 /end CHARACTERISTIC
/begin CHARACTERISTIC TSC_nTEDes_C "Requested speed / speed limit by TSC1-TE message" VALUE 0x39ADF6 Scalar_SWORD 0 EngSpeed_rpm 0.0 6000.0 /end CHARACTERISTIC
/begin CHARACTERISTIC TSC_nVEDes_C "Requested speed / speed limit by TSC1-VE message" VALUE 0x39ADF8 Scalar_SWORD 0 EngSpeed_rpm 0.0 6000.0 /end CHARACTERISTIC
/begin CHARACTERISTIC CoETS_TrqTSCRmpSlopeNeg_C "Ramp parameter set for  TSC1 Torque / Negative ramp step " VALUE 0x3866B4 Scalar_SWORD 0 Trq_Nm_s 0.0 3276.0 /end CHARACTERISTIC
/begin CHARACTERISTIC CoETS_TrqTSCRmpSlopePos_C "Ramp parameter set for  TSC1 Torque / Positive ramp step " VALUE 0x3866B6 Scalar_SWORD 0 Trq_Nm_s 0.0 3276.0 /end CHARACTERISTIC
/begin CHARACTERISTIC CoETS_tEngEmgcyRunTemp_C "temperature threshold to act  Engine emergency start" VALUE 0x3866CE Scalar_SWORD 0 Temp_deg -50.0 200.0 /end CHARACTERISTIC
/begin CHARACTERISTIC CoETS_numTSEAPrioAE_C "Priority number of VMC TSC1 incoming message" VALUE 0x3866C2 Scalar_UBYTE 0 State_uint8 0.0 3.0 /end CHARACTERISTIC
/begin CHARACTERISTIC CoETS_numTSEAPrioDE_C "Priority number of VMC TSC1 incoming message" VALUE 0x3866C3 Scalar_UBYTE 0 State_uint8 0.0 3.0 /end CHARACTERISTIC
/begin CHARACTERISTIC CoETS_numTSEAPrioGpsLim_C "Priority number of Tbox incoming message" VALUE 0x3866C4 Scalar_UBYTE 0 State_uint8 0.0 3.0 /end CHARACTERISTIC
/begin CHARACTERISTIC CoETS_numTSEAPrioPE_C "Priority number of VMC TSC1 incoming message" VALUE 0x3866C5 Scalar_UBYTE 0 State_uint8 0.0 3.0 /end CHARACTERISTIC
/begin CHARACTERISTIC CoETS_numTSEAPrioTE_C "Priority number of VMC TSC1 incoming message" VALUE 0x3866C6 Scalar_UBYTE 0 State_uint8 0.0 3.0 /end CHARACTERISTIC
/begin CHARACTERISTIC CoETS_numTSEAPrioVE_C "Priority number of VMC TSC1 incoming message" VALUE 0x3866C7 Scalar_UBYTE 0 State_uint8 0.0 3.0 /end CHARACTERISTIC
/begin CHARACTERISTIC Ecu_stGps_Status_C "Tbox control status bypass" VALUE 0x38774E Scalar_UBYTE 0 State_uint8 0.0 255.0 /end CHARACTERISTIC
/begin CHARACTERISTIC TSC_rTrqAEDes_C "Requested torque percent / torque limit by TSC1-AE CANmessage Nm" VALUE 0x39ADFA Scalar_UBYTE 0 State_uint8 0.0 100.0 /end CHARACTERISTIC
/begin CHARACTERISTIC TSC_rTrqDEDes_C "Requested torque percent / torque limit by TSC1-DE CANmessage Nm" VALUE 0x39ADFB Scalar_UBYTE 0 State_uint8 0.0 100.0 /end CHARACTERISTIC
/begin CHARACTERISTIC TSC_rTrqPEDes_C "Requested torque percent / torque limit by TSC1-PE CANmessage Nm" VALUE 0x39ADFC Scalar_UBYTE 0 State_uint8 0.0 100.0 /end CHARACTERISTIC
/begin CHARACTERISTIC TSC_rTrqTEDes_C "Requested torque percent / torque limit by TSC1-TE CANmessage Nm" VALUE 0x39ADFD Scalar_UBYTE 0 State_uint8 0.0 100.0 /end CHARACTERISTIC
/begin CHARACTERISTIC TSC_rTrqVEDes_C "Requested torque percent / torque limit by TSC1-VE CANmessage Nm" VALUE 0x39ADFE Scalar_UBYTE 0 State_uint8 0.0 100.0 /end CHARACTERISTIC
/begin CHARACTERISTIC TSC_stAEErr_C "Error status of receiving the TSC1-AE CAN message" VALUE 0x39ADFF Scalar_UBYTE 0 State_uint8 0.0 1.0 /end CHARACTERISTIC
/begin CHARACTERISTIC TSC_stAEMode_C "Override control mode of TSC1-AE CAN message" VALUE 0x39AE00 Scalar_UBYTE 0 State_uint8 0.0 255.0 /end CHARACTERISTIC
/begin CHARACTERISTIC TSC_stDEErr_C "Error status of receiving the TSC1-DE CAN message" VALUE 0x39AE01 Scalar_UBYTE 0 State_uint8 0.0 1.0 /end CHARACTERISTIC
/begin CHARACTERISTIC TSC_stDEMode_C "Override control mode of TSC1-DE CAN message" VALUE 0x39AE02 Scalar_UBYTE 0 State_uint8 0.0 255.0 /end CHARACTERISTIC
/begin CHARACTERISTIC TSC_stPEErr_C "Error status of receiving the TSC1-PE CAN message" VALUE 0x39AE04 Scalar_UBYTE 0 State_uint8 0.0 1.0 /end CHARACTERISTIC
/begin CHARACTERISTIC TSC_stPEMode_C "Override control mode of TSC1-PE CAN message" VALUE 0x39AE05 Scalar_UBYTE 0 State_uint8 0.0 255.0 /end CHARACTERISTIC
/begin CHARACTERISTIC TSC_stTEErr_C "Error status of receiving the TSC1-TE CAN message" VALUE 0x39AE06 Scalar_UBYTE 0 State_uint8 0.0 1.0 /end CHARACTERISTIC
/begin CHARACTERISTIC TSC_stTEMode_C "Override control mode of TSC1-TE CAN message" VALUE 0x39AE07 Scalar_UBYTE 0 State_uint8 0.0 255.0 /end CHARACTERISTIC
/begin CHARACTERISTIC TSC_stVEErr_C "Error status of receiving the TSC1-VE CAN message" VALUE 0x39AE08 Scalar_UBYTE 0 State_uint8 0.0 1.0 /end CHARACTERISTIC
/begin CHARACTERISTIC TSC_stVEMode_C "Override control mode of TSC1-VE CAN message" VALUE 0x39AE09 Scalar_UBYTE 0 State_uint8 0.0 255.0 /end CHARACTERISTIC
/begin CHARACTERISTIC CoETS_stEngEmgcyRunEN_C "Enable Engine emergency running" VALUE 0x3866C8 Scalar_BOOLEAN 0 boolean 0.0 1.0 /end CHARACTERISTIC
/begin CHARACTERISTIC CoETS_stStartRelayCtrl_C "Start Relay Control by ECU or not(1-ecu 0-key)" VALUE 0x3866C9 Scalar_BOOLEAN 0 boolean 0.0 1.0 /end CHARACTERISTIC
/begin CHARACTERISTIC CoETS_stTSEATrqSpd_C "Enhanced torque speed control priority mode selection" VALUE 0x3866CA Scalar_BOOLEAN 0 boolean 0.0 1.0 /end CHARACTERISTIC
/begin CHARACTERISTIC CoETS_stTboxUse_C "Tbox USED" VALUE 0x3866CB Scalar_BOOLEAN 0 boolean 0.0 1.0 /end CHARACTERISTIC
/begin CHARACTERISTIC TSC_stModeBypassEN_C "" VALUE 0x39AE03 Scalar_BOOLEAN 0 boolean 0.0 1.0 /end CHARACTERISTIC
/begin CHARACTERISTIC CoETS_swtTempSel_C "0-coolant_temperature 1-oil_temperature 2-EngDa_tEng" VALUE 0x3866CC Scalar_UBYTE 0 EngTempFldSel_conv 0 2 /end CHARACTERISTIC
/begin AXIS_PTS CoETS_tiSetTimeTSEReq_CURX "Temperature used for correction factor calculation" 0x3866FC NO_INPUT_QUANTITY Lookup1D_X_WORD 0 Temp_deg 8 -45.0 200.0 /end AXIS_PTS
/begin CHARACTERISTIC CoETS_trqMaxOfsBrkDes_C "Max offset torque" VALUE 0x386710 Scalar_SWORD 0 Trq_Nm -3276.0 3276.0 /end CHARACTERISTIC
/begin CHARACTERISTIC CoETS_trqMinOfsBrkDes_C "Min offset torque" VALUE 0x386712 Scalar_SWORD 0 Trq_Nm -3276.0 3276.0 /end CHARACTERISTIC
/begin CHARACTERISTIC PthSet_trqOvrRunThres_C "Torque threshold for overrun detection" VALUE 0x395A48 Scalar_SWORD 0 Trq_Nm -3000.0 3276.7 /end CHARACTERISTIC
/begin CHARACTERISTIC PthSet_dtrqRmpDwn_CUR "curve of ramp slope" CURVE 0x3959DA Lookup1D_WORD 0 Trq_Nm_s -3000.0 3276.7
 /begin AXIS_DESCR COM_AXIS PT_rTrq TransRatio 6 -327.0 327.0 AXIS_PTS_REF PthSet_dtrqRmpDwn_CURX /end AXIS_DESCR
/end CHARACTERISTIC
/begin CHARACTERISTIC PthSet_tiRmpStrt_CUR "curve of time before start ramp" CURVE 0x3959F8 Lookup1D_ULONG 0 Debounce_ms 0.0 65535.0
 /begin AXIS_DESCR COM_AXIS PT_rTrq TransRatio 6 -327.0 327.0 AXIS_PTS_REF PthSet_tiRmpStrt_CURX /end AXIS_DESCR
/end CHARACTERISTIC
/begin CHARACTERISTIC PthSet_tiSwtOff_CUR "curve of time before switchoff" CURVE 0x395A20 Lookup1D_ULONG 0 Debounce_ms 0.0 65535.0
 /begin AXIS_DESCR COM_AXIS PT_rTrq TransRatio 6 -327.0 327.0 AXIS_PTS_REF PthSet_tiSwtOff_CURX /end AXIS_DESCR
/end CHARACTERISTIC
/begin CHARACTERISTIC PthSet_tiRmpStrtDfl_C "Default time after overrun detection until ramp starts" VALUE 0x3959F4 Scalar_ULONG 0 Debounce_ms 0.0 65535.0 /end CHARACTERISTIC
/begin CHARACTERISTIC PthSet_tiSwtOffDfl_C "Default time after overrun detection until switch off" VALUE 0x395A1C Scalar_ULONG 0 Debounce_ms 0.0 65535.0 /end CHARACTERISTIC
/begin CHARACTERISTIC PthSet_dtrqRmpDwnDfl_C "Torque ramp negative slope" VALUE 0x3959D8 Scalar_SWORD 0 Trq_Nm_s -3000.0 3276.7 /end CHARACTERISTIC
/begin CHARACTERISTIC PthSet_trqOffs_C "Offset on limitation torque value to allow ASDdc to work" VALUE 0x395A46 Scalar_SWORD 0 Trq_Nm -3000.0 3276.7 /end CHARACTERISTIC
/begin AXIS_PTS PthSet_dtrqRmpDwn_CURX "axis of ramp slope" 0x3959E6 PT_rTrq Lookup1D_X_WORD 0 TransRatio 6 -327.0 327.0 /end AXIS_PTS
/begin AXIS_PTS PthSet_tiRmpStrt_CURX "axis of time before start ramp" 0x395A10 PT_rTrq Lookup1D_X_WORD 0 TransRatio 6 -327.0 327.0 /end AXIS_PTS
/begin AXIS_PTS PthSet_tiSwtOff_CURX "axis of time before switchoff" 0x395A38 PT_rTrq Lookup1D_X_WORD 0 TransRatio 6 -327.0 327.0 /end AXIS_PTS
/begin CHARACTERISTIC EngDem_trqLimPDiff_CUR "Limitation value for the differential pressure of particulate filter." CURVE 0x3878F4 Lookup1D_WORD 0 Trq_Nm -3276.8 3276.7
 /begin AXIS_DESCR COM_AXIS EngDem_pDiffPFltPrdc_mp AirPressure_kPa 25 0.0 350.0 AXIS_PTS_REF EngDem_trqLimPDiff_CURX /end AXIS_DESCR
/end CHARACTERISTIC
/begin CHARACTERISTIC EngDem_trqLimErr1_CUR "Limiting torque curve in the event of system error" CURVE 0x387764 Lookup1D_WORD 0 Trq_Nm -3276.8 3276.7
 /begin AXIS_DESCR COM_AXIS Epm_nEng EngSpeed_rpm 25 0.0 6000.0 AXIS_PTS_REF EngDem_trqLimErr1_CURX /end AXIS_DESCR
/end CHARACTERISTIC
/begin CHARACTERISTIC EngDem_trqLimErr2_CUR "Limiting torque curve in the event of system error 2." CURVE 0x3877C8 Lookup1D_WORD 0 Trq_Nm -3276.8 3276.7
 /begin AXIS_DESCR COM_AXIS Epm_nEng EngSpeed_rpm 25 0.0 6000.0 AXIS_PTS_REF EngDem_trqLimErr2_CURX /end AXIS_DESCR
/end CHARACTERISTIC
/begin CHARACTERISTIC EngDem_trqLimErr3_CUR "Limiting torque curve in the event of system error 3." CURVE 0x38782C Lookup1D_WORD 0 Trq_Nm -3276.8 3276.7
 /begin AXIS_DESCR COM_AXIS Epm_nEng EngSpeed_rpm 25 0.0 6000.0 AXIS_PTS_REF EngDem_trqLimErr3_CURX /end AXIS_DESCR
/end CHARACTERISTIC
/begin CHARACTERISTIC EngDem_trqLimErr4_CUR "Limiting torque curve in the event of system error 4." CURVE 0x387890 Lookup1D_WORD 0 Trq_Nm -3276.8 3276.7
 /begin AXIS_DESCR COM_AXIS Epm_nEng EngSpeed_rpm 25 0.0 6000.0 AXIS_PTS_REF EngDem_trqLimErr4_CURX /end AXIS_DESCR
/end CHARACTERISTIC
/begin CHARACTERISTIC EngDem_RmpLimErrNeg_C "Coordination of the limiting torques of engine demands " VALUE 0x387752 Scalar_SWORD 0 Trq_Nm_s -1000.0 1000.0 /end CHARACTERISTIC
/begin CHARACTERISTIC EngDem_RmpLimErrPos_C "Coordination of the limiting torques of engine demands " VALUE 0x387754 Scalar_SWORD 0 Trq_Nm_s -1000.0 1000.0 /end CHARACTERISTIC
/begin CHARACTERISTIC EngDem_TrqLimErrRmpNeg_C "Slope ramp up and down (limitation in case of system error) " VALUE 0x387756 Scalar_SWORD 0 Trq_Nm_s -1000.0 1000.0 /end CHARACTERISTIC
/begin CHARACTERISTIC EngDem_TrqLimErrRmpPos_C "Slope ramp up and down (limitation in case of system error) " VALUE 0x387758 Scalar_SWORD 0 Trq_Nm_s -1000.0 1000.0 /end CHARACTERISTIC
/begin CHARACTERISTIC EngDem_facAdjMax_C "Maximum adjustment value for correction of torque limitation" VALUE 0x38775A Scalar_SWORD 0 Factor -10.0 10.0 /end CHARACTERISTIC
/begin CHARACTERISTIC EngDem_facAdjMin_C "Minimum adjustment value for correction of torque limitation" VALUE 0x38775C Scalar_SWORD 0 Factor -10.0 10.0 /end CHARACTERISTIC
/begin CHARACTERISTIC EngDem_facAdj_C "EEPROM adjustment value for correction of the limiting torque" VALUE 0x38775E Scalar_SWORD 0 Factor -10.0 10.0 /end CHARACTERISTIC
/begin CHARACTERISTIC EngDem_facDvolPT1_C "Time constant of exhatust gas volume PT1 filtering." VALUE 0x387760 Scalar_UWORD 0 PT_fac 0.0 99.9985 /end CHARACTERISTIC
/begin CHARACTERISTIC EngDem_facResFlowPT1_C "Time constant of exhaust gas flow resistance PT1 filtering." VALUE 0x387762 Scalar_UWORD 0 PT_fac 0.0 99.9985 /end CHARACTERISTIC
/begin AXIS_PTS EngDem_trqLimPDiff_CURX "EngDem_pDiffPFltPrdc_mp" 0x387926 EngDem_pDiffPFltPrdc_mp Lookup1D_X_WORD 0 AirPressure_kPa 25 0.0 350.0 /end AXIS_PTS
/begin AXIS_PTS EngDem_trqLimErr1_CURX "Epm_nEng" 0x387796 Epm_nEng Lookup1D_X_WORD 0 EngSpeed_rpm 25 0.0 6000.0 /end AXIS_PTS
/begin AXIS_PTS EngDem_trqLimErr2_CURX "Epm_nEng" 0x3877FA Epm_nEng Lookup1D_X_WORD 0 EngSpeed_rpm 25 0.0 6000.0 /end AXIS_PTS
/begin AXIS_PTS EngDem_trqLimErr3_CURX "Epm_nEng" 0x38785E Epm_nEng Lookup1D_X_WORD 0 EngSpeed_rpm 25 0.0 6000.0 /end AXIS_PTS
/begin AXIS_PTS EngDem_trqLimErr4_CURX "Epm_nEng" 0x3878C2 Epm_nEng Lookup1D_X_WORD 0 EngSpeed_rpm 25 0.0 6000.0 /end AXIS_PTS
/begin CHARACTERISTIC EngPrt_tiOvrSpdDeb_C "Duration of defect or healing debouncing for check DFC_EngPrtOvrSpd" VALUE 0x388094 Scalar_ULONG 0 Debounce_ms 0.0 65535.0 /end CHARACTERISTIC
/begin CHARACTERISTIC EngPrt_nOvrSpd_C "Threshold for overspeed detection" VALUE 0x387FB8 Scalar_SWORD 0 EngSpeed_rpm 0.0 6000.0 /end CHARACTERISTIC
/begin CHARACTERISTIC EngPrt_qLim_CUR "Curve for normal engine speed limitation (Injection quantity)" CURVE 0x387FBE Lookup1D_WORD 0 FuelMass_mg_hub -319.0 319.0
 /begin AXIS_DESCR COM_AXIS Epm_nEng EngSpeed_rpm 25 0.0 6000.0 AXIS_PTS_REF EngPrt_qLim_CURX /end AXIS_DESCR
/end CHARACTERISTIC
/begin CHARACTERISTIC EngPrt_trqLim_CUR "Curve for torque limitation (according to application inner or outer engine torque)" CURVE 0x388518 Lookup1D_WORD 0 Trq_Nm -3276.8 3276.7
 /begin AXIS_DESCR COM_AXIS Epm_nEng EngSpeed_rpm 20 0.0 6000.0 AXIS_PTS_REF EngPrt_trqLim_CURX /end AXIS_DESCR
/end CHARACTERISTIC
/begin CHARACTERISTIC EngPrt_trqNLimSpr_CUR "Curve for for engine speed limitation in case of system errors (as limitation torque)" CURVE 0x388568 Lookup1D_WORD 0 Trq_Nm -3276.8 3276.7
 /begin AXIS_DESCR COM_AXIS Epm_nEng EngSpeed_rpm 20 0.0 6000.0 AXIS_PTS_REF EngPrt_trqNLimSpr_CURX /end AXIS_DESCR
/end CHARACTERISTIC
/begin CHARACTERISTIC EngPrt_trqNLim_CUR "Curve for normal engine speed limitation (inner engine torque)" CURVE 0x3885B8 Lookup1D_WORD 0 Trq_Nm -3276.8 3276.7
 /begin AXIS_DESCR COM_AXIS Epm_nEng EngSpeed_rpm 20 0.0 6000.0 AXIS_PTS_REF EngPrt_trqNLim_CURX /end AXIS_DESCR
/end CHARACTERISTIC
/begin CHARACTERISTIC EngPrt_facTrqLimCor_MAP "Env pressure and Engine Temperature Correction value for Torque Limitation" MAP 0x387D72 Lookup2D_WORD 0 Factor -10.0 10.0
 /begin AXIS_DESCR COM_AXIS NO_INPUT_QUANTITY Temp_deg 16 -3000.0 3000.0 AXIS_PTS_REF EngPrt_facTrqLimCor_MAPX /end AXIS_DESCR
 /begin AXIS_DESCR COM_AXIS EnvP_p AirPressure_kPa 16 0.0 500.0 AXIS_PTS_REF EngPrt_facTrqLimCor_MAPY /end AXIS_DESCR
/end CHARACTERISTIC
/begin CHARACTERISTIC EngPrt_trqLimAPSCor_MAP "Torque limitation correction factor based on atmospheric pressure for engine " MAP 0x388098 Lookup2D_WORD 0 Trq_Nm -3276.8 3276.7
 /begin AXIS_DESCR COM_AXIS Epm_nEng EngSpeed_rpm 16 0.0 6000.0 AXIS_PTS_REF EngPrt_trqLimAPSCor_MAPX /end AXIS_DESCR
 /begin AXIS_DESCR COM_AXIS EnvP_p AirPressure_kPa 16 0.0 500.0 AXIS_PTS_REF EngPrt_trqLimAPSCor_MAPY /end AXIS_DESCR
/end CHARACTERISTIC
/begin CHARACTERISTIC EngPrt_trqLimEngTempCor_MAP "Engine Protection based on Engine temperature and Engine Speed" MAP 0x3882D8 Lookup2D_WORD 0 Trq_Nm -3276.8 3276.7
 /begin AXIS_DESCR COM_AXIS Epm_nEng EngSpeed_rpm 16 0.0 6000.0 AXIS_PTS_REF EngPrt_trqLimEngTempCor_MAPX /end AXIS_DESCR
 /begin AXIS_DESCR COM_AXIS NO_INPUT_QUANTITY Temp_deg 16 -3000.0 3000.0 AXIS_PTS_REF EngPrt_trqLimEngTempCor_MAPY /end AXIS_DESCR
/end CHARACTERISTIC
/begin CHARACTERISTIC EngPrt_facEngSPOffset_CUR "Curve for Engsp limation" CURVE 0x38795C Lookup1D_WORD 0 Factor 0.0 1.0
 /begin AXIS_DESCR COM_AXIS NO_INPUT_QUANTITY EngSpeed_rpm 10 -1000.0 1000.0 AXIS_PTS_REF EngPrt_facEngSPOffset_CURX /end AXIS_DESCR
/end CHARACTERISTIC
/begin CHARACTERISTIC EngPrt_nEngSplimOffset_C "engine speed  offset" VALUE 0x387FB2 Scalar_SWORD 0 EngSpeed_rpm 0.0 1000.0 /end CHARACTERISTIC
/begin CHARACTERISTIC EngPrt_nEngSplimRmpSlopeNeg_C "slope if the ramp has to be decreased" VALUE 0x387FB4 Scalar_SWORD 0 EngSpeed_rpm_s -12000.0 12000.0 /end CHARACTERISTIC
/begin CHARACTERISTIC EngPrt_nEngSplimRmpSlopePos_C "slope if the ramp has to be increased" VALUE 0x387FB6 Scalar_SWORD 0 EngSpeed_rpm_s -12000.0 12000.0 /end CHARACTERISTIC
/begin CHARACTERISTIC EngPrt_RmpLimNErrNeg_C "negative (.Neg_C) ramp gradient between engine speed limitation curves" VALUE 0x387958 Scalar_SWORD 0 Trq_Nm_s -1000.0 1000.0 /end CHARACTERISTIC
/begin CHARACTERISTIC EngPrt_RmpLimNErrPos_C "Positive (.Pos_C) resp. ramp gradient between engine speed limitation curves" VALUE 0x38795A Scalar_SWORD 0 Trq_Nm_s -1000.0 1000.0 /end CHARACTERISTIC
/begin CHARACTERISTIC EngPrt_swtTrq_C "Switch for chosing kind of torque limitation" VALUE 0x388025 Scalar_UBYTE 0 State_uint8 0.0 2.0 /end CHARACTERISTIC
/begin CHARACTERISTIC EngPrt_swtLimCorType_C "Application parameter to determine the torque correction factor" VALUE 0x388022 Scalar_UBYTE 0 Switch_conv 0 1 /end CHARACTERISTIC
/begin CHARACTERISTIC EngPrt_numTrqLim_C "0-->CoolantTemperature,1-->OilTemperature,2-->EngDa_tEng" VALUE 0x387FBD Scalar_UBYTE 0 EngTempFldSel_conv 0 2 /end CHARACTERISTIC
/begin AXIS_PTS EngPrt_qLim_CURX "Epm_nEng" 0x387FF0 Epm_nEng Lookup1D_X_WORD 0 EngSpeed_rpm 25 0.0 6000.0 /end AXIS_PTS
/begin AXIS_PTS EngPrt_trqLim_CURX "Epm_nEng" 0x388540 Epm_nEng Lookup1D_X_WORD 0 EngSpeed_rpm 20 0.0 6000.0 /end AXIS_PTS
/begin AXIS_PTS EngPrt_trqNLimSpr_CURX "Epm_nEng" 0x388590 Epm_nEng Lookup1D_X_WORD 0 EngSpeed_rpm 20 0.0 6000.0 /end AXIS_PTS
/begin AXIS_PTS EngPrt_trqNLim_CURX "Epm_nEng" 0x3885E0 Epm_nEng Lookup1D_X_WORD 0 EngSpeed_rpm 20 0.0 6000.0 /end AXIS_PTS
/begin AXIS_PTS EngPrt_facTrqLimCor_MAPY "EnvP_p" 0x387F92 EnvP_p Lookup2D_X_WORD 0 AirPressure_kPa 16 0.0 500.0 /end AXIS_PTS
/begin AXIS_PTS EngPrt_facTrqLimCor_MAPX "EngPrt_tTrqLim_mp" 0x387F72 NO_INPUT_QUANTITY Lookup2D_X_WORD 0 Temp_deg 16 -3000.0 3000.0 /end AXIS_PTS
/begin AXIS_PTS EngPrt_trqLimAPSCor_MAPY "EnvP_p" 0x3882B8 EnvP_p Lookup2D_X_WORD 0 AirPressure_kPa 16 0.0 500.0 /end AXIS_PTS
/begin AXIS_PTS EngPrt_trqLimAPSCor_MAPX "Epm_nEng" 0x388298 Epm_nEng Lookup2D_X_WORD 0 EngSpeed_rpm 16 0.0 6000.0 /end AXIS_PTS
/begin AXIS_PTS EngPrt_trqLimEngTempCor_MAPY "EngPrt_tTrqLim_mp" 0x3884F8 NO_INPUT_QUANTITY Lookup2D_X_WORD 0 Temp_deg 16 -3000.0 3000.0 /end AXIS_PTS
/begin AXIS_PTS EngPrt_trqLimEngTempCor_MAPX "Epm_nEng" 0x3884D8 Epm_nEng Lookup2D_X_WORD 0 EngSpeed_rpm 16 0.0 6000.0 /end AXIS_PTS
/begin AXIS_PTS EngPrt_facEngSPOffset_CURX "EngSp  offset" 0x387970 NO_INPUT_QUANTITY Lookup1D_X_WORD 0 EngSpeed_rpm 10 -1000.0 1000.0 /end AXIS_PTS
/begin MEASUREMENT HPUn_numInjQntBal "Maximum amount of injections due to high pressure pump quantity balance" ULONG Counter_num 0 0 0.0 8.0 ECU_ADDRESS 0x40022570 /end MEASUREMENT
/begin MEASUREMENT AirCtl_stAirCtlBits "Status of the switch-off events of the exhaust-gas recirculation control, monitoring" ULONG State_uint32 0 0 0.0 4.294967295E+9 ECU_ADDRESS 0x4002299C /end MEASUREMENT
/begin MEASUREMENT EISGov_st "Status information of EISGov and its clients" ULONG State_uint32 0 0 0.0 2.147483648E+9 ECU_ADDRESS 0x400225E4 /end MEASUREMENT
/begin MEASUREMENT EISGov_st1 "Status information of HLSDem client" ULONG State_uint32 0 0 0.0 2.147483648E+9 ECU_ADDRESS 0x400225E8 /end MEASUREMENT
/begin MEASUREMENT EISGov_st6 "Status information of ExtDem for EISGov and its clients" ULONG State_uint32 0 0 0.0 2.147483648E+9 ECU_ADDRESS 0x400226E4 /end MEASUREMENT
/begin MEASUREMENT EISGov_st7 "Status information of DrvDem client" ULONG State_uint32 0 0 0.0 2.147483648E+9 ECU_ADDRESS 0x40022750 /end MEASUREMENT
/begin MEASUREMENT VehMot_drAccPedUnFlt "accelerator pedal angle slope, unfiltered" SLONG Accpedal_rate_s 0 0 -400.0 399.0 ECU_ADDRESS 0x400228E8 /end MEASUREMENT
/begin MEASUREMENT PFltLd_resFlw "Flow resistance of the particulate filter" SLONG FlowRes_kPa_m3_h 0 0 -0.3 0.3 ECU_ADDRESS 0x40022720 /end MEASUREMENT
/begin MEASUREMENT ExtDem_tiFltTrqLosEstCurr "Time constant for EISGov torque loss calculation" SLONG Time_s 0 0 -180.0 180.0 ECU_ADDRESS 0x400226C0 /end MEASUREMENT
/begin MEASUREMENT HLSDem_KpLoCurr_mp "Current gain of the P-element of lower path" SLONG HLSDem_Kp 0 0 -10000.0 10000.0 ECU_ADDRESS 0x40022590 /end MEASUREMENT
/begin MEASUREMENT HLSDem_KpPosLoCurr_mp "Current positive large signal gain of the P-element of lower path" SLONG HLSDem_Kp 0 0 -10000.0 10000.0 ECU_ADDRESS 0x40022594 /end MEASUREMENT
/begin MEASUREMENT HLSDem_KpNegLoCurr_mp "Current negative large signal gain of the P-element of lower path" SLONG HLSDem_Kp 0 0 -10000.0 10000.0 ECU_ADDRESS 0x4002258C /end MEASUREMENT
/begin MEASUREMENT HLSDem_KpHiCurr_mp "Current gain of the P-element of upper path" SLONG HLSDem_Kp 0 0 -10000.0 10000.0 ECU_ADDRESS 0x4002259C /end MEASUREMENT
/begin MEASUREMENT HLSDem_KpPosHiCurr_mp "Current positive large signal gain of the P-element of upper path" SLONG HLSDem_Kp 0 0 -10000.0 10000.0 ECU_ADDRESS 0x400225A0 /end MEASUREMENT
/begin MEASUREMENT HLSDem_KpNegHiCurr_mp "Current negative large signal gain of the P-element of upper path" SLONG HLSDem_Kp 0 0 -10000.0 10000.0 ECU_ADDRESS 0x40022598 /end MEASUREMENT
/begin MEASUREMENT ExtDem_KpCurrHi_mp "Current small signal gain for the P higher component" SLONG HLSDem_Kp 0 0 -10000.0 10000.0 ECU_ADDRESS 0x40022690 /end MEASUREMENT
/begin MEASUREMENT ExtDem_KpCurrLo_mp "Current small signal gain for the P lower component" SLONG HLSDem_Kp 0 0 -10000.0 10000.0 ECU_ADDRESS 0x40022694 /end MEASUREMENT
/begin MEASUREMENT ExtDem_KpNegCurrHi_mp "Current negative large signal gain for the P higher component" SLONG HLSDem_Kp 0 0 -10000.0 10000.0 ECU_ADDRESS 0x40022698 /end MEASUREMENT
/begin MEASUREMENT ExtDem_KpNegCurrLo_mp "Current negative large signal gain for the lower P component" SLONG HLSDem_Kp 0 0 -10000.0 10000.0 ECU_ADDRESS 0x4002269C /end MEASUREMENT
/begin MEASUREMENT ExtDem_KpPosCurrHi_mp "Current positive large signal gain for the P higher component" SLONG HLSDem_Kp 0 0 -10000.0 10000.0 ECU_ADDRESS 0x400226A0 /end MEASUREMENT
/begin MEASUREMENT ExtDem_KpPosCurrLo_mp "Current positive large signal gain for the P lower component" SLONG HLSDem_Kp 0 0 -10000.0 10000.0 ECU_ADDRESS 0x400226A4 /end MEASUREMENT
/begin MEASUREMENT EISGov_KpCurrLo_mp "Current gain for the P element for the lower path" SLONG HLSDem_Kp 0 0 -10000.0 10000.0 ECU_ADDRESS 0x400227EC /end MEASUREMENT
/begin MEASUREMENT EISGov_KpPosCurrLo_mp "Current positive large signal gain for the P component lower PI-path" SLONG HLSDem_Kp 0 0 -10000.0 10000.0 ECU_ADDRESS 0x400227F0 /end MEASUREMENT
/begin MEASUREMENT EISGov_KpNegCurrLo_mp "Current negative large signal gain for the P component lower PI-path" SLONG HLSDem_Kp 0 0 -10000.0 10000.0 ECU_ADDRESS 0x400227F4 /end MEASUREMENT
/begin MEASUREMENT EISGov_KpCurrHi_mp "Current gain for the P element for the upper path" SLONG HLSDem_Kp 0 0 -10000.0 10000.0 ECU_ADDRESS 0x400227E0 /end MEASUREMENT
/begin MEASUREMENT EISGov_KpPosCurrHi_mp "Current positive large signal gain for the P component upper PI-path" SLONG HLSDem_Kp 0 0 -10000.0 10000.0 ECU_ADDRESS 0x400227E4 /end MEASUREMENT
/begin MEASUREMENT EISGov_KpNegCurrHi_mp "Current negative large signal gain for the P component upper PI-path" SLONG HLSDem_Kp 0 0 -10000.0 10000.0 ECU_ADDRESS 0x400227E8 /end MEASUREMENT
/begin MEASUREMENT DrvDem_KpCurrLo_mp "Current gain for the P element for the lower path" SLONG HLSDem_Kp 0 0 -10000.0 10000.0 ECU_ADDRESS 0x40022758 /end MEASUREMENT
/begin MEASUREMENT DrvDem_KpPosCurrLo_mp "Current positive large signal gain for the P component lower PI-path" SLONG HLSDem_Kp 0 0 -10000.0 10000.0 ECU_ADDRESS 0x4002275C /end MEASUREMENT
/begin MEASUREMENT DrvDem_KpNegCurrLo_mp "Current negative large signal gain for the P component lower PI-path" SLONG HLSDem_Kp 0 0 -10000.0 10000.0 ECU_ADDRESS 0x40022760 /end MEASUREMENT
/begin MEASUREMENT DrvDem_KpCurrHi_mp "Current gain for the P element for the upper path" SLONG HLSDem_Kp 0 0 -10000.0 10000.0 ECU_ADDRESS 0x40022778 /end MEASUREMENT
/begin MEASUREMENT DrvDem_KpPosCurrHi_mp "Current positive large signal gain for the P component upper PI-path" SLONG HLSDem_Kp 0 0 -10000.0 10000.0 ECU_ADDRESS 0x4002277C /end MEASUREMENT
/begin MEASUREMENT DrvDem_KpNegCurrHi_mp "Current negative large signal gain for the P component upper PI-path" SLONG HLSDem_Kp 0 0 -10000.0 10000.0 ECU_ADDRESS 0x40022780 /end MEASUREMENT
/begin MEASUREMENT HLSDem_KiLoCurr_mp "Current gain of the I-element of lower path" SLONG HLSDem_Ki 0 0 -18000.0 18000.0 ECU_ADDRESS 0x400225A8 /end MEASUREMENT
/begin MEASUREMENT HLSDem_KiPosLoCurr_mp "Current positive large signal gain of the I-element of lower path" SLONG HLSDem_Ki 0 0 -18000.0 18000.0 ECU_ADDRESS 0x400225AC /end MEASUREMENT
/begin MEASUREMENT HLSDem_KiNegLoCurr_mp "Current negative large signal gain of the I-element of lower path" SLONG HLSDem_Ki 0 0 -18000.0 18000.0 ECU_ADDRESS 0x400225A4 /end MEASUREMENT
/begin MEASUREMENT HLSDem_KiHiCurr_mp "Current small signal gain for the I component upper PI - path" SLONG HLSDem_Ki 0 0 -18000.0 18000.0 ECU_ADDRESS 0x400225B4 /end MEASUREMENT
/begin MEASUREMENT HLSDem_KiPosHiCurr_mp "Current positive large signal gain for the I component upper PI-path" SLONG HLSDem_Ki 0 0 -18000.0 18000.0 ECU_ADDRESS 0x400225B8 /end MEASUREMENT
/begin MEASUREMENT HLSDem_KiNegHiCurr_mp "Current negative large signal gain for the I component upper PI - path" SLONG HLSDem_Ki 0 0 -18000.0 18000.0 ECU_ADDRESS 0x400225B0 /end MEASUREMENT
/begin MEASUREMENT ExtDem_KiCurrHi_mp "Current small signal gain for the I higher component" SLONG HLSDem_Ki 0 0 -18000.0 18000.0 ECU_ADDRESS 0x400226A8 /end MEASUREMENT
/begin MEASUREMENT ExtDem_KiCurrLo_mp "Current small signal gain for the I lower component" SLONG HLSDem_Ki 0 0 -18000.0 18000.0 ECU_ADDRESS 0x400226AC /end MEASUREMENT
/begin MEASUREMENT ExtDem_KiNegCurrHi_mp "Current negative large signal gain for the I higher component" SLONG HLSDem_Ki 0 0 -18000.0 18000.0 ECU_ADDRESS 0x400226B8 /end MEASUREMENT
/begin MEASUREMENT ExtDem_KiNegCurrLo_mp "Current negative large signal gain for the I lower component" SLONG HLSDem_Ki 0 0 -18000.0 18000.0 ECU_ADDRESS 0x400226BC /end MEASUREMENT
/begin MEASUREMENT ExtDem_KiPosCurrHi_mp "Current positive large signal gain for the I higher component" SLONG HLSDem_Ki 0 0 -18000.0 18000.0 ECU_ADDRESS 0x400226B0 /end MEASUREMENT
/begin MEASUREMENT ExtDem_KiPosCurrLo_mp "Current positive large signal gain for the I lower component" SLONG HLSDem_Ki 0 0 -18000.0 18000.0 ECU_ADDRESS 0x400226B4 /end MEASUREMENT
/begin MEASUREMENT EISGov_KiCurrLo_mp "Current gain for the I element for the lower path" SLONG HLSDem_Ki 0 0 -18000.0 18000.0 ECU_ADDRESS 0x40022804 /end MEASUREMENT
/begin MEASUREMENT EISGov_KiPosCurrLo_mp "Current positive large signal gain for the I component lower PI-path" SLONG HLSDem_Ki 0 0 -18000.0 18000.0 ECU_ADDRESS 0x40022808 /end MEASUREMENT
/begin MEASUREMENT EISGov_KiNegCurrLo_mp "Current negative large signal gain for the I component lower PI-path" SLONG HLSDem_Ki 0 0 -18000.0 18000.0 ECU_ADDRESS 0x4002280C /end MEASUREMENT
/begin MEASUREMENT EISGov_KiCurrHi_mp "Current gain for the I element for the upper path" SLONG HLSDem_Ki 0 0 -18000.0 18000.0 ECU_ADDRESS 0x400227F8 /end MEASUREMENT
/begin MEASUREMENT EISGov_KiPosCurrHi_mp "Current positive large signal gain for the I component upper PI-path" SLONG HLSDem_Ki 0 0 -18000.0 18000.0 ECU_ADDRESS 0x400227FC /end MEASUREMENT
/begin MEASUREMENT EISGov_KiNegCurrHi_mp "Current negative large signal gain for the I component upper PI-path" SLONG HLSDem_Ki 0 0 -18000.0 18000.0 ECU_ADDRESS 0x40022800 /end MEASUREMENT
/begin MEASUREMENT DrvDem_KiCurrLo_mp "Current gain for the I element for the lower path" SLONG HLSDem_Ki 0 0 -18000.0 18000.0 ECU_ADDRESS 0x40022768 /end MEASUREMENT
/begin MEASUREMENT DrvDem_KiPosCurrLo_mp "Current positive large signal gain for the I component lower PI-path" SLONG HLSDem_Ki 0 0 -18000.0 18000.0 ECU_ADDRESS 0x4002276C /end MEASUREMENT
/begin MEASUREMENT DrvDem_KiNegCurrLo_mp "Current negative large signal gain for the I component lower PI-path" SLONG HLSDem_Ki 0 0 -18000.0 18000.0 ECU_ADDRESS 0x40022770 /end MEASUREMENT
/begin MEASUREMENT DrvDem_KiCurrHi_mp "Current gain for the I element for the upper path" SLONG HLSDem_Ki 0 0 -18000.0 18000.0 ECU_ADDRESS 0x40022788 /end MEASUREMENT
/begin MEASUREMENT DrvDem_KiPosCurrHi_mp "Current positive large signal gain for the I component upper PI-path" SLONG HLSDem_Ki 0 0 -18000.0 18000.0 ECU_ADDRESS 0x4002278C /end MEASUREMENT
/begin MEASUREMENT DrvDem_KiNegCurrHi_mp "Current negative large signal gain for the I component upper PI-path" SLONG HLSDem_Ki 0 0 -18000.0 18000.0 ECU_ADDRESS 0x40022790 /end MEASUREMENT
/begin MEASUREMENT RailP_uRaw "Raw value of rail pressure" SWORD Ad_mv 0 0 0.0 5000.0 ECU_ADDRESS 0x400223F0 /end MEASUREMENT
/begin MEASUREMENT RailP_uRawSens_mp "Raw value of rail pressure before Peak Selection" SWORD Ad_mv 0 0 0.0 5000.0 ECU_ADDRESS 0x400223F2 /end MEASUREMENT
/begin MEASUREMENT PRV_ctPresShck_mp "number of performed rail pressure shock cycles toforce the opening of the pressure relief valve" UWORD State_uint16 0 0 0.0 6000.0 ECU_ADDRESS 0x400223E6 /end MEASUREMENT
/begin MEASUREMENT VMD_stBrkDes "Application parameter for torque status information" UWORD State_uint16 0 0 0.0 65535.0 ECU_ADDRESS 0x400228BA /end MEASUREMENT
/begin MEASUREMENT Rail_tiMeUnCtlDT1_mp "Time constant of the DT1 element for pressure control by metering unit" UWORD RailDT1_ms 0 0 0.0 65535.0 ECU_ADDRESS 0x400223B8 /end MEASUREMENT
/begin MEASUREMENT Rail_fBlkSht "Limited blank shot frequency" UWORD Freq_q1p0 0 0 0.0 65535.0 ECU_ADDRESS 0x400223D4 /end MEASUREMENT
/begin MEASUREMENT SpdGov_st "status speed control SpdGov" UWORD State_uint16 0 0 0.0 65535.0 ECU_ADDRESS 0x400225EC /end MEASUREMENT
/begin MEASUREMENT ASDdc_T1GovCurr_mp "Current parameter T1 for ASD disturbance compensator" UWORD RailDT1_ms 0 0 0.0 65535.0 ECU_ADDRESS 0x400229E2 /end MEASUREMENT
/begin MEASUREMENT VMD_trqLeadUnLim "Unlimited propulsion lead torque." SWORD Trq_Nm 0 0 -3000.0 3000.0 ECU_ADDRESS 0x400228B0 /end MEASUREMENT
/begin MEASUREMENT VMD_trqLeadRaw "Raw value of propulsion lead torque after driving assistance coordination" SWORD Trq_Nm 0 0 -3000.0 3000.0 ECU_ADDRESS 0x400228B2 /end MEASUREMENT
/begin MEASUREMENT VMD_trqLead "propulsion lead torque after driving assistance coordination" SWORD Trq_Nm 0 0 -3000.0 3000.0 ECU_ADDRESS 0x40022896 /end MEASUREMENT
/begin MEASUREMENT VMD_trqLeadIn "lead torque of Propulsion and Brake" SWORD Trq_Nm 0 0 -3000.0 3000.0 ECU_ADDRESS 0x400228AE /end MEASUREMENT
/begin MEASUREMENT VMD_trqDesUnLim "Desired torque in front of top speed limitation Nm" SWORD Trq_Nm 0 0 -3000.0 3000.0 ECU_ADDRESS 0x400228BE /end MEASUREMENT
/begin MEASUREMENT VMD_trqDesRaw "Raw value of propulsion torque demand." SWORD Trq_Nm 0 0 -3000.0 3000.0 ECU_ADDRESS 0x400228C0 /end MEASUREMENT
/begin MEASUREMENT VMD_trqDesIn "Desired Propulsion Torque Nm" SWORD Trq_Nm 0 0 -3000.0 3000.0 ECU_ADDRESS 0x400228BC /end MEASUREMENT
/begin MEASUREMENT VMD_trqDes "propulsion  torque after driving assistance coordination" SWORD Trq_Nm 0 0 -3000.0 3000.0 ECU_ADDRESS 0x40022898 /end MEASUREMENT
/begin MEASUREMENT CoVMD_trqLLim "propulsion torque of longitudinal limter" SWORD Trq_Nm 0 0 -3000.0 3000.0 ECU_ADDRESS 0x400228C6 /end MEASUREMENT
/begin MEASUREMENT AccPed_trqDes "Driver torque value of propulsion after step limitation" SWORD Trq_Nm 0 0 -3000.0 3000.0 ECU_ADDRESS 0x400228B4 /end MEASUREMENT
/begin MEASUREMENT AccPed_trqLeadPull_mp "Driver command torque for pull component lead path" SWORD Trq_Nm 0 0 -3000.0 3000.0 ECU_ADDRESS 0x400229D0 /end MEASUREMENT
/begin MEASUREMENT AccPed_trqLeadOvrRun_mp "Driver command torque for overrun part lead path" SWORD Trq_Nm 0 0 -3000.0 3000.0 ECU_ADDRESS 0x400229D2 /end MEASUREMENT
/begin MEASUREMENT AccPed_trqLead "Lead torque of accelerator pedal" SWORD Trq_Nm 0 0 -3000.0 3000.0 ECU_ADDRESS 0x400228AC /end MEASUREMENT
/begin MEASUREMENT AccPed_trqDesAct "driver torque raw of propulsion" SWORD Trq_Nm 0 0 -3000.0 3000.0 ECU_ADDRESS 0x400229C6 /end MEASUREMENT
/begin MEASUREMENT AccPed_trqComp "Compensation torque of accelerator pedal" SWORD Trq_Nm 0 0 -3000.0 3000.0 ECU_ADDRESS 0x400229CC /end MEASUREMENT
/begin MEASUREMENT AccPed_trqDifBrk_mp "completely possible engine brake torque Nm" SWORD Trq_Nm 0 0 -3000.0 3000.0 ECU_ADDRESS 0x400229D6 /end MEASUREMENT
/begin MEASUREMENT AccPed_trqDesPull "Application parameter for driver demand in pull mode for desired value" SWORD Trq_Nm 0 0 -3000.0 3000.0 ECU_ADDRESS 0x400229D4 /end MEASUREMENT
/begin MEASUREMENT AccPed_trqLimMax "Maximum wheel torque in case of accelerator pedal error" SWORD Trq_Nm 0 0 -3000.0 3000.0 ECU_ADDRESS 0x400229CA /end MEASUREMENT
/begin MEASUREMENT VehMot_trqPrtDfftl "Differential protection torque" SWORD Trq_Nm 0 0 -3000.0 3000.0 ECU_ADDRESS 0x4002241A /end MEASUREMENT
/begin MEASUREMENT PT_trqCrSCurr "application parameter for lead torque order to engine for rail pressure control（crankshaft torque）" SWORD Trq_Nm 0 0 -3000.0 3000.0 ECU_ADDRESS 0x40022444 /end MEASUREMENT
/begin MEASUREMENT PT_trqCrSLead "application parameter for lead torque order to engine（crankshaft torque）" SWORD Trq_Nm 0 0 -3000.0 3000.0 ECU_ADDRESS 0x40022446 /end MEASUREMENT
/begin MEASUREMENT PT_trqCrSPTPrt "Application parameter for powertrain protection train protection torque(crankshaft torque)" SWORD Trq_Nm 0 0 -3000.0 3000.0 ECU_ADDRESS 0x4002244E /end MEASUREMENT
/begin MEASUREMENT PT_trqCrSDes "Application parameter for requested propulsion torque to engine(crankshaft torque)" SWORD Trq_Nm 0 0 -3000.0 3000.0 ECU_ADDRESS 0x40022450 /end MEASUREMENT
/begin MEASUREMENT PT_trqCrSDCS "crankshaft torque for request decrcment" SWORD Trq_Nm 0 0 -3000.0 3000.0 ECU_ADDRESS 0x40022452 /end MEASUREMENT
/begin MEASUREMENT CoPT_trqDesCompEng "Application parameter for engine torque desired for compensation" SWORD Trq_Nm 0 0 -3276.0 3276.0 ECU_ADDRESS 0x40022456 /end MEASUREMENT
/begin MEASUREMENT PT_trqLos "Parameter for loss torque of the drive train" SWORD Trq_Nm 0 0 -3000.0 3000.0 ECU_ADDRESS 0x4002247A /end MEASUREMENT
/begin MEASUREMENT PT_trqLosComp "Torque loss of the power train" SWORD Trq_Nm 0 0 -3000.0 3000.0 ECU_ADDRESS 0x40022478 /end MEASUREMENT
/begin MEASUREMENT PT_trqResv "torque reserve of the drive train" SWORD Trq_Nm 0 0 -3000.0 3000.0 ECU_ADDRESS 0x4002247C /end MEASUREMENT
/begin MEASUREMENT PT_trqWhlInrLim "Engine torque limitation converted to wheel torque" SWORD Trq_Nm 0 0 -3000.0 3000.0 ECU_ADDRESS 0x4002248E /end MEASUREMENT
/begin MEASUREMENT PT_trqWhl "Actual wheel torque" SWORD Trq_Nm 0 0 -3000.0 3000.0 ECU_ADDRESS 0x40022490 /end MEASUREMENT
/begin MEASUREMENT PT_trqWhlMinEngBrk "Minimum possible drag torque" SWORD Trq_Nm 0 0 -3000.0 3000.0 ECU_ADDRESS 0x4002248C /end MEASUREMENT
/begin MEASUREMENT PT_trqWhlMinEng "Minimum wheel torque from the engine" SWORD Trq_Nm 0 0 -3000.0 3000.0 ECU_ADDRESS 0x4002248A /end MEASUREMENT
/begin MEASUREMENT PT_trqWhlMaxEng "Maximum wheel torque from the engine" SWORD Trq_Nm 0 0 -3000.0 3000.0 ECU_ADDRESS 0x40022488 /end MEASUREMENT
/begin MEASUREMENT PT_trqSpdGovLtd "Low-idle governor torque" SWORD Trq_Nm 0 0 -3000.0 3000.0 ECU_ADDRESS 0x40022486 /end MEASUREMENT
/begin MEASUREMENT Rail_trqLim "Torque limitation dependent on fuel temperature" SWORD Trq_Nm 0 0 0.0 3000.0 ECU_ADDRESS 0x40022372 /end MEASUREMENT
/begin MEASUREMENT FlSys_p "Fuelpressure on high pressure pump" SWORD AirPressure_kPa 0 0 0.0 3000.0 ECU_ADDRESS 0x40022370 /end MEASUREMENT
/begin MEASUREMENT HPUn_trqLoss "High pressure pump torque demand" SWORD Trq_Nm 0 0 0.0 1000.0 ECU_ADDRESS 0x400224FC /end MEASUREMENT
/begin MEASUREMENT TCPrt_trqInrBstPrtLim "Torque limitation from VGT Nm" SWORD Trq_Nm 0 0 -3276.8 3276.7 ECU_ADDRESS 0x400222DC /end MEASUREMENT
/begin MEASUREMENT AirCtl_trqCtlVal "Injection torque for the open-loop control of the exhaust-gas recirculation control" SWORD Trq_Nm 0 0 -3000.0 3000.0 ECU_ADDRESS 0x400229BA /end MEASUREMENT
/begin MEASUREMENT AirCtl_trqDesVal "Inner torque for open-loop control of the exhaustgas recirculation control" SWORD Trq_Nm 0 0 -3000.0 3000.0 ECU_ADDRESS 0x400229B8 /end MEASUREMENT
/begin MEASUREMENT AirCtl_trqGov "Inner torque for open-loop control of the exhaustgas recirculation control" SWORD Trq_Nm 0 0 -3000.0 3000.0 ECU_ADDRESS 0x400229BC /end MEASUREMENT
/begin MEASUREMENT AirCtl_trqMon "Inner torque of monitoring level for open-loop control of the exhaustgas recirculation control" SWORD Trq_Nm 0 0 -3000.0 3000.0 ECU_ADDRESS 0x400229BE /end MEASUREMENT
/begin MEASUREMENT RngMod_trqCrSMax "maximal crankshaft torque" SWORD Trq_Nm 0 0 -3276.8 3276.7 ECU_ADDRESS 0x4002232A /end MEASUREMENT
/begin MEASUREMENT RngMod_trqMax "Maximum of torque interval" SWORD Trq_Nm 0 0 -3276.8 3276.7 ECU_ADDRESS 0x4002232C /end MEASUREMENT
/begin MEASUREMENT RngMod_trqFrc "Current friction torque" SWORD Trq_Nm 0 0 -3276.8 3276.7 ECU_ADDRESS 0x40022334 /end MEASUREMENT
/begin MEASUREMENT RngMod_trqMin "Drag torque (minimum torque)" SWORD Trq_Nm 0 0 -3276.8 3276.7 ECU_ADDRESS 0x40022336 /end MEASUREMENT
/begin MEASUREMENT RngMod_trqLossComp "compensation for torque" SWORD Trq_Nm 0 0 -3276.8 3276.7 ECU_ADDRESS 0x40022338 /end MEASUREMENT
/begin MEASUREMENT RngMod_trqDiffAdap "Adapted difference torque loss" SWORD Trq_Nm 0 0 -3276.8 3276.7 ECU_ADDRESS 0x4002233A /end MEASUREMENT
/begin MEASUREMENT RngMod_trqLos "sum of all engine losses including frictional torque adaption" SWORD Trq_Nm 0 0 -3276.8 3276.7 ECU_ADDRESS 0x40022340 /end MEASUREMENT
/begin MEASUREMENT RngMod_trqCrSMin "minimal crankshaft torque" SWORD Trq_Nm 0 0 -3276.8 3276.7 ECU_ADDRESS 0x4002233E /end MEASUREMENT
/begin MEASUREMENT RngMod_trqComp "torque to be compensated" SWORD Trq_Nm 0 0 -3276.8 3276.7 ECU_ADDRESS 0x40022342 /end MEASUREMENT
/begin MEASUREMENT ActMod_trqCrS "Current crankshaft torque" SWORD Trq_Nm 0 0 -3276.8 3276.7 ECU_ADDRESS 0x40022480 /end MEASUREMENT
/begin MEASUREMENT ActMod_trqClth "actual engine torque - clutch torque" SWORD Trq_Nm 0 0 -3276.8 3276.7 ECU_ADDRESS 0x400229C0 /end MEASUREMENT
/begin MEASUREMENT ActMod_trqMinBrk "minimum possible drag torque" SWORD Trq_Nm 0 0 -3276.8 3276.7 ECU_ADDRESS 0x40022482 /end MEASUREMENT
/begin MEASUREMENT ActMod_trqClthMinBrk "minimum possible clutch drag torque." SWORD Trq_Nm 0 0 -3276.8 3276.7 ECU_ADDRESS 0x400229C2 /end MEASUREMENT
/begin MEASUREMENT ActMod_trqInr "Current, back-calculated inner engine torque" SWORD Trq_Nm 0 0 -3276.8 3276.7 ECU_ADDRESS 0x4002226C /end MEASUREMENT
/begin MEASUREMENT PthSet_trqInrSetAct "Current inner engine torque" SWORD Trq_Nm 0 0 -3276.8 3276.7 ECU_ADDRESS 0x4002273C /end MEASUREMENT
/begin MEASUREMENT HLSDem_trqReq "Requested initialisation torque to engine speed governor (with reference to the output)" SWORD Trq_Nm 0 0 -3000.0 3000.0 ECU_ADDRESS 0x400225EE /end MEASUREMENT
/begin MEASUREMENT ExtDem_trqReq "Torque intialization request of the EISGov External Intervention function" SWORD Trq_Nm 0 0 -3000.0 3000.0 ECU_ADDRESS 0x400226E8 /end MEASUREMENT
/begin MEASUREMENT EISGov_trqLosFlt "estimated torque loss" SWORD Trq_Nm 0 0 -3276.8 3276.7 ECU_ADDRESS 0x4002273E /end MEASUREMENT
/begin MEASUREMENT EISGov_trqSpdGovLim "limitation for inner engine torque" SWORD Trq_Nm 0 0 -3276.8 3276.7 ECU_ADDRESS 0x4002274A /end MEASUREMENT
/begin MEASUREMENT EISGov_trqCmpMinStruct "Torque limitation of the controlling torque path (relevant in case of MIN structure)" SWORD Trq_Nm 0 0 -3276.8 3276.7 ECU_ADDRESS 0x40022748 /end MEASUREMENT
/begin MEASUREMENT EISGov_trqCmpMaxStruct "Torque limitation of the controlling torque path (relevant in case of MAX structure)" SWORD Trq_Nm 0 0 -3276.8 3276.7 ECU_ADDRESS 0x40022746 /end MEASUREMENT
/begin MEASUREMENT EISGov_trqLimMin "lower torque control limit for EISGov" SWORD Trq_Nm 0 0 -3276.8 3276.7 ECU_ADDRESS 0x4002274C /end MEASUREMENT
/begin MEASUREMENT EISGov_trqLimMax "Upper torque control limit for EISGov" SWORD Trq_Nm 0 0 -3276.8 3276.7 ECU_ADDRESS 0x4002274E /end MEASUREMENT
/begin MEASUREMENT EISGov_trqReq "Selected requirement (from all the requirements of the active EISGov clients) to the EISGov for an initialisation torque" SWORD Trq_Nm 0 0 -3276.8 3276.7 ECU_ADDRESS 0x40022822 /end MEASUREMENT
/begin MEASUREMENT EISGov_trqPLo "P-component of the lower path" SWORD Trq_Nm 0 0 -3276.8 3276.7 ECU_ADDRESS 0x400225DE /end MEASUREMENT
/begin MEASUREMENT EISGov_trq "Resulted output torque of EISGov controller" SWORD Trq_Nm 0 0 -3276.8 3276.7 ECU_ADDRESS 0x400225DC /end MEASUREMENT
/begin MEASUREMENT EISGov_trqFlt "Filtered output torque of the EISGov" SWORD Trq_Nm 0 0 -3276.8 3276.7 ECU_ADDRESS 0x40022828 /end MEASUREMENT
/begin MEASUREMENT SpdGov_trqFlt "filtered setpoint torque of SpdGov" SWORD Trq_Nm 0 0 -3267.0 3267.0 ECU_ADDRESS 0x40022824 /end MEASUREMENT
/begin MEASUREMENT SpdGov_trqSet "Set point torque of SpdGov on the fuel path" SWORD Trq_Nm 0 0 -3000.0 3000.0 ECU_ADDRESS 0x40022484 /end MEASUREMENT
/begin MEASUREMENT SpdGov_trqLead "lead torque of SpdGov on the air path" SWORD Trq_Nm 0 0 -3267.0 3267.0 ECU_ADDRESS 0x40022826 /end MEASUREMENT
/begin MEASUREMENT DrvDem_trqReq "Requested initialisation torque to engine speed governor from DrvDem (with reference to the output)" SWORD Trq_Nm 0 0 -3000.0 3000.0 ECU_ADDRESS 0x40022798 /end MEASUREMENT
/begin MEASUREMENT EngReq_trqLim "Resulting limiting torque from engine specifications" SWORD Trq_Nm 0 0 -3276.8 3276.7 ECU_ADDRESS 0x40022702 /end MEASUREMENT
/begin MEASUREMENT EngReq_trqInrLimSmkPrs "Resulting limiting torque smoke limit current operation mode" SWORD Trq_Nm 0 0 -3276.8 3276.7 ECU_ADDRESS 0x40022708 /end MEASUREMENT
/begin MEASUREMENT EngReq_trqInrLimSmk "Limiting torque smoke limit" SWORD Trq_Nm 0 0 -3276.8 3276.7 ECU_ADDRESS 0x40022700 /end MEASUREMENT
/begin MEASUREMENT EngReq_trqInrLimSmkSlow "Limiting torque smoke limit of slow path" SWORD Trq_Nm 0 0 -3276.8 3276.7 ECU_ADDRESS 0x4002270A /end MEASUREMENT
/begin MEASUREMENT EngReq_trqInrQLim "Limiting torque due to limitation quantities (except smoke limitation)" SWORD Trq_Nm 0 0 -3276.8 3276.7 ECU_ADDRESS 0x400226FE /end MEASUREMENT
/begin MEASUREMENT EngReq_trqFullLdIncrOfs "quantity offset for full load increase" SWORD Trq_Nm 0 0 -3276.8 3276.7 ECU_ADDRESS 0x4002270C /end MEASUREMENT
/begin MEASUREMENT EngPrt_trqLimPTO "Torque limitation value from PTO state" SWORD Trq_Nm 0 0 -3276.8 3276.7 ECU_ADDRESS 0x40022710 /end MEASUREMENT
/begin MEASUREMENT EngPrt_trqLim "Limitation torque for engine mechanic protection by torque limitation (as inner engine torque)" SWORD Trq_Nm 0 0 -3276.8 3276.7 ECU_ADDRESS 0x40022716 /end MEASUREMENT
/begin MEASUREMENT EngPrt_trqLimOvhtPrv "Torque limitation value for engine protection from overheating" SWORD Trq_Nm 0 0 -3276.8 3276.7 ECU_ADDRESS 0x40022714 /end MEASUREMENT
/begin MEASUREMENT EngPrt_trqLimMech "Resulting limiting torque for engine mechanics protection (inner engine torque)" SWORD Trq_Nm 0 0 -3276.8 3276.7 ECU_ADDRESS 0x40022712 /end MEASUREMENT
/begin MEASUREMENT EngPrt_trqUnLim "Enabled torque from the maximum power manager" SWORD Trq_Nm 0 0 -3276.8 3276.7 ECU_ADDRESS 0x4002270E /end MEASUREMENT
/begin MEASUREMENT EngPrt_trqNLim "Limiting torque for protection from excessive engine speed" SWORD Trq_Nm 0 0 -3276.8 3276.7 ECU_ADDRESS 0x4002271A /end MEASUREMENT
/begin MEASUREMENT PthSet_trqInrSetSum "Sum of inner set torque" SWORD Trq_Nm 0 0 -3000.0 3276.7 ECU_ADDRESS 0x40022406 /end MEASUREMENT
/begin MEASUREMENT PthSet_trqInrSet "Inner torque set value after monitoring limitation" SWORD Trq_Nm 0 0 -3000.0 3276.7 ECU_ADDRESS 0x4002226A /end MEASUREMENT
/begin MEASUREMENT PthLead_trqInrCurr "Actual percent engine torque" SWORD Trq_Nm 0 0 -3000.0 3000.0 ECU_ADDRESS 0x40022410 /end MEASUREMENT
/begin MEASUREMENT PthLead_trqInrLead "Inner torque lead value" SWORD Trq_Nm 0 0 -3000.0 3000.0 ECU_ADDRESS 0x40022412 /end MEASUREMENT
/begin MEASUREMENT ASDrf_trqInrSet "ASD reference filter torque output" SWORD Trq_Nm 0 0 -3000.0 3000.0 ECU_ADDRESS 0x400223FE /end MEASUREMENT
/begin MEASUREMENT ASDdc_trq "ASD disturbance compensator torque output" SWORD Trq_Nm 0 0 -3000.0 3000.0 ECU_ADDRESS 0x40022400 /end MEASUREMENT
/begin MEASUREMENT VMD_nMin "Minimum engine speed limitation after driving assistance coordination" SWORD EngSpeed_rpm 0 0 -12000.0 12000.0 ECU_ADDRESS 0x4002289E /end MEASUREMENT
/begin MEASUREMENT VMD_nMax "Maximum engine speed limitation after driving assistance coordination" SWORD EngSpeed_rpm 0 0 -12000.0 12000.0 ECU_ADDRESS 0x400228A0 /end MEASUREMENT
/begin MEASUREMENT Epm_dnEng "Engine speed gradient calculated over current crankshaft-segment (S0-S0 or S1-S1)" SWORD EngSpeed_rpm_s 0 0 -12000.0 12000.0 ECU_ADDRESS 0x4002273A /end MEASUREMENT
/begin MEASUREMENT AccPed_nMax "Maximum engine speed in case of accelerator pedal error" SWORD EngSpeed_rpm 0 0 0.0 6000.0 ECU_ADDRESS 0x400228CA /end MEASUREMENT
/begin MEASUREMENT AccPed_nMin "Minimum engine speed in case of accelerator pedal error" SWORD EngSpeed_rpm 0 0 0.0 6000.0 ECU_ADDRESS 0x400228C8 /end MEASUREMENT
/begin MEASUREMENT TS_nMinAC "idle speed request" SWORD EngSpeed_rpm 0 0 -12000.0 12000.0 ECU_ADDRESS 0x400228F8 /end MEASUREMENT
/begin MEASUREMENT CoPT_nMinSysErr "Application parameter for Minimum engine speed demand while system error" SWORD EngSpeed_rpm 0 0 0.0 6000.0 ECU_ADDRESS 0x40022464 /end MEASUREMENT
/begin MEASUREMENT CoPT_nMaxSysErr "Application parameter for maximum engine speed demand while system error" SWORD EngSpeed_rpm 0 0 0.0 6000.0 ECU_ADDRESS 0x40022466 /end MEASUREMENT
/begin MEASUREMENT CoPT_nMinAcs "Application parameter for Minimum engine speed demand of Accessories" SWORD EngSpeed_rpm 0 0 0.0 6000.0 ECU_ADDRESS 0x40022468 /end MEASUREMENT
/begin MEASUREMENT CoPT_nMaxAcs "Application parameter for maximum engine speed" SWORD EngSpeed_rpm 0 0 0.0 6000.0 ECU_ADDRESS 0x4002246A /end MEASUREMENT
/begin MEASUREMENT CoPT_nMinTra "Application parameter for Minimum engine speed demand of transmission" SWORD EngSpeed_rpm 0 0 0.0 6000.0 ECU_ADDRESS 0x4002246C /end MEASUREMENT
/begin MEASUREMENT CoPT_nMaxTra "Application parameter for maximum engine speed demand of transmission" SWORD EngSpeed_rpm 0 0 0.0 6000.0 ECU_ADDRESS 0x4002246E /end MEASUREMENT
/begin MEASUREMENT SmkLim_mAirPerCyl "Air mass for smoke limitation" SWORD AirMass_mg_hub 0 0 0.0 16383.0 ECU_ADDRESS 0x4002230E /end MEASUREMENT
/begin MEASUREMENT AirCtl_mGovDvt "Deviation of Air mass" SWORD AirMass_mg_hub 0 0 -15000.0 15000.0 ECU_ADDRESS 0x4002298C /end MEASUREMENT
/begin MEASUREMENT AirCtl_mDesBasEOM0 "Base air mass setpoint value from the basic map" SWORD AirMass_mg_hub 0 0 -15000.0 15000.0 ECU_ADDRESS 0x400229AC /end MEASUREMENT
/begin MEASUREMENT AirCtl_mDesVal "Desired air mass" SWORD AirMass_mg_hub 0 0 -15000.0 15000.0 ECU_ADDRESS 0x4002298E /end MEASUREMENT
/begin MEASUREMENT ASMod_mAirPerCylCor "Dynamically corrected fresh air mass per cylinderupstream of the intake manifold" SWORD AirMass_mg_hub 0 0 0.0 16383.0 ECU_ADDRESS 0x40022324 /end MEASUREMENT
/begin MEASUREMENT HLSDem_nSetPLo "Minimum engine speed of HLSDem" SWORD EngSpeed_rpm 0 0 0.0 6000.0 ECU_ADDRESS 0x40022586 /end MEASUREMENT
/begin MEASUREMENT HLSDem_nSetPHi "Maximum engine speed of HLSDem" SWORD EngSpeed_rpm 0 0 0.0 6000.0 ECU_ADDRESS 0x40022588 /end MEASUREMENT
/begin MEASUREMENT HLSDem_nSetPLoBas "Basic low idle setpoint speed (rpm)" SWORD EngSpeed_rpm 0 0 0.0 6000.0 ECU_ADDRESS 0x40022584 /end MEASUREMENT
/begin MEASUREMENT HLSDem_dnAccLim "Maximum permissible acceleration (Engine speed)" SWORD EngSpeed_rpm_s 0 0 -12000.0 12000.0 ECU_ADDRESS 0x400225CC /end MEASUREMENT
/begin MEASUREMENT HLSDem_dnDeclLim "Maximum permissible deceleration (Engine speed)" SWORD EngSpeed_rpm_s 0 0 -12000.0 12000.0 ECU_ADDRESS 0x400225CE /end MEASUREMENT
/begin MEASUREMENT HLSDem_PWinPosLoCurr_mp "Current positive small-signal window P-component of the lower path" SWORD EngSpeed_rpm 0 0 -6000.0 6000.0 ECU_ADDRESS 0x400225C6 /end MEASUREMENT
/begin MEASUREMENT HLSDem_PWinNegLoCurr_mp "Current negative small-signal window P-component of the lower path" SWORD EngSpeed_rpm 0 0 -6000.0 6000.0 ECU_ADDRESS 0x400225CA /end MEASUREMENT
/begin MEASUREMENT HLSDem_IWinPosLoCurr_mp "Current positive small-signal window I-component of the lower path" SWORD EngSpeed_rpm 0 0 -6000.0 6000.0 ECU_ADDRESS 0x400225C0 /end MEASUREMENT
/begin MEASUREMENT HLSDem_IWinNegLoCurr_mp "Current negative small-signal window I-component of the lower path" SWORD EngSpeed_rpm 0 0 -6000.0 6000.0 ECU_ADDRESS 0x400225C4 /end MEASUREMENT
/begin MEASUREMENT HLSDem_PWinPosHiCurr_mp "Current positive small-signal window P-component of the upper path" SWORD EngSpeed_rpm 0 0 -6000.0 6000.0 ECU_ADDRESS 0x400225C8 /end MEASUREMENT
/begin MEASUREMENT HLSDem_PWinNegHiCurr_mp "Current negative small-signal window P-component of the upper path" SWORD EngSpeed_rpm 0 0 -6000.0 6000.0 ECU_ADDRESS 0x400225BC /end MEASUREMENT
/begin MEASUREMENT HLSDem_IWinPosHiCurr_mp "Current positive small-signal window I-component of the upper path" SWORD EngSpeed_rpm 0 0 -6000.0 6000.0 ECU_ADDRESS 0x400225C2 /end MEASUREMENT
/begin MEASUREMENT HLSDem_IWinNegHiCurr_mp "Current negative small-signal window I-component of the upper path" SWORD EngSpeed_rpm 0 0 -6000.0 6000.0 ECU_ADDRESS 0x400225BE /end MEASUREMENT
/begin MEASUREMENT ExtDem_nSetPCorVal "Setpoint for correction factor calculation" SWORD EngSpeed_rpm 0 0 0.0 6000.0 ECU_ADDRESS 0x40022682 /end MEASUREMENT
/begin MEASUREMENT ExtDem_nSetPHi "Higher limit of external demand set point speed" SWORD EngSpeed_rpm 0 0 0.0 6000.0 ECU_ADDRESS 0x40022684 /end MEASUREMENT
/begin MEASUREMENT ExtDem_nSetPLo "Lower limit of external demand set point speed" SWORD EngSpeed_rpm 0 0 0.0 6000.0 ECU_ADDRESS 0x40022686 /end MEASUREMENT
/begin MEASUREMENT ExtDem_dnAccLim "Maximum permissible acceleration (Engine speed)" SWORD EngSpeed_rpm_s 0 0 -12000.0 12000.0 ECU_ADDRESS 0x400226D4 /end MEASUREMENT
/begin MEASUREMENT ExtDem_dnDeclLim "Maximum permissible deceleration (Engine speed)" SWORD EngSpeed_rpm_s 0 0 -12000.0 12000.0 ECU_ADDRESS 0x400226D6 /end MEASUREMENT
/begin MEASUREMENT ExtDem_PWinPosHi "Positive small signal window for proportional higher component " SWORD EngSpeed_rpm 0 0 -1000.0 1000.0 ECU_ADDRESS 0x400226CE /end MEASUREMENT
/begin MEASUREMENT ExtDem_PWinPosLo "Positive small signal window for proportional lower component " SWORD EngSpeed_rpm 0 0 -1000.0 1000.0 ECU_ADDRESS 0x400226CC /end MEASUREMENT
/begin MEASUREMENT ExtDem_PWinNegHi "Negative small signal window for proportional higher component " SWORD EngSpeed_rpm 0 0 -1000.0 1000.0 ECU_ADDRESS 0x400226D0 /end MEASUREMENT
/begin MEASUREMENT ExtDem_PWinNegLo "Negative small signal window for proportional lower component " SWORD EngSpeed_rpm 0 0 -1000.0 1000.0 ECU_ADDRESS 0x400226D2 /end MEASUREMENT
/begin MEASUREMENT ExtDem_IWinPosHi "Positive small signal window for integral higher component" SWORD EngSpeed_rpm 0 0 -1000.0 1000.0 ECU_ADDRESS 0x400226C4 /end MEASUREMENT
/begin MEASUREMENT ExtDem_IWinPosLo "Positive small signal window for integral lower component" SWORD EngSpeed_rpm 0 0 -1000.0 1000.0 ECU_ADDRESS 0x400226C6 /end MEASUREMENT
/begin MEASUREMENT ExtDem_IWinNegHi "Negative small signal window for integral higher component" SWORD EngSpeed_rpm 0 0 -1000.0 1000.0 ECU_ADDRESS 0x400226C8 /end MEASUREMENT
/begin MEASUREMENT ExtDem_IWinNegLo "Negative small signal window for integral lower component" SWORD EngSpeed_rpm 0 0 -1000.0 1000.0 ECU_ADDRESS 0x400226CA /end MEASUREMENT
/begin MEASUREMENT EISGov_nSetPLo "Lower limit of the speed interval (set point speed) of the EISGov" SWORD EngSpeed_rpm 0 0 0.0 6000.0 ECU_ADDRESS 0x400225E2 /end MEASUREMENT
/begin MEASUREMENT EISGov_nSetPHi "Upper limit of the speed interval (maximum speed) of EISGov" SWORD EngSpeed_rpm 0 0 0.0 6000.0 ECU_ADDRESS 0x40022810 /end MEASUREMENT
/begin MEASUREMENT EISGov_PWinPosLo "P component Positive window for parameterset lower PI- path" SWORD EngSpeed_rpm 0 0 -6000.0 6000.0 ECU_ADDRESS 0x4002281E /end MEASUREMENT
/begin MEASUREMENT EISGov_PWinNegLo "P component negative window for parameterset lower PI- path" SWORD EngSpeed_rpm 0 0 -6000.0 6000.0 ECU_ADDRESS 0x40022820 /end MEASUREMENT
/begin MEASUREMENT EISGov_IWinPosLo "I component Positive window for parameterset lower PI- path" SWORD EngSpeed_rpm 0 0 -6000.0 6000.0 ECU_ADDRESS 0x40022812 /end MEASUREMENT
/begin MEASUREMENT EISGov_IWinNegLo "I component negative window for parameterset lower PI- path" SWORD EngSpeed_rpm 0 0 -6000.0 6000.0 ECU_ADDRESS 0x40022814 /end MEASUREMENT
/begin MEASUREMENT EISGov_PWinPosHi "P component Positive window for parameterset upper PI- path" SWORD EngSpeed_rpm 0 0 -6000.0 6000.0 ECU_ADDRESS 0x40022816 /end MEASUREMENT
/begin MEASUREMENT EISGov_PWinNegHi "P component negative window for parameterset upper PI- path" SWORD EngSpeed_rpm 0 0 -6000.0 6000.0 ECU_ADDRESS 0x40022818 /end MEASUREMENT
/begin MEASUREMENT EISGov_IWinPosHi "I component Positive window for parameterset upper PI- path" SWORD EngSpeed_rpm 0 0 -6000.0 6000.0 ECU_ADDRESS 0x4002281A /end MEASUREMENT
/begin MEASUREMENT EISGov_IWinNegHi "I component negative window for parameterset upper PI- path" SWORD EngSpeed_rpm 0 0 -6000.0 6000.0 ECU_ADDRESS 0x4002281C /end MEASUREMENT
/begin MEASUREMENT DrvDem_nSetPLo "Minimal engine speed of DrvDem" SWORD EngSpeed_rpm 0 0 0.0 6000.0 ECU_ADDRESS 0x40022754 /end MEASUREMENT
/begin MEASUREMENT DrvDem_nSetPHi "Maximal engine speed of DrvDem" SWORD EngSpeed_rpm 0 0 0.0 6000.0 ECU_ADDRESS 0x40022756 /end MEASUREMENT
/begin MEASUREMENT DrvDem_PWinPosLo "P component Positive window for parameterset lower PI- path" SWORD EngSpeed_rpm 0 0 -6000.0 6000.0 ECU_ADDRESS 0x40022764 /end MEASUREMENT
/begin MEASUREMENT DrvDem_PWinNegLo "P component negative window for parameterset lower PI- path" SWORD EngSpeed_rpm 0 0 -6000.0 6000.0 ECU_ADDRESS 0x40022766 /end MEASUREMENT
/begin MEASUREMENT DrvDem_IWinPosLo "I component Positive window for parameterset lower PI- path" SWORD EngSpeed_rpm 0 0 -6000.0 6000.0 ECU_ADDRESS 0x40022774 /end MEASUREMENT
/begin MEASUREMENT DrvDem_IWinNegLo "I component negative window for parameterset lower PI- path" SWORD EngSpeed_rpm 0 0 -6000.0 6000.0 ECU_ADDRESS 0x40022776 /end MEASUREMENT
/begin MEASUREMENT DrvDem_PWinPosHi "P component Positive window for parameterset upper PI- path" SWORD EngSpeed_rpm 0 0 -6000.0 6000.0 ECU_ADDRESS 0x40022784 /end MEASUREMENT
/begin MEASUREMENT DrvDem_PWinNegHi "P component negative window for parameterset upper PI- path" SWORD EngSpeed_rpm 0 0 -6000.0 6000.0 ECU_ADDRESS 0x40022786 /end MEASUREMENT
/begin MEASUREMENT DrvDem_IWinPosHi "I component Positive window for parameterset upper PI- path" SWORD EngSpeed_rpm 0 0 -6000.0 6000.0 ECU_ADDRESS 0x40022794 /end MEASUREMENT
/begin MEASUREMENT DrvDem_IWinNegHi "I component negative window for parameterset upper PI- path" SWORD EngSpeed_rpm 0 0 -6000.0 6000.0 ECU_ADDRESS 0x40022796 /end MEASUREMENT
/begin MEASUREMENT DrvDem_dnAccLim "Maximum permissible acceleration (Engine speed)" SWORD EngSpeed_rpm_s 0 0 -12000.0 12000.0 ECU_ADDRESS 0x4002287C /end MEASUREMENT
/begin MEASUREMENT DrvDem_dnDeclLim "Maximum permissible deceleration (Engine speed)" SWORD EngSpeed_rpm_s 0 0 -12000.0 12000.0 ECU_ADDRESS 0x4002287A /end MEASUREMENT
/begin MEASUREMENT AFS_mAirPerCylFlt "filtered Air mass per cylinder" SWORD AirMass_mg_hub 0 0 0.0 16383.0 ECU_ADDRESS 0x40022322 /end MEASUREMENT
/begin MEASUREMENT MeUn_rPs "PWM signal output from the metering unit" SWORD DutyCycle_rate 0 0 0.0 100.0 ECU_ADDRESS 0x400224CC /end MEASUREMENT
/begin MEASUREMENT AccPed_rTrq "Total drive train ratio of engine - wheel" SWORD TransRatio 0 0 -327.0 327.0 ECU_ADDRESS 0x40022894 /end MEASUREMENT
/begin MEASUREMENT VehMot_rTrqDfftl "Torque ratio of differential" SWORD TransRatio 0 0 -300.0 300.0 ECU_ADDRESS 0x40022418 /end MEASUREMENT
/begin MEASUREMENT HPUn_rTransCrS "High pressure pump to crankshaft ratio" SWORD TransRatio 0 0 0.0 10.0 ECU_ADDRESS 0x40022576 /end MEASUREMENT
/begin MEASUREMENT VehMot_facCompAcs "Compensation factor for loss compensation" SWORD Fact8192 0 0 -4.0 3.999 ECU_ADDRESS 0x400228C2 /end MEASUREMENT
/begin MEASUREMENT AccPed_facCompAcs "Factor \"Overrun Ramp\"" SWORD Fact8192 0 0 -4.0 3.999 ECU_ADDRESS 0x400228B8 /end MEASUREMENT
/begin MEASUREMENT VehMot_facDesDyn "Dynamic factor for driver demand" SWORD Fact8192 0 0 -4.0 3.999 ECU_ADDRESS 0x4002244C /end MEASUREMENT
/begin MEASUREMENT ASMod_facVolEff "Volumetric efficiency of the engine" SWORD Fact8192 0 0 -4.0 3.9999 ECU_ADDRESS 0x400229DC /end MEASUREMENT
/begin MEASUREMENT Rail_facMeUnCtlPT1_mp "Time constant of the PT1 filter for pressure control by metering unit" UWORD PT_fac 0 0 0.0 99.9985 ECU_ADDRESS 0x400223C8 /end MEASUREMENT
/begin MEASUREMENT HLSDem_tiFltTrqLosEstCurr "Time constant (PT1filter) for EISGov torque loss estimation" UWORD PT_fac 0 0 0.0 99.998 ECU_ADDRESS 0x400225D4 /end MEASUREMENT
/begin MEASUREMENT DrvDem_tiFltTrqLosEstCurr "Time constant (PT1filter) for EISGov torque loss estimation" UWORD PT_fac 0 0 0.0 99.998 ECU_ADDRESS 0x4002287E /end MEASUREMENT
/begin MEASUREMENT ASDrf_facGovCurr_mp "Active state after priorisation (decimal coded)" UWORD PT_fac 0 0 0.0 99.9 ECU_ADDRESS 0x400229E0 /end MEASUREMENT
/begin MEASUREMENT ASMod_dmIndAirRef "Reference of gas mass flow into the engine while exhaust-gas recirculation is closed" SWORD AirMassPerTime 0 0 -8192.0 8191.0 ECU_ADDRESS 0x40022990 /end MEASUREMENT
/begin MEASUREMENT Rail_qCorPresPeakLim "Quantity correction for limiting pressure peaks (pos. and neg.) mg/cyc" SWORD FuelMass_mg_hub 0 0 -300.0 300.0 ECU_ADDRESS 0x4002238E /end MEASUREMENT
/begin MEASUREMENT InjCrv_qPoI2Bas_mp "PoI2 base quantity for injection" SWORD FuelMass_mg_hub 0 0 -319.0 319.0 ECU_ADDRESS 0x40022516 /end MEASUREMENT
/begin MEASUREMENT InjCrv_qPoI2Cor "PoI2 correction quantity" SWORD FuelMass_mg_hub 0 0 -319.0 319.0 ECU_ADDRESS 0x4002251E /end MEASUREMENT
/begin MEASUREMENT InjCrv_qMI1BalPoI2 "Actual PoI2 quantity contained in FMTC (used for MI1 balance)" SWORD FuelMass_mg_hub 0 0 -319.0 319.0 ECU_ADDRESS 0x40022528 /end MEASUREMENT
/begin MEASUREMENT InjCrv_qPoI2OfsUnLim "Unlimited PoI2 offset quantity" SWORD FuelMass_mg_hub 0 0 -319.0 319.0 ECU_ADDRESS 0x4002252A /end MEASUREMENT
/begin MEASUREMENT InjCrv_qPoI2Des "Desired PoI2 injection quantity" SWORD FuelMass_mg_hub 0 0 -319.0 319.0 ECU_ADDRESS 0x4002239A /end MEASUREMENT
/begin MEASUREMENT InjCrv_qPiI2Bas_mp "Basic injection quantity for PiI2" SWORD FuelMass_mg_hub 0 0 -319.0 319.0 ECU_ADDRESS 0x40022538 /end MEASUREMENT
/begin MEASUREMENT InjCrv_qPiI2Cor1 "PiI quantity correction" SWORD FuelMass_mg_hub 0 0 -319.0 319.0 ECU_ADDRESS 0x4002253E /end MEASUREMENT
/begin MEASUREMENT InjCrv_qPiI2Set_mp "Set PiI2 quantity " SWORD FuelMass_mg_hub 0 0 -319.0 319.0 ECU_ADDRESS 0x40022544 /end MEASUREMENT
/begin MEASUREMENT InjCrv_qPiI2Des "Desired PiI2 injection quantity" SWORD FuelMass_mg_hub 0 0 -319.0 319.0 ECU_ADDRESS 0x400223A0 /end MEASUREMENT
/begin MEASUREMENT InjCrv_qPiI1Bas_mp "Basic injection quantity for PiI1" SWORD FuelMass_mg_hub 0 0 -319.0 319.0 ECU_ADDRESS 0x40022550 /end MEASUREMENT
/begin MEASUREMENT InjCrv_qPiI1Cor1 "PiI quantity correction" SWORD FuelMass_mg_hub 0 0 -319.0 319.0 ECU_ADDRESS 0x40022556 /end MEASUREMENT
/begin MEASUREMENT InjCrv_qPiI1Set_mp "Set PiI1 quantity " SWORD FuelMass_mg_hub 0 0 -319.0 319.0 ECU_ADDRESS 0x4002255C /end MEASUREMENT
/begin MEASUREMENT InjCrv_qPiI1Des "Desired PiI injection quantity" SWORD FuelMass_mg_hub 0 0 -319.0 319.0 ECU_ADDRESS 0x40022396 /end MEASUREMENT
/begin MEASUREMENT InjCrv_qMI1Des "desired MI1 injection quantity" SWORD FuelMass_mg_hub 0 0 -319.0 319.0 ECU_ADDRESS 0x40022398 /end MEASUREMENT
/begin MEASUREMENT SmkLim_qLimSmkBas "Smoke limitation quantity in current operation mode" SWORD FuelMass_mg_hub 0 0 -319.0 319.0 ECU_ADDRESS 0x4002231E /end MEASUREMENT
/begin MEASUREMENT SmkLim_qLimSmk "Smoke limitation quantity in current operation mode" SWORD FuelMass_mg_hub 0 0 -319.0 319.0 ECU_ADDRESS 0x40022320 /end MEASUREMENT
/begin MEASUREMENT AirCtl_qCtlVal "Injection quantity for the open-loop control of the exhaust-gas recirculation control" SWORD FuelMass_mg_hub 0 0 -300.0 300.0 ECU_ADDRESS 0x400229B6 /end MEASUREMENT
/begin MEASUREMENT AirCtl_qDesVal "Inner quantity for open-loop control of the exhaustgas recirculation control" SWORD FuelMass_mg_hub 0 0 -300.0 300.0 ECU_ADDRESS 0x400229AA /end MEASUREMENT
/begin MEASUREMENT AirCtl_qGov "Inner quantity for open-loop control of the exhaustgas recirculation control" SWORD FuelMass_mg_hub 0 0 -300.0 300.0 ECU_ADDRESS 0x400229A4 /end MEASUREMENT
/begin MEASUREMENT AirCtl_qMon "Inner quantity of monitoring level for open-loop control of the exhaustgas recirculation control" SWORD FuelMass_mg_hub 0 0 -300.0 300.0 ECU_ADDRESS 0x40022982 /end MEASUREMENT
/begin MEASUREMENT PhyMod_qCor "Correction quantity" SWORD FuelMass_mg_hub 0 0 -319.0 319.0 ECU_ADDRESS 0x40022428 /end MEASUREMENT
/begin MEASUREMENT PhyMod_qCorNxt "next correction quantity" SWORD FuelMass_mg_hub 0 0 -319.0 319.0 ECU_ADDRESS 0x4002242A /end MEASUREMENT
/begin MEASUREMENT CnvSet_qSetPrs "Setpoint injection quantity current operation mode" SWORD FuelMass_mg_hub 0 0 -319.0 319.0 ECU_ADDRESS 0x40022960 /end MEASUREMENT
/begin MEASUREMENT CnvSet_qSet "Set point injection quantity" SWORD FuelMass_mg_hub 0 0 -319.0 319.0 ECU_ADDRESS 0x4002250A /end MEASUREMENT
/begin MEASUREMENT CnvSet_qSetNxt "Setpoint injection quantity next opration mode" SWORD FuelMass_mg_hub 0 0 -319.0 319.0 ECU_ADDRESS 0x40022962 /end MEASUREMENT
/begin MEASUREMENT CnvSet_qStrt "Injection start quantity" SWORD FuelMass_mg_hub 0 0 -319.0 319.0 ECU_ADDRESS 0x4002250C /end MEASUREMENT
/begin MEASUREMENT CnvLead_qCurr "Injection quantity current path" SWORD FuelMass_mg_hub 0 0 -319.0 319.0 ECU_ADDRESS 0x4002250E /end MEASUREMENT
/begin MEASUREMENT CnvLead_qRaw "Injection quantity raw path" SWORD FuelMass_mg_hub 0 0 -319.0 319.0 ECU_ADDRESS 0x40022510 /end MEASUREMENT
/begin MEASUREMENT AccPed_rBrk50_mp "percentage of engine brake torque" SWORD Accpedal_rate 0 0 0.0 100.0 ECU_ADDRESS 0x400229D8 /end MEASUREMENT
/begin MEASUREMENT VehMot_rAccPedFlt "Filtered accelerator pedal value" SWORD Accpedal_rate 0 0 0.0 100.0 ECU_ADDRESS 0x400228E4 /end MEASUREMENT
/begin MEASUREMENT EGRVlv_r "Commanded value from application SW" SWORD Prc_100_rate 0 0 -100.0 100.0 ECU_ADDRESS 0x4002231C /end MEASUREMENT
/begin MEASUREMENT ThrVlv_r "Commanded value from application SW" SWORD Prc_100_rate 0 0 -100.0 100.0 ECU_ADDRESS 0x400229A0 /end MEASUREMENT
/begin MEASUREMENT AirCtl_rGovTVA "Opening for intake throttle (TVA)" SWORD Prc_100_rate 0 0 -100.0 100.0 ECU_ADDRESS 0x40022992 /end MEASUREMENT
/begin MEASUREMENT AirCtl_rGovEGR "Setpoint position of the exhaust-gas recirculation valve from the exhaust-gas recirculation control" SWORD Prc_100_rate 0 0 -100.0 100.0 ECU_ADDRESS 0x40022994 /end MEASUREMENT
/begin MEASUREMENT AirCtl_rCtlVal "Stationary part of controlled variable" SWORD Prc_100_rate 0 0 -100.0 100.0 ECU_ADDRESS 0x400229A6 /end MEASUREMENT
/begin MEASUREMENT ActMod_rTrq "Actual engine output torque ratio" SWORD Prc_100_rate 0 0 -300.0 300.0 ECU_ADDRESS 0x400229C4 /end MEASUREMENT
/begin MEASUREMENT CoPT_facDesDyn "Dynamics factor of vehicle located requestors" SWORD Factor 0 0 -30.0 30.0 ECU_ADDRESS 0x40022454 /end MEASUREMENT
/begin MEASUREMENT InjCrv_facPoI2Bas_mp "PoI2 base Efficiency factor" SWORD Factor 0 0 -10.0 10.0 ECU_ADDRESS 0x40022518 /end MEASUREMENT
/begin MEASUREMENT InjCrv_facPoI2EffSet "Factor for torque forming part of PoI2 injection quantity (setpoint)" SWORD Factor 0 0 -10.0 10.0 ECU_ADDRESS 0x4002252C /end MEASUREMENT
/begin MEASUREMENT PhyMod_facEtaCor "Current efficiency correction factor" SWORD Factor 0 0 -30.0 30.0 ECU_ADDRESS 0x400222DA /end MEASUREMENT
/begin MEASUREMENT PhyMod_facEtaCorNxt "next efficiency correction factor" SWORD Factor 0 0 -31.0 31.0 ECU_ADDRESS 0x40022424 /end MEASUREMENT
/begin MEASUREMENT CoEOM_facRmpVal "Central ramp value for operation mode change" SWORD Factor 0 0 -31.0 31.0 ECU_ADDRESS 0x40022426 /end MEASUREMENT
/begin MEASUREMENT CnvSet_facRmpVal "ramp value for operation mode switchover" SWORD Factor 0 0 -31.0 31.0 ECU_ADDRESS 0x4002295E /end MEASUREMENT
/begin MEASUREMENT CnvLead_facRmpVal "ramp factor" SWORD Factor 0 0 -31.0 31.0 ECU_ADDRESS 0x40022966 /end MEASUREMENT
/begin MEASUREMENT ExtDem_KpCorFac_mp "Current small signal gain for the P component" SWORD Factor 0 0 -30.0 30.0 ECU_ADDRESS 0x400226DE /end MEASUREMENT
/begin MEASUREMENT ExtDem_KiCorFac_mp "Correction factor for I gain" SWORD Factor 0 0 -30.0 30.0 ECU_ADDRESS 0x400226DC /end MEASUREMENT
/begin MEASUREMENT MeUn_facCrntCtlLim_mp "Metering unit current control, I component" UWORD Pid_Kp_Kd 0 0 0.0 15.0 ECU_ADDRESS 0x400224C2 /end MEASUREMENT
/begin MEASUREMENT Rail_MeUnCtlDKd_mp "D amplification for pressure control by metering unit" UWORD Pid_Kp_Kd 0 0 0.0 65.0 ECU_ADDRESS 0x400223C0 /end MEASUREMENT
/begin MEASUREMENT Rail_MeUnCtlPKp_mp "P-Gain within the window" UWORD Pid_Kp_Kd 0 0 0.0 65.0 ECU_ADDRESS 0x400223C4 /end MEASUREMENT
/begin MEASUREMENT Rail_MeUnCtlPKpPos_mp "P-gain above upper window border" UWORD Pid_Kp_Kd 0 0 0.0 65.0 ECU_ADDRESS 0x400223BA /end MEASUREMENT
/begin MEASUREMENT Rail_MeUnCtlPKpNeg_mp "P-gain below lower window border" UWORD Pid_Kp_Kd 0 0 0.0 65.0 ECU_ADDRESS 0x400223C2 /end MEASUREMENT
/begin MEASUREMENT Rail_MeUnCtlIKi_mp "I-Gain within the window" UWORD Pid_Ki 0 0 0.0 65.0 ECU_ADDRESS 0x400223BC /end MEASUREMENT
/begin MEASUREMENT Rail_MeUnCtlIKiPos_mp "I-Gain above upper window border" UWORD Pid_Ki 0 0 0.0 65.0 ECU_ADDRESS 0x400223C6 /end MEASUREMENT
/begin MEASUREMENT Rail_MeUnCtlIKiNeg_mp "I-Gain below upper window border" UWORD Pid_Ki 0 0 0.0 65.0 ECU_ADDRESS 0x400223BE /end MEASUREMENT
/begin MEASUREMENT ASDdc_KdGovCurr_mp "Current parameter Kd for ASD disturbance compensator" UWORD Pid_Kp_Kd 0 0 0.0 15.0 ECU_ADDRESS 0x400229E4 /end MEASUREMENT
/begin MEASUREMENT ASMod_dvolPFltEG "Calculated exhaust-gas volume flow in the particulate filter" SWORD AirVol_m3_h 0 0 0.0 100.0 ECU_ADDRESS 0x4002271C /end MEASUREMENT
/begin MEASUREMENT CnvSet_etaCurrRmp "Conversion efficiency corresponding to CnvSet_qSet" SWORD TrqEta_Nm_mg_hub 0 0 -255.0 255.0 ECU_ADDRESS 0x40022706 /end MEASUREMENT
/begin MEASUREMENT CnvSet_etaCurr "Current conversion efficiency" SWORD TrqEta_Nm_mg_hub 0 0 -255.0 255.0 ECU_ADDRESS 0x40022718 /end MEASUREMENT
/begin MEASUREMENT CnvSet_etaCurrNxt "conversion efficiency for next operation mode" SWORD TrqEta_Nm_mg_hub 0 0 -255.0 255.0 ECU_ADDRESS 0x40022964 /end MEASUREMENT
/begin MEASUREMENT HLSDem_InrtVehCurr "Mass Inertia for EISGov torque loss estimation" SWORD HLSDem_Inrt 0 0 -50.0 50.0 ECU_ADDRESS 0x400225D6 /end MEASUREMENT
/begin MEASUREMENT ExtDem_InrtVehCurr "Mass inirtia for EISGov torque loss estimation" SWORD HLSDem_Inrt 0 0 -50.0 50.0 ECU_ADDRESS 0x400226E0 /end MEASUREMENT
/begin MEASUREMENT DrvDem_InrtVehCurr "Mass Inertia for EISGov torque loss estimation" SWORD HLSDem_Inrt 0 0 -50.0 50.0 ECU_ADDRESS 0x40022880 /end MEASUREMENT
/begin MEASUREMENT HLSDem_facFdbkHi "Feedback factor for the upper setpoint" SWORD FdbkNm2rpm_rpm_Nm 0 0 -20.0 20.0 ECU_ADDRESS 0x40022580 /end MEASUREMENT
/begin MEASUREMENT HLSDem_facFdbkLo "Feedback factor for the lower setpoint" SWORD FdbkNm2rpm_rpm_Nm 0 0 -20.0 20.0 ECU_ADDRESS 0x40022582 /end MEASUREMENT
/begin MEASUREMENT HLSDem_facFdbkTrqLosLo "Inner feedback factor for the lower setpoint" SWORD FdbkNm2rpm_rpm_Nm 0 0 -20.0 20.0 ECU_ADDRESS 0x400225D2 /end MEASUREMENT
/begin MEASUREMENT HLSDem_facFdbkTrqLosHi "Inner feedback factor for the upper setpoint" SWORD FdbkNm2rpm_rpm_Nm 0 0 -20.0 20.0 ECU_ADDRESS 0x400225D0 /end MEASUREMENT
/begin MEASUREMENT ExtDem_facFdbk "External intervention feedback factor" SWORD FdbkNm2rpm_rpm_Nm 0 0 -20.0 20.0 ECU_ADDRESS 0x4002267A /end MEASUREMENT
/begin MEASUREMENT ExtDem_facFdbkTrqLosHi "inner feedback factor for the upper setpoint" SWORD FdbkNm2rpm_rpm_Nm 0 0 -20.0 20.0 ECU_ADDRESS 0x400226D8 /end MEASUREMENT
/begin MEASUREMENT ExtDem_facFdbkTrqLosLo "inner feedback factor for the lower setpoint" SWORD FdbkNm2rpm_rpm_Nm 0 0 -20.0 20.0 ECU_ADDRESS 0x400226DA /end MEASUREMENT
/begin MEASUREMENT DrvDem_facFdbkTrqLosLo "Inner feedback factor for the lower setpoint" SWORD FdbkNm2rpm_rpm_Nm 0 0 -20.0 20.0 ECU_ADDRESS 0x40022884 /end MEASUREMENT
/begin MEASUREMENT DrvDem_facFdbkTrqLosHi "Inner feedback factor for the upper setpoint" SWORD FdbkNm2rpm_rpm_Nm 0 0 -20.0 20.0 ECU_ADDRESS 0x40022882 /end MEASUREMENT
/begin MEASUREMENT MeUn_iSet "Setpoint current for the metering unit" SWORD Current_mA 0 0 -12000.0 12000.0 ECU_ADDRESS 0x400224C4 /end MEASUREMENT
/begin MEASUREMENT MeUn_iActVal "Current actual value of the analog intput" SWORD Current_mA 0 0 -12000.0 12000.0 ECU_ADDRESS 0x400224C6 /end MEASUREMENT
/begin MEASUREMENT Rail_dvolDemSysMax "Volume flow requested overall for a maximum tolerated injection system" SWORD FuelVol_mm3_s 0 0 -327680.0 327670.0 ECU_ADDRESS 0x400223A6 /end MEASUREMENT
/begin MEASUREMENT Rail_dvolDemSysNom "Volume flow demanded overall for a nominal injection system" SWORD FuelVol_mm3_s 0 0 -327680.0 327670.0 ECU_ADDRESS 0x40022388 /end MEASUREMENT
/begin MEASUREMENT Rail_dvolLeakSum "Summary of Leakages" SWORD FuelVol_mm3_s 0 0 -327680.0 327670.0 ECU_ADDRESS 0x400223A8 /end MEASUREMENT
/begin MEASUREMENT Rail_dvolLeakSumMax "Lifetime dependant maximum estimated system leakage" SWORD FuelVol_mm3_s 0 0 -327680.0 327670.0 ECU_ADDRESS 0x400223A4 /end MEASUREMENT
/begin MEASUREMENT Rail_dvolPreCtl "Precontrol value for pressure governing by metering unit" SWORD FuelVol_mm3_s 0 0 -327680.0 327670.0 ECU_ADDRESS 0x400223A2 /end MEASUREMENT
/begin MEASUREMENT Rail_dvolMeUnCtlUpLim "Upper actuator value limit for pressure governing by metering unit" SWORD FuelVol_mm3_s 0 0 0.0 327670.0 ECU_ADDRESS 0x400223AE /end MEASUREMENT
/begin MEASUREMENT MeUn_dvolSet "Setpoint value (volume flow) of rail pressure governing" SWORD FuelVol_mm3_s 0 0 -327670.0 327670.0 ECU_ADDRESS 0x400223AC /end MEASUREMENT
/begin MEASUREMENT MeUn_dvolSetAdapt "Correction value of the adaption of the metering unit" SWORD FuelVol_mm3_s 0 0 -327680.0 327670.0 ECU_ADDRESS 0x400223B2 /end MEASUREMENT
/begin MEASUREMENT HPUn_dvolPmpNom "Pump Nominal value" SWORD FuelVol_mm3_s 0 0 0.0 50000.0 ECU_ADDRESS 0x4002238A /end MEASUREMENT
/begin MEASUREMENT HPUn_dvolPmpMin "Minimum pump flow" SWORD FuelVol_mm3_s 0 0 0.0 50000.0 ECU_ADDRESS 0x4002256C /end MEASUREMENT
/begin MEASUREMENT RailP_pCurr "Current fuel pressure" SWORD RailPressure_bar 0 0 0.0 2500.0 ECU_ADDRESS 0x400223DC /end MEASUREMENT
/begin MEASUREMENT RailP_pFlt "Maximum rail pressure of the last 10 sampling cycle" SWORD RailPressure_bar 0 0 0.0 2500.0 ECU_ADDRESS 0x40022386 /end MEASUREMENT
/begin MEASUREMENT RailP_pSubsVal_mp "Rail pressure substitution value in case of an error in pressure sensor " SWORD RailPressure_bar 0 0 0.0 2500.0 ECU_ADDRESS 0x400223E4 /end MEASUREMENT
/begin MEASUREMENT PRV_pAvrgRP_mp "averaged rail pressure for detection of an openedpressure relief valve by the rail pressure evaluation" SWORD RailPressure_bar 0 0 0.0 2000.0 ECU_ADDRESS 0x400223E8 /end MEASUREMENT
/begin MEASUREMENT RailP_pLinCurr_mp "Linearisation value current rail pressure" SWORD RailPressure_bar 0 0 0.0 2500.0 ECU_ADDRESS 0x400223DA /end MEASUREMENT
/begin MEASUREMENT RailP_pLin "Fuel pressure" SWORD RailPressure_bar 0 0 0.0 2500.0 ECU_ADDRESS 0x400223DE /end MEASUREMENT
/begin MEASUREMENT Rail_pSetPointEnvCor "Corrected rail pressure setpoint based on environmental conditions (for present operation mode)" SWORD RailPressure_bar 0 0 -2500.0 2500.0 ECU_ADDRESS 0x4002237A /end MEASUREMENT
/begin MEASUREMENT Rail_pSetPointAddCor "Buffer variable for additional correction rail setpoint values which were received via the remote function Rail_SetPointAddCor." SWORD RailPressure_bar 0 0 -2500.0 2500.0 ECU_ADDRESS 0x40022380 /end MEASUREMENT
/begin MEASUREMENT Rail_pSetPointMax "Maximum rail pressure setpoint" SWORD RailPressure_bar 0 0 -2500.0 2500.0 ECU_ADDRESS 0x40022384 /end MEASUREMENT
/begin MEASUREMENT Rail_pSetPointMin "Minimum rail pressure setpoint" SWORD RailPressure_bar 0 0 -2500.0 2500.0 ECU_ADDRESS 0x40022382 /end MEASUREMENT
/begin MEASUREMENT Rail_pSetPoint "Rail pressure setpoint" SWORD RailPressure_bar 0 0 -2500.0 2500.0 ECU_ADDRESS 0x4002238C /end MEASUREMENT
/begin MEASUREMENT Rail_pDvt "Governor deviation of the rail pressure governor" SWORD RailPressure_bar 0 0 -2500.0 2500.0 ECU_ADDRESS 0x400223AA /end MEASUREMENT
/begin MEASUREMENT InjCrv_phiPoI2Bas_mp "PoI2 base start of energizing of angle" SWORD Angle_CA 0 0 -719.0 719.0 ECU_ADDRESS 0x4002251A /end MEASUREMENT
/begin MEASUREMENT InjCrv_phiPoI2Cor "PoI2 start of energizing correction angle" SWORD Angle_CA 0 0 -719.0 719.0 ECU_ADDRESS 0x40022522 /end MEASUREMENT
/begin MEASUREMENT InjCrv_phiPoI2Set_mp "start of energizing Agngle for PoI2" SWORD Angle_CA 0 0 -719.0 719.0 ECU_ADDRESS 0x40022530 /end MEASUREMENT
/begin MEASUREMENT InjCrv_phiPoI2MaxEOMX_mp "Maximum PoI2 start of energizing for EOM1-EOM7" SWORD Angle_CA 0 0 -719.0 719.0 ECU_ADDRESS 0x40022524 /end MEASUREMENT
/begin MEASUREMENT InjCrv_phiPoI2Des "Desired reference angle for the start of PoI" SWORD Angle_CA 0 0 -719.0 719.0 ECU_ADDRESS 0x40022534 /end MEASUREMENT
/begin MEASUREMENT InjCrv_phiPiI2Bas_mp "Basic PiI2 start of energizing(phi)" SWORD Angle_CA 0 0 -719.0 719.0 ECU_ADDRESS 0x4002253A /end MEASUREMENT
/begin MEASUREMENT InjCrv_phiPiI2Cor1 "PiI2 start of energizing correction(phi)" SWORD Angle_CA 0 0 -719.0 719.0 ECU_ADDRESS 0x40022540 /end MEASUREMENT
/begin MEASUREMENT InjCrv_phiPiI2Set_mp "Set PiI2 start of energizing during starting time(phi)" SWORD Angle_CA 0 0 -719.0 719.0 ECU_ADDRESS 0x40022546 /end MEASUREMENT
/begin MEASUREMENT InjCrv_phiPiI2Des "Desired angular component for PiI2 start of energizing" SWORD Angle_CA 0 0 -719.0 719.0 ECU_ADDRESS 0x4002254E /end MEASUREMENT
/begin MEASUREMENT InjCrv_phiPiI1Bas_mp "Basic PiI1 start of energizing(phi)" SWORD Angle_CA 0 0 -719.0 719.0 ECU_ADDRESS 0x40022552 /end MEASUREMENT
/begin MEASUREMENT InjCrv_phiPiI1Cor1 "PiI1 start of energizing correction(phi)" SWORD Angle_CA 0 0 -719.0 719.0 ECU_ADDRESS 0x40022558 /end MEASUREMENT
/begin MEASUREMENT InjCrv_phiPiI1Set_mp "Set PiI1 start of energizing during starting time(phi)" SWORD Angle_CA 0 0 -719.0 719.0 ECU_ADDRESS 0x4002255E /end MEASUREMENT
/begin MEASUREMENT InjCrv_phiPiI1Des "Desired angular component for PiI1 start of energizing" SWORD Angle_CA 0 0 -719.0 719.0 ECU_ADDRESS 0x4002254A /end MEASUREMENT
/begin MEASUREMENT InjCrv_phiMI1AirMsCor "The dynamic correction value is calculated as the compensation based on the air quality deviation" SWORD Angle_CA 0 0 -10.0 40.0 ECU_ADDRESS 0x40022564 /end MEASUREMENT
/begin MEASUREMENT InjCrv_phiMI1Cor1 "Start of energizing correction for MI1" SWORD Angle_CA 0 0 -40.0 40.0 ECU_ADDRESS 0x40022566 /end MEASUREMENT
/begin MEASUREMENT InjCrv_phiMI1Des "Desired reference angle for the start of MI1" SWORD Angle_CA 0 0 -40.0 40.0 ECU_ADDRESS 0x40022532 /end MEASUREMENT
/begin MEASUREMENT InjCrv_tiPoI2Bas_mp "PoI2 base start of energizing of time" SWORD InjTime_us 0 0 -13107.0 13106.0 ECU_ADDRESS 0x4002251C /end MEASUREMENT
/begin MEASUREMENT InjCrv_tiPoI2Cor "PoI2 start of energizing correction time" SWORD InjTime_us 0 0 -13107.0 13106.0 ECU_ADDRESS 0x40022520 /end MEASUREMENT
/begin MEASUREMENT InjCrv_tiPoI2Set_mp "start of energizing time for PoI2" SWORD InjTime_us 0 0 -13107.0 13106.0 ECU_ADDRESS 0x4002252E /end MEASUREMENT
/begin MEASUREMENT InjCrv_tiPoI2Des "Desired reference time component for start of PoI2" SWORD InjTime_us 0 0 -13107.0 13106.0 ECU_ADDRESS 0x40022536 /end MEASUREMENT
/begin MEASUREMENT InjCrv_tiPiI2Bas_mp "Basic PiI2 start of energizing(ti)" SWORD InjTime_us 0 0 -13107.0 13106.0 ECU_ADDRESS 0x4002253C /end MEASUREMENT
/begin MEASUREMENT InjCrv_tiPiI2Cor1 "PiI2 start of energizing correction(ti)" SWORD InjTime_us 0 0 -13107.0 13106.0 ECU_ADDRESS 0x40022542 /end MEASUREMENT
/begin MEASUREMENT InjCrv_tiPiI2Set_mp "Set PiI2 start of energizing during starting time(ti)" SWORD InjTime_us 0 0 -13107.0 13106.0 ECU_ADDRESS 0x40022548 /end MEASUREMENT
/begin MEASUREMENT InjCrv_tiPiI2Des "Desired time component for PiI2 start of energizing" SWORD InjTime_us 0 0 -13107.0 13106.0 ECU_ADDRESS 0x4002254C /end MEASUREMENT
/begin MEASUREMENT InjCrv_tiPiI1Bas_mp "Basic PiI1 start of energizing(ti)" SWORD InjTime_us 0 0 -13107.0 13106.0 ECU_ADDRESS 0x40022554 /end MEASUREMENT
/begin MEASUREMENT InjCrv_tiPiI1Cor1 "PiI1 start of energizing correction(ti)" SWORD InjTime_us 0 0 -13107.0 13106.0 ECU_ADDRESS 0x4002255A /end MEASUREMENT
/begin MEASUREMENT InjCrv_tiPiI1Set_mp "Set PiI1 start of energizing during starting time(ti)" SWORD InjTime_us 0 0 -13107.0 13106.0 ECU_ADDRESS 0x40022560 /end MEASUREMENT
/begin MEASUREMENT InjCrv_tiPiI1Des "Desired time component for PiI1 start of energizing" SWORD InjTime_us 0 0 -13107.0 13106.0 ECU_ADDRESS 0x40022562 /end MEASUREMENT
/begin MEASUREMENT Gbx_stNPos "Gearbox neutral position status signal" UBYTE State_uint8 0 0 0.0 255.0 ECU_ADDRESS 0x400222A8 /end MEASUREMENT
/begin MEASUREMENT VMD_swtTrqSel "Driver demand - Cruise control torque selection switch" UBYTE State_uint8 0 0 0.0 255.0 ECU_ADDRESS 0x400228AA /end MEASUREMENT
/begin MEASUREMENT VMD_stNSetP "Status of engine speed request after driving assistance coordination" UBYTE State_uint8 0 0 0.0 255.0 ECU_ADDRESS 0x400228A2 /end MEASUREMENT
/begin MEASUREMENT VehMot_stBrkPed "Information brake pedal pressed" UBYTE State_uint8 0 0 0.0 255.0 ECU_ADDRESS 0x40022977 /end MEASUREMENT
/begin MEASUREMENT AccPed_stBrkDes "Application parameter for engine brake request" UBYTE State_uint8 0 0 0.0 255.0 ECU_ADDRESS 0x400228B6 /end MEASUREMENT
/begin MEASUREMENT AccPed_stBrkDes_mp "raw engine brake request before prioritisation" UBYTE State_uint8 0 0 0.0 255.0 ECU_ADDRESS 0x400229DA /end MEASUREMENT
/begin MEASUREMENT AccPed_stNSetP "Status of engine speed demand of driver demand interpretation" UBYTE State_uint8 0 0 0.0 255.0 ECU_ADDRESS 0x400228CC /end MEASUREMENT
/begin MEASUREMENT CoPT_stNSetPSysErr "Application parameter for state of low idle speed request while system error" UBYTE State_uint8 0 0 0.0 255.0 ECU_ADDRESS 0x40022470 /end MEASUREMENT
/begin MEASUREMENT CoPT_stNSetPAcs "Application parameter for state of low idle speed request of accessories" UBYTE State_uint8 0 0 0.0 255.0 ECU_ADDRESS 0x40022471 /end MEASUREMENT
/begin MEASUREMENT CoPT_stNSetPTra "Application parameter for state of low idle speed request of transmission" UBYTE State_uint8 0 0 0.0 255.0 ECU_ADDRESS 0x40022472 /end MEASUREMENT
/begin MEASUREMENT HPUn_stNumInjMax_mp "Status variable, fuel quantity balance of the high pressure pump" UBYTE State_uint8 0 0 0.0 255.0 ECU_ADDRESS 0x40022574 /end MEASUREMENT
/begin MEASUREMENT CoAS_stEGRVlv "State  of EGR control enable" UBYTE State_uint8 0 0 0.0 255.0 ECU_ADDRESS 0x4002295C /end MEASUREMENT
/begin MEASUREMENT CoAS_stThrVlv "State  of TVA control enable" UBYTE State_uint8 0 0 0.0 255.0 ECU_ADDRESS 0x4002295D /end MEASUREMENT
/begin MEASUREMENT AirCtl_stMon "status: shutdown case of the governor" UBYTE State_uint8 0 0 0.0 255.0 ECU_ADDRESS 0x400229A2 /end MEASUREMENT
/begin MEASUREMENT AirCtl_stGov "Status of the exhaust-gas recirculation control" UBYTE State_uint8 0 0 0.0 255.0 ECU_ADDRESS 0x400229A8 /end MEASUREMENT
/begin MEASUREMENT PhyMod_stPrs "Current operating mode for the torque structure" UBYTE State_uint8 0 0 0.0 255.0 ECU_ADDRESS 0x4002242C /end MEASUREMENT
/begin MEASUREMENT PhyMod_stNxt "Next operating mode for the torque structure" UBYTE State_uint8 0 0 0.0 255.0 ECU_ADDRESS 0x4002242D /end MEASUREMENT
/begin MEASUREMENT ExtDem_Cfg_mp "Configuration for EISGov structure" UBYTE State_uint8 0 0 0.0 255.0 ECU_ADDRESS 0x400226E2 /end MEASUREMENT
/begin MEASUREMENT DrvDem_st "Drive demand status to select the pedal for setpoint calculation" UBYTE State_uint8 0 0 0.0 255.0 ECU_ADDRESS 0x40022879 /end MEASUREMENT
/begin MEASUREMENT DrvDem_stShOff "ShutOff conditions from DrvDem" UBYTE State_uint8 0 0 0.0 255.0 ECU_ADDRESS 0x40022886 /end MEASUREMENT
/begin MEASUREMENT PthSet_stActvMonLim "State of monitoring limitation" UBYTE State_uint8 0 0 0.0 255.0 ECU_ADDRESS 0x40022408 /end MEASUREMENT
/begin MEASUREMENT PthLead_stActvMonLim "State of monitoring limitation" UBYTE State_uint8 0 0 0.0 255.0 ECU_ADDRESS 0x40022414 /end MEASUREMENT
/begin MEASUREMENT RailP_stGrad "Status of the gradient test" UBYTE boolean 0 0 0.0 1.0 ECU_ADDRESS 0x400223E0 /end MEASUREMENT
/begin MEASUREMENT RailP_bGradMonFinalDef "Status of the final default for pressure gradient monitoring" UBYTE boolean 0 0 0.0 1.0 ECU_ADDRESS 0x400223E1 /end MEASUREMENT
/begin MEASUREMENT RailP_bGradMonProvDef "Status of the  provisional default for pressure gradient monitoring" UBYTE boolean 0 0 0.0 1.0 ECU_ADDRESS 0x400223E2 /end MEASUREMENT
/begin MEASUREMENT RailP_stSRCCurr_mp "Maximum SRC default value" UBYTE boolean 0 0 0.0 1.0 ECU_ADDRESS 0x400223D8 /end MEASUREMENT
/begin MEASUREMENT RailP_bFinalDef "Status of final default" UBYTE boolean 0 0 0.0 1.0 ECU_ADDRESS 0x400223F4 /end MEASUREMENT
/begin MEASUREMENT RailP_bProvDef "Status of provisional default" UBYTE boolean 0 0 0.0 1.0 ECU_ADDRESS 0x400223F5 /end MEASUREMENT
/begin MEASUREMENT MeUn_bFinalDef "the final fault flag " UBYTE boolean 0 0 0.0 1.0 ECU_ADDRESS 0x400224C8 /end MEASUREMENT
/begin MEASUREMENT MeUn_bProvDef "the fault flag for the moment" UBYTE boolean 0 0 0.0 1.0 ECU_ADDRESS 0x400224C9 /end MEASUREMENT
/begin MEASUREMENT MeUn_stRot "State of anchor rotation function of metering unit" UBYTE boolean 0 0 0.0 1.0 ECU_ADDRESS 0x400224BE /end MEASUREMENT
/begin MEASUREMENT VehMot_stPrpLLim "Status longitudinal limiter controls propulsion torque" UBYTE boolean 0 0 0.0 1.0 ECU_ADDRESS 0x400228C4 /end MEASUREMENT
/begin MEASUREMENT VehMot_stPrpCrCt "Status cruise control overrides acceleration pedal" UBYTE boolean 0 0 0.0 1.0 ECU_ADDRESS 0x400228C5 /end MEASUREMENT
/begin MEASUREMENT BrkPed_bEngStrtReq "Start request brake system" UBYTE boolean 0 0 0.0 1.0 ECU_ADDRESS 0x40022978 /end MEASUREMENT
/begin MEASUREMENT AccPed_stPTSLEna "Enable status of the propulsion torque step limitation" UBYTE boolean 0 0 0.0 1.0 ECU_ADDRESS 0x400229C8 /end MEASUREMENT
/begin MEASUREMENT VehMot_stPrpAccPed "Status of propulsion demand by driver demand" UBYTE boolean 0 0 0.0 1.0 ECU_ADDRESS 0x400229DB /end MEASUREMENT
/begin MEASUREMENT AccPed_stMS "Switch of the mastershift operation" UBYTE boolean 0 0 0.0 1.0 ECU_ADDRESS 0x400229CE /end MEASUREMENT
/begin MEASUREMENT Rail_stMeUnFrzI "State bits for monitoring for a positive governor deviation" UBYTE Dsm 0 0 0.0 1.0 ECU_ADDRESS 0x400223D0 /end MEASUREMENT
/begin MEASUREMENT InjCrv_stShutOffPiIPoI "State of MI1 fuelMass too small" UBYTE boolean 0 0 0.0 1.0 ECU_ADDRESS 0x40022526 /end MEASUREMENT
/begin MEASUREMENT InjCrv_stShutOffPoI "State of MI1 fuelMass too small" UBYTE boolean 0 0 0.0 1.0 ECU_ADDRESS 0x40022527 /end MEASUREMENT
/begin MEASUREMENT IAirHt_st "Request for intake air heater ON/OFF from ASW." UBYTE boolean 0 0 0.0 1.0 ECU_ADDRESS 0x40022568 /end MEASUREMENT
/begin MEASUREMENT GlwLmp_st "Glow lamp status" UBYTE boolean 0 0 0.0 1.0 ECU_ADDRESS 0x400225F0 /end MEASUREMENT
/begin MEASUREMENT PthSet_stOvrRun "State of overrun detection (0: No overrun; 1: overrun)" UBYTE boolean 0 0 0.0 1.0 ECU_ADDRESS 0x400223B4 /end MEASUREMENT
/begin MEASUREMENT ASDrf_stPosNeg "Positive or negative intervention status" UBYTE boolean 0 0 0.0 1.0 ECU_ADDRESS 0x400229DE /end MEASUREMENT
/begin MEASUREMENT VMD_swtVCMActv "Application parameter which Indicates whether Vehicle Control Mode(VCM) is enabled or disabled" UBYTE Switch_conv 0 0 0 1 ECU_ADDRESS 0x400225DA /end MEASUREMENT
/begin MEASUREMENT DrvDem_swtDrvNGovActv "Switch to activate DrvDem" UBYTE Switch_conv 0 0 0 1 ECU_ADDRESS 0x400226E3 /end MEASUREMENT
/begin MEASUREMENT EISGov_numCurrFunc "Identification name / number of the currently active EISGov client, which determines the current controller parameters" UBYTE EISGov_num_conv 0 0 0 127 ECU_ADDRESS 0x400225E0 /end MEASUREMENT
/begin MEASUREMENT AirHt_st "status of AirHeater" UBYTE AirHtState_conv 0 0 0 8 ECU_ADDRESS 0x400222FE /end MEASUREMENT
/begin MEASUREMENT Rail_stCtlLoop "State of the rail pressure governor control" UBYTE RailCtl_State_conv 0 0 0 18 ECU_ADDRESS 0x4002237E /end MEASUREMENT
/begin MEASUREMENT Rail_stBlkShtMode "Current active blankshot mode" UBYTE Rail_BlkShtMode_VERB 0 0 0 2 ECU_ADDRESS 0x400223D6 /end MEASUREMENT
/begin MEASUREMENT Rail_stBlkShtStM "State machine for currently active blankshot phase" UBYTE Rail_StM_VERB 0 0 0 10 ECU_ADDRESS 0x400223D7 /end MEASUREMENT
/begin MEASUREMENT PRV_st "state variable of the pressure relief valve" UBYTE PRV_State_conv 0 0 0 5 ECU_ADDRESS 0x400223EB /end MEASUREMENT
/begin MEASUREMENT PRV_stEvalRP "state variable of the rail pressure evaluation for the recognition of the opening of the pressure relief valve" UBYTE PRV_EVALRPState_conv 0 0 0 5 ECU_ADDRESS 0x400223EA /end MEASUREMENT
/begin MEASUREMENT ASDdc_nInitXFrst_mp "Engine speed" SWORD EngSpeed_rpm 0 0 -6000.0 6000.0 ECU_ADDRESS 0x400220CC /end MEASUREMENT
/begin MEASUREMENT ASDdc_trqInitYFrst_mp "Initialisation value for ASDDc 1st torque" SWORD Trq_Nm 0 0 -3000.0 3000.0 ECU_ADDRESS 0x400220CE /end MEASUREMENT
/begin MEASUREMENT ASDdc_trqInitYScnd_mp "Initialisation value for ASDDc 2nd torque" SWORD Trq_Nm 0 0 -3000.0 3000.0 ECU_ADDRESS 0x400220D0 /end MEASUREMENT
/begin MEASUREMENT ASDdc_trqInitXScnd_mp "Initialisation value for ASDDc 2nd torque" SWORD Trq_Nm 0 0 -3000.0 3000.0 ECU_ADDRESS 0x400220D2 /end MEASUREMENT
/begin MEASUREMENT ASDdc_trqUnLtd_mp "ASD disturbance compensator torque output before limitation" SWORD Trq_Nm 0 0 -3000.0 3000.0 ECU_ADDRESS 0x400220D4 /end MEASUREMENT
/begin MEASUREMENT ASDdc_trqFrstDT1_mp "Min. permitted torque by gradient limitation" SWORD Trq_Nm 0 0 -3000.0 3000.0 ECU_ADDRESS 0x400220D6 /end MEASUREMENT
/begin MEASUREMENT ASDdc_stInitFrst_mp "Indicator for initialisation" UBYTE boolean 0 0 0.0 1.0 ECU_ADDRESS 0x400220D8 /end MEASUREMENT
/begin MEASUREMENT ASDdc_stInitScnd_mp "Indicator for initialisation" UBYTE boolean 0 0 0.0 1.0 ECU_ADDRESS 0x400220D9 /end MEASUREMENT
/begin MEASUREMENT ASDrf_trqP_mp "Output of ASD reference filter P-part" SWORD Trq_Nm 0 0 -3000.0 3000.0 ECU_ADDRESS 0x400220DE /end MEASUREMENT
/begin MEASUREMENT ASDrf_trqSpdGovCor_mp "Actual correction value of speed governor compensation" SWORD Trq_Nm 0 0 -3000.0 3000.0 ECU_ADDRESS 0x400220E0 /end MEASUREMENT
/begin MEASUREMENT ASDrf_trqIni_mp "Calculated initial value for PT1 state variable" SWORD Trq_Nm 0 0 -3000.0 3000.0 ECU_ADDRESS 0x400220E2 /end MEASUREMENT
/begin MEASUREMENT ASDrf_trqPT1Out_mp "Current PT1 output value" SWORD Trq_Nm 0 0 -3000.0 3000.0 ECU_ADDRESS 0x400220E4 /end MEASUREMENT
/begin MEASUREMENT ASDrf_trqPT1P_mp "Output of P-part in PT1 filtered signal path" SWORD Trq_Nm 0 0 -3000.0 3000.0 ECU_ADDRESS 0x400220E6 /end MEASUREMENT
/begin MEASUREMENT ASDrf_trqInrSetUnLtd_mp "Output of PDT1 element, before gradient limitation of ASD reference filter" SWORD Trq_Nm 0 0 -3000.0 3000.0 ECU_ADDRESS 0x400220E8 /end MEASUREMENT
/begin MEASUREMENT ASDrf_trqInrSetMin_mp "Min permitted torque by gradient limitation" SWORD Trq_Nm 0 0 -3000.0 3000.0 ECU_ADDRESS 0x400220EA /end MEASUREMENT
/begin MEASUREMENT ASDrf_trqInrSetMax_mp "Max. permitted torque by gradient limitation" SWORD Trq_Nm 0 0 -3000.0 3000.0 ECU_ADDRESS 0x400220EC /end MEASUREMENT
/begin MEASUREMENT ASDrf_stIniSteepIn_mp "Indicator for initialisation due to steep input" UBYTE boolean 0 0 0.0 1.0 ECU_ADDRESS 0x400220EE /end MEASUREMENT
/begin MEASUREMENT ASDrf_stInit_mp "Indicator for initialisation" UBYTE boolean 0 0 0.0 1.0 ECU_ADDRESS 0x400220EF /end MEASUREMENT
/begin MEASUREMENT ASDrf_facGovNegCurr_mp "ASD reference filter current negative factor parameter" UWORD PT_fac 0 0 0.0 99.9 ECU_ADDRESS 0x400220F0 /end MEASUREMENT
/begin MEASUREMENT ASDrf_facGovPosCurr_mp "ASD reference filter current positive factor parameter" UWORD PT_fac 0 0 0.0 99.9 ECU_ADDRESS 0x400220F2 /end MEASUREMENT
/begin MEASUREMENT CoETS_trqInrSecLimOVHT_mp "Second lowest limitation torque of overheating protection" SWORD Trq_Nm 0 0 -3276.8 3276.7 ECU_ADDRESS 0x400221CA /end MEASUREMENT
/begin MEASUREMENT CoETS_trqInrSecLimHiPres "Second lowest limitation torque of high pressure protection" SWORD Trq_Nm 0 0 -3276.8 3276.7 ECU_ADDRESS 0x400221CC /end MEASUREMENT
/begin MEASUREMENT CoETS_tiEngLockTime_mp "Measuring point for Time threshold to act  EngSp limit" SLONG TimeEngOn_s 0 0 0.0 2.14748E+9 ECU_ADDRESS 0x400221DC /end MEASUREMENT
/begin MEASUREMENT CoETS_tiEngEmgcySt_mp "Measuring point for Time threshold to act  Engine emergency start" SLONG TimeEngOn_s 0 0 0.0 2.14748E+9 ECU_ADDRESS 0x400221E0 /end MEASUREMENT
/begin MEASUREMENT Gps_nSpdLmt_EEP_mp "Measuring point for Requested speed / speed limit by Tbox message" SWORD EngSpeed_rpm 0 0 0.0 6000.0 ECU_ADDRESS 0x400221E4 /end MEASUREMENT
/begin MEASUREMENT TSC_nAEGpsLimOUT_mp "Measuring point for  Requested speed / speed limit by Tbox message" SWORD EngSpeed_rpm 0 0 0.0 6000.0 ECU_ADDRESS 0x400221E6 /end MEASUREMENT
/begin MEASUREMENT TSC_nVEDes_mp "Measuring point for Requested speed / speed limit by TSC1-VE message" SWORD EngSpeed_rpm 0 0 0.0 6000.0 ECU_ADDRESS 0x400221E8 /end MEASUREMENT
/begin MEASUREMENT TSC_nPEDes_mp "Measuring point for Requested speed / speed limit by TSC1-TE message" SWORD EngSpeed_rpm 0 0 0.0 6000.0 ECU_ADDRESS 0x400221EA /end MEASUREMENT
/begin MEASUREMENT TSC_nTEDes_mp "Measuring point for Requested speed / speed limit by TSC1-PE message" SWORD EngSpeed_rpm 0 0 0.0 6000.0 ECU_ADDRESS 0x400221EC /end MEASUREMENT
/begin MEASUREMENT TSC_nDEDes_mp "Measuring point for Requested speed / speed limit by TSC1-DE message" SWORD EngSpeed_rpm 0 0 0.0 6000.0 ECU_ADDRESS 0x400221EE /end MEASUREMENT
/begin MEASUREMENT TSC_nAEDes_mp "Measuring point for Requested speed / speed limit by TSC1-AE message" SWORD EngSpeed_rpm 0 0 0.0 6000.0 ECU_ADDRESS 0x400221F0 /end MEASUREMENT
/begin MEASUREMENT CoETS_nTSEASpdRaw_mp "Measuring point for Requested Raw speed / speed limit" SWORD EngSpeed_rpm 0 0 0.0 6000.0 ECU_ADDRESS 0x400221F2 /end MEASUREMENT
/begin MEASUREMENT CoETS_nTSEASpdRawRamp_mp "Measuring point for Requested Raw speed / speed limit after ramp" SWORD EngSpeed_rpm 0 0 0.0 6000.0 ECU_ADDRESS 0x400221F4 /end MEASUREMENT
/begin MEASUREMENT TSC_trqAEDes_mp "Requested torque / torque limit by TSC1-AE CANmessage Nm" SWORD Trq_Nm 0 0 -2000.0 2000.0 ECU_ADDRESS 0x400221F6 /end MEASUREMENT
/begin MEASUREMENT TSC_trqDEDes_mp "Requested torque / torque limit by TSC1-DE CANmessage Nm" SWORD Trq_Nm 0 0 -2000.0 2000.0 ECU_ADDRESS 0x400221F8 /end MEASUREMENT
/begin MEASUREMENT TSC_trqTEDes_mp "Requested torque / torque limit by TSC1-TE CANmessage Nm" SWORD Trq_Nm 0 0 -2000.0 2000.0 ECU_ADDRESS 0x400221FA /end MEASUREMENT
/begin MEASUREMENT TSC_trqPEDes_mp "Requested torque / torque limit by TSC1-PE CANmessage Nm" SWORD Trq_Nm 0 0 -2000.0 2000.0 ECU_ADDRESS 0x400221FC /end MEASUREMENT
/begin MEASUREMENT TSC_trqVEDes_mp "Requested torque/ torque limit by TSC1-VE CANmessage Nm" SWORD Trq_Nm 0 0 -2000.0 2000.0 ECU_ADDRESS 0x400221FE /end MEASUREMENT
/begin MEASUREMENT TSC_trqGpsLimOut_mp "Measuring point for torque limit by Tbox message" SWORD Trq_Nm 0 0 0.0 3000.0 ECU_ADDRESS 0x40022200 /end MEASUREMENT
/begin MEASUREMENT CoETS_trqTSEAEngRaw_mp "Measuring point for Requested Raw torque / torque limit" SWORD Trq_Nm 0 0 -2000.0 2000.0 ECU_ADDRESS 0x40022202 /end MEASUREMENT
/begin MEASUREMENT CoETS_trqTSEAEngRawRamp_mp "Measuring point for Requested Raw torque / torque limit after ramp" SWORD Trq_Nm 0 0 -2000.0 2000.0 ECU_ADDRESS 0x40022204 /end MEASUREMENT
/begin MEASUREMENT TSC_stGpsLimMode_mp "Measuring point for Override control mode of Tbox" UBYTE State_uint8 0 0 0.0 255.0 ECU_ADDRESS 0x40022206 /end MEASUREMENT
/begin MEASUREMENT TSC_stVEErr_mp "Measuring point for Error status of receiving the TSC1-VE CAN message" UBYTE State_uint8 0 0 0.0 1.0 ECU_ADDRESS 0x40022207 /end MEASUREMENT
/begin MEASUREMENT TSC_stPEErr_mp "Measuring point for Error status of receiving the TSC1-PE CAN message" UBYTE State_uint8 0 0 0.0 1.0 ECU_ADDRESS 0x40022208 /end MEASUREMENT
/begin MEASUREMENT TSC_stTEErr_mp "Measuring point for Error status of receiving the TSC1-TE CAN message" UBYTE State_uint8 0 0 0.0 1.0 ECU_ADDRESS 0x40022209 /end MEASUREMENT
/begin MEASUREMENT TSC_stDEErr_mp "Measuring point for Error status of receiving the TSC1-DE CAN message" UBYTE State_uint8 0 0 0.0 1.0 ECU_ADDRESS 0x4002220A /end MEASUREMENT
/begin MEASUREMENT TSC_stAEErr_mp "Measuring point for Error status of receiving the TSC1-AE CAN message" UBYTE State_uint8 0 0 0.0 1.0 ECU_ADDRESS 0x4002220B /end MEASUREMENT
/begin MEASUREMENT TSC_stVEMode_mp "Measuring point for Override control mode of TSC1-VE CAN message" UBYTE State_uint8 0 0 0.0 255.0 ECU_ADDRESS 0x4002220C /end MEASUREMENT
/begin MEASUREMENT TSC_stPEMode_mp "Measuring point for Override control mode of TSC1-TE CAN message" UBYTE State_uint8 0 0 0.0 255.0 ECU_ADDRESS 0x4002220D /end MEASUREMENT
/begin MEASUREMENT TSC_stTEMode_mp "Measuring point for Override control mode of TSC1-PE CAN message" UBYTE State_uint8 0 0 0.0 255.0 ECU_ADDRESS 0x4002220E /end MEASUREMENT
/begin MEASUREMENT TSC_stDEMode_mp "Measuring point for Override control mode of TSC1-DE CAN message" UBYTE State_uint8 0 0 0.0 255.0 ECU_ADDRESS 0x4002220F /end MEASUREMENT
/begin MEASUREMENT TSC_stAEMode_mp "Measuring point for Override control mode of TSC1-AE CAN message" UBYTE State_uint8 0 0 0.0 255.0 ECU_ADDRESS 0x40022210 /end MEASUREMENT
/begin MEASUREMENT TSC_stACTIVE_mp "Measuring point for " UBYTE State_uint8 0 0 0.0 255.0 ECU_ADDRESS 0x40022211 /end MEASUREMENT
/begin MEASUREMENT CoETS_stEngEmgcyRunTi_mp "Measuring point for the active state of Engine emergency running time" UBYTE boolean 0 0 0.0 1.0 ECU_ADDRESS 0x40022212 /end MEASUREMENT
/begin MEASUREMENT CoETS_stEngEmgcyRunCt_mp "Measuring point for   the active state of Engine emergency start request count" UBYTE boolean 0 0 0.0 1.0 ECU_ADDRESS 0x40022213 /end MEASUREMENT
/begin MEASUREMENT CoETS_stGpsLimActive_mp "Measuring point for Tbox limit  active state" UBYTE boolean 0 0 0.0 1.0 ECU_ADDRESS 0x40022214 /end MEASUREMENT
/begin MEASUREMENT CoETS_tiEngEmgcyRun_EEP "" ULONG uint32 0 0 0 4294967295 ECU_ADDRESS 0x4002FBFC /end MEASUREMENT
/begin MEASUREMENT CoETS_ctEngEmgcyRun_EEP "" UBYTE uint8 0 0 0 255 ECU_ADDRESS 0x4002FC00 /end MEASUREMENT
/begin MEASUREMENT CoETS_trqInrLim "Limitation torque (inner engine torque)" SWORD Trq_Nm 0 0 -3276.0 3276.0 ECU_ADDRESS 0x400221D4 /end MEASUREMENT
/begin MEASUREMENT CoETS_trqLlim_mp "Longitudinal limitation for inner engine torque" SWORD Trq_Nm 0 0 -3276.0 3276.0 ECU_ADDRESS 0x400221D6 /end MEASUREMENT
/begin MEASUREMENT PthLead_trqInrCurrNoMo_mp "Inner torque current value before monitoring limitation" SWORD Trq_Nm 0 0 -3000.0 3276.7 ECU_ADDRESS 0x40023128 /end MEASUREMENT
/begin MEASUREMENT PthLead_trqInrLeadNoMo_mp "Inner torque lead value before monitoring limitation" SWORD Trq_Nm 0 0 -3000.0 3276.7 ECU_ADDRESS 0x4002312A /end MEASUREMENT
/begin MEASUREMENT PthLead_trqInrLeadMo_mp "Inner torque lead value after monitoring limitation" SWORD Trq_Nm 0 0 -3000.0 3276.7 ECU_ADDRESS 0x4002312C /end MEASUREMENT
/begin MEASUREMENT PthLead_trqInrCurrMo_mp "Inner torque current value after monitoring limitation" SWORD Trq_Nm 0 0 -3000.0 3276.7 ECU_ADDRESS 0x4002312E /end MEASUREMENT
/begin MEASUREMENT PthSet_tiSwtOff_mp "Time for switch off after overrun detection" ULONG Debounce_ms 0 0 0.0 65535.0 ECU_ADDRESS 0x40023130 /end MEASUREMENT
/begin MEASUREMENT PthSet_tiRmpStrt_mp "Time after overrun detection for ramp start" ULONG Debounce_ms 0 0 0.0 65535.0 ECU_ADDRESS 0x40023134 /end MEASUREMENT
/begin MEASUREMENT PthSet_dtrqRmpDwn_mp "Value for ramp negative slope" SWORD Trq_Nm_s 0 0 -3000.0 3276.7 ECU_ADDRESS 0x40023138 /end MEASUREMENT
/begin MEASUREMENT PthSet_trqLimOffs_mp "Limitation torque value with offset" SWORD Trq_Nm 0 0 -3000.0 3276.7 ECU_ADDRESS 0x4002313A /end MEASUREMENT
/begin MEASUREMENT PthSet_trqSetASDdc "Inner torque set value after first limitation" SWORD Trq_Nm 0 0 -3000.0 3276.7 ECU_ADDRESS 0x4002313C /end MEASUREMENT
/begin MEASUREMENT PthSet_trqBefPeakLim_mp "Maximum torque value before railpressure peak limiter" SWORD Trq_Nm 0 0 -3000.0 3276.7 ECU_ADDRESS 0x4002313E /end MEASUREMENT
/begin MEASUREMENT PthSet_trqBefRmp_mp "Set torque after second limitation, before overrun shut off" SWORD Trq_Nm 0 0 -3000.0 3276.7 ECU_ADDRESS 0x40023140 /end MEASUREMENT
/begin MEASUREMENT PthSet_trqRmp_mp "Ramp output torque of overrun shut off" SWORD Trq_Nm 0 0 -3000.0 3276.7 ECU_ADDRESS 0x40023142 /end MEASUREMENT
/begin MEASUREMENT PthSet_trqInrSetNoMo "Inner torque set value before monitoring limitation" SWORD Trq_Nm 0 0 -3000.0 3276.7 ECU_ADDRESS 0x40023144 /end MEASUREMENT
/begin MEASUREMENT PthSet_trqInrSet_mp "PthSet: inner torque set value measure point" SWORD Trq_Nm 0 0 -3000.0 3276.7 ECU_ADDRESS 0x40023146 /end MEASUREMENT
/begin MEASUREMENT PthSet_stDisable "Condition: overrun fuel cut-off" UBYTE boolean 0 0 0.0 1.0 ECU_ADDRESS 0x40023148 /end MEASUREMENT
/begin MEASUREMENT PthSet_stRmp_mp "Ramp state for overrun shut off (0: inactive; 1: active)" UBYTE boolean 0 0 0.0 1.0 ECU_ADDRESS 0x40023149 /end MEASUREMENT
/begin MEASUREMENT EngDem_trqLimRawErr_mp "Raw value of torque limitation in case of system error" SWORD Trq_Nm 0 0 -3276.8 3276.7 ECU_ADDRESS 0x40022BDA /end MEASUREMENT
/begin MEASUREMENT EngDem_trqLimMinCalc "Application parameter for engine torque limit demanded by the performance limiter." SWORD Trq_Nm 0 0 -3276.8 3276.7 ECU_ADDRESS 0x40022BDC /end MEASUREMENT
/begin MEASUREMENT EngDem_pDiffPFltPrdc_mp "Predicted difference pressure over particulate filter" SWORD AirPressure_kPa 0 0 0.0 500.0 ECU_ADDRESS 0x40022BDE /end MEASUREMENT
/begin MEASUREMENT EngDem_trqLimCalc "Limiting torque due to exhaust gas back-pressure" SWORD Trq_Nm 0 0 -3276.8 3276.7 ECU_ADDRESS 0x40022BE0 /end MEASUREMENT
/begin MEASUREMENT EngDem_trqLimRslt_mp "Resulting limiting torque before ramp" SWORD Trq_Nm 0 0 -3276.8 3276.7 ECU_ADDRESS 0x40022BE2 /end MEASUREMENT
/begin MEASUREMENT EngDem_trqLimSwt "Output of ramp switch element for torque limitation in case of system error" SWORD Trq_Nm 0 0 -3276.8 3276.7 ECU_ADDRESS 0x40022BE4 /end MEASUREMENT
/begin MEASUREMENT EngPrt_trqLimEngTempCor_mp "Engine Protection based on Engine temperature and Engine Speed" SWORD Trq_Nm 0 0 -3276.8 3276.7 ECU_ADDRESS 0x40022BEA /end MEASUREMENT
/begin MEASUREMENT EngPrt_trqLimAPSCor_mp "Torque limitation correction factor based on atmospheric pressure for engine protection" SWORD Trq_Nm 0 0 -3276.8 3276.7 ECU_ADDRESS 0x40022BEC /end MEASUREMENT
/begin MEASUREMENT EngPrt_trqLimCor_mp "Torque correction based on Env Pressure or Engine Temperature field" SWORD Trq_Nm 0 0 -3276.8 3276.7 ECU_ADDRESS 0x40022BEE /end MEASUREMENT
/begin MEASUREMENT EngPrt_trqLimCorVal_mp "Torque correction based on Env Pressure or Engine Temperature field multiplied by a factor" SWORD Trq_Nm 0 0 -3276.8 3276.7 ECU_ADDRESS 0x40022BF0 /end MEASUREMENT
/begin MEASUREMENT EngPrt_facTrqLimCor_mp "Env pressure and Engine Temperature Correction value for Torque Limitation" SWORD Factor 0 0 -10.0 10.0 ECU_ADDRESS 0x40022BF2 /end MEASUREMENT
/begin MEASUREMENT EngPrt_qLim_mp "Limitation quantity to protection from excessivetorque (Application of the limitation as Injectionquantity)" SWORD FuelMass_mg_hub 0 0 -319.0 319.0 ECU_ADDRESS 0x40022BF4 /end MEASUREMENT
/begin COMPU_METHOD EngSpeed_rpm "f(x)=(c1*X*X+c2*X+c3)/(c4*X*X+c5*X+c6)" RAT_FUNC "%6.1" "rpm" COEFFS 0 2.000 0.000 0 0 1.000 /end COMPU_METHOD
/begin COMPU_METHOD State_uint8 "f(x)=(c1*X*X+c2*X+c3)/(c4*X*X+c5*X+c6)" RAT_FUNC "%3.0" "" COEFFS 0 1 0 0 0 1 /end COMPU_METHOD
/begin COMPU_METHOD State_uint16 "f(x)=(c1*X*X+c2*X+c3)/(c4*X*X+c5*X+c6)" RAT_FUNC "%5.0" "" COEFFS 0 1 0 0 0 1 /end COMPU_METHOD
/begin COMPU_METHOD State_uint32 "f(x)=(c1*X*X+c2*X+c3)/(c4*X*X+c5*X+c6)" RAT_FUNC "%10.0" "" COEFFS 0 1 0 0 0 1 /end COMPU_METHOD
/begin COMPU_METHOD HLSDem_Kp "f(x)=(c1*X*X+c2*X+c3)/(c4*X*X+c5*X+c6)" RAT_FUNC "%0.3" "Nm/rpm" COEFFS 0 163840.000 0.000 0 0 1.000 /end COMPU_METHOD
/begin COMPU_METHOD HLSDem_Ki "f(x)=(c1*X*X+c2*X+c3)/(c4*X*X+c5*X+c6)" RAT_FUNC "%0.3" "Nm/(rpm*s)" COEFFS 0 10737.000 0.000 0 0 1.000 /end COMPU_METHOD
/begin COMPU_METHOD Trq_Nm "f(x)=(c1*X*X+c2*X+c3)/(c4*X*X+c5*X+c6)" RAT_FUNC "%0.3" "Nm" COEFFS 0 10.000 0.000 0 0 1.000 /end COMPU_METHOD
/begin COMPU_METHOD FdbkNm2rpm_rpm_Nm "f(x)=(c1*X*X+c2*X+c3)/(c4*X*X+c5*X+c6)" RAT_FUNC "%0.3" "rpm/Nm" COEFFS 0 1638.350 0.000 0 0 1.000 /end COMPU_METHOD
/begin COMPU_METHOD FuelMass_mg_hub "f(x)=(c1*X*X+c2*X+c3)/(c4*X*X+c5*X+c6)" RAT_FUNC "%0.3" "mg/hub" COEFFS 0 102.400 0.000 0 0 1.000 /end COMPU_METHOD
/begin COMPU_METHOD AirPressure_kPa "f(x)=(c1*X*X+c2*X+c3)/(c4*X*X+c5*X+c6)" RAT_FUNC "%0.3" "kPa" COEFFS 0 10.000 0.000 0 0 1.000 /end COMPU_METHOD
/begin COMPU_METHOD boolean "f(x)=(c1*X*X+c2*X+c3)/(c4*X*X+c5*X+c6)" RAT_FUNC "%1.0" "" COEFFS 0 1 0 0 0 1 /end COMPU_METHOD
/begin COMPU_METHOD Counter_num "f(x)=(c1*X*X+c2*X+c3)/(c4*X*X+c5*X+c6)" RAT_FUNC "%10.0" "" COEFFS 0 1 0 0 0 1 /end COMPU_METHOD
/begin COMPU_METHOD uint8 "f(x)=(c1*X*X+c2*X+c3)/(c4*X*X+c5*X+c6)" RAT_FUNC "%3.0" "" COEFFS 0 1 0 0 0 1 /end COMPU_METHOD
/begin COMPU_METHOD EngTime_ms "f(x)=(c1*X*X+c2*X+c3)/(c4*X*X+c5*X+c6)" RAT_FUNC "%0.3" "ms" COEFFS 0 1.000 0.000 0 0 10.000 /end COMPU_METHOD
/begin COMPU_METHOD Prc_100_rate "f(x)=(c1*X*X+c2*X+c3)/(c4*X*X+c5*X+c6)" RAT_FUNC "%0.3" "%" COEFFS 0 81.920 0.000 0 0 1.000 /end COMPU_METHOD
/begin COMPU_METHOD InjTime_us "f(x)=(c1*X*X+c2*X+c3)/(c4*X*X+c5*X+c6)" RAT_FUNC "%0.3" "us" COEFFS 0 2.500 0.000 0 0 1.000 /end COMPU_METHOD
/begin COMPU_METHOD DutyCycle_rate "f(x)=(c1*X*X+c2*X+c3)/(c4*X*X+c5*X+c6)" RAT_FUNC "%0.3" "%" COEFFS 0 100.000 0.000 0 0 1.000 /end COMPU_METHOD
/begin COMPU_METHOD Ad_mv "f(x)=(c1*X*X+c2*X+c3)/(c4*X*X+c5*X+c6)" RAT_FUNC "%5.0" "mv" COEFFS 0 1 0 0 0 1 /end COMPU_METHOD
/begin COMPU_METHOD TimeEngOn_s "f(x)=(c1*X*X+c2*X+c3)/(c4*X*X+c5*X+c6)" RAT_FUNC "%10.0" "s" COEFFS 0 1 0 0 0 1 /end COMPU_METHOD
/begin COMPU_METHOD Debounce_ms "f(x)=(c1*X*X+c2*X+c3)/(c4*X*X+c5*X+c6)" RAT_FUNC "%10.0" "ms" COEFFS 0 1 0 0 0 1 /end COMPU_METHOD
/begin COMPU_METHOD Accpedal_rate_s "f(x)=(c1*X*X+c2*X+c3)/(c4*X*X+c5*X+c6)" RAT_FUNC "%0.3" "%/s" COEFFS 0 81.920 0.000 0 0 1.000 /end COMPU_METHOD
/begin COMPU_METHOD FlowRes_kPa_m3_h "f(x)=(c1*X*X+c2*X+c3)/(c4*X*X+c5*X+c6)" RAT_FUNC "%0.3" "kPa/(m^3/h)" COEFFS 0 100000.000 0.000 0 0 1.000 /end COMPU_METHOD
/begin COMPU_METHOD Time_s "f(x)=(c1*X*X+c2*X+c3)/(c4*X*X+c5*X+c6)" RAT_FUNC "%0.3" "s" COEFFS 0 100.000 0.000 0 0 1.000 /end COMPU_METHOD
/begin COMPU_METHOD Freq_q1p0 "f(x)=(c1*X*X+c2*X+c3)/(c4*X*X+c5*X+c6)" RAT_FUNC "%5.0" "Hz" COEFFS 0 1 0 0 0 1 /end COMPU_METHOD
/begin COMPU_METHOD RailDT1_ms "f(x)=(c1*X*X+c2*X+c3)/(c4*X*X+c5*X+c6)" RAT_FUNC "%5.0" "ms" COEFFS 0 1 0 0 0 1 /end COMPU_METHOD
/begin COMPU_METHOD AirMass_mg_hub "f(x)=(c1*X*X+c2*X+c3)/(c4*X*X+c5*X+c6)" RAT_FUNC "%6.1" "mg/hub" COEFFS 0 2.000 0.000 0 0 1.000 /end COMPU_METHOD
/begin COMPU_METHOD EngSpeed_rpm_s "f(x)=(c1*X*X+c2*X+c3)/(c4*X*X+c5*X+c6)" RAT_FUNC "%6.1" "rpm/s" COEFFS 0 2.000 0.000 0 0 1.000 /end COMPU_METHOD
/begin COMPU_METHOD VehSpeed_km_h "f(x)=(c1*X*X+c2*X+c3)/(c4*X*X+c5*X+c6)" RAT_FUNC "%0.3" "km/h" COEFFS 0 100.000 0.000 0 0 1.000 /end COMPU_METHOD
/begin COMPU_METHOD TransRatio "f(x)=(c1*X*X+c2*X+c3)/(c4*X*X+c5*X+c6)" RAT_FUNC "%0.3" "" COEFFS 0 100.000 0.000 0 0 1.000 /end COMPU_METHOD
/begin COMPU_METHOD Temp_deg "f(x)=(c1*X*X+c2*X+c3)/(c4*X*X+c5*X+c6)" RAT_FUNC "%0.3" "deg" COEFFS 0 10.000 2731.400 0 0 1.000 /end COMPU_METHOD
/begin COMPU_METHOD Fact8192 "f(x)=(c1*X*X+c2*X+c3)/(c4*X*X+c5*X+c6)" RAT_FUNC "%14.6" "" COEFFS 0 8192.000 0.000 0 0 1.000 /end COMPU_METHOD
/begin COMPU_METHOD PT_fac "f(x)=(c1*X*X+c2*X+c3)/(c4*X*X+c5*X+c6)" RAT_FUNC "%0.3" "" COEFFS 0 655.360 0.000 0 0 1.000 /end COMPU_METHOD
/begin COMPU_METHOD AirMassPerTime "f(x)=(c1*X*X+c2*X+c3)/(c4*X*X+c5*X+c6)" RAT_FUNC "%7.2" "kg/h" COEFFS 0 4.000 0.000 0 0 1.000 /end COMPU_METHOD
/begin COMPU_METHOD Accpedal_rate "f(x)=(c1*X*X+c2*X+c3)/(c4*X*X+c5*X+c6)" RAT_FUNC "%0.3" "%" COEFFS 0 81.920 0.000 0 0 1.000 /end COMPU_METHOD
/begin COMPU_METHOD Factor "f(x)=(c1*X*X+c2*X+c3)/(c4*X*X+c5*X+c6)" RAT_FUNC "%12.6" "" COEFFS 0 1024.000 0.000 0 0 1.000 /end COMPU_METHOD
/begin COMPU_METHOD Pid_Kp_Kd "f(x)=(c1*X*X+c2*X+c3)/(c4*X*X+c5*X+c6)" RAT_FUNC "%0.3" "" COEFFS 0 1000.000 0.000 0 0 1.000 /end COMPU_METHOD
/begin COMPU_METHOD Pid_Ki "f(x)=(c1*X*X+c2*X+c3)/(c4*X*X+c5*X+c6)" RAT_FUNC "%0.3" "" COEFFS 0 1000.000 0.000 0 0 1.000 /end COMPU_METHOD
/begin COMPU_METHOD AirVol_m3_h "f(x)=(c1*X*X+c2*X+c3)/(c4*X*X+c5*X+c6)" RAT_FUNC "%0.3" "m^3/h" COEFFS 0 5.000 0.000 0 0 1.000 /end COMPU_METHOD
/begin COMPU_METHOD TrqEta_Nm_mg_hub "f(x)=(c1*X*X+c2*X+c3)/(c4*X*X+c5*X+c6)" RAT_FUNC "%10.6" "Nm/(mg/hub)" COEFFS 0 128.000 0.000 0 0 1.000 /end COMPU_METHOD
/begin COMPU_METHOD HLSDem_Inrt "f(x)=(c1*X*X+c2*X+c3)/(c4*X*X+c5*X+c6)" RAT_FUNC "%0.3" "Nm/(rpm/s)" COEFFS 0 640.000 0.000 0 0 1.000 /end COMPU_METHOD
/begin COMPU_METHOD Current_mA "f(x)=(c1*X*X+c2*X+c3)/(c4*X*X+c5*X+c6)" RAT_FUNC "%0.3" "mA" COEFFS 0 2.560 0.000 0 0 1.000 /end COMPU_METHOD
/begin COMPU_METHOD FuelVol_mm3_s "f(x)=(c1*X*X+c2*X+c3)/(c4*X*X+c5*X+c6)" RAT_FUNC "%0.3" "mm^3/s" COEFFS 0 1.000 0.000 0 0 10.000 /end COMPU_METHOD
/begin COMPU_METHOD RailPressure_bar "f(x)=(c1*X*X+c2*X+c3)/(c4*X*X+c5*X+c6)" RAT_FUNC "%0.3" "bar" COEFFS 0 12.800 0.000 0 0 1.000 /end COMPU_METHOD
/begin COMPU_METHOD Angle_CA "f(x)=(c1*X*X+c2*X+c3)/(c4*X*X+c5*X+c6)" RAT_FUNC "%0.3" "CA" COEFFS 0 45.511 0.000 0 0 1.000 /end COMPU_METHOD
/begin COMPU_METHOD Dsm "f(x)=(c1*X*X+c2*X+c3)/(c4*X*X+c5*X+c6)" RAT_FUNC "%1.0" "" COEFFS 0 1 0 0 0 1 /end COMPU_METHOD
/begin COMPU_METHOD Switch_conv "Enumerated data type: Switch_conv" TAB_VERB "%0.3" "" COMPU_TAB_REF VTAB_FOR_Switch_conv /end COMPU_METHOD
/begin COMPU_METHOD EISGov_num_conv "Enumerated data type: EISGov_num_conv" TAB_VERB "%0.3" "" COMPU_TAB_REF VTAB_FOR_EISGov_num_conv /end COMPU_METHOD
/begin COMPU_METHOD AirHtState_conv "Enumerated data type: AirHtState_conv" TAB_VERB "%0.3" "" COMPU_TAB_REF VTAB_FOR_AirHtState_conv /end COMPU_METHOD
/begin COMPU_METHOD RailCtl_State_conv "Enumerated data type: RailCtl_State_conv" TAB_VERB "%0.3" "" COMPU_TAB_REF VTAB_FOR_RailCtl_State_conv /end COMPU_METHOD
/begin COMPU_METHOD Rail_BlkShtMode_VERB "Enumerated data type: Rail_BlkShtMode_VERB" TAB_VERB "%0.3" "" COMPU_TAB_REF VTAB_FOR_Rail_BlkShtMode_VERB /end COMPU_METHOD
/begin COMPU_METHOD Rail_StM_VERB "Enumerated data type: Rail_StM_VERB" TAB_VERB "%0.3" "" COMPU_TAB_REF VTAB_FOR_Rail_StM_VERB /end COMPU_METHOD
/begin COMPU_METHOD PRV_State_conv "Enumerated data type: PRV_State_conv" TAB_VERB "%0.3" "" COMPU_TAB_REF VTAB_FOR_PRV_State_conv /end COMPU_METHOD
/begin COMPU_METHOD PRV_EVALRPState_conv "Enumerated data type: PRV_EVALRPState_conv" TAB_VERB "%0.3" "" COMPU_TAB_REF VTAB_FOR_PRV_EVALRPState_conv /end COMPU_METHOD
/begin COMPU_METHOD Trq_Nm_s "f(x)=(c1*X*X+c2*X+c3)/(c4*X*X+c5*X+c6)" RAT_FUNC "%0.3" "Nm/s" COEFFS 0 10.000 0.000 0 0 1.000 /end COMPU_METHOD
/begin COMPU_METHOD EngTempFldSel_conv "Enumerated data type: EngTempFldSel_conv" TAB_VERB "%0.3" "" COMPU_TAB_REF VTAB_FOR_EngTempFldSel_conv /end COMPU_METHOD
/begin COMPU_METHOD uint32 "f(x)=(c1*X*X+c2*X+c3)/(c4*X*X+c5*X+c6)" RAT_FUNC "%10.0" "" COEFFS 0 1 0 0 0 1 /end COMPU_METHOD
/begin COMPU_VTAB VTAB_FOR_Switch_conv "Enumerated data type: Switch_conv" TAB_VERB 2 0 "OFF" 1 "ON" /end COMPU_VTAB
/begin COMPU_VTAB VTAB_FOR_EISGov_num_conv "Enumerated data type: EISGov_num_conv" TAB_VERB 9 0 "EISGov" 1 "HLSDem" 2 "GSHDem" 3 "WESDem" 4 "DiaDem" 5 "AGSDem" 6 "ExtDem" 127 "EngICO" 7 "DrvDem" /end COMPU_VTAB
/begin COMPU_VTAB VTAB_FOR_AirHtState_conv "Enumerated data type: AirHtState_conv" TAB_VERB 9 0 "AIRHT_READING" 1 "AIRHT_PREHTR" 2 "AIRHT_STBHTR" 3 "AIRHT_STB" 4 "AIRHT_CRKHTR" 5 "AIRHT_CRK" 6 "AIRHT_POSTHTR" 7 "AIRHT_END" 8 "AIRHT_AFTERRUN" /end COMPU_VTAB
/begin COMPU_VTAB VTAB_FOR_RailCtl_State_conv "Enumerated data type: RailCtl_State_conv" TAB_VERB 12 0 "RAIL_STRT" 3 "RAIL_PRECTL_MEUN" 4 "RAIL_CTL_PCV" 5 "RAIL_CTL_MEUN" 7 "RAIL_SHUTOFF_SYS" 11 "RAIL_DEFLATE" 13 "RAIL_LIMP_NOCTL" 14 "RAIL_LIMP_OPENCTL" 15 "RAIL_CTL_CPC" 16 "RAIL_SWT_PRECTL_PCV" 17 "RAIL_SWT_CTL_CPC" 18 "RAIL_SWT_PRECTL_MEUN" /end COMPU_VTAB
/begin COMPU_VTAB VTAB_FOR_Rail_BlkShtMode_VERB "Enumerated data type: Rail_BlkShtMode_VERB" TAB_VERB 3 0 "RAIL_NOBLKSHT" 1 "RAIL_BSOVRRUNDEFLATE" 2 "RAIL_BSAFTRRUN" /end COMPU_VTAB
/begin COMPU_VTAB VTAB_FOR_Rail_StM_VERB "Enumerated data type: Rail_StM_VERB" TAB_VERB 11 0 "RAIL_STBSINACTV" 1 "RAIL_STBSPRECTL" 2 "RAIL_STBSREDFREQ" 3 "RAIL_STBSSTABILIZE" 4 "RAIL_STBSDEFLATE" 5 "RAIL_STBSCLSDLOOP" 6 "RAIL_STBSOPENLOOP" 7 "RAIL_STBSRDY" 8 "RAIL_STBSDRVRUN" 9 "RAIL_STBSABORT" 10 "RAIL_STBSCMPL" /end COMPU_VTAB
/begin COMPU_VTAB VTAB_FOR_PRV_State_conv "Enumerated data type: PRV_State_conv" TAB_VERB 5 0 "PRV_ST_INIT" 2 "PRV_ST_CLOSED" 3 "PRV_ST_FORCEOPN_PRESINC" 4 "PRV_ST_FORCEOPN_PRESSHCK" 5 "PRV_ST_OPEN" /end COMPU_VTAB
/begin COMPU_VTAB VTAB_FOR_PRV_EVALRPState_conv "Enumerated data type: PRV_EVALRPState_conv" TAB_VERB 6 0 "PRV_EVALRP_INIT" 1 "PRV_EVALRP_GRAD0" 2 "PRV_EVALRP_GRAD1" 3 "PRV_EVALRP_OPEN" 4 "PRV_EVALRP_OUTOFRNG" 5 "PRV_EVALRP_NOCALC" /end COMPU_VTAB
/begin COMPU_VTAB VTAB_FOR_EngTempFldSel_conv "Enumerated data type: EngTempFldSel_conv" TAB_VERB 3 0 "Coolant_Temperature" 1 "Oil_Temperature" 2 "Eng_Temperature" /end COMPU_VTAB
/begin GROUP S318_MeUn_Rot "DCRS_FrameModel_TorqueStructure/Subsystem/CORE/DE/Fl/Rail/MeUn/MeUn_Rot" /begin SUB_GROUP MeUn_Rot /end SUB_GROUP /begin REF_MEASUREMENT MeUn_rPs MeUn_stRot /end REF_MEASUREMENT /end GROUP
/begin GROUP S318_MeUn_VD "DCRS_FrameModel_TorqueStructure/Subsystem/CORE/DE/Fl/Rail/MeUn/MeUn_VD" /begin SUB_GROUP MeUn_VD /end SUB_GROUP
 /begin REF_MEASUREMENT MeUn_bFinalDef MeUn_bProvDef MeUn_facCrntCtlLim_mp MeUn_iActVal MeUn_iSet /end REF_MEASUREMENT
/end GROUP
/begin GROUP S319_RailP_DD "DCRS_FrameModel_TorqueStructure/Subsystem/CORE/DE/Fl/Rail/RailP/RailP_DD" /begin SUB_GROUP RailP_DD /end SUB_GROUP /begin REF_MEASUREMENT RailP_bFinalDef RailP_bProvDef RailP_pLin /end REF_MEASUREMENT /end GROUP
/begin GROUP S319_RailP_DD1ms "DCRS_FrameModel_TorqueStructure/Subsystem/CORE/DE/Fl/Rail/RailP/RailP_DD1ms" /begin SUB_GROUP RailP_DD1ms /end SUB_GROUP /begin REF_MEASUREMENT RailP_uRaw RailP_uRawSens_mp /end REF_MEASUREMENT /end GROUP
/begin GROUP S319_RailP_DDsync "DCRS_FrameModel_TorqueStructure/Subsystem/CORE/DE/Fl/Rail/RailP/RailP_DDsync" /begin SUB_GROUP RailP_DDsync /end SUB_GROUP /begin REF_MEASUREMENT RailP_pLinCurr_mp RailP_stSRCCurr_mp /end REF_MEASUREMENT /end GROUP
/begin GROUP S319_RailP_PRV "DCRS_FrameModel_TorqueStructure/Subsystem/CORE/DE/Fl/Rail/RailP/RailP_PRV" /begin SUB_GROUP RailP_PRV /end SUB_GROUP /begin REF_MEASUREMENT PRV_ctPresShck_mp PRV_pAvrgRP_mp PRV_st PRV_stEvalRP /end REF_MEASUREMENT /end GROUP
/begin GROUP S319_RailP_VD "DCRS_FrameModel_TorqueStructure/Subsystem/CORE/DE/Fl/Rail/RailP/RailP_VD" /begin SUB_GROUP RailP_VD /end SUB_GROUP /begin REF_MEASUREMENT RailP_pFlt RailP_pSubsVal_mp /end REF_MEASUREMENT /end GROUP
/begin GROUP S319_RailP_VDGradMon "DCRS_FrameModel_TorqueStructure/Subsystem/CORE/DE/Fl/Rail/RailP/RailP_VDGradMon" /begin SUB_GROUP RailP_VDGradMon /end SUB_GROUP /begin REF_MEASUREMENT RailP_bGradMonFinalDef RailP_bGradMonProvDef RailP_stGrad /end REF_MEASUREMENT /end GROUP
/begin GROUP S319_RailP_VDSync "DCRS_FrameModel_TorqueStructure/Subsystem/CORE/DE/Fl/Rail/RailP/RailP_VDSync" /begin SUB_GROUP RailP_VDSync /end SUB_GROUP /begin REF_MEASUREMENT RailP_pCurr /end REF_MEASUREMENT /end GROUP
/begin GROUP S380_GbxNPos_DD "DCRS_FrameModel_TorqueStructure/Subsystem/CORE/DE/VehDev/Gbx/GbxNPos/GbxNPos_DD" /begin SUB_GROUP GbxNPos_DD /end SUB_GROUP /begin REF_MEASUREMENT Gbx_stNPos /end REF_MEASUREMENT /end GROUP
/begin GROUP S27_ASDdc_Governor "DCRS_FrameModel_TorqueStructure/Subsystem/CORE/ASW/Eng/ETS/ASD/ASDdc/ASDdc_Governor" /begin SUB_GROUP ASDdc_Governor /end SUB_GROUP /begin REF_MEASUREMENT ASDdc_trq /end REF_MEASUREMENT /end GROUP
/begin GROUP S27_ASDdc_SelectParameter "DCRS_FrameModel_TorqueStructure/Subsystem/CORE/ASW/Eng/ETS/ASD/ASDdc/ASDdc_SelectParameter" /begin SUB_GROUP ASDdc_SelectParameter /end SUB_GROUP /begin REF_MEASUREMENT ASDdc_KdGovCurr_mp ASDdc_T1GovCurr_mp /end REF_MEASUREMENT /end GROUP
/begin GROUP S28_ASDrf_Governor "DCRS_FrameModel_TorqueStructure/Subsystem/CORE/ASW/Eng/ETS/ASD/ASDrf/ASDrf_Governor" /begin SUB_GROUP ASDrf_Governor /end SUB_GROUP /begin REF_MEASUREMENT ASDrf_stPosNeg ASDrf_trqInrSet /end REF_MEASUREMENT /end GROUP
/begin GROUP S28_ASDrf_SelectParameter "DCRS_FrameModel_TorqueStructure/Subsystem/CORE/ASW/Eng/ETS/ASD/ASDrf/ASDrf_SelectParameter" /begin SUB_GROUP ASDrf_SelectParameter /end SUB_GROUP /begin REF_MEASUREMENT ASDrf_facGovCurr_mp /end REF_MEASUREMENT /end GROUP
/begin GROUP S37_PthLead_TrqCalc "DCRS_FrameModel_TorqueStructure/Subsystem/CORE/ASW/Eng/ETS/ETSPth/PthLead/PthLead_TrqCalc" /begin SUB_GROUP PthLead_TrqCalc /end SUB_GROUP /begin REF_MEASUREMENT PthLead_stActvMonLim PthLead_trqInrCurr PthLead_trqInrLead /end REF_MEASUREMENT /end GROUP
/begin GROUP S38_PthSet_OvrRunCoord "DCRS_FrameModel_TorqueStructure/Subsystem/CORE/ASW/Eng/ETS/ETSPth/PthSet/PthSet_OvrRunCoord" /begin SUB_GROUP PthSet_OvrRunCoord /end SUB_GROUP /begin REF_MEASUREMENT PthSet_stOvrRun /end REF_MEASUREMENT /end GROUP
/begin GROUP S38_PthSet_TrqCalc "DCRS_FrameModel_TorqueStructure/Subsystem/CORE/ASW/Eng/ETS/ETSPth/PthSet/PthSet_TrqCalc" /begin SUB_GROUP PthSet_TrqCalc /end SUB_GROUP /begin REF_MEASUREMENT PthSet_stActvMonLim PthSet_trqInrSet PthSet_trqInrSetSum /end REF_MEASUREMENT /end GROUP
/begin GROUP S43_EngPrt_OvrSpd "DCRS_FrameModel_TorqueStructure/Subsystem/CORE/ASW/Eng/ETS/EngDem/EngPrt/EngPrt_OvrSpd" /begin SUB_GROUP EngPrt_OvrSpd /end SUB_GROUP /end GROUP
/begin GROUP S43_EngPrt_PrtLimMech "DCRS_FrameModel_TorqueStructure/Subsystem/CORE/ASW/Eng/ETS/EngDem/EngPrt/EngPrt_PrtLimMech" /begin SUB_GROUP EngPrt_PrtLimMech /end SUB_GROUP /begin REF_MEASUREMENT EngPrt_trqLimMech EngPrt_trqNLim EngPrt_trqUnLim /end REF_MEASUREMENT /end GROUP
/begin GROUP S43_EngPrt_PrtLimOvht "DCRS_FrameModel_TorqueStructure/Subsystem/CORE/ASW/Eng/ETS/EngDem/EngPrt/EngPrt_PrtLimOvht" /begin SUB_GROUP EngPrt_PrtLimOvht /end SUB_GROUP /begin REF_MEASUREMENT EngPrt_trqLimOvhtPrv /end REF_MEASUREMENT /end GROUP
/begin GROUP S43_EngPrt_TrqLimCalc "DCRS_FrameModel_TorqueStructure/Subsystem/CORE/ASW/Eng/ETS/EngDem/EngPrt/EngPrt_TrqLimCalc" /begin SUB_GROUP /end SUB_GROUP /begin REF_MEASUREMENT EngPrt_trqLim /end REF_MEASUREMENT /end GROUP
/begin GROUP S43_EngPrt_TrqLimPTO "DCRS_FrameModel_TorqueStructure/Subsystem/CORE/ASW/Eng/ETS/EngDem/EngPrt/EngPrt_TrqLimPTO" /begin SUB_GROUP EngPrt_TrqLimPTO /end SUB_GROUP /begin REF_MEASUREMENT EngPrt_trqLimPTO /end REF_MEASUREMENT /end GROUP
/begin GROUP S44_EngReq_FullLdIncr "DCRS_FrameModel_TorqueStructure/Subsystem/CORE/ASW/Eng/ETS/EngDem/EngReq/EngReq_FullLdIncr" /begin SUB_GROUP /end SUB_GROUP /begin REF_MEASUREMENT EngReq_trqFullLdIncrOfs /end REF_MEASUREMENT /end GROUP
/begin GROUP S44_EngReq_InjLimCalc "DCRS_FrameModel_TorqueStructure/Subsystem/CORE/ASW/Eng/ETS/EngDem/EngReq/EngReq_InjLimCalc" /begin SUB_GROUP /end SUB_GROUP /begin REF_MEASUREMENT EngReq_trqInrQLim /end REF_MEASUREMENT /end GROUP
/begin GROUP S44_EngReq_SmkLimCalc "DCRS_FrameModel_TorqueStructure/Subsystem/CORE/ASW/Eng/ETS/EngDem/EngReq/EngReq_SmkLimCalc" /begin SUB_GROUP EngReq_SmkLimCalc /end SUB_GROUP
 /begin REF_MEASUREMENT AFS_mAirPerCylFlt EngReq_trqInrLimSmk EngReq_trqInrLimSmkPrs EngReq_trqInrLimSmkSlow /end REF_MEASUREMENT
/end GROUP
/begin GROUP S44_EngReq_TrqLimCalc "DCRS_FrameModel_TorqueStructure/Subsystem/CORE/ASW/Eng/ETS/EngDem/EngReq/EngReq_TrqLimCalc" /begin SUB_GROUP /end SUB_GROUP /begin REF_MEASUREMENT EngReq_trqLim /end REF_MEASUREMENT /end GROUP
/begin GROUP S54_DrvDem_CalcState "DCRS_FrameModel_TorqueStructure/Subsystem/CORE/ASW/Eng/ETS/SpdGov/DrvDem/DrvDem_CalcState" /begin SUB_GROUP DrvDem_CalcState /end SUB_GROUP /begin REF_MEASUREMENT DrvDem_st DrvDem_stShOff DrvDem_trqReq EISGov_st7 /end REF_MEASUREMENT /end GROUP
/begin GROUP S54_DrvDem_SelectParameter "DCRS_FrameModel_TorqueStructure/Subsystem/CORE/ASW/Eng/ETS/SpdGov/DrvDem/DrvDem_SelectParameter" /begin SUB_GROUP DrvDem_SelectParameter /end SUB_GROUP
 /begin REF_MEASUREMENT DrvDem_IWinNegHi DrvDem_IWinNegLo DrvDem_IWinPosHi DrvDem_IWinPosLo DrvDem_InrtVehCurr DrvDem_KiCurrHi_mp DrvDem_KiCurrLo_mp DrvDem_KiNegCurrHi_mp DrvDem_KiNegCurrLo_mp DrvDem_KiPosCurrHi_mp DrvDem_KiPosCurrLo_mp DrvDem_KpCurrHi_mp DrvDem_KpCurrLo_mp DrvDem_KpNegCurrHi_mp DrvDem_KpNegCurrLo_mp DrvDem_KpPosCurrHi_mp DrvDem_KpPosCurrLo_mp DrvDem_PWinNegHi DrvDem_PWinNegLo DrvDem_PWinPosHi DrvDem_PWinPosLo DrvDem_dnAccLim DrvDem_dnDeclLim DrvDem_facFdbkTrqLosHi DrvDem_facFdbkTrqLosLo DrvDem_tiFltTrqLosEstCurr /end REF_MEASUREMENT
/end GROUP
/begin GROUP S54_DrvDem_SetPoint "DCRS_FrameModel_TorqueStructure/Subsystem/CORE/ASW/Eng/ETS/SpdGov/DrvDem/DrvDem_SetPoint" /begin SUB_GROUP DrvDem_SetPoint /end SUB_GROUP /begin REF_MEASUREMENT DrvDem_nSetPHi DrvDem_nSetPLo DrvDem_swtDrvNGovActv /end REF_MEASUREMENT /end GROUP
/begin GROUP S55_EISGov_Governor "DCRS_FrameModel_TorqueStructure/Subsystem/CORE/ASW/Eng/ETS/SpdGov/EISGov/EISGov_Governor" /begin SUB_GROUP EISGov_Governor /end SUB_GROUP
 /begin REF_MEASUREMENT EISGov_trq EISGov_trqFlt EISGov_trqPLo SpdGov_trqFlt SpdGov_trqLead SpdGov_trqSet /end REF_MEASUREMENT
/end GROUP
/begin GROUP S55_EISGov_SelectParameter "DCRS_FrameModel_TorqueStructure/Subsystem/CORE/ASW/Eng/ETS/SpdGov/EISGov/EISGov_SelectParameter" /begin SUB_GROUP EISGov_SelectParameter /end SUB_GROUP
 /begin REF_MEASUREMENT EISGov_IWinNegHi EISGov_IWinNegLo EISGov_IWinPosHi EISGov_IWinPosLo EISGov_KiCurrHi_mp EISGov_KiCurrLo_mp EISGov_KiNegCurrHi_mp EISGov_KiNegCurrLo_mp EISGov_KiPosCurrHi_mp EISGov_KiPosCurrLo_mp EISGov_KpCurrHi_mp EISGov_KpCurrLo_mp EISGov_KpNegCurrHi_mp EISGov_KpNegCurrLo_mp EISGov_KpPosCurrHi_mp EISGov_KpPosCurrLo_mp EISGov_PWinNegHi EISGov_PWinNegLo EISGov_PWinPosHi EISGov_PWinPosLo EISGov_nSetPHi EISGov_nSetPLo EISGov_numCurrFunc EISGov_trqReq /end REF_MEASUREMENT
/end GROUP
/begin GROUP S55_EISGov_SelectTrqLim "DCRS_FrameModel_TorqueStructure/Subsystem/CORE/ASW/Eng/ETS/SpdGov/EISGov/EISGov_SelectTrqLim" /begin SUB_GROUP EISGov_SelectTrqLim /end SUB_GROUP
 /begin REF_MEASUREMENT EISGov_trqCmpMaxStruct EISGov_trqCmpMinStruct EISGov_trqLimMax EISGov_trqLimMin EISGov_trqSpdGovLim /end REF_MEASUREMENT
/end GROUP
/begin GROUP S55_EISGov_TrqLosEst "DCRS_FrameModel_TorqueStructure/Subsystem/CORE/ASW/Eng/ETS/SpdGov/EISGov/EISGov_TrqLosEst" /begin SUB_GROUP EISGov_TrqLosEst /end SUB_GROUP /begin REF_MEASUREMENT EISGov_trqLosFlt /end REF_MEASUREMENT /end GROUP
/begin GROUP S56_ExtDem_CalcState "DCRS_FrameModel_TorqueStructure/Subsystem/CORE/ASW/Eng/ETS/SpdGov/ExtDem/ExtDem_CalcState" /begin SUB_GROUP ExtDem_CalcState /end SUB_GROUP /begin REF_MEASUREMENT EISGov_st6 ExtDem_trqReq /end REF_MEASUREMENT /end GROUP
/begin GROUP S56_ExtDem_SelectParameter "DCRS_FrameModel_TorqueStructure/Subsystem/CORE/ASW/Eng/ETS/SpdGov/ExtDem/ExtDem_SelectParameter" /begin SUB_GROUP ExtDem_SelectParameter /end SUB_GROUP
 /begin REF_MEASUREMENT ExtDem_Cfg_mp ExtDem_IWinNegHi ExtDem_IWinNegLo ExtDem_IWinPosHi ExtDem_IWinPosLo ExtDem_InrtVehCurr ExtDem_KiCorFac_mp ExtDem_KiCurrHi_mp ExtDem_KiCurrLo_mp ExtDem_KiNegCurrHi_mp ExtDem_KiNegCurrLo_mp ExtDem_KiPosCurrHi_mp ExtDem_KiPosCurrLo_mp ExtDem_KpCorFac_mp ExtDem_KpCurrHi_mp ExtDem_KpCurrLo_mp ExtDem_KpNegCurrHi_mp ExtDem_KpNegCurrLo_mp ExtDem_KpPosCurrHi_mp ExtDem_KpPosCurrLo_mp ExtDem_PWinNegHi ExtDem_PWinNegLo ExtDem_PWinPosHi ExtDem_PWinPosLo ExtDem_dnAccLim ExtDem_dnDeclLim ExtDem_facFdbk ExtDem_facFdbkTrqLosHi ExtDem_facFdbkTrqLosLo ExtDem_tiFltTrqLosEstCurr /end REF_MEASUREMENT
/end GROUP
/begin GROUP S56_ExtDem_SetPoint "DCRS_FrameModel_TorqueStructure/Subsystem/CORE/ASW/Eng/ETS/SpdGov/ExtDem/ExtDem_SetPoint" /begin SUB_GROUP ExtDem_SetPoint /end SUB_GROUP /begin REF_MEASUREMENT ExtDem_nSetPCorVal ExtDem_nSetPHi ExtDem_nSetPLo /end REF_MEASUREMENT /end GROUP
/begin GROUP S57_HLSDem_CalcState "DCRS_FrameModel_TorqueStructure/Subsystem/CORE/ASW/Eng/ETS/SpdGov/HLSDem/HLSDem_CalcState" /begin SUB_GROUP HLSDem_CalcState /end SUB_GROUP /begin REF_MEASUREMENT EISGov_st EISGov_st1 HLSDem_trqReq SpdGov_st /end REF_MEASUREMENT /end GROUP
/begin GROUP S57_HLSDem_SelectParameter "DCRS_FrameModel_TorqueStructure/Subsystem/CORE/ASW/Eng/ETS/SpdGov/HLSDem/HLSDem_SelectParameter" /begin SUB_GROUP HLSDem_SelectParameter /end SUB_GROUP
 /begin REF_MEASUREMENT HLSDem_IWinNegHiCurr_mp HLSDem_IWinNegLoCurr_mp HLSDem_IWinPosHiCurr_mp HLSDem_IWinPosLoCurr_mp HLSDem_InrtVehCurr HLSDem_KiHiCurr_mp HLSDem_KiLoCurr_mp HLSDem_KiNegHiCurr_mp HLSDem_KiNegLoCurr_mp HLSDem_KiPosHiCurr_mp HLSDem_KiPosLoCurr_mp HLSDem_KpHiCurr_mp HLSDem_KpLoCurr_mp HLSDem_KpNegHiCurr_mp HLSDem_KpNegLoCurr_mp HLSDem_KpPosHiCurr_mp HLSDem_KpPosLoCurr_mp HLSDem_PWinNegHiCurr_mp HLSDem_PWinNegLoCurr_mp HLSDem_PWinPosHiCurr_mp HLSDem_PWinPosLoCurr_mp HLSDem_dnAccLim HLSDem_dnDeclLim HLSDem_facFdbkHi HLSDem_facFdbkLo HLSDem_facFdbkTrqLosHi HLSDem_facFdbkTrqLosLo HLSDem_tiFltTrqLosEstCurr /end REF_MEASUREMENT
/end GROUP
/begin GROUP S57_HLSDem_SetPoint "DCRS_FrameModel_TorqueStructure/Subsystem/CORE/ASW/Eng/ETS/SpdGov/HLSDem/HLSDem_SetPoint" /begin SUB_GROUP HLSDem_SetPoint /end SUB_GROUP /begin REF_MEASUREMENT HLSDem_nSetPHi HLSDem_nSetPLo HLSDem_nSetPLoBas /end REF_MEASUREMENT /end GROUP
/begin GROUP S71_CnvLead_Trq2Q "DCRS_FrameModel_TorqueStructure/Subsystem/CORE/ASW/Eng/ETS/TrqCnv/CnvLead/CnvLead_Trq2Q" /begin SUB_GROUP CnvLead_Trq2Q /end SUB_GROUP /begin REF_MEASUREMENT CnvLead_facRmpVal CnvLead_qCurr CnvLead_qRaw /end REF_MEASUREMENT /end GROUP
/begin GROUP S72_CnvSet_Trq2Q "DCRS_FrameModel_TorqueStructure/Subsystem/CORE/ASW/Eng/ETS/TrqCnv/CnvSet/CnvSet_Trq2Q" /begin SUB_GROUP CnvSet_Trq2Q /end SUB_GROUP
 /begin REF_MEASUREMENT CnvSet_etaCurr CnvSet_etaCurrNxt CnvSet_etaCurrRmp CnvSet_facRmpVal CnvSet_qSet CnvSet_qSetNxt CnvSet_qSetPrs CnvSet_qStrt PthSet_trqInrSetAct /end REF_MEASUREMENT
/end GROUP
/begin GROUP S75_ActMod_Q2Trq "DCRS_FrameModel_TorqueStructure/Subsystem/CORE/ASW/Eng/ETS/TrqMod/ActMod/ActMod_Q2Trq" /begin SUB_GROUP ActMod_Q2Trq /end SUB_GROUP /begin REF_MEASUREMENT ActMod_trqInr /end REF_MEASUREMENT /end GROUP
/begin GROUP S75_ActMod_TrqCalc "DCRS_FrameModel_TorqueStructure/Subsystem/CORE/ASW/Eng/ETS/TrqMod/ActMod/ActMod_TrqCalc" /begin SUB_GROUP /end SUB_GROUP
 /begin REF_MEASUREMENT ActMod_rTrq ActMod_trqClth ActMod_trqClthMinBrk ActMod_trqCrS ActMod_trqMinBrk /end REF_MEASUREMENT
/end GROUP
/begin GROUP S76_PhyMod_CalcCor "DCRS_FrameModel_TorqueStructure/Subsystem/CORE/ASW/Eng/ETS/TrqMod/PhyMod/PhyMod_CalcCor" /begin SUB_GROUP PhyMod_CalcCor /end SUB_GROUP
 /begin REF_MEASUREMENT CoEOM_facRmpVal PhyMod_facEtaCor PhyMod_facEtaCorNxt PhyMod_qCor PhyMod_qCorNxt PhyMod_stNxt PhyMod_stPrs /end REF_MEASUREMENT
/end GROUP
/begin GROUP S77_RngMod_TrqCalc "DCRS_FrameModel_TorqueStructure/Subsystem/CORE/ASW/Eng/ETS/TrqMod/RngMod/RngMod_TrqCalc" /begin SUB_GROUP /end SUB_GROUP /begin REF_MEASUREMENT RngMod_trqComp RngMod_trqCrSMin RngMod_trqLos /end REF_MEASUREMENT /end GROUP
/begin GROUP S77_RngMod_TrqFrcAdpt "DCRS_FrameModel_TorqueStructure/Subsystem/CORE/ASW/Eng/ETS/TrqMod/RngMod/RngMod_TrqFrcAdpt" /begin SUB_GROUP RngMod_TrqFrcAdpt /end SUB_GROUP /begin REF_MEASUREMENT RngMod_trqDiffAdap /end REF_MEASUREMENT /end GROUP
/begin GROUP S77_RngMod_TrqFrcCalc "DCRS_FrameModel_TorqueStructure/Subsystem/CORE/ASW/Eng/ETS/TrqMod/RngMod/RngMod_TrqFrcCalc" /begin SUB_GROUP RngMod_TrqFrcCalc /end SUB_GROUP /begin REF_MEASUREMENT RngMod_trqFrc RngMod_trqLossComp RngMod_trqMin /end REF_MEASUREMENT /end GROUP
/begin GROUP S77_RngMod_TrqSpdCrv "DCRS_FrameModel_TorqueStructure/Subsystem/CORE/ASW/Eng/ETS/TrqMod/RngMod/RngMod_TrqSpdCrv" /begin SUB_GROUP RngMod_TrqSpdCrv /end SUB_GROUP /begin REF_MEASUREMENT RngMod_trqCrSMax RngMod_trqMax /end REF_MEASUREMENT /end GROUP
/begin GROUP S92_ASMod_VolEff "DCRS_FrameModel_TorqueStructure/Subsystem/CORE/ASW/Eng/GsSys/ASMod/AirMod/ASMod_VolEff" /begin SUB_GROUP ASMod_VolEff /end SUB_GROUP /begin REF_MEASUREMENT ASMod_dmIndAirRef ASMod_facVolEff ASMod_mAirPerCylCor /end REF_MEASUREMENT /end GROUP
/begin GROUP S93_ASMod_TempCatMod "DCRS_FrameModel_TorqueStructure/Subsystem/CORE/ASW/Eng/GsSys/ASMod/ExhMod/ASMod_TempCatMod" /begin SUB_GROUP ASMod_TempCatMod /end SUB_GROUP /begin REF_MEASUREMENT ASMod_dvolPFltEG PFltLd_resFlw /end REF_MEASUREMENT /end GROUP
/begin GROUP S96_AirCtl_Co "DCRS_FrameModel_TorqueStructure/Subsystem/CORE/ASW/Eng/GsSys/AirSys/AirCtl/AirCtl_Co" /begin SUB_GROUP AirCtl_Co /end SUB_GROUP
 /begin REF_MEASUREMENT AirCtl_qCtlVal AirCtl_qDesVal AirCtl_qGov AirCtl_qMon AirCtl_trqCtlVal AirCtl_trqDesVal AirCtl_trqGov AirCtl_trqMon /end REF_MEASUREMENT
/end GROUP
/begin GROUP S96_AirCtl_CtlValCalc "DCRS_FrameModel_TorqueStructure/Subsystem/CORE/ASW/Eng/GsSys/AirSys/AirCtl/AirCtl_CtlValCalc" /begin SUB_GROUP AirCtl_CtlValCalc /end SUB_GROUP /begin REF_MEASUREMENT AirCtl_rCtlVal /end REF_MEASUREMENT /end GROUP
/begin GROUP S96_AirCtl_DesValCalc "DCRS_FrameModel_TorqueStructure/Subsystem/CORE/ASW/Eng/GsSys/AirSys/AirCtl/AirCtl_DesValCalc" /begin SUB_GROUP AirCtl_DesValCalc /end SUB_GROUP /begin REF_MEASUREMENT AirCtl_mDesBasEOM0 AirCtl_mDesVal /end REF_MEASUREMENT /end GROUP
/begin GROUP S96_AirCtl_Gov "DCRS_FrameModel_TorqueStructure/Subsystem/CORE/ASW/Eng/GsSys/AirSys/AirCtl/AirCtl_Gov" /begin SUB_GROUP AirCtl_Gov /end SUB_GROUP /begin REF_MEASUREMENT AirCtl_mGovDvt AirCtl_rGovEGR AirCtl_rGovTVA AirCtl_stGov /end REF_MEASUREMENT /end GROUP
/begin GROUP S96_AirCtl_Mon "DCRS_FrameModel_TorqueStructure/Subsystem/CORE/ASW/Eng/GsSys/AirSys/AirCtl/AirCtl_Mon" /begin SUB_GROUP AirCtl_Mon /end SUB_GROUP /begin REF_MEASUREMENT AirCtl_stAirCtlBits AirCtl_stMon EGRVlv_r ThrVlv_r /end REF_MEASUREMENT /end GROUP
/begin GROUP S97_AirHt_Ctl "DCRS_FrameModel_TorqueStructure/Subsystem/CORE/ASW/Eng/GsSys/AirSys/AirHt/AirHt_Ctl" /begin SUB_GROUP AirHt_Ctl /end SUB_GROUP /begin REF_MEASUREMENT AirHt_st GlwLmp_st IAirHt_st /end REF_MEASUREMENT /end GROUP
/begin GROUP S98_CoAS_RlsCmpn "DCRS_FrameModel_TorqueStructure/Subsystem/CORE/ASW/Eng/GsSys/AirSys/CoAS/CoAS_RlsCmpn" /begin SUB_GROUP CoAS_RlsCmpn /end SUB_GROUP /begin REF_MEASUREMENT CoAS_stEGRVlv CoAS_stThrVlv /end REF_MEASUREMENT /end GROUP
/begin GROUP S99_TCPrt_TrqLim "DCRS_FrameModel_TorqueStructure/Subsystem/CORE/ASW/Eng/GsSys/AirSys/TCPrt/TCPrt_TrqLim" /begin SUB_GROUP TCPrt_TrqLim /end SUB_GROUP /begin REF_MEASUREMENT TCPrt_trqInrBstPrtLim /end REF_MEASUREMENT /end GROUP
/begin GROUP S108_SmkLim_AirMsSel "DCRS_FrameModel_TorqueStructure/Subsystem/CORE/ASW/Eng/GsSys/EGSys/SmkLim/SmkLim_AirMsSel" /begin SUB_GROUP SmkLim_AirMsSel /end SUB_GROUP /begin REF_MEASUREMENT SmkLim_mAirPerCyl /end REF_MEASUREMENT /end GROUP
/begin GROUP S108_SmkLim_InjMassLim "DCRS_FrameModel_TorqueStructure/Subsystem/CORE/ASW/Eng/GsSys/EGSys/SmkLim/SmkLim_InjMassLim" /begin SUB_GROUP SmkLim_InjMassLim /end SUB_GROUP /begin REF_MEASUREMENT SmkLim_qLimSmk SmkLim_qLimSmkBas /end REF_MEASUREMENT /end GROUP
/begin GROUP S119_InjCrv_MI1 "DCRS_FrameModel_TorqueStructure/Subsystem/CORE/ASW/Eng/InjSys/InjCtl/InjCrv/InjCrv_MI1" /begin SUB_GROUP InjCrv_MI1 /end SUB_GROUP
 /begin REF_MEASUREMENT InjCrv_phiMI1Des InjCrv_qMI1Des InjCrv_stShutOffPiIPoI InjCrv_stShutOffPoI /end REF_MEASUREMENT
/end GROUP
/begin GROUP S119_InjCrv_MI1Cor "DCRS_FrameModel_TorqueStructure/Subsystem/CORE/ASW/Eng/InjSys/InjCtl/InjCrv/InjCrv_MI1Cor" /begin SUB_GROUP InjCrv_MI1Cor /end SUB_GROUP /begin REF_MEASUREMENT InjCrv_phiMI1Cor1 /end REF_MEASUREMENT /end GROUP
/begin GROUP S119_InjCrv_MI1SOEAirMsCor "DCRS_FrameModel_TorqueStructure/Subsystem/CORE/ASW/Eng/InjSys/InjCtl/InjCrv/InjCrv_MI1SOEAirMsCor" /begin SUB_GROUP InjCrv_MI1SOEAirMsCor /end SUB_GROUP /begin REF_MEASUREMENT InjCrv_phiMI1AirMsCor /end REF_MEASUREMENT /end GROUP
/begin GROUP S119_InjCrv_PiI1 "DCRS_FrameModel_TorqueStructure/Subsystem/CORE/ASW/Eng/InjSys/InjCtl/InjCrv/InjCrv_PiI1" /begin SUB_GROUP InjCrv_PiI1 /end SUB_GROUP /begin REF_MEASUREMENT InjCrv_phiPiI1Des InjCrv_qPiI1Des InjCrv_tiPiI1Des /end REF_MEASUREMENT /end GROUP
/begin GROUP S119_InjCrv_PiI1AddCor "DCRS_FrameModel_TorqueStructure/Subsystem/CORE/ASW/Eng/InjSys/InjCtl/InjCrv/InjCrv_PiI1AddCor" /begin SUB_GROUP InjCrv_PiI1AddCor /end SUB_GROUP
 /begin REF_MEASUREMENT InjCrv_phiPiI1Set_mp InjCrv_qPiI1Set_mp InjCrv_tiPiI1Set_mp /end REF_MEASUREMENT
/end GROUP
/begin GROUP S119_InjCrv_PiI1Cor "DCRS_FrameModel_TorqueStructure/Subsystem/CORE/ASW/Eng/InjSys/InjCtl/InjCrv/InjCrv_PiI1Cor" /begin SUB_GROUP InjCrv_PiI1Cor /end SUB_GROUP /begin REF_MEASUREMENT InjCrv_phiPiI1Cor1 InjCrv_qPiI1Cor1 InjCrv_tiPiI1Cor1 /end REF_MEASUREMENT /end GROUP
/begin GROUP S119_InjCrv_PiI1Set "DCRS_FrameModel_TorqueStructure/Subsystem/CORE/ASW/Eng/InjSys/InjCtl/InjCrv/InjCrv_PiI1Set" /begin SUB_GROUP InjCrv_PiI1Set /end SUB_GROUP
 /begin REF_MEASUREMENT InjCrv_phiPiI1Bas_mp InjCrv_qPiI1Bas_mp InjCrv_tiPiI1Bas_mp /end REF_MEASUREMENT
/end GROUP
/begin GROUP S119_InjCrv_PiI2 "DCRS_FrameModel_TorqueStructure/Subsystem/CORE/ASW/Eng/InjSys/InjCtl/InjCrv/InjCrv_PiI2" /begin SUB_GROUP InjCrv_PiI2 /end SUB_GROUP /begin REF_MEASUREMENT InjCrv_phiPiI2Des InjCrv_qPiI2Des InjCrv_tiPiI2Des /end REF_MEASUREMENT /end GROUP
/begin GROUP S119_InjCrv_PiI2AddCor "DCRS_FrameModel_TorqueStructure/Subsystem/CORE/ASW/Eng/InjSys/InjCtl/InjCrv/InjCrv_PiI2AddCor" /begin SUB_GROUP InjCrv_PiI2AddCor /end SUB_GROUP
 /begin REF_MEASUREMENT InjCrv_phiPiI2Set_mp InjCrv_qPiI2Set_mp InjCrv_tiPiI2Set_mp /end REF_MEASUREMENT
/end GROUP
/begin GROUP S119_InjCrv_PiI2Cor "DCRS_FrameModel_TorqueStructure/Subsystem/CORE/ASW/Eng/InjSys/InjCtl/InjCrv/InjCrv_PiI2Cor" /begin SUB_GROUP InjCrv_PiI2Cor /end SUB_GROUP /begin REF_MEASUREMENT InjCrv_phiPiI2Cor1 InjCrv_qPiI2Cor1 InjCrv_tiPiI2Cor1 /end REF_MEASUREMENT /end GROUP
/begin GROUP S119_InjCrv_PiI2Set "DCRS_FrameModel_TorqueStructure/Subsystem/CORE/ASW/Eng/InjSys/InjCtl/InjCrv/InjCrv_PiI2Set" /begin SUB_GROUP InjCrv_PiI2Set /end SUB_GROUP
 /begin REF_MEASUREMENT InjCrv_phiPiI2Bas_mp InjCrv_qPiI2Bas_mp InjCrv_tiPiI2Bas_mp /end REF_MEASUREMENT
/end GROUP
/begin GROUP S119_InjCrv_PoI2 "DCRS_FrameModel_TorqueStructure/Subsystem/CORE/ASW/Eng/InjSys/InjCtl/InjCrv/InjCrv_PoI2" /begin SUB_GROUP InjCrv_PoI2 /end SUB_GROUP
 /begin REF_MEASUREMENT InjCrv_phiPoI2Des InjCrv_phiPoI2MaxEOMX_mp InjCrv_tiPoI2Des /end REF_MEASUREMENT
/end GROUP
/begin GROUP S119_InjCrv_PoI2AddCor "DCRS_FrameModel_TorqueStructure/Subsystem/CORE/ASW/Eng/InjSys/InjCtl/InjCrv/InjCrv_PoI2AddCor" /begin SUB_GROUP InjCrv_PoI2AddCor /end SUB_GROUP
 /begin REF_MEASUREMENT InjCrv_facPoI2EffSet InjCrv_phiPoI2Set_mp InjCrv_qMI1BalPoI2 InjCrv_qPoI2Des InjCrv_qPoI2OfsUnLim InjCrv_tiPoI2Set_mp /end REF_MEASUREMENT
/end GROUP
/begin GROUP S119_InjCrv_PoI2Cor "DCRS_FrameModel_TorqueStructure/Subsystem/CORE/ASW/Eng/InjSys/InjCtl/InjCrv/InjCrv_PoI2Cor" /begin SUB_GROUP InjCrv_PoI2Cor /end SUB_GROUP /begin REF_MEASUREMENT InjCrv_phiPoI2Cor InjCrv_qPoI2Cor InjCrv_tiPoI2Cor /end REF_MEASUREMENT /end GROUP
/begin GROUP S119_InjCrv_PoI2Set "DCRS_FrameModel_TorqueStructure/Subsystem/CORE/ASW/Eng/InjSys/InjCtl/InjCrv/InjCrv_PoI2Set" /begin SUB_GROUP InjCrv_PoI2Set /end SUB_GROUP
 /begin REF_MEASUREMENT InjCrv_facPoI2Bas_mp InjCrv_phiPoI2Bas_mp InjCrv_qPoI2Bas_mp InjCrv_tiPoI2Bas_mp /end REF_MEASUREMENT
/end GROUP
/begin GROUP S137_HPUn_Co "DCRS_FrameModel_TorqueStructure/Subsystem/CORE/ASW/Eng/InjSys/InjUn/HPUn/HPUn_Co" /begin SUB_GROUP HPUn_Co /end SUB_GROUP
 /begin REF_MEASUREMENT HPUn_dvolPmpMin HPUn_dvolPmpNom HPUn_rTransCrS HPUn_trqLoss /end REF_MEASUREMENT
/end GROUP
/begin GROUP S137_HPUn_QntBalInjLim "DCRS_FrameModel_TorqueStructure/Subsystem/CORE/ASW/Eng/InjSys/InjUn/HPUn/HPUn_QntBalInjLim" /begin SUB_GROUP HPUn_QntBalInjLim /end SUB_GROUP /begin REF_MEASUREMENT HPUn_numInjQntBal HPUn_stNumInjMax_mp /end REF_MEASUREMENT /end GROUP
/begin GROUP S138_Rail_BlkShtCtl "DCRS_FrameModel_TorqueStructure/Subsystem/CORE/ASW/Eng/InjSys/InjUn/Rail/Rail_BlkShtCtl" /begin SUB_GROUP Rail_BlkShtCtl /end SUB_GROUP /begin REF_MEASUREMENT Rail_fBlkSht Rail_stBlkShtMode Rail_stBlkShtStM /end REF_MEASUREMENT /end GROUP
/begin GROUP S138_Rail_CtlLoop "DCRS_FrameModel_TorqueStructure/Subsystem/CORE/ASW/Eng/InjSys/InjUn/Rail/Rail_CtlLoop" /begin SUB_GROUP Rail_CtlLoop /end SUB_GROUP
 /begin REF_MEASUREMENT MeUn_dvolSet MeUn_dvolSetAdapt Rail_pDvt Rail_stCtlLoop Rail_stMeUnFrzI /end REF_MEASUREMENT
/end GROUP
/begin GROUP S138_Rail_CtlLoopLimMeUn "DCRS_FrameModel_TorqueStructure/Subsystem/CORE/ASW/Eng/InjSys/InjUn/Rail/Rail_CtlLoopLimMeUn" /begin SUB_GROUP Rail_CtlLoopLimMeUn /end SUB_GROUP /begin REF_MEASUREMENT Rail_dvolMeUnCtlUpLim /end REF_MEASUREMENT /end GROUP
/begin GROUP S138_Rail_CtlLoopParaMeUn "DCRS_FrameModel_TorqueStructure/Subsystem/CORE/ASW/Eng/InjSys/InjUn/Rail/Rail_CtlLoopParaMeUn" /begin SUB_GROUP Rail_CtlLoopParaMeUn /end SUB_GROUP
 /begin REF_MEASUREMENT Rail_MeUnCtlDKd_mp Rail_MeUnCtlIKiNeg_mp Rail_MeUnCtlIKiPos_mp Rail_MeUnCtlIKi_mp Rail_MeUnCtlPKpNeg_mp Rail_MeUnCtlPKpPos_mp Rail_MeUnCtlPKp_mp Rail_facMeUnCtlPT1_mp Rail_tiMeUnCtlDT1_mp /end REF_MEASUREMENT
/end GROUP
/begin GROUP S138_Rail_MonMeUn "DCRS_FrameModel_TorqueStructure/Subsystem/CORE/ASW/Eng/InjSys/InjUn/Rail/Rail_MonMeUn" /begin SUB_GROUP Rail_MonMeUn /end SUB_GROUP /end GROUP
/begin GROUP S138_Rail_PreCtlMeUn "DCRS_FrameModel_TorqueStructure/Subsystem/CORE/ASW/Eng/InjSys/InjUn/Rail/Rail_PreCtlMeUn" /begin SUB_GROUP Rail_PreCtlMeUn /end SUB_GROUP
 /begin REF_MEASUREMENT Rail_dvolDemSysMax Rail_dvolDemSysNom Rail_dvolLeakSum Rail_dvolLeakSumMax Rail_dvolPreCtl /end REF_MEASUREMENT
/end GROUP
/begin GROUP S138_Rail_PresPeakLim "DCRS_FrameModel_TorqueStructure/Subsystem/CORE/ASW/Eng/InjSys/InjUn/Rail/Rail_PresPeakLim" /begin SUB_GROUP Rail_PresPeakLim /end SUB_GROUP /begin REF_MEASUREMENT Rail_qCorPresPeakLim /end REF_MEASUREMENT /end GROUP
/begin GROUP S138_Rail_SetPoint "DCRS_FrameModel_TorqueStructure/Subsystem/CORE/ASW/Eng/InjSys/InjUn/Rail/Rail_SetPoint" /begin SUB_GROUP Rail_SetPoint /end SUB_GROUP /begin REF_MEASUREMENT Rail_pSetPoint /end REF_MEASUREMENT /end GROUP
/begin GROUP S138_Rail_SetPointAddCor "DCRS_FrameModel_TorqueStructure/Subsystem/CORE/ASW/Eng/InjSys/InjUn/Rail/Rail_SetPointAddCor" /begin SUB_GROUP Rail_SetPointAddCor /end SUB_GROUP
 /begin REF_MEASUREMENT FlSys_p Rail_pSetPointAddCor Rail_pSetPointMax Rail_pSetPointMin /end REF_MEASUREMENT
/end GROUP
/begin GROUP S138_Rail_SetPointCor "DCRS_FrameModel_TorqueStructure/Subsystem/CORE/ASW/Eng/InjSys/InjUn/Rail/Rail_SetPointCor" /begin SUB_GROUP Rail_SetPointCor /end SUB_GROUP /begin REF_MEASUREMENT Rail_pSetPointEnvCor /end REF_MEASUREMENT /end GROUP
/begin GROUP S138_Rail_TempLim "DCRS_FrameModel_TorqueStructure/Subsystem/CORE/ASW/Eng/InjSys/InjUn/Rail/Rail_TempLim" /begin SUB_GROUP Rail_TempLim /end SUB_GROUP /begin REF_MEASUREMENT Rail_trqLim /end REF_MEASUREMENT /end GROUP
/begin GROUP S190_PTCOP_TrqCnv "DCRS_FrameModel_TorqueStructure/Subsystem/CORE/ASW/Veh/PT/CoPT/PTCOP/PTCOP_TrqCnv" /begin SUB_GROUP /end SUB_GROUP
 /begin REF_MEASUREMENT PT_trqSpdGovLtd PT_trqWhl PT_trqWhlInrLim PT_trqWhlMaxEng PT_trqWhlMinEng PT_trqWhlMinEngBrk /end REF_MEASUREMENT
/end GROUP
/begin GROUP S191_PTLo_LosCalc "DCRS_FrameModel_TorqueStructure/Subsystem/CORE/ASW/Veh/PT/CoPT/PTLo/PTLo_LosCalc" /begin SUB_GROUP PTLo_LosCalc /end SUB_GROUP /begin REF_MEASUREMENT PT_trqLos PT_trqLosComp PT_trqResv /end REF_MEASUREMENT /end GROUP
/begin GROUP S192_PTODi_SpdCoord "DCRS_FrameModel_TorqueStructure/Subsystem/CORE/ASW/Veh/PT/CoPT/PTODi/PTODi_SpdCoord" /begin SUB_GROUP /end SUB_GROUP
 /begin REF_MEASUREMENT CoPT_nMaxAcs CoPT_nMaxSysErr CoPT_nMaxTra CoPT_nMinAcs CoPT_nMinSysErr CoPT_nMinTra CoPT_stNSetPAcs CoPT_stNSetPSysErr CoPT_stNSetPTra /end REF_MEASUREMENT
/end GROUP
/begin GROUP S192_PTODi_TrqComp "DCRS_FrameModel_TorqueStructure/Subsystem/CORE/ASW/Veh/PT/CoPT/PTODi/PTODi_TrqComp" /begin SUB_GROUP PTODi_TrqComp /end SUB_GROUP /begin REF_MEASUREMENT CoPT_trqDesCompEng /end REF_MEASUREMENT /end GROUP
/begin GROUP S192_PTODi_TrqDesCoord "DCRS_FrameModel_TorqueStructure/Subsystem/CORE/ASW/Veh/PT/CoPT/PTODi/PTODi_TrqDesCoord" /begin SUB_GROUP PTODi_TrqDesCoord /end SUB_GROUP /begin REF_MEASUREMENT CoPT_facDesDyn PT_trqCrSDCS PT_trqCrSDes PT_trqCrSPTPrt /end REF_MEASUREMENT /end GROUP
/begin GROUP S192_PTODi_TrqLeadCoord "DCRS_FrameModel_TorqueStructure/Subsystem/CORE/ASW/Veh/PT/CoPT/PTODi/PTODi_TrqLeadCoord" /begin SUB_GROUP /end SUB_GROUP /begin REF_MEASUREMENT PT_trqCrSCurr PT_trqCrSLead /end REF_MEASUREMENT /end GROUP
/begin GROUP S214_ACCtl "DCRS_FrameModel_TorqueStructure/Subsystem/CORE/ASW/Veh/TS/CTM/AC/ACCtl" /begin SUB_GROUP S215_ACCtl_Demand /end SUB_GROUP /end GROUP
/begin GROUP S228_Diff_PlausPrtTrq "DCRS_FrameModel_TorqueStructure/Subsystem/CORE/ASW/Veh/VehMot/Prp/Diff/Diff_PlausPrtTrq" /begin SUB_GROUP Diff_PlausPrtTrq /end SUB_GROUP /begin REF_MEASUREMENT VehMot_trqPrtDfftl /end REF_MEASUREMENT /end GROUP
/begin GROUP S228_Diff_TrqRat "DCRS_FrameModel_TorqueStructure/Subsystem/CORE/ASW/Veh/VehMot/Prp/Diff/Diff_TrqRat" /begin SUB_GROUP Diff_TrqRat /end SUB_GROUP /begin REF_MEASUREMENT VehMot_rTrqDfftl /end REF_MEASUREMENT /end GROUP
/begin GROUP S233_AccPed_DoCoordOut "DCRS_FrameModel_TorqueStructure/Subsystem/CORE/ASW/Veh/VehMot/VMD/AccPed/AccPed_DoCoordOut" /begin SUB_GROUP AccPed_DoCoordOut /end SUB_GROUP
 /begin REF_MEASUREMENT AccPed_nMax AccPed_nMin AccPed_rTrq AccPed_stMS AccPed_stNSetP AccPed_trqLimMax VehMot_drAccPedUnFlt VehMot_facDesDyn VehMot_rAccPedFlt /end REF_MEASUREMENT
/end GROUP
/begin GROUP S233_AccPed_DrvDemDes "DCRS_FrameModel_TorqueStructure/Subsystem/CORE/ASW/Veh/VehMot/VMD/AccPed/AccPed_DrvDemDes" /begin SUB_GROUP AccPed_DrvDemDes /end SUB_GROUP
 /begin REF_MEASUREMENT AccPed_facCompAcs AccPed_rBrk50_mp AccPed_stBrkDes AccPed_stBrkDes_mp AccPed_trqComp AccPed_trqDesAct AccPed_trqDesPull AccPed_trqDifBrk_mp VehMot_stPrpAccPed /end REF_MEASUREMENT
/end GROUP
/begin GROUP S233_AccPed_DrvDemLead "DCRS_FrameModel_TorqueStructure/Subsystem/CORE/ASW/Veh/VehMot/VMD/AccPed/AccPed_DrvDemLead" /begin SUB_GROUP AccPed_DrvDemLead /end SUB_GROUP
 /begin REF_MEASUREMENT AccPed_trqLead AccPed_trqLeadOvrRun_mp AccPed_trqLeadPull_mp /end REF_MEASUREMENT
/end GROUP
/begin GROUP S233_AccPed_DrvDemStpLim "DCRS_FrameModel_TorqueStructure/Subsystem/CORE/ASW/Veh/VehMot/VMD/AccPed/AccPed_DrvDemStpLim" /begin SUB_GROUP AccPed_DrvDemStpLim /end SUB_GROUP /begin REF_MEASUREMENT AccPed_stPTSLEna AccPed_trqDes Epm_dnEng /end REF_MEASUREMENT /end GROUP
/begin GROUP S234_BrkPed_SetData "DCRS_FrameModel_TorqueStructure/Subsystem/CORE/ASW/Veh/VehMot/VMD/BrkPed/BrkPed_SetData" /begin SUB_GROUP /end SUB_GROUP /begin REF_MEASUREMENT BrkPed_bEngStrtReq VehMot_stBrkPed /end REF_MEASUREMENT /end GROUP
/begin GROUP S235_CoVMD_SpdCoord "DCRS_FrameModel_TorqueStructure/Subsystem/CORE/ASW/Veh/VehMot/VMD/CoVMD/CoVMD_SpdCoord" /begin SUB_GROUP /end SUB_GROUP /begin REF_MEASUREMENT VMD_nMax VMD_nMin VMD_stNSetP /end REF_MEASUREMENT /end GROUP
/begin GROUP S235_CoVMD_TrqCalc "DCRS_FrameModel_TorqueStructure/Subsystem/CORE/ASW/Veh/VehMot/VMD/CoVMD/CoVMD_TrqCalc" /begin SUB_GROUP CoVMD_TrqCalc /end SUB_GROUP /begin REF_MEASUREMENT CoVMD_trqLLim /end REF_MEASUREMENT /end GROUP
/begin GROUP S235_CoVMD_TrqDesCoord "DCRS_FrameModel_TorqueStructure/Subsystem/CORE/ASW/Veh/VehMot/VMD/CoVMD/CoVMD_TrqDesCoord" /begin SUB_GROUP CoVMD_TrqDesCoord /end SUB_GROUP
 /begin REF_MEASUREMENT VMD_stBrkDes VMD_swtTrqSel VMD_swtVCMActv VMD_trqDes VMD_trqDesIn VMD_trqDesRaw VMD_trqDesUnLim VehMot_facCompAcs VehMot_stPrpCrCt VehMot_stPrpLLim /end REF_MEASUREMENT
/end GROUP
/begin GROUP S235_CoVMD_TrqLeadCoord "DCRS_FrameModel_TorqueStructure/Subsystem/CORE/ASW/Veh/VehMot/VMD/CoVMD/CoVMD_TrqLeadCoord" /begin SUB_GROUP /end SUB_GROUP /begin REF_MEASUREMENT VMD_trqLead VMD_trqLeadIn VMD_trqLeadRaw VMD_trqLeadUnLim /end REF_MEASUREMENT /end GROUP
/begin GROUP S215_ACCtl_Demand "DCRS_FrameModel_TorqueStructure/Subsystem/CORE/ASW/Veh/TS/CTM/AC/ACCtl/ACCtl_Demand" /begin SUB_GROUP ACCtl_Demand /end SUB_GROUP /begin REF_MEASUREMENT TS_nMinAC /end REF_MEASUREMENT /end GROUP
/begin GROUP CoEng_StEng "CoEng_StEng"
 /begin REF_CHARACTERISTIC CoEng_nThresCranking_C CoEng_nThresNrml2Strt_C CoEng_tiNrml2Strt_C /end REF_CHARACTERISTIC
/end GROUP
/begin GROUP CoEng_Stop "CoEng_Stop" /begin REF_CHARACTERISTIC CoEng_stEngStop_C /end REF_CHARACTERISTIC /end GROUP
/begin GROUP CoTemp "CoTemp" /begin REF_CHARACTERISTIC CoTemp_rClgDes_C CoTemp_tEngDes_C /end REF_CHARACTERISTIC /end GROUP
/begin GROUP ASDdc_Governor "ASDdc_Governor"
 /begin SUB_GROUP Root_DT1_1st Root_DT1_2nd Root_FirstDT1_BlockInit Root_SecondDT1_BlockInit /end SUB_GROUP
 /begin REF_CHARACTERISTIC ASDdc_trqLimMax_C ASDdc_trqLimMin_C PthSet_trqASDdcInit_C /end REF_CHARACTERISTIC
/end GROUP
/begin GROUP Root_DT1_1st "ASDdc_Governor/DT1_1st" /begin SUB_GROUP S1_Function_Call_Subsystem1 /end SUB_GROUP /end GROUP
/begin GROUP Root_DT1_2nd "ASDdc_Governor/DT1_2nd" /begin SUB_GROUP S2_Function_Call_Subsystem1 /end SUB_GROUP /end GROUP
/begin GROUP Root_FirstDT1_BlockInit "ASDdc_Governor/FirstDT1_BlockInit" /begin SUB_GROUP S3_chkInitZero /end SUB_GROUP
 /begin REF_MEASUREMENT ASDdc_nInitXFrst_mp ASDdc_stInitFrst_mp ASDdc_trqInitYFrst_mp /end REF_MEASUREMENT
/end GROUP
/begin GROUP Root_SecondDT1_BlockInit "ASDdc_Governor/SecondDT1_BlockInit" /begin SUB_GROUP S5_chkInitZero /end SUB_GROUP
 /begin REF_MEASUREMENT ASDdc_stInitScnd_mp ASDdc_trqInitXScnd_mp ASDdc_trqInitYScnd_mp /end REF_MEASUREMENT
/end GROUP
/begin GROUP S1_Function_Call_Subsystem1 "ASDdc_Governor/DT1_1st/Function-Call Subsystem1" /begin REF_MEASUREMENT ASDdc_trqFrstDT1_mp /end REF_MEASUREMENT /end GROUP
/begin GROUP S2_Function_Call_Subsystem1 "ASDdc_Governor/DT1_2nd/Function-Call Subsystem1" /begin REF_MEASUREMENT ASDdc_trqUnLtd_mp /end REF_MEASUREMENT /end GROUP
/begin GROUP S3_chkInitZero "ASDdc_Governor/FirstDT1_BlockInit/chkInitZero" /begin REF_CHARACTERISTIC ASDdc_vLimIni_C /end REF_CHARACTERISTIC /end GROUP
/begin GROUP S5_chkInitZero "ASDdc_Governor/SecondDT1_BlockInit/chkInitZero" /begin REF_CHARACTERISTIC ASDdc_vLimIni_C /end REF_CHARACTERISTIC /end GROUP
/begin GROUP ASDdc_SelectParameter "ASDdc_SelectParameter"
 /begin REF_CHARACTERISTIC ASDdc_DT1GovGear0_CUR ASDdc_DT1GovGear1_CUR ASDdc_DT1GovGear2_CUR ASDdc_DT1GovGear3_CUR ASDdc_DT1GovGear4_CUR ASDdc_DT1GovGear5_CUR ASDdc_KdGovGear0_CUR ASDdc_KdGovGear1_CUR ASDdc_KdGovGear2_CUR ASDdc_KdGovGear3_CUR ASDdc_KdGovGear4_CUR ASDdc_KdGovGear5_CUR /end REF_CHARACTERISTIC
/end GROUP
/begin GROUP ASDrf_Governor "ASDrf_Governor"
 /begin SUB_GROUP Root_Compensation_of_SpdGov Root_Subsystem1 Root_init Root_initialization_of_steep_input_gradients_ /end SUB_GROUP
 /begin REF_CHARACTERISTIC ASDrf_KpFltCurr_C /end REF_CHARACTERISTIC
 /begin REF_MEASUREMENT ASDrf_trqInrSetUnLtd_mp ASDrf_trqPT1Out_mp ASDrf_trqPT1P_mp ASDrf_trqP_mp /end REF_MEASUREMENT
/end GROUP
/begin GROUP Root_Compensation_of_SpdGov "ASDrf_Governor/Compensation of SpdGov" /begin REF_CHARACTERISTIC ASDrf_swtSpdGovCor_C /end REF_CHARACTERISTIC /begin REF_MEASUREMENT ASDrf_trqSpdGovCor_mp /end REF_MEASUREMENT /end GROUP
/begin GROUP Root_Subsystem1 "ASDrf_Governor/Subsystem" /begin REF_CHARACTERISTIC ASDrf_swtLim_C /end REF_CHARACTERISTIC /begin REF_MEASUREMENT ASDrf_trqInrSetMax_mp ASDrf_trqInrSetMin_mp /end REF_MEASUREMENT /end GROUP
/begin GROUP Root_init "ASDrf_Governor/init" /begin REF_CHARACTERISTIC ASDrf_KpFltCurr_C /end REF_CHARACTERISTIC /begin REF_MEASUREMENT ASDrf_stInit_mp ASDrf_trqIni_mp /end REF_MEASUREMENT /end GROUP
/begin GROUP Root_initialization_of_steep_input_gradients_ "ASDrf_Governor/initialization of steep input gradients "
 /begin REF_CHARACTERISTIC ASDrf_trqSteepNeg_C ASDrf_trqSteepPos_C ASDrf_trqThresNeg_C ASDrf_trqThresPos_C /end REF_CHARACTERISTIC
 /begin REF_MEASUREMENT ASDrf_stIniSteepIn_mp /end REF_MEASUREMENT
/end GROUP
/begin GROUP ASDrf_SelectParameter "ASDrf_SelectParameter"
 /begin REF_CHARACTERISTIC ASDrf_facGovNegGear0_CUR ASDrf_facGovNegGear1_CUR ASDrf_facGovNegGear2_CUR ASDrf_facGovNegGear3_CUR ASDrf_facGovNegGear4_CUR ASDrf_facGovNegGear5_CUR ASDrf_facGovPosGear0_CUR ASDrf_facGovPosGear1_CUR ASDrf_facGovPosGear2_CUR ASDrf_facGovPosGear3_CUR ASDrf_facGovPosGear4_CUR ASDrf_facGovPosGear5_CUR /end REF_CHARACTERISTIC
 /begin REF_MEASUREMENT ASDrf_facGovNegCurr_mp ASDrf_facGovPosCurr_mp /end REF_MEASUREMENT
/end GROUP
/begin GROUP CoETS_NTC "CoETS_NTC"
 /begin REF_CHARACTERISTIC CoETS_trqNTCInrAct_C CoETS_trqNTCInrMax_C CoETS_trqNTCLim_C /end REF_CHARACTERISTIC
/end GROUP
/begin GROUP CoETS_StTrqLimCalc "CoETS_StTrqLimCalc"
 /begin SUB_GROUP Root_Ratio_of_current_torque_to_maximum_torque Root_Reporting_of_the_limitation_event_occurrence Root_Torque_limitation_due_to_engine_overheating Root_Torque_limitation_due_to_high_pressure /end SUB_GROUP
/end GROUP
/begin GROUP Root_Ratio_of_current_torque_to_maximum_torque "CoETS_StTrqLimCalc/Ratio_of_current_torque_to_maximum_torque" /begin REF_CHARACTERISTIC CoETS_nTrqRatMin_C CoETS_trqInrCurrMinLim_C /end REF_CHARACTERISTIC /end GROUP
/begin GROUP Root_Reporting_of_the_limitation_event_occurrence "CoETS_StTrqLimCalc/Reporting_of_the_limitation_event_occurrence" /begin REF_CHARACTERISTIC Rail_stLimDetSetPoint_C /end REF_CHARACTERISTIC /end GROUP
/begin GROUP Root_Torque_limitation_due_to_engine_overheating "CoETS_StTrqLimCalc/Torque_limitation_due_to_engine_overheating" /begin REF_CHARACTERISTIC CoETS_trqDiffMaxLim_C /end REF_CHARACTERISTIC /begin REF_MEASUREMENT CoETS_trqInrSecLimOVHT_mp /end REF_MEASUREMENT /end GROUP
/begin GROUP Root_Torque_limitation_due_to_high_pressure "CoETS_StTrqLimCalc/Torque_limitation_due_to_high_pressure" /begin REF_CHARACTERISTIC CoETS_trqDiffMaxLim_C /end REF_CHARACTERISTIC /begin REF_MEASUREMENT CoETS_trqInrSecLimHiPres /end REF_MEASUREMENT /end GROUP
/begin GROUP CoETS_TSEACo "CoETS_TSEACo" /begin SUB_GROUP Root_CoETS_TSEACo /end SUB_GROUP /end GROUP
/begin GROUP Root_CoETS_TSEACo "CoETS_TSEACo/CoETS_TSEACo" /begin SUB_GROUP S1_Interface S1_TSC1ModeGov S1_TSC1TrqSpdGov /end SUB_GROUP /end GROUP
/begin GROUP S1_Interface "CoETS_TSEACo/CoETS_TSEACo/Interface" /begin SUB_GROUP S2_Tbox_GPSLim /end SUB_GROUP
 /begin REF_CHARACTERISTIC CoETS_swtTempSel_C CoETS_tiSetTimeTSEReq_CUR TSC_nAEDes_C TSC_nDEDes_C TSC_nPEDes_C TSC_nTEDes_C TSC_nVEDes_C TSC_rTrqAEDes_C TSC_rTrqDEDes_C TSC_rTrqPEDes_C TSC_rTrqTEDes_C TSC_rTrqVEDes_C TSC_stAEErr_C TSC_stAEMode_C TSC_stDEErr_C TSC_stDEMode_C TSC_stModeBypassEN_C TSC_stPEErr_C TSC_stPEMode_C TSC_stTEErr_C TSC_stTEMode_C TSC_stVEErr_C TSC_stVEMode_C /end REF_CHARACTERISTIC
 /begin REF_MEASUREMENT TSC_nAEDes_mp TSC_nDEDes_mp TSC_nPEDes_mp TSC_nTEDes_mp TSC_nVEDes_mp TSC_stAEErr_mp TSC_stAEMode_mp TSC_stDEErr_mp TSC_stDEMode_mp TSC_stPEErr_mp TSC_stPEMode_mp TSC_stTEErr_mp TSC_stTEMode_mp TSC_stVEErr_mp TSC_stVEMode_mp /end REF_MEASUREMENT
/end GROUP
/begin GROUP S1_TSC1ModeGov "CoETS_TSEACo/CoETS_TSEACo/TSC1ModeGov"
 /begin REF_CHARACTERISTIC CoETS_numTSEAPrioAE_C CoETS_numTSEAPrioDE_C CoETS_numTSEAPrioGpsLim_C CoETS_numTSEAPrioPE_C CoETS_numTSEAPrioTE_C CoETS_numTSEAPrioVE_C CoETS_stTSEATrqSpd_C /end REF_CHARACTERISTIC
 /begin REF_MEASUREMENT TSC_stACTIVE_mp /end REF_MEASUREMENT
/end GROUP
/begin GROUP S1_TSC1TrqSpdGov "CoETS_TSEACo/CoETS_TSEACo/TSC1TrqSpdGov"
 /begin REF_CHARACTERISTIC CoETS_TrqTSCRmpSlopeNeg_C CoETS_TrqTSCRmpSlopePos_C CoETS_nTSCRmpSlopeNeg_C CoETS_nTSCRmpSlopePos_C EngPrt_nRateSp_C /end REF_CHARACTERISTIC
 /begin REF_MEASUREMENT CoETS_nTSEASpdRawRamp_mp CoETS_nTSEASpdRaw_mp CoETS_trqTSEAEngRawRamp_mp CoETS_trqTSEAEngRaw_mp TSC_trqAEDes_mp TSC_trqDEDes_mp TSC_trqGpsLimOut_mp TSC_trqPEDes_mp TSC_trqTEDes_mp TSC_trqVEDes_mp /end REF_MEASUREMENT
/end GROUP
/begin GROUP S2_Tbox_GPSLim "CoETS_TSEACo/CoETS_TSEACo/Interface/Tbox_GPSLim"
 /begin REF_CHARACTERISTIC CoETS_ctEngEmgcyRunCnt_C CoETS_stEngEmgcyRunEN_C CoETS_stStartRelayCtrl_C CoETS_stTboxUse_C CoETS_tEngEmgcyRunTemp_C CoETS_tiEngEmgcyRunTime_C CoETS_tiEngEmgcyStartTime_C CoETS_tiEngLockTime_C Ecu_stGps_Status_C EngPrt_nRateSp_C Gps_nSpdLmt_C /end REF_CHARACTERISTIC
 /begin REF_MEASUREMENT CoETS_ctEngEmgcyRun_EEP CoETS_stEngEmgcyRunCt_mp CoETS_stEngEmgcyRunTi_mp CoETS_stGpsLimActive_mp CoETS_tiEngEmgcyRun_EEP CoETS_tiEngEmgcySt_mp CoETS_tiEngLockTime_mp Gps_nSpdLmt_EEP_mp TSC_nAEGpsLimOUT_mp TSC_stGpsLimMode_mp /end REF_MEASUREMENT
/end GROUP
/begin GROUP CoETS_TrqCalc "CoETS_TrqCalc"
 /begin SUB_GROUP Root_set_path_torque Root_speed_goverment_torque Root_state_of_brake /end SUB_GROUP
/end GROUP
/begin GROUP Root_set_path_torque "CoETS_TrqCalc/set path torque" /begin SUB_GROUP S3_setpoint_limited_inner_torque /end SUB_GROUP /end GROUP
/begin GROUP Root_speed_goverment_torque "CoETS_TrqCalc/speed goverment torque" /begin REF_MEASUREMENT CoETS_trqLlim_mp /end REF_MEASUREMENT /end GROUP
/begin GROUP Root_state_of_brake "CoETS_TrqCalc/state of brake" /begin REF_CHARACTERISTIC CoETS_trqMaxOfsBrkDes_C CoETS_trqMinOfsBrkDes_C /end REF_CHARACTERISTIC /end GROUP
/begin GROUP S3_setpoint_limited_inner_torque "CoETS_TrqCalc/set path torque/setpoint limited inner torque" /begin SUB_GROUP S11_CoETS_TrqCalc_Inl2 /end SUB_GROUP /end GROUP
/begin GROUP S11_CoETS_TrqCalc_Inl2 "CoETS_TrqCalc/set path torque/setpoint limited inner torque/CoETS_TrqCalc_Inl2" /begin REF_MEASUREMENT CoETS_trqInrLim /end REF_MEASUREMENT /end GROUP
/begin GROUP PthLead_TrqCalc "PthLead_TrqCalc"
 /begin REF_MEASUREMENT PthLead_trqInrCurrMo_mp PthLead_trqInrCurrNoMo_mp PthLead_trqInrLeadMo_mp PthLead_trqInrLeadNoMo_mp /end REF_MEASUREMENT
/end GROUP
/begin GROUP PthSet_OvrRunCoord "PthSet_OvrRunCoord" /begin REF_CHARACTERISTIC PthSet_trqOvrRunThres_C /end REF_CHARACTERISTIC /end GROUP
/begin GROUP PthSet_TrqCalc "PthSet_TrqCalc"
 /begin SUB_GROUP Root_Monitoring_Level Root_inner_torque_limited_before_rail_pressure_limitation Root_overrun_shut_off /end SUB_GROUP
/end GROUP
/begin GROUP Root_Monitoring_Level "PthSet_TrqCalc/Monitoring_Level" /begin REF_MEASUREMENT PthSet_trqInrSet_mp /end REF_MEASUREMENT /end GROUP
/begin GROUP Root_inner_torque_limited_before_rail_pressure_limitation "PthSet_TrqCalc/inner torque limited before rail pressure limitation" /begin REF_CHARACTERISTIC PthSet_trqOffs_C /end REF_CHARACTERISTIC
 /begin REF_MEASUREMENT PthSet_trqBefPeakLim_mp PthSet_trqLimOffs_mp PthSet_trqSetASDdc /end REF_MEASUREMENT
/end GROUP
/begin GROUP Root_overrun_shut_off "PthSet_TrqCalc/overrun_shut_off" /begin SUB_GROUP S3_OvrRun_Ramp S3_OvrRun_Swt_Off S3_Parameter_selection /end SUB_GROUP /begin REF_MEASUREMENT PthSet_trqBefRmp_mp /end REF_MEASUREMENT /end GROUP
/begin GROUP S3_OvrRun_Ramp "PthSet_TrqCalc/overrun_shut_off/OvrRun_Ramp" /begin REF_MEASUREMENT PthSet_stRmp_mp PthSet_trqInrSetNoMo PthSet_trqRmp_mp /end REF_MEASUREMENT /end GROUP
/begin GROUP S3_OvrRun_Swt_Off "PthSet_TrqCalc/overrun_shut_off/OvrRun_Swt_Off" /begin REF_MEASUREMENT PthSet_stDisable /end REF_MEASUREMENT /end GROUP
/begin GROUP S3_Parameter_selection "PthSet_TrqCalc/overrun_shut_off/Parameter_selection"
 /begin REF_CHARACTERISTIC PthSet_dtrqRmpDwnDfl_C PthSet_dtrqRmpDwn_CUR PthSet_tiRmpStrtDfl_C PthSet_tiRmpStrt_CUR PthSet_tiSwtOffDfl_C PthSet_tiSwtOff_CUR /end REF_CHARACTERISTIC
 /begin REF_MEASUREMENT PthSet_dtrqRmpDwn_mp PthSet_tiRmpStrt_mp PthSet_tiSwtOff_mp /end REF_MEASUREMENT
/end GROUP
/begin GROUP EngDem_TrqLimCoord "EngDem_TrqLimCoord"
 /begin SUB_GROUP Root_TrqInrLimCalc Root_TrqLimCalc Root_TrqLimErr Root_TrqLimMinCalc /end SUB_GROUP
/end GROUP
/begin GROUP Root_TrqInrLimCalc "EngDem_TrqLimCoord/TrqInrLimCalc"
 /begin REF_CHARACTERISTIC EngDem_RmpLimErrNeg_C EngDem_RmpLimErrPos_C EngDem_facAdjMax_C EngDem_facAdjMin_C EngDem_facAdj_C /end REF_CHARACTERISTIC
 /begin REF_MEASUREMENT EngDem_trqLimRslt_mp EngDem_trqLimSwt /end REF_MEASUREMENT
/end GROUP
/begin GROUP Root_TrqLimCalc "EngDem_TrqLimCoord/TrqLimCalc"
 /begin REF_CHARACTERISTIC EngDem_facDvolPT1_C EngDem_facResFlowPT1_C EngDem_trqLimPDiff_CUR /end REF_CHARACTERISTIC
 /begin REF_MEASUREMENT EngDem_pDiffPFltPrdc_mp EngDem_trqLimCalc /end REF_MEASUREMENT
/end GROUP
/begin GROUP Root_TrqLimErr "EngDem_TrqLimCoord/TrqLimErr"
 /begin REF_CHARACTERISTIC EngDem_TrqLimErrRmpNeg_C EngDem_TrqLimErrRmpPos_C EngDem_trqLimErr1_CUR EngDem_trqLimErr2_CUR EngDem_trqLimErr3_CUR EngDem_trqLimErr4_CUR /end REF_CHARACTERISTIC
 /begin REF_MEASUREMENT EngDem_trqLimRawErr_mp /end REF_MEASUREMENT
/end GROUP
/begin GROUP Root_TrqLimMinCalc "EngDem_TrqLimCoord/TrqLimMinCalc" /begin REF_MEASUREMENT EngDem_trqLimMinCalc /end REF_MEASUREMENT /end GROUP
/begin GROUP EngPrt_OvrSpd "EngPrt_OvrSpd" /begin SUB_GROUP Root_EngPrt_OvrSpd /end SUB_GROUP /end GROUP
/begin GROUP Root_EngPrt_OvrSpd "EngPrt_OvrSpd/EngPrt_OvrSpd" /begin REF_CHARACTERISTIC EngPrt_nOvrSpd_C EngPrt_tiOvrSpdDeb_C /end REF_CHARACTERISTIC /end GROUP
/begin GROUP EngPrt_PrtLimMech "EngPrt_PrtLimMech" /begin SUB_GROUP Root_EngPrt_TrqLimCor Root_EngSpdLim /end SUB_GROUP
 /begin REF_CHARACTERISTIC EngPrt_RmpLimNErrNeg_C EngPrt_RmpLimNErrPos_C EngPrt_qLim_CUR EngPrt_swtTrq_C EngPrt_trqLim_CUR EngPrt_trqNLimSpr_CUR EngPrt_trqNLim_CUR /end REF_CHARACTERISTIC
 /begin REF_MEASUREMENT EngPrt_qLim_mp /end REF_MEASUREMENT
/end GROUP
/begin GROUP Root_EngPrt_TrqLimCor "EngPrt_PrtLimMech/EngPrt_TrqLimCor"
 /begin REF_CHARACTERISTIC EngPrt_facTrqLimCor_MAP EngPrt_numTrqLim_C EngPrt_swtLimCorType_C EngPrt_trqLimAPSCor_MAP EngPrt_trqLimEngTempCor_MAP /end REF_CHARACTERISTIC
 /begin REF_MEASUREMENT EngPrt_facTrqLimCor_mp EngPrt_trqLimAPSCor_mp EngPrt_trqLimCorVal_mp EngPrt_trqLimCor_mp EngPrt_trqLimEngTempCor_mp /end REF_MEASUREMENT
/end GROUP
/begin GROUP Root_EngSpdLim "EngPrt_PrtLimMech/EngSpdLim"
 /begin REF_CHARACTERISTIC EngPrt_facEngSPOffset_CUR EngPrt_nEngSplimOffset_C EngPrt_nEngSplimRmpSlopeNeg_C EngPrt_nEngSplimRmpSlopePos_C /end REF_CHARACTERISTIC
/end GROUP
/begin GROUP EngPrt_PrtLimOvht "EngPrt_PrtLimOvht"
 /begin SUB_GROUP Root_Exhaust_gas_temperature_limitation Root_Temperature_Limitation /end SUB_GROUP
/end GROUP
/begin RECORD_LAYOUT Scalar_BOOLEAN FNC_VALUES 1 UBYTE COLUMN_DIR DIRECT /end RECORD_LAYOUT
/begin RECORD_LAYOUT Scalar_UBYTE FNC_VALUES 1 UBYTE COLUMN_DIR DIRECT /end RECORD_LAYOUT
/begin RECORD_LAYOUT Scalar_UWORD FNC_VALUES 1 UWORD COLUMN_DIR DIRECT /end RECORD_LAYOUT
/begin RECORD_LAYOUT Scalar_SWORD FNC_VALUES 1 SWORD COLUMN_DIR DIRECT /end RECORD_LAYOUT
/begin RECORD_LAYOUT Scalar_ULONG FNC_VALUES 1 ULONG COLUMN_DIR DIRECT /end RECORD_LAYOUT
/begin RECORD_LAYOUT Scalar_LONG FNC_VALUES 1 SLONG COLUMN_DIR DIRECT /end RECORD_LAYOUT
/begin RECORD_LAYOUT Scalar_FLOAT64_IEEE FNC_VALUES 1 FLOAT64_IEEE COLUMN_DIR DIRECT /end RECORD_LAYOUT
/begin RECORD_LAYOUT Lookup1D_BOOLEAN FNC_VALUES 1 UBYTE COLUMN_DIR DIRECT /end RECORD_LAYOUT
/begin RECORD_LAYOUT Lookup1D_UWORD FNC_VALUES 1 UWORD COLUMN_DIR DIRECT /end RECORD_LAYOUT
/begin RECORD_LAYOUT Lookup1D_WORD FNC_VALUES 1 SWORD COLUMN_DIR DIRECT /end RECORD_LAYOUT
/begin RECORD_LAYOUT Lookup1D_X_WORD AXIS_PTS_X 1 SWORD INDEX_INCR DIRECT /end RECORD_LAYOUT
/begin RECORD_LAYOUT Lookup1D_ULONG FNC_VALUES 1 ULONG COLUMN_DIR DIRECT /end RECORD_LAYOUT
/begin RECORD_LAYOUT Lookup1D_SLONG FNC_VALUES 1 SLONG COLUMN_DIR DIRECT /end RECORD_LAYOUT
/begin RECORD_LAYOUT Lookup2D_WORD FNC_VALUES 1 SWORD COLUMN_DIR DIRECT /end RECORD_LAYOUT
/begin RECORD_LAYOUT Lookup2D_X_WORD AXIS_PTS_X 1 SWORD INDEX_INCR DIRECT /end RECORD_LAYOUT
/end MODULE
/end PROJECT
