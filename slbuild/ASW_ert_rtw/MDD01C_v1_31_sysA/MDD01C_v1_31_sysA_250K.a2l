ASAP2_VERSION 1 51
/begin PROJECT XCPDemo ""
/begin MODULE XCP ""
/begin MOD_COMMON "" BYTE_ORDER MSB_FIRST ALIGNMENT_BYTE 1 ALIGNMENT_WORD 1 ALIGNMENT_LONG 1 ALIGNMENT_FLOAT32_IEEE 1 ALIGNMENT_FLOAT64_IEEE 1 /end MOD_COMMON
/begin MEASUREMENT version_Label "" UWORD nse_version_conv 0 0 0 65535 MATRIX_DIM 5 1 1 ECU_ADDRESS 0x9018C /end MEASUREMENT
/begin MEASUREMENT version_Date "" ULONG nse_basic 0 0 20000101 20991231 ECU_ADDRESS 0xAC5E8 /end MEASUREMENT
/begin MEASUREMENT version_Cali "" UBYTE nse_basic 0 0 0 255 MATRIX_DIM 64 1 1 ECU_ADDRESS 0x40024558 /end MEASUREMENT
/begin COMPU_METHOD nse_version_conv "Software Version define" TAB_VERB "%5.0" "-" COMPU_TAB_REF nse_version_conv /end COMPU_METHOD
/begin COMPU_VTAB nse_version_conv "" TAB_VERB 605 0 "0" 1 "1" 2 "2" 3 "3" 4 "4" 5 "5" 6 "6" 7 "7" 8 "8" 9 "9" 10 "10" 11 "11" 12 "12" 13 "13" 14 "14" 15 "15" 16 "16" 17 "17" 18 "18" 19 "19" 20 "20" 21 "21" 22 "22" 23 "23" 24 "24" 25 "25" 26 "26" 27 "27" 28 "28" 29 "29" 30 "30" 31 "31" 32 "32" 33 "33" 34 "34" 35 "35" 36 "36" 37 "37" 38 "38" 39 "39" 40 "40" 41 "41" 42 "42" 43 "43" 44 "44" 45 "45" 46 "46" 47 "47" 48 "48" 49 "49" 50 "50" 51 "51" 52 "52" 53 "53" 54 "54" 55 "55" 56 "56" 57 "57" 58 "58" 59 "59" 60 "60" 61 "61" 62 "62" 63 "63" 64 "64" 65 "65" 66 "66" 67 "67" 68 "68" 69 "69" 70 "70" 71 "71" 72 "72" 73 "73" 74 "74" 75 "75" 76 "76" 77 "77" 78 "78" 79 "79" 80 "80" 81 "81" 82 "82" 83 "83" 84 "84" 85 "85" 86 "86" 87 "87" 88 "88" 89 "89" 90 "90" 91 "91" 92 "92" 93 "93" 94 "94" 95 "95" 96 "96" 97 "97" 98 "98" 99 "99" 100 "100" 101 "101" 102 "102" 103 "103" 104 "104" 105 "105" 106 "106" 107 "107" 108 "108" 109 "109" 110 "110" 111 "111" 112 "112" 113 "113" 114 "114" 115 "115" 116 "116" 117 "117" 118 "118" 119 "119" 120 "120" 121 "121" 122 "122" 123 "123" 124 "124" 125 "125" 126 "126" 127 "127" 128 "128" 129 "129" 130 "130" 131 "131" 132 "132" 133 "133" 134 "134" 135 "135" 136 "136" 137 "137" 138 "138" 139 "139" 140 "140" 141 "141" 142 "142" 143 "143" 144 "144" 145 "145" 146 "146" 147 "147" 148 "148" 149 "149" 150 "150" 151 "151" 152 "152" 153 "153" 154 "154" 155 "155" 156 "156" 157 "157" 158 "158" 159 "159" 160 "160" 161 "161" 162 "162" 163 "163" 164 "164" 165 "165" 166 "166" 167 "167" 168 "168" 169 "169" 170 "170" 171 "171" 172 "172" 173 "173" 174 "174" 175 "175" 176 "176" 177 "177" 178 "178" 179 "179" 180 "180" 181 "181" 182 "182" 183 "183" 184 "184" 185 "185" 186 "186" 187 "187" 188 "188" 189 "189" 190 "190" 191 "191" 192 "192" 193 "193" 194 "194" 195 "195" 196 "196" 197 "197" 198 "198" 199 "199" 200 "200" 201 "201" 202 "202" 203 "203" 204 "204" 205 "205" 206 "206" 207 "207" 208 "208" 209 "209" 210 "210" 211 "211" 212 "212" 213 "213" 214 "214" 215 "215" 216 "216" 217 "217" 218 "218" 219 "219" 220 "220" 221 "221" 222 "222" 223 "223" 224 "224" 225 "225" 226 "226" 227 "227" 228 "228" 229 "229" 230 "230" 231 "231" 232 "232" 233 "233" 234 "234" 235 "235" 236 "236" 237 "237" 238 "238" 239 "239" 240 "240" 241 "241" 242 "242" 243 "243" 244 "244" 245 "245" 246 "246" 247 "247" 248 "248" 249 "249" 500 "v0" 501 "v1" 502 "v2" 503 "v3" 504 "v4" 505 "v5" 506 "v6" 507 "v7" 508 "v8" 509 "v9" 510 "v10" 511 "v11" 512 "v12" 513 "v13" 514 "v14" 515 "v15" 516 "v16" 517 "v17" 518 "v18" 519 "v19" 520 "v20" 521 "v21" 522 "v22" 523 "v23" 524 "v24" 525 "v25" 526 "v26" 527 "v27" 528 "v28" 529 "v29" 530 "v30" 531 "v31" 532 "v32" 533 "v33" 534 "v34" 535 "v35" 536 "v36" 537 "v37" 538 "v38" 539 "v39" 540 "v40" 541 "v41" 542 "v42" 543 "v43" 544 "v44" 545 "v45" 546 "v46" 547 "v47" 548 "v48" 549 "v49" 550 "v50" 551 "v51" 552 "v52" 553 "v53" 554 "v54" 555 "v55" 556 "v56" 557 "v57" 558 "v58" 559 "v59" 560 "v60" 561 "v61" 562 "v62" 563 "v63" 564 "v64" 565 "v65" 566 "v66" 567 "v67" 568 "v68" 569 "v69" 570 "v70" 571 "v71" 572 "v72" 573 "v73" 574 "v74" 575 "v75" 576 "v76" 577 "v77" 578 "v78" 579 "v79" 580 "v80" 581 "v81" 582 "v82" 583 "v83" 584 "v84" 585 "v85" 586 "v86" 587 "v87" 588 "v88" 589 "v89" 590 "v90" 591 "v91" 592 "v92" 593 "v93" 594 "v94" 595 "v95" 596 "v96" 597 "v97" 598 "v98" 599 "v99" 600 "v100" 601 "v101" 602 "v102" 603 "v103" 604 "v104" 605 "v105" 606 "v106" 607 "v107" 608 "v108" 609 "v109" 610 "v110" 611 "v111" 612 "v112" 613 "v113" 614 "v114" 615 "v115" 616 "v116" 617 "v117" 618 "v118" 619 "v119" 620 "v120" 621 "v121" 622 "v122" 623 "v123" 624 "v124" 625 "v125" 626 "v126" 627 "v127" 628 "v128" 629 "v129" 630 "v130" 631 "v131" 632 "v132" 633 "v133" 634 "v134" 635 "v135" 636 "v136" 637 "v137" 638 "v138" 639 "v139" 640 "v140" 641 "v141" 642 "v142" 643 "v143" 644 "v144" 645 "v145" 646 "v146" 647 "v147" 648 "v148" 649 "v149" 650 "v150" 651 "v151" 652 "v152" 653 "v153" 654 "v154" 655 "v155" 656 "v156" 657 "v157" 658 "v158" 659 "v159" 660 "v160" 661 "v161" 662 "v162" 663 "v163" 664 "v164" 665 "v165" 666 "v166" 667 "v167" 668 "v168" 669 "v169" 670 "v170" 671 "v171" 672 "v172" 673 "v173" 674 "v174" 675 "v175" 676 "v176" 677 "v177" 678 "v178" 679 "v179" 680 "v180" 681 "v181" 682 "v182" 683 "v183" 684 "v184" 685 "v185" 686 "v186" 687 "v187" 688 "v188" 689 "v189" 690 "v190" 691 "v191" 692 "v192" 693 "v193" 694 "v194" 695 "v195" 696 "v196" 697 "v197" 698 "v198" 699 "v199" 700 "v200" 701 "v201" 702 "v202" 703 "v203" 704 "v204" 705 "v205" 706 "v206" 707 "v207" 708 "v208" 709 "v209" 710 "v210" 711 "v211" 712 "v212" 713 "v213" 714 "v214" 715 "v215" 716 "v216" 717 "v217" 718 "v218" 719 "v219" 720 "v220" 721 "v221" 722 "v222" 723 "v223" 724 "v224" 725 "v225" 726 "v226" 727 "v227" 728 "v228" 729 "v229" 730 "v230" 731 "v231" 732 "v232" 733 "v233" 734 "v234" 735 "v235" 736 "v236" 737 "v237" 738 "v238" 739 "v239" 740 "v240" 741 "v241" 742 "v242" 743 "v243" 744 "v244" 745 "v245" 746 "v246" 747 "v247" 748 "v248" 749 "v249" 1000 "T3NSE" 1001 "T4NSE" 1002 "MRATS" 1003 "D20" 2000 "MDD01A" 2001 "MDD01B" 2002 "MDD01C" 2003 "MDD02" 2004 "MDD01CS" 2005 "MDD01CMRATS" 2006 "MDD01BS" 2007 "MDD01CS563" 2008 "MDD01BS563" 3007 "tmpA" 3008 "tmpB" 3009 "tmpC" 3010 "tmpD" 3011 "tmpE" 3012 "tmpF" 3013 "tmpG" 3014 "tmpH" 3015 "tmpJ" 3016 "tmpK" 3017 "tmpL" 3018 "tmpM" 3019 "tmpN" 3020 "tmpP" 3021 "tmpQ" 3022 "tmpR" 3023 "tmpS" 3024 "tmpT" 3025 "tmpU" 3026 "tmpW" 3027 "tmpX" 3028 "tmpY" 3029 "tmpZ" 3030 "a" 3031 "b" 3032 "c" 3033 "d" 3034 "e" 3035 "f" 3036 "g" 3037 "h" 3038 "j" 3039 "k" 3040 "l" 3041 "m" 3042 "n" 3043 "p" 3044 "q" 3045 "r" 3046 "s" 3047 "t" 3048 "u" 3049 "w" 3050 "x" 3051 "y" 3052 "z" 3060 "sysA" 3061 "sysB" 3062 "sysC" 3063 "sysD" 3064 "sysE" 3065 "sysF" 3066 "sysG" 3067 "sysH" 3068 "sysJ" 3069 "sysK" 3070 "sysL" 3071 "sysM" 3072 "sysN" 3073 "sysP" 3074 "sysQ" 3075 "sysR" 3076 "sysS" 3077 "sysT" 3078 "sysU" 3079 "sysW" 3080 "sysX" 3081 "sysY" 3082 "sysZ" 3090 "vsA" 3091 "vsB" 3092 "vsC" 3093 "vsD" 3094 "vsE" 3095 "vsF" 3096 "vsG" 3097 "vsH" 3098 "vsJ" 3099 "vsK" 3100 "vsL" 3101 "vsM" 3102 "vsN" 3103 "vsP" 3104 "vsQ" 3105 "vsR" 3106 "vsS" 3107 "vsT" 3108 "vsU" 3109 "vsW" 3110 "vsX" 3111 "vsY" 3112 "vsZ" DEFAULT_VALUE "--" /end COMPU_VTAB
/begin CHARACTERISTIC AppID_cali "Application Identifier by calibration" ASCII 0x380020 RL_UBYTE 0 nse_ident 0 127 NUMBER 64 /end CHARACTERISTIC
/begin COMPU_VTAB Gps_type_conv "Enumerated data type" TAB_VERB 2 0 "LINYI_TMP_PRJ" 1 "XUZHOU_PRJ" /end COMPU_VTAB
/begin COMPU_VTAB Gps_switch_fun_conv "Enumerated data type" TAB_VERB 2 0 "OFF" 1 "ON" /end COMPU_VTAB
/begin MEASUREMENT millisec_count "系统毫秒计数器" ULONG nse_basic 0 0 0 0xFFFFFFFF ECU_ADDRESS 0x400232D0 /end MEASUREMENT
/begin MEASUREMENT second_count "系统秒计数器" ULONG nse_basic 0 0 0 0xFFFFFFFF ECU_ADDRESS 0x400232D4 /end MEASUREMENT
/begin MEASUREMENT task1ms_count "1ms任务计数器" ULONG nse_basic 0 0 0 0xFFFFFFFF ECU_ADDRESS 0x400232D8 /end MEASUREMENT
/begin MEASUREMENT task2ms_count "2ms任务计数器" ULONG nse_basic 0 0 0 0xFFFFFFFF ECU_ADDRESS 0x400232DC /end MEASUREMENT
/begin MEASUREMENT task5ms_count "5ms任务计数器" ULONG nse_basic 0 0 0 0xFFFFFFFF ECU_ADDRESS 0x400232E0 /end MEASUREMENT
/begin MEASUREMENT task10ms_count "10ms任务计数器" ULONG nse_basic 0 0 0 0xFFFFFFFF ECU_ADDRESS 0x400232E4 /end MEASUREMENT
/begin MEASUREMENT task10ms_s2_count "10ms_s2任务计数器" ULONG nse_basic 0 0 0 0xFFFFFFFF ECU_ADDRESS 0x400232E8 /end MEASUREMENT
/begin MEASUREMENT task10ms_s3_count "10ms_s3任务计数器" ULONG nse_basic 0 0 0 0xFFFFFFFF ECU_ADDRESS 0x400232EC /end MEASUREMENT
/begin MEASUREMENT task10ms_s4_count "10ms_s4任务计数器" ULONG nse_basic 0 0 0 0xFFFFFFFF ECU_ADDRESS 0x400232F0 /end MEASUREMENT
/begin MEASUREMENT task10ms_s5_count "10ms_s5任务计数器" ULONG nse_basic 0 0 0 0xFFFFFFFF ECU_ADDRESS 0x400232F4 /end MEASUREMENT
/begin MEASUREMENT task20ms_count "20ms任务计数器" ULONG nse_basic 0 0 0 0xFFFFFFFF ECU_ADDRESS 0x400232F8 /end MEASUREMENT
/begin MEASUREMENT task50ms_count "50ms任务计数器" ULONG nse_basic 0 0 0 0xFFFFFFFF ECU_ADDRESS 0x400232FC /end MEASUREMENT
/begin MEASUREMENT task100ms_count "100ms任务计数器" ULONG nse_basic 0 0 0 0xFFFFFFFF ECU_ADDRESS 0x40023300 /end MEASUREMENT
/begin MEASUREMENT task200ms_count "200ms任务计数器" ULONG nse_basic 0 0 0 0xFFFFFFFF ECU_ADDRESS 0x40023304 /end MEASUREMENT
/begin MEASUREMENT task1000ms_count "1000ms任务计数器" ULONG nse_basic 0 0 0 0xFFFFFFFF ECU_ADDRESS 0x40023308 /end MEASUREMENT
/begin MEASUREMENT taskS0_count "S0任务计数器" ULONG nse_basic 0 0 0 0xFFFFFFFF ECU_ADDRESS 0x4002330C /end MEASUREMENT
/begin MEASUREMENT taskS1_count "S1任务计数器" ULONG nse_basic 0 0 0 0xFFFFFFFF ECU_ADDRESS 0x40023310 /end MEASUREMENT
/begin MEASUREMENT idle_count "空闲任务计数器" ULONG nse_basic 0 0 0 0xFFFFFFFF ECU_ADDRESS 0x40023318 /end MEASUREMENT
/begin MEASUREMENT taskdyn_count "动态喷射任务计数器" ULONG nse_basic 0 0 0 0xFFFFFFFF ECU_ADDRESS 0x40023314 /end MEASUREMENT
/begin MEASUREMENT task1ms_time "1ms任务时间" ULONG nse_basic 0 0 0 0xFFFFFFFF ECU_ADDRESS 0x40023324 /end MEASUREMENT
/begin MEASUREMENT task2ms_time "2ms任务时间" ULONG nse_basic 0 0 0 0xFFFFFFFF ECU_ADDRESS 0x40023328 /end MEASUREMENT
/begin MEASUREMENT task5ms_time "5ms任务时间" ULONG nse_basic 0 0 0 0xFFFFFFFF ECU_ADDRESS 0x4002332C /end MEASUREMENT
/begin MEASUREMENT task10ms_time "10ms任务时间" ULONG nse_basic 0 0 0 0xFFFFFFFF ECU_ADDRESS 0x40023330 /end MEASUREMENT
/begin MEASUREMENT task10ms_s4_time "10ms_s4任务时间" ULONG nse_basic 0 0 0 0xFFFFFFFF ECU_ADDRESS 0x40023334 /end MEASUREMENT
/begin MEASUREMENT task20ms_time "20ms任务时间" ULONG nse_basic 0 0 0 0xFFFFFFFF ECU_ADDRESS 0x40023338 /end MEASUREMENT
/begin MEASUREMENT task50ms_time "50ms任务时间" ULONG nse_basic 0 0 0 0xFFFFFFFF ECU_ADDRESS 0x4002333C /end MEASUREMENT
/begin MEASUREMENT task100ms_time "100ms任务时间" ULONG nse_basic 0 0 0 0xFFFFFFFF ECU_ADDRESS 0x40023340 /end MEASUREMENT
/begin MEASUREMENT task200ms_time "200ms任务时间" ULONG nse_basic 0 0 0 0xFFFFFFFF ECU_ADDRESS 0x40023344 /end MEASUREMENT
/begin MEASUREMENT task1000ms_time "1000ms任务时间" ULONG nse_basic 0 0 0 0xFFFFFFFF ECU_ADDRESS 0x40023348 /end MEASUREMENT
/begin MEASUREMENT taskS0_time "S0任务时间" ULONG nse_basic 0 0 0 0xFFFFFFFF ECU_ADDRESS 0x4002334C /end MEASUREMENT
/begin MEASUREMENT taskS1_time "S1任务时间" ULONG nse_basic 0 0 0 0xFFFFFFFF ECU_ADDRESS 0x40023350 /end MEASUREMENT
/begin MEASUREMENT idle_time "空闲任务时间" ULONG nse_basic 0 0 0 0xFFFFFFFF ECU_ADDRESS 0x4002338C /end MEASUREMENT
/begin MEASUREMENT taskDyn_time "动态喷射任务时间" ULONG nse_basic 0 0 0 0xFFFFFFFF ECU_ADDRESS 0x40023354 /end MEASUREMENT
/begin MEASUREMENT task1ms_maxtime "1ms任务最大时间" ULONG nse_basic 0 0 0 0xFFFFFFFF ECU_ADDRESS 0x40023358 /end MEASUREMENT
/begin MEASUREMENT task2ms_maxtime "2ms任务最大时间" ULONG nse_basic 0 0 0 0xFFFFFFFF ECU_ADDRESS 0x4002335C /end MEASUREMENT
/begin MEASUREMENT task5ms_maxtime "5ms任务最大时间" ULONG nse_basic 0 0 0 0xFFFFFFFF ECU_ADDRESS 0x40023360 /end MEASUREMENT
/begin MEASUREMENT task10ms_maxtime "10ms任务最大时间" ULONG nse_basic 0 0 0 0xFFFFFFFF ECU_ADDRESS 0x40023364 /end MEASUREMENT
/begin MEASUREMENT task10ms_s4_maxtime "10ms_s4任务最大时间" ULONG nse_basic 0 0 0 0xFFFFFFFF ECU_ADDRESS 0x40023368 /end MEASUREMENT
/begin MEASUREMENT task20ms_maxtime "20ms任务最大时间" ULONG nse_basic 0 0 0 0xFFFFFFFF ECU_ADDRESS 0x4002336C /end MEASUREMENT
/begin MEASUREMENT task50ms_maxtime "50ms任务最大时间" ULONG nse_basic 0 0 0 0xFFFFFFFF ECU_ADDRESS 0x40023370 /end MEASUREMENT
/begin MEASUREMENT task100ms_maxtime "100ms任务最大时间" ULONG nse_basic 0 0 0 0xFFFFFFFF ECU_ADDRESS 0x40023374 /end MEASUREMENT
/begin MEASUREMENT task200ms_maxtime "200ms任务最大时间" ULONG nse_basic 0 0 0 0xFFFFFFFF ECU_ADDRESS 0x40023378 /end MEASUREMENT
/begin MEASUREMENT task1000ms_maxtime "1000ms任务最大时间" ULONG nse_basic 0 0 0 0xFFFFFFFF ECU_ADDRESS 0x4002337C /end MEASUREMENT
/begin MEASUREMENT taskS0_maxtime "S0任务最大时间" ULONG nse_basic 0 0 0 0xFFFFFFFF ECU_ADDRESS 0x40023380 /end MEASUREMENT
/begin MEASUREMENT taskS1_maxtime "S1任务最大时间" ULONG nse_basic 0 0 0 0xFFFFFFFF ECU_ADDRESS 0x40023384 /end MEASUREMENT
/begin MEASUREMENT taskDyn_maxtime "空闲任务最大时间" ULONG nse_basic 0 0 0 0xFFFFFFFF ECU_ADDRESS 0x40023388 /end MEASUREMENT
/begin MEASUREMENT idle_maxtime "动态喷射任务最大时间" ULONG nse_basic 0 0 0 0xFFFFFFFF ECU_ADDRESS 0x40023390 /end MEASUREMENT
/begin MEASUREMENT isrCrank_maxtime "曲轴中断最大时间" ULONG nse_basic 0 0 0 0xFFFFFFFF ECU_ADDRESS 0x40023394 /end MEASUREMENT
/begin MEASUREMENT isrCam_maxtime "凸轮轴中断最大时间" ULONG nse_basic 0 0 0 0xFFFFFFFF ECU_ADDRESS 0x40023398 /end MEASUREMENT
/begin MEASUREMENT isrDyn_maxtime "动态任务中断最大时间" ULONG nse_basic 0 0 0 0xFFFFFFFF ECU_ADDRESS 0x4002339C /end MEASUREMENT
/begin MEASUREMENT task1ms_stackusage "1ms任务堆栈使用量" ULONG nse_basic 0 0 0 0xFFFFFFFF ECU_ADDRESS 0x400233A0 /end MEASUREMENT
/begin MEASUREMENT task2ms_stackusage "2ms任务堆栈使用量" ULONG nse_basic 0 0 0 0xFFFFFFFF ECU_ADDRESS 0x400233A4 /end MEASUREMENT
/begin MEASUREMENT task5ms_stackusage "5ms任务堆栈使用量" ULONG nse_basic 0 0 0 0xFFFFFFFF ECU_ADDRESS 0x400233A8 /end MEASUREMENT
/begin MEASUREMENT task10ms_stackusage "10ms任务堆栈使用量" ULONG nse_basic 0 0 0 0xFFFFFFFF ECU_ADDRESS 0x400233AC /end MEASUREMENT
/begin MEASUREMENT task20ms_stackusage "20ms任务堆栈使用量" ULONG nse_basic 0 0 0 0xFFFFFFFF ECU_ADDRESS 0x400233B0 /end MEASUREMENT
/begin MEASUREMENT task50ms_stackusage "50ms任务堆栈使用量" ULONG nse_basic 0 0 0 0xFFFFFFFF ECU_ADDRESS 0x400233B4 /end MEASUREMENT
/begin MEASUREMENT task100ms_stackusage "100ms任务堆栈使用量" ULONG nse_basic 0 0 0 0xFFFFFFFF ECU_ADDRESS 0x400233B8 /end MEASUREMENT
/begin MEASUREMENT task200ms_stackusage "200ms任务堆栈使用量" ULONG nse_basic 0 0 0 0xFFFFFFFF ECU_ADDRESS 0x400233BC /end MEASUREMENT
/begin MEASUREMENT task1000ms_stackusage "1000ms任务堆栈使用量" ULONG nse_basic 0 0 0 0xFFFFFFFF ECU_ADDRESS 0x400233C0 /end MEASUREMENT
/begin MEASUREMENT taskS0_stackusage "S0任务任务堆栈使用量" ULONG nse_basic 0 0 0 0xFFFFFFFF ECU_ADDRESS 0x400233C4 /end MEASUREMENT
/begin MEASUREMENT taskS1_stackusage "S1任务任务堆栈使用量" ULONG nse_basic 0 0 0 0xFFFFFFFF ECU_ADDRESS 0x400233C8 /end MEASUREMENT
/begin MEASUREMENT taskDyn_stackusage "动态任务堆栈使用量" ULONG nse_basic 0 0 0 0xFFFFFFFF ECU_ADDRESS 0x400233CC /end MEASUREMENT
/begin MEASUREMENT pitch0_stackusage "PIT中断堆栈使用量" ULONG nse_basic 0 0 0 0xFFFFFFFF ECU_ADDRESS 0x400233D0 /end MEASUREMENT
/begin MEASUREMENT crank_stackusage "曲轴中断堆栈使用量" ULONG nse_basic 0 0 0 0xFFFFFFFF ECU_ADDRESS 0x400233D4 /end MEASUREMENT
/begin MEASUREMENT dyn_stackusage "动态任务中断堆栈使用量" ULONG nse_basic 0 0 0 0xFFFFFFFF ECU_ADDRESS 0x400233D8 /end MEASUREMENT
/begin MEASUREMENT fifo1_stackusage "FIFO1中断堆栈使用量" ULONG nse_basic 0 0 0 0xFFFFFFFF ECU_ADDRESS 0x400233DC /end MEASUREMENT
/begin MEASUREMENT fifo2_stackusage "FIFO2中断堆栈使用量" ULONG nse_basic 0 0 0 0xFFFFFFFF ECU_ADDRESS 0x400233E0 /end MEASUREMENT
/begin MEASUREMENT canc08_stackusage "CANC08中断堆栈使用量" ULONG nse_basic 0 0 0 0xFFFFFFFF ECU_ADDRESS 0x400233E4 /end MEASUREMENT
/begin MEASUREMENT canc09_stackusage "CANC09中断堆栈使用量" ULONG nse_basic 0 0 0 0xFFFFFFFF ECU_ADDRESS 0x400233E8 /end MEASUREMENT
/begin MEASUREMENT canc10_stackusage "CANC10中断堆栈使用量" ULONG nse_basic 0 0 0 0xFFFFFFFF ECU_ADDRESS 0x400233EC /end MEASUREMENT
/begin MEASUREMENT canc11_stackusage "CANC11中断堆栈使用量" ULONG nse_basic 0 0 0 0xFFFFFFFF ECU_ADDRESS 0x400233F0 /end MEASUREMENT
/begin MEASUREMENT canc12_stackusage "CANC12中断堆栈使用量" ULONG nse_basic 0 0 0 0xFFFFFFFF ECU_ADDRESS 0x400233F4 /end MEASUREMENT
/begin MEASUREMENT canc13_stackusage "CANC13中断堆栈使用量" ULONG nse_basic 0 0 0 0xFFFFFFFF ECU_ADDRESS 0x400233F8 /end MEASUREMENT
/begin MEASUREMENT canc14_stackusage "CANC14中断堆栈使用量" ULONG nse_basic 0 0 0 0xFFFFFFFF ECU_ADDRESS 0x400233FC /end MEASUREMENT
/begin MEASUREMENT canc15_stackusage "CANC15中断堆栈使用量" ULONG nse_basic 0 0 0 0xFFFFFFFF ECU_ADDRESS 0x40023400 /end MEASUREMENT
/begin MEASUREMENT power_off_counter "下电延时监控变量" UBYTE nse_basic 0 0 0 255 ECU_ADDRESS 0x40021DDD /end MEASUREMENT
/begin MEASUREMENT k03_di_an_phy "T15原始AD值" UWORD nse_basic 0 0 0 65535 ECU_ADDRESS 0x40022076 /end MEASUREMENT
/begin MEASUREMENT DDRC_Debounce_0p "故障防抖计数器" UWORD nse_basic 0 0 0 65535 MATRIX_DIM 50 1 1 ECU_ADDRESS 0x40024BEC /end MEASUREMENT
/begin MEASUREMENT DDRC_Debounce_50p "故障防抖计数器" UWORD nse_basic 0 0 0 65535 MATRIX_DIM 50 1 1 ECU_ADDRESS 0x40024C50 /end MEASUREMENT
/begin MEASUREMENT DDRC_Debounce_100p "故障防抖计数器" UWORD nse_basic 0 0 0 65535 MATRIX_DIM 50 1 1 ECU_ADDRESS 0x40024CB4 /end MEASUREMENT
/begin MEASUREMENT DDRC_Debounce_150p "故障防抖计数器" UWORD nse_basic 0 0 0 65535 MATRIX_DIM 50 1 1 ECU_ADDRESS 0x40024D18 /end MEASUREMENT
/begin MEASUREMENT DDRC_Debounce_200p "故障防抖计数器" UWORD nse_basic 0 0 0 65535 MATRIX_DIM 50 1 1 ECU_ADDRESS 0x40024D7C /end MEASUREMENT
/begin MEASUREMENT DDRC_Debounce_250p "故障防抖计数器" UWORD nse_basic 0 0 0 65535 MATRIX_DIM 50 1 1 ECU_ADDRESS 0x40024DE0 /end MEASUREMENT
/begin MEASUREMENT DDRC_Debounce_300p "故障防抖计数器" UWORD nse_basic 0 0 0 65535 MATRIX_DIM 50 1 1 ECU_ADDRESS 0x40024E44 /end MEASUREMENT
/begin MEASUREMENT DDRC_Debounce_350p "故障防抖计数器" UWORD nse_basic 0 0 0 65535 MATRIX_DIM 50 1 1 ECU_ADDRESS 0x40024EA8 /end MEASUREMENT
/begin MEASUREMENT DFC_stAll_0p "故障实时状态" UBYTE nse_basic 0 0 0 255 MATRIX_DIM 50 1 1 ECU_ADDRESS 0x4002F800 /end MEASUREMENT
/begin MEASUREMENT DFC_stAll_50p "故障实时状态" UBYTE nse_basic 0 0 0 255 MATRIX_DIM 50 1 1 ECU_ADDRESS 0x4002F832 /end MEASUREMENT
/begin MEASUREMENT DFC_stAll_100p "故障实时状态" UBYTE nse_basic 0 0 0 255 MATRIX_DIM 50 1 1 ECU_ADDRESS 0x4002F864 /end MEASUREMENT
/begin MEASUREMENT DFC_stAll_150p "故障实时状态" UBYTE nse_basic 0 0 0 255 MATRIX_DIM 50 1 1 ECU_ADDRESS 0x4002F896 /end MEASUREMENT
/begin MEASUREMENT DFC_stAll_200p "故障实时状态" UBYTE nse_basic 0 0 0 255 MATRIX_DIM 50 1 1 ECU_ADDRESS 0x4002F8C8 /end MEASUREMENT
/begin MEASUREMENT DFC_stAll_250p "故障实时状态" UBYTE nse_basic 0 0 0 255 MATRIX_DIM 50 1 1 ECU_ADDRESS 0x4002F8FA /end MEASUREMENT
/begin MEASUREMENT DFC_stAll_300p "故障实时状态" UBYTE nse_basic 0 0 0 255 MATRIX_DIM 50 1 1 ECU_ADDRESS 0x4002F92C /end MEASUREMENT
/begin MEASUREMENT DFC_stAll_350p "故障实时状态" UBYTE nse_basic 0 0 0 255 MATRIX_DIM 50 1 1 ECU_ADDRESS 0x4002F95E /end MEASUREMENT
/begin MEASUREMENT DFES_st_0_numDFC "故障存贮状态" UWORD nse_DFCVerb 0 0 0 65535 ECU_ADDRESS 0x4002F9BE /end MEASUREMENT
/begin MEASUREMENT DFES_st_0_stEntry "故障存贮状态" UBYTE nse_DFESstVerb 0 0 0 255 ECU_ADDRESS 0x4002F9C0 /end MEASUREMENT
/begin MEASUREMENT DFES_st_0_ctFault "故障存贮状态" UBYTE nse_basic 0 0 0 255 ECU_ADDRESS 0x4002F9C1 /end MEASUREMENT
/begin MEASUREMENT DFES_st_0_ctHeal "故障存贮状态" UBYTE nse_basic 0 0 0 255 ECU_ADDRESS 0x4002F9C2 /end MEASUREMENT
/begin MEASUREMENT DFES_st_0_ctSvcDlt "故障存贮状态" UBYTE nse_basic 0 0 0 255 ECU_ADDRESS 0x4002F9C3 /end MEASUREMENT
/begin MEASUREMENT DFES_st_0_ctDlt "故障存贮状态" UBYTE nse_basic 0 0 0 255 ECU_ADDRESS 0x4002F9C4 /end MEASUREMENT
/begin MEASUREMENT DFES_st_0_ctDef "故障存贮状态" UBYTE nse_basic 0 0 0 255 ECU_ADDRESS 0x4002F9C5 /end MEASUREMENT
/begin MEASUREMENT DFES_st_0_idxSequence "故障存贮状态" UBYTE nse_basic 0 0 0 255 ECU_ADDRESS 0x4002F9C6 /end MEASUREMENT
/begin MEASUREMENT DFES_st_0_FrzFrm "故障存贮状态" UBYTE nse_basic 0 0 0 255 MATRIX_DIM 40 1 1 ECU_ADDRESS 0x4002F9C7 /end MEASUREMENT
/begin MEASUREMENT DFES_st_1_numDFC "故障存贮状态" UWORD nse_DFCVerb 0 0 0 65535 ECU_ADDRESS 0x4002F9F0 /end MEASUREMENT
/begin MEASUREMENT DFES_st_1_stEntry "故障存贮状态" UBYTE nse_DFESstVerb 0 0 0 255 ECU_ADDRESS 0x4002F9F2 /end MEASUREMENT
/begin MEASUREMENT DFES_st_1_ctFault "故障存贮状态" UBYTE nse_basic 0 0 0 255 ECU_ADDRESS 0x4002F9F3 /end MEASUREMENT
/begin MEASUREMENT DFES_st_1_ctHeal "故障存贮状态" UBYTE nse_basic 0 0 0 255 ECU_ADDRESS 0x4002F9F4 /end MEASUREMENT
/begin MEASUREMENT DFES_st_1_ctSvcDlt "故障存贮状态" UBYTE nse_basic 0 0 0 255 ECU_ADDRESS 0x4002F9F5 /end MEASUREMENT
/begin MEASUREMENT DFES_st_1_ctDlt "故障存贮状态" UBYTE nse_basic 0 0 0 255 ECU_ADDRESS 0x4002F9F6 /end MEASUREMENT
/begin MEASUREMENT DFES_st_1_ctDef "故障存贮状态" UBYTE nse_basic 0 0 0 255 ECU_ADDRESS 0x4002F9F7 /end MEASUREMENT
/begin MEASUREMENT DFES_st_1_idxSequence "故障存贮状态" UBYTE nse_basic 0 0 0 255 ECU_ADDRESS 0x4002F9F8 /end MEASUREMENT
/begin MEASUREMENT DFES_st_1_FrzFrm "故障存贮状态" UBYTE nse_basic 0 0 0 255 MATRIX_DIM 40 1 1 ECU_ADDRESS 0x4002F9F9 /end MEASUREMENT
/begin MEASUREMENT DFES_st_2_numDFC "故障存贮状态" UWORD nse_DFCVerb 0 0 0 65535 ECU_ADDRESS 0x4002FA22 /end MEASUREMENT
/begin MEASUREMENT DFES_st_2_stEntry "故障存贮状态" UBYTE nse_DFESstVerb 0 0 0 255 ECU_ADDRESS 0x4002FA24 /end MEASUREMENT
/begin MEASUREMENT DFES_st_2_ctFault "故障存贮状态" UBYTE nse_basic 0 0 0 255 ECU_ADDRESS 0x4002FA25 /end MEASUREMENT
/begin MEASUREMENT DFES_st_2_ctHeal "故障存贮状态" UBYTE nse_basic 0 0 0 255 ECU_ADDRESS 0x4002FA26 /end MEASUREMENT
/begin MEASUREMENT DFES_st_2_ctSvcDlt "故障存贮状态" UBYTE nse_basic 0 0 0 255 ECU_ADDRESS 0x4002FA27 /end MEASUREMENT
/begin MEASUREMENT DFES_st_2_ctDlt "故障存贮状态" UBYTE nse_basic 0 0 0 255 ECU_ADDRESS 0x4002FA28 /end MEASUREMENT
/begin MEASUREMENT DFES_st_2_ctDef "故障存贮状态" UBYTE nse_basic 0 0 0 255 ECU_ADDRESS 0x4002FA29 /end MEASUREMENT
/begin MEASUREMENT DFES_st_2_idxSequence "故障存贮状态" UBYTE nse_basic 0 0 0 255 ECU_ADDRESS 0x4002FA2A /end MEASUREMENT
/begin MEASUREMENT DFES_st_2_FrzFrm "故障存贮状态" UBYTE nse_basic 0 0 0 255 MATRIX_DIM 40 1 1 ECU_ADDRESS 0x4002FA2B /end MEASUREMENT
/begin MEASUREMENT DFES_st_3_numDFC "故障存贮状态" UWORD nse_DFCVerb 0 0 0 65535 ECU_ADDRESS 0x4002FA54 /end MEASUREMENT
/begin MEASUREMENT DFES_st_3_stEntry "故障存贮状态" UBYTE nse_DFESstVerb 0 0 0 255 ECU_ADDRESS 0x4002FA56 /end MEASUREMENT
/begin MEASUREMENT DFES_st_3_ctFault "故障存贮状态" UBYTE nse_basic 0 0 0 255 ECU_ADDRESS 0x4002FA57 /end MEASUREMENT
/begin MEASUREMENT DFES_st_3_ctHeal "故障存贮状态" UBYTE nse_basic 0 0 0 255 ECU_ADDRESS 0x4002FA58 /end MEASUREMENT
/begin MEASUREMENT DFES_st_3_ctSvcDlt "故障存贮状态" UBYTE nse_basic 0 0 0 255 ECU_ADDRESS 0x4002FA59 /end MEASUREMENT
/begin MEASUREMENT DFES_st_3_ctDlt "故障存贮状态" UBYTE nse_basic 0 0 0 255 ECU_ADDRESS 0x4002FA5A /end MEASUREMENT
/begin MEASUREMENT DFES_st_3_ctDef "故障存贮状态" UBYTE nse_basic 0 0 0 255 ECU_ADDRESS 0x4002FA5B /end MEASUREMENT
/begin MEASUREMENT DFES_st_3_idxSequence "故障存贮状态" UBYTE nse_basic 0 0 0 255 ECU_ADDRESS 0x4002FA5C /end MEASUREMENT
/begin MEASUREMENT DFES_st_3_FrzFrm "故障存贮状态" UBYTE nse_basic 0 0 0 255 MATRIX_DIM 40 1 1 ECU_ADDRESS 0x4002FA5D /end MEASUREMENT
/begin MEASUREMENT DFES_st_4_numDFC "故障存贮状态" UWORD nse_DFCVerb 0 0 0 65535 ECU_ADDRESS 0x4002FA86 /end MEASUREMENT
/begin MEASUREMENT DFES_st_4_stEntry "故障存贮状态" UBYTE nse_DFESstVerb 0 0 0 255 ECU_ADDRESS 0x4002FA88 /end MEASUREMENT
/begin MEASUREMENT DFES_st_4_ctFault "故障存贮状态" UBYTE nse_basic 0 0 0 255 ECU_ADDRESS 0x4002FA89 /end MEASUREMENT
/begin MEASUREMENT DFES_st_4_ctHeal "故障存贮状态" UBYTE nse_basic 0 0 0 255 ECU_ADDRESS 0x4002FA8A /end MEASUREMENT
/begin MEASUREMENT DFES_st_4_ctSvcDlt "故障存贮状态" UBYTE nse_basic 0 0 0 255 ECU_ADDRESS 0x4002FA8B /end MEASUREMENT
/begin MEASUREMENT DFES_st_4_ctDlt "故障存贮状态" UBYTE nse_basic 0 0 0 255 ECU_ADDRESS 0x4002FA8C /end MEASUREMENT
/begin MEASUREMENT DFES_st_4_ctDef "故障存贮状态" UBYTE nse_basic 0 0 0 255 ECU_ADDRESS 0x4002FA8D /end MEASUREMENT
/begin MEASUREMENT DFES_st_4_idxSequence "故障存贮状态" UBYTE nse_basic 0 0 0 255 ECU_ADDRESS 0x4002FA8E /end MEASUREMENT
/begin MEASUREMENT DFES_st_4_FrzFrm "故障存贮状态" UBYTE nse_basic 0 0 0 255 MATRIX_DIM 40 1 1 ECU_ADDRESS 0x4002FA8F /end MEASUREMENT
/begin MEASUREMENT DFES_st_5_numDFC "故障存贮状态" UWORD nse_DFCVerb 0 0 0 65535 ECU_ADDRESS 0x4002FAB8 /end MEASUREMENT
/begin MEASUREMENT DFES_st_5_stEntry "故障存贮状态" UBYTE nse_DFESstVerb 0 0 0 255 ECU_ADDRESS 0x4002FABA /end MEASUREMENT
/begin MEASUREMENT DFES_st_5_ctFault "故障存贮状态" UBYTE nse_basic 0 0 0 255 ECU_ADDRESS 0x4002FABB /end MEASUREMENT
/begin MEASUREMENT DFES_st_5_ctHeal "故障存贮状态" UBYTE nse_basic 0 0 0 255 ECU_ADDRESS 0x4002FABC /end MEASUREMENT
/begin MEASUREMENT DFES_st_5_ctSvcDlt "故障存贮状态" UBYTE nse_basic 0 0 0 255 ECU_ADDRESS 0x4002FABD /end MEASUREMENT
/begin MEASUREMENT DFES_st_5_ctDlt "故障存贮状态" UBYTE nse_basic 0 0 0 255 ECU_ADDRESS 0x4002FABE /end MEASUREMENT
/begin MEASUREMENT DFES_st_5_ctDef "故障存贮状态" UBYTE nse_basic 0 0 0 255 ECU_ADDRESS 0x4002FABF /end MEASUREMENT
/begin MEASUREMENT DFES_st_5_idxSequence "故障存贮状态" UBYTE nse_basic 0 0 0 255 ECU_ADDRESS 0x4002FAC0 /end MEASUREMENT
/begin MEASUREMENT DFES_st_5_FrzFrm "故障存贮状态" UBYTE nse_basic 0 0 0 255 MATRIX_DIM 40 1 1 ECU_ADDRESS 0x4002FAC1 /end MEASUREMENT
/begin MEASUREMENT DFES_st_6_numDFC "故障存贮状态" UWORD nse_DFCVerb 0 0 0 65535 ECU_ADDRESS 0x4002FAEA /end MEASUREMENT
/begin MEASUREMENT DFES_st_6_stEntry "故障存贮状态" UBYTE nse_DFESstVerb 0 0 0 255 ECU_ADDRESS 0x4002FAEC /end MEASUREMENT
/begin MEASUREMENT DFES_st_6_ctFault "故障存贮状态" UBYTE nse_basic 0 0 0 255 ECU_ADDRESS 0x4002FAED /end MEASUREMENT
/begin MEASUREMENT DFES_st_6_ctHeal "故障存贮状态" UBYTE nse_basic 0 0 0 255 ECU_ADDRESS 0x4002FAEE /end MEASUREMENT
/begin MEASUREMENT DFES_st_6_ctSvcDlt "故障存贮状态" UBYTE nse_basic 0 0 0 255 ECU_ADDRESS 0x4002FAEF /end MEASUREMENT
/begin MEASUREMENT DFES_st_6_ctDlt "故障存贮状态" UBYTE nse_basic 0 0 0 255 ECU_ADDRESS 0x4002FAF0 /end MEASUREMENT
/begin MEASUREMENT DFES_st_6_ctDef "故障存贮状态" UBYTE nse_basic 0 0 0 255 ECU_ADDRESS 0x4002FAF1 /end MEASUREMENT
/begin MEASUREMENT DFES_st_6_idxSequence "故障存贮状态" UBYTE nse_basic 0 0 0 255 ECU_ADDRESS 0x4002FAF2 /end MEASUREMENT
/begin MEASUREMENT DFES_st_6_FrzFrm "故障存贮状态" UBYTE nse_basic 0 0 0 255 MATRIX_DIM 40 1 1 ECU_ADDRESS 0x4002FAF3 /end MEASUREMENT
/begin MEASUREMENT DFES_st_7_numDFC "故障存贮状态" UWORD nse_DFCVerb 0 0 0 65535 ECU_ADDRESS 0x4002FB1C /end MEASUREMENT
/begin MEASUREMENT DFES_st_7_stEntry "故障存贮状态" UBYTE nse_DFESstVerb 0 0 0 255 ECU_ADDRESS 0x4002FB1E /end MEASUREMENT
/begin MEASUREMENT DFES_st_7_ctFault "故障存贮状态" UBYTE nse_basic 0 0 0 255 ECU_ADDRESS 0x4002FB1F /end MEASUREMENT
/begin MEASUREMENT DFES_st_7_ctHeal "故障存贮状态" UBYTE nse_basic 0 0 0 255 ECU_ADDRESS 0x4002FB20 /end MEASUREMENT
/begin MEASUREMENT DFES_st_7_ctSvcDlt "故障存贮状态" UBYTE nse_basic 0 0 0 255 ECU_ADDRESS 0x4002FB21 /end MEASUREMENT
/begin MEASUREMENT DFES_st_7_ctDlt "故障存贮状态" UBYTE nse_basic 0 0 0 255 ECU_ADDRESS 0x4002FB22 /end MEASUREMENT
/begin MEASUREMENT DFES_st_7_ctDef "故障存贮状态" UBYTE nse_basic 0 0 0 255 ECU_ADDRESS 0x4002FB23 /end MEASUREMENT
/begin MEASUREMENT DFES_st_7_idxSequence "故障存贮状态" UBYTE nse_basic 0 0 0 255 ECU_ADDRESS 0x4002FB24 /end MEASUREMENT
/begin MEASUREMENT DFES_st_7_FrzFrm "故障存贮状态" UBYTE nse_basic 0 0 0 255 MATRIX_DIM 40 1 1 ECU_ADDRESS 0x4002FB25 /end MEASUREMENT
/begin MEASUREMENT DFES_st_8_numDFC "故障存贮状态" UWORD nse_DFCVerb 0 0 0 65535 ECU_ADDRESS 0x4002FB4E /end MEASUREMENT
/begin MEASUREMENT DFES_st_8_stEntry "故障存贮状态" UBYTE nse_DFESstVerb 0 0 0 255 ECU_ADDRESS 0x4002FB50 /end MEASUREMENT
/begin MEASUREMENT DFES_st_8_ctFault "故障存贮状态" UBYTE nse_basic 0 0 0 255 ECU_ADDRESS 0x4002FB51 /end MEASUREMENT
/begin MEASUREMENT DFES_st_8_ctHeal "故障存贮状态" UBYTE nse_basic 0 0 0 255 ECU_ADDRESS 0x4002FB52 /end MEASUREMENT
/begin MEASUREMENT DFES_st_8_ctSvcDlt "故障存贮状态" UBYTE nse_basic 0 0 0 255 ECU_ADDRESS 0x4002FB53 /end MEASUREMENT
/begin MEASUREMENT DFES_st_8_ctDlt "故障存贮状态" UBYTE nse_basic 0 0 0 255 ECU_ADDRESS 0x4002FB54 /end MEASUREMENT
/begin MEASUREMENT DFES_st_8_ctDef "故障存贮状态" UBYTE nse_basic 0 0 0 255 ECU_ADDRESS 0x4002FB55 /end MEASUREMENT
/begin MEASUREMENT DFES_st_8_idxSequence "故障存贮状态" UBYTE nse_basic 0 0 0 255 ECU_ADDRESS 0x4002FB56 /end MEASUREMENT
/begin MEASUREMENT DFES_st_8_FrzFrm "故障存贮状态" UBYTE nse_basic 0 0 0 255 MATRIX_DIM 40 1 1 ECU_ADDRESS 0x4002FB57 /end MEASUREMENT
/begin MEASUREMENT DFES_st_9_numDFC "故障存贮状态" UWORD nse_DFCVerb 0 0 0 65535 ECU_ADDRESS 0x4002FB80 /end MEASUREMENT
/begin MEASUREMENT DFES_st_9_stEntry "故障存贮状态" UBYTE nse_DFESstVerb 0 0 0 255 ECU_ADDRESS 0x4002FB82 /end MEASUREMENT
/begin MEASUREMENT DFES_st_9_ctFault "故障存贮状态" UBYTE nse_basic 0 0 0 255 ECU_ADDRESS 0x4002FB83 /end MEASUREMENT
/begin MEASUREMENT DFES_st_9_ctHeal "故障存贮状态" UBYTE nse_basic 0 0 0 255 ECU_ADDRESS 0x4002FB84 /end MEASUREMENT
/begin MEASUREMENT DFES_st_9_ctSvcDlt "故障存贮状态" UBYTE nse_basic 0 0 0 255 ECU_ADDRESS 0x4002FB85 /end MEASUREMENT
/begin MEASUREMENT DFES_st_9_ctDlt "故障存贮状态" UBYTE nse_basic 0 0 0 255 ECU_ADDRESS 0x4002FB86 /end MEASUREMENT
/begin MEASUREMENT DFES_st_9_ctDef "故障存贮状态" UBYTE nse_basic 0 0 0 255 ECU_ADDRESS 0x4002FB87 /end MEASUREMENT
/begin MEASUREMENT DFES_st_9_idxSequence "故障存贮状态" UBYTE nse_basic 0 0 0 255 ECU_ADDRESS 0x4002FB88 /end MEASUREMENT
/begin MEASUREMENT DFES_st_9_FrzFrm "故障存贮状态" UBYTE nse_basic 0 0 0 255 MATRIX_DIM 40 1 1 ECU_ADDRESS 0x4002FB89 /end MEASUREMENT
/begin MEASUREMENT DINH_st_0p "功能抑制标志" UBYTE nse_basic 0 0 0 255 MATRIX_DIM 50 1 1 ECU_ADDRESS 0x40024F40 /end MEASUREMENT
/begin MEASUREMENT DINH_st_50p "功能抑制标志" UBYTE nse_basic 0 0 0 255 MATRIX_DIM 50 1 1 ECU_ADDRESS 0x40024F72 /end MEASUREMENT
/begin MEASUREMENT DINH_st_100p "功能抑制标志" UBYTE nse_basic 0 0 0 255 MATRIX_DIM 50 1 1 ECU_ADDRESS 0x40024FA4 /end MEASUREMENT
/begin MEASUREMENT DINH_st_150p "功能抑制标志" UBYTE nse_basic 0 0 0 255 MATRIX_DIM 50 1 1 ECU_ADDRESS 0x40024FD6 /end MEASUREMENT
/begin MEASUREMENT DINH_st_200p "功能抑制标志" UBYTE nse_basic 0 0 0 255 MATRIX_DIM 50 1 1 ECU_ADDRESS 0x40025008 /end MEASUREMENT
/begin MEASUREMENT DINH_st_250p "功能抑制标志" UBYTE nse_basic 0 0 0 255 MATRIX_DIM 50 1 1 ECU_ADDRESS 0x4002503A /end MEASUREMENT
/begin MEASUREMENT DINH_st_300p "功能抑制标志" UBYTE nse_basic 0 0 0 255 MATRIX_DIM 50 1 1 ECU_ADDRESS 0x4002506C /end MEASUREMENT
/begin MEASUREMENT DINH_st_350p "功能抑制标志" UBYTE nse_basic 0 0 0 255 MATRIX_DIM 50 1 1 ECU_ADDRESS 0x4002509E /end MEASUREMENT
/begin MEASUREMENT CoEng_stAftRun "系统afterrun状态" UBYTE nse_basic 0 0 0 255 ECU_ADDRESS 0x40021BD0 /end MEASUREMENT
/begin MEASUREMENT StSys_stStrtEnd "系统启动完成状态" UBYTE nse_basic 0 0 0 255 ECU_ADDRESS 0x40021BD1 /end MEASUREMENT
/begin MEASUREMENT T15_stdsm "T15状态" UBYTE nse_basic 0 0 0 255 ECU_ADDRESS 0x40021BD2 /end MEASUREMENT
/begin MEASUREMENT OilT_t "油温(暖机循环判定用）" UWORD nse_basic 0 0 0 65535 ECU_ADDRESS 0x40021BD4 /end MEASUREMENT
/begin MEASUREMENT DSMAUX_DTrg_DrC "驾驶循环成立标志" UBYTE nse_basic 0 0 0 255 ECU_ADDRESS 0x40022AC2 /end MEASUREMENT
/begin MEASUREMENT DSMAUX_DTrg_WuC "暖机循环成立标志" UBYTE nse_basic 0 0 0 255 ECU_ADDRESS 0x40022AC3 /end MEASUREMENT
/begin MEASUREMENT DSM_tClntStrt "系统启动油温" UWORD nse_basic 0 0 0 65535 ECU_ADDRESS 0x40022AC6 /end MEASUREMENT
/begin MEASUREMENT DSM_stStrtEnd "系统启动完成状态（DSM）" UBYTE nse_basic 0 0 0 255 ECU_ADDRESS 0x40022AC4 /end MEASUREMENT
/begin MEASUREMENT flag_start1_fail "喷油器1故障状态" UBYTE nse_basic 0 0 0 255 ECU_ADDRESS 0x40023072 /end MEASUREMENT
/begin MEASUREMENT flag_start2_fail "喷油器2故障状态" UBYTE nse_basic 0 0 0 255 ECU_ADDRESS 0x40023073 /end MEASUREMENT
/begin MEASUREMENT flag_start3_fail "喷油器3故障状态" UBYTE nse_basic 0 0 0 255 ECU_ADDRESS 0x40023074 /end MEASUREMENT
/begin MEASUREMENT flag_start4_fail "喷油器4故障状态" UBYTE nse_basic 0 0 0 255 ECU_ADDRESS 0x40023075 /end MEASUREMENT
/begin MEASUREMENT flag_start5_fail "喷油器5故障状态" UBYTE nse_basic 0 0 0 255 ECU_ADDRESS 0x40023076 /end MEASUREMENT
/begin MEASUREMENT flag_start6_fail "喷油器6故障状态" UBYTE nse_basic 0 0 0 255 ECU_ADDRESS 0x40023077 /end MEASUREMENT
/begin MEASUREMENT inj_err_state "喷油器故障种类明细" UWORD nse_basic 0 0 0 65535 MATRIX_DIM 6 1 1 ECU_ADDRESS 0x400258AC /end MEASUREMENT
/begin MEASUREMENT LSD_DIA1 "底边诊断1" ULONG nse_basic 0 0 0 0xFFFFFFFF ECU_ADDRESS 0x40022F88 /end MEASUREMENT
/begin MEASUREMENT LSD_DIA2 "底边诊断2" ULONG nse_basic 0 0 0 0xFFFFFFFF ECU_ADDRESS 0x40022F8C /end MEASUREMENT
/begin MEASUREMENT LSD_DIA3 "底边诊断3" ULONG nse_basic 0 0 0 0xFFFFFFFF ECU_ADDRESS 0x40022F90 /end MEASUREMENT
/begin MEASUREMENT LSD_DIA4 "底边诊断4" ULONG nse_basic 0 0 0 0xFFFFFFFF ECU_ADDRESS 0x40022F94 /end MEASUREMENT
/begin MEASUREMENT LSD_DIA5 "底边诊断5" ULONG nse_basic 0 0 0 0xFFFFFFFF ECU_ADDRESS 0x40022F98 /end MEASUREMENT
/begin MEASUREMENT task_CPULoad "CPU负荷" ULONG nse_div1000 0 0 0 0xFFFFFFFF ECU_ADDRESS 0x40021E08 /end MEASUREMENT
/begin MEASUREMENT vcv_feedbackRaw_mp "vcv原始采样值" UWORD nse_basic 0 0 0 65535 ECU_ADDRESS 0x40022084 /end MEASUREMENT
/begin MEASUREMENT vcv_feedbackFlt_mp "vcv过滤值（底层过滤）" UWORD nse_basic 0 0 0 65535 ECU_ADDRESS 0x400220A0 /end MEASUREMENT
/begin MEASUREMENT ee_store_init_flg "E方初始化标志" UBYTE nse_basic 0 0 0 255 ECU_ADDRESS 0x40021DE1 /end MEASUREMENT
/begin MEASUREMENT DFES_ctMILOff "MIL灭灯计数器" UBYTE nse_basic 0 0 0 255 MATRIX_DIM 10 1 1 ECU_ADDRESS 0x4002F990 /end MEASUREMENT
/begin MEASUREMENT DFES_ctMILOn "MIL亮灯计数器" UBYTE nse_basic 0 0 0 255 MATRIX_DIM 10 1 1 ECU_ADDRESS 0x4002F9A8 /end MEASUREMENT
/begin MEASUREMENT fee_state_mp "E方存储状态" ULONG nse_basic 0 0 0 0xFFFFFFFF ECU_ADDRESS 0x40021C08 /end MEASUREMENT
/begin MEASUREMENT bsw_version "底层软件版本" ULONG nse_basic 0 0 0 0xFFFFFFFF MATRIX_DIM 3 1 1 ECU_ADDRESS 0x870D8 /end MEASUREMENT
/begin MEASUREMENT etpu_speed_phy_mp "无任何限制的转速检测量（debug用）" UWORD nse_basic 0 0 0 65535 ECU_ADDRESS 0x400230A8 /end MEASUREMENT
/begin MEASUREMENT crsStatus_mp "曲轴状态机" UBYTE nse_basic 0 0 0 255 ECU_ADDRESS 0x40021DEA /end MEASUREMENT
/begin MEASUREMENT casStatus_mp "凸轮轴状态机" UBYTE nse_basic 0 0 0 255 ECU_ADDRESS 0x40021DEB /end MEASUREMENT
/begin MEASUREMENT casCounter_mp "凸轮轴计数器（曲轴故障和停机判定用）" UBYTE nse_basic 0 0 0 255 ECU_ADDRESS 0x40021DF2 /end MEASUREMENT
/begin MEASUREMENT crsNoFlag_mp "曲轴无信号标志" UBYTE nse_basic 0 0 0 255 ECU_ADDRESS 0x40021DF3 /end MEASUREMENT
/begin MEASUREMENT casNoFlag_mp "凸轮轴无信号标志" UBYTE nse_basic 0 0 0 255 ECU_ADDRESS 0x40021DD7 /end MEASUREMENT
/begin MEASUREMENT cam_seek_mp "凸轮轴线程标志" ULONG nse_basic 0 0 0 0xFFFFFFFF ECU_ADDRESS 0x40021DF4 /end MEASUREMENT
/begin MEASUREMENT cam_angle_mp "凸轮轴线程标志" ULONG nse_basic 0 0 0 0xFFFFFFFF ECU_ADDRESS 0x40021DF8 /end MEASUREMENT
/begin MEASUREMENT cam_lost_mp "凸轮轴线程标志" ULONG nse_basic 0 0 0 0xFFFFFFFF ECU_ADDRESS 0x40021DFC /end MEASUREMENT
/begin MEASUREMENT cam_rst_mp "凸轮轴线程标志" ULONG nse_basic 0 0 0 0xFFFFFFFF ECU_ADDRESS 0x40021E00 /end MEASUREMENT
/begin MEASUREMENT cam_lsr_mp "凸轮轴线程标志" ULONG nse_basic 0 0 0 0xFFFFFFFF ECU_ADDRESS 0x40021E04 /end MEASUREMENT
/begin MEASUREMENT testInjInh_mp "试喷禁止标志" UBYTE nse_basic 0 0 0 255 ECU_ADDRESS 0x40021DD6 /end MEASUREMENT
/begin MEASUREMENT DSM_setDFC_time "" ULONG nse_basic 0 0 0 0xFFFFFFFF ECU_ADDRESS 0x40021AE0 /end MEASUREMENT
/begin MEASUREMENT DSM_setDFC_maxtime "" ULONG nse_basic 0 0 0 0xFFFFFFFF ECU_ADDRESS 0x40021AE4 /end MEASUREMENT
/begin MEASUREMENT ECU_tboxCtlLmtTq_N "监控EEPROM中的电子围栏标志是否有效" UBYTE nse_basic 0 0 0 255 ECU_ADDRESS 0x4002FBD0 /end MEASUREMENT
/begin MEASUREMENT ECU_tboxCtlLmtTq_N_flag_mp "监控是否收到电子围栏有效信号" UBYTE nse_basic 0 0 0 255 ECU_ADDRESS 0x40021E64 /end MEASUREMENT
/begin MEASUREMENT safetycertificationa_flag_mp "监控安全认证是否通过" UBYTE nse_basic 0 0 0 255 ECU_ADDRESS 0x40021E65 /end MEASUREMENT
/begin MEASUREMENT ECU_ctRunTime_N "ECU上电时间" ULONG nse_min 0 0 0 0xFFFFFFFF ECU_ADDRESS 0x4002FBCC /end MEASUREMENT
/begin MEASUREMENT StartupSpeed_mp "启动成功转速" ULONG nse_basic 0 0 0 0xFFFFFFFF ECU_ADDRESS 0x400230AC /end MEASUREMENT
/begin MEASUREMENT cam0Tooth_mp "凸轮轴0#齿对应的曲轴齿号" UBYTE nse_basic 0 0 0 255 ECU_ADDRESS 0x400230B0 /end MEASUREMENT
/begin MEASUREMENT DFESEntry_stMIL "存储故障MIL灯状态" UBYTE nse_basic 0 0 0 255 MATRIX_DIM 10 1 1 ECU_ADDRESS 0x4002FBB4 /end MEASUREMENT
/begin MEASUREMENT DFESEntry_stWrn "存储故障WRN灯状态" UBYTE nse_basic 0 0 0 255 MATRIX_DIM 10 1 1 ECU_ADDRESS 0x4002FBC0 /end MEASUREMENT
/begin MEASUREMENT DSM_stMILLmp "MIL灯最终状态" UBYTE nse_basic 0 0 0 255 ECU_ADDRESS 0x40022AA7 /end MEASUREMENT
/begin MEASUREMENT DSM_stWrnLmp "WRN灯最终状态" UBYTE nse_basic 0 0 0 255 ECU_ADDRESS 0x40022AA5 /end MEASUREMENT
/begin MEASUREMENT t15states_mp "T15状态" UBYTE nse_basic 0 0 0 255 ECU_ADDRESS 0x40021DD8 /end MEASUREMENT
/begin MEASUREMENT phase_err_mp "相位故障标志" UBYTE nse_basic 0 0 0 255 ECU_ADDRESS 0x40021DD9 /end MEASUREMENT
/begin MEASUREMENT eng_speed "58齿转速" UWORD nse_basic 0 0 0 65535 ECU_ADDRESS 0x40021DF0 /end MEASUREMENT
/begin MEASUREMENT fee_wcnt_mp "下电实际写E2的次数的监控量，主要用于ECC故障注入" UBYTE nse_basic 0 0 0 255 ECU_ADDRESS 0x40021DDF /end MEASUREMENT
/begin MEASUREMENT ivor1cnt "IVOR1异常处理函数调用计数器" UBYTE nse_basic 0 0 0 255 ECU_ADDRESS 0x40022C64 /end MEASUREMENT
/begin MEASUREMENT e2_ecc_flag "e2错误标志" UBYTE nse_basic 0 0 0 255 ECU_ADDRESS 0x40022C63 /end MEASUREMENT
/begin MEASUREMENT ECU_ctRunTime_S "ECU上电时间（单位秒）" ULONG nse_basic 0 0 0 0xFFFFFFFF ECU_ADDRESS 0x40021AC4 /end MEASUREMENT
/begin MEASUREMENT inj_auto_err_state "喷油器驱动诊断故障种类明细" UWORD nse_basic 0 0 0 65535 MATRIX_DIM 6 1 1 ECU_ADDRESS 0x400258C4 /end MEASUREMENT
/begin MEASUREMENT inj_sw_err_state "喷油器空闲诊断故障种类明细" UWORD nse_basic 0 0 0 65535 MATRIX_DIM 6 1 1 ECU_ADDRESS 0x400258B8 /end MEASUREMENT
/begin CHARACTERISTIC DFES_swtClear_C "故障存储清除标志，设置成1会清除所有故障" VALUE 0x39BF08 RL_UBYTE 0 nse_basic 0 255 /end CHARACTERISTIC
/begin CHARACTERISTIC DSM_ctMILInit_C "MIL灯初始化亮灯时间" VALUE 0x39BF09 RL_UBYTE 0 nse_basic 0 255 /end CHARACTERISTIC
/begin CHARACTERISTIC DSM_ctWrnInit_C "警告灯初始化亮灯时间" VALUE 0x39BF0A RL_UBYTE 0 nse_basic 0 255 /end CHARACTERISTIC
/begin CHARACTERISTIC DSM_dtWuCMin_C "暖机循环成立的最小温度差值" VALUE 0x39BF0E RL_SWORD 0 nse_basic -32768 32767 /end CHARACTERISTIC
/begin CHARACTERISTIC DSM_tWuCMin_C "暖机循环成立的最小温度上升值" VALUE 0x39BF10 RL_SWORD 0 nse_basic -32768 32767 /end CHARACTERISTIC
/begin CHARACTERISTIC DFES_stCls_CA "故障类别" VAL_BLK 0x39BF14 RL_UBYTE 0 nse_basic 0 255 NUMBER 400 /end CHARACTERISTIC
/begin CHARACTERISTIC DFES_xClsPrio_CA "故障优先级" VAL_BLK 0x39C0A4 RL_UBYTE 0 nse_basic 0 255 NUMBER 10 /end CHARACTERISTIC
/begin CHARACTERISTIC DFES_ctFaultTrg_CA "故障确定计数值" VAL_BLK 0x39C0B0 RL_UBYTE 0 nse_basic 0 255 NUMBER 10 /end CHARACTERISTIC
/begin CHARACTERISTIC DFES_ctSvcDltTrg_CA "未确定故障删除计数值" VAL_BLK 0x39C0BC RL_UBYTE 0 nse_basic 0 255 NUMBER 10 /end CHARACTERISTIC
/begin CHARACTERISTIC DFES_ctDltTrg_CA "确定故障删除计数值" VAL_BLK 0x39C0C8 RL_UBYTE 0 nse_basic 0 255 NUMBER 10 /end CHARACTERISTIC
/begin CHARACTERISTIC DFES_ctHealTrg_CA "故障恢复计数值" VAL_BLK 0x39C0D4 RL_UBYTE 0 nse_basic 0 255 NUMBER 10 /end CHARACTERISTIC
/begin CHARACTERISTIC DFES_stMILEna_CA "MIL灯使能" VAL_BLK 0x39C0E0 RL_UBYTE 0 nse_basic 0 255 NUMBER 10 /end CHARACTERISTIC
/begin CHARACTERISTIC DFES_ctMILOn_CA "MIL亮灯计数值" VAL_BLK 0x39C0EC RL_UBYTE 0 nse_basic 0 255 NUMBER 10 /end CHARACTERISTIC
/begin CHARACTERISTIC DFES_ctMILOff_CA "MIL灭灯计数值" VAL_BLK 0x39C0F8 RL_UBYTE 0 nse_basic 0 255 NUMBER 10 /end CHARACTERISTIC
/begin CHARACTERISTIC DFES_stWrnEna_CA "警告灯使能" VAL_BLK 0x39C104 RL_UBYTE 0 nse_basic 0 255 NUMBER 10 /end CHARACTERISTIC
/begin CHARACTERISTIC DFES_ctWrnOn_CA "警告亮灯计数值" VAL_BLK 0x39C110 RL_UBYTE 0 nse_basic 0 255 NUMBER 10 /end CHARACTERISTIC
/begin CHARACTERISTIC DFES_ctWrnOff_CA "警告灭灯计数值" VAL_BLK 0x39C11C RL_UBYTE 0 nse_basic 0 255 NUMBER 10 /end CHARACTERISTIC
/begin CHARACTERISTIC DFES_DTCManu_CA "故障DTC标定" VAL_BLK 0x39E068 RL_ULONG 0 nse_basic 0 4294967295 NUMBER 400 /end CHARACTERISTIC
/begin CHARACTERISTIC DINH_stFIdEna_C "功能抑制使能" VALUE 0x39BF0C RL_UBYTE 0 nse_basic 0 255 /end CHARACTERISTIC
/begin CHARACTERISTIC power_off_time_C "下电延时（单位秒）" VALUE 0x39E6D9 RL_UBYTE 0 nse_second 0 255 /end CHARACTERISTIC
/begin CHARACTERISTIC dynINJ_sw_C "动态喷射使能" VALUE 0x39E6D8 RL_UBYTE 0 nse_basic 0 255 /end CHARACTERISTIC
/begin CHARACTERISTIC DDRC_DebType_CA "防抖类型" VAL_BLK 0x39B418 RL_UBYTE 0 nse_basic 0 2 NUMBER 400 /end CHARACTERISTIC
/begin CHARACTERISTIC DDRC_DebUp_CA "防抖上升沿值" VAL_BLK 0x39B5A8 RL_UWORD 0 nse_basic 0 65535 NUMBER 400 /end CHARACTERISTIC
/begin CHARACTERISTIC DDRC_DebDW_CA "防抖下降沿值" VAL_BLK 0x39B8C8 RL_UWORD 0 nse_basic 0 65535 NUMBER 400 /end CHARACTERISTIC
/begin CHARACTERISTIC DDRC_DebDt_CA "时间型故障检测逻辑所在的调度周期时间" VAL_BLK 0x39BBE8 RL_UWORD 0 nse_basic 0 65535 NUMBER 400 /end CHARACTERISTIC
/begin CHARACTERISTIC DSM_stEna_C "故障存贮使能" VALUE 0x39BF0B RL_BYTE 0 nse_basic 0 1 /end CHARACTERISTIC
/begin CHARACTERISTIC vcv_filter_sw_C "vcv采集算法选择" VALUE 0x39B1A6 RL_UBYTE 0 nse_basic 0 255 /end CHARACTERISTIC
/begin CHARACTERISTIC vcv_offset_C "vcv采集值偏移" VALUE 0x39B1A8 RL_UWORD 0 nse_basic 0 65535 /end CHARACTERISTIC
/begin CHARACTERISTIC BlankShotMaxAngle_C "空喷最大角度" VALUE 0x39E6B4 RL_LONG 0 nse_basic -350 -190 /end CHARACTERISTIC
/begin CHARACTERISTIC BlankShotMinStartAngle_C "空喷最小开始角度" VALUE 0x39E6B8 RL_LONG 0 nse_basic -350 -190 /end CHARACTERISTIC
/begin CHARACTERISTIC BlankShotAfterrunGap_C "afterrun空喷间隙" VALUE 0x39E6BC RL_LONG 0 nse_basic 50 100 /end CHARACTERISTIC
/begin CHARACTERISTIC triDelayTime_C "vcv采样延时值" VALUE 0x39E6D0 RL_UWORD 0 nse_basic 0 65535 /end CHARACTERISTIC
/begin CHARACTERISTIC fee_write_delay_C "T15下电后EEPROM写入延时" VALUE 0x39E6DA RL_UBYTE 0 nse_second 0 255 /end CHARACTERISTIC
/begin CHARACTERISTIC Cam0Tooth_C "凸轮0#齿对应曲轴的齿号" VALUE 0x39E6C2 RL_UBYTE 0 nse_basic 0 255 /end CHARACTERISTIC
/begin CHARACTERISTIC Phase_MoreTooth_crank_num_C "凸轮多齿对应曲轴的齿号" VALUE 0x39E6C1 RL_UBYTE 0 nse_basic 0 255 /end CHARACTERISTIC
/begin CHARACTERISTIC Phase_Cam1_crank_num_C "凸轮1#齿对应曲轴的齿号" VALUE 0x39E6C3 RL_UBYTE 0 nse_basic 0 255 /end CHARACTERISTIC
/begin CHARACTERISTIC Phase_Cam4_crank_num_C "凸轮4#齿对应曲轴的齿号" VALUE 0x39E6C4 RL_UBYTE 0 nse_basic 0 255 /end CHARACTERISTIC
/begin CHARACTERISTIC phase_offset_num_C "相位判断冗余齿数（默认为2)" VALUE 0x39E6C5 RL_UBYTE 0 nse_basic 0 255 /end CHARACTERISTIC
/begin CHARACTERISTIC phase_check_switch_C "相位判断使能" VALUE 0x39E6C6 RL_UBYTE 0 nse_basic 0 255 /end CHARACTERISTIC
/begin CHARACTERISTIC Crank_Startup_Speed_C "试喷启动转速" VALUE 0x39E6CC RL_ULONG 0 nse_basic 200 800 /end CHARACTERISTIC
/begin CHARACTERISTIC crank_speed_sw_C "转速算法切换开关（5齿，30齿，58齿）" VALUE 0x39E6C0 RL_UBYTE 0 nse_basic 0 255 /end CHARACTERISTIC
/begin CHARACTERISTIC EngSpeed_updata_sw_C "转速更新选择开关（20ms,sync)" VALUE 0x39E6D2 RL_UBYTE 0 nse_basic 0 1 /end CHARACTERISTIC
/begin CHARACTERISTIC T15_off_vcc_C "T15下电阈值判断" VALUE 0x39E6DC RL_UWORD 0 nse_basic 0 65535 /end CHARACTERISTIC
/begin CHARACTERISTIC Cam_Count_Up_C "凸轮计数器上限值" VALUE 0x39E6C7 RL_UBYTE 0 nse_basic 0 255 /end CHARACTERISTIC
/begin CHARACTERISTIC Cam_Count_CheckDown_C "曲轴故障判断用凸轮计数器限值" VALUE 0x39E6C8 RL_UBYTE 0 nse_basic 0 255 /end CHARACTERISTIC
/begin CHARACTERISTIC K2REI_EMEINUB_CA "发动机编号" ASCII 0x39B1AC RL_UBYTE 0 nse_ident 0 255 NUMBER 34 /end CHARACTERISTIC
/begin CHARACTERISTIC K2REI_EMEngModelUB_CA "发动机型号  " ASCII 0x39B1D0 RL_UBYTE 0 nse_ident 0 255 NUMBER 34 /end CHARACTERISTIC
/begin CHARACTERISTIC K2REI_EMDataNameUB_CA "标定数据名称   " ASCII 0x39B1F4 RL_UBYTE 0 nse_ident 0 255 NUMBER 66 /end CHARACTERISTIC
/begin CHARACTERISTIC K2REI_EMDataPartNoUB_CA "标定数据零件号    " ASCII 0x39B238 RL_UBYTE 0 nse_ident 0 255 NUMBER 34 /end CHARACTERISTIC
/begin CHARACTERISTIC K2REI_EMECUPartNoUB_CA "ECU零件号" ASCII 0x39B3E4 RL_UBYTE 0 nse_ident 0 255 NUMBER 18 /end CHARACTERISTIC
/begin CHARACTERISTIC K2REI_EMSwVerRefUB_CA "标定数据对应 ECU软件版本    " ASCII 0x39B25C RL_UBYTE 0 nse_ident 0 255 NUMBER 64 /end CHARACTERISTIC
/begin CHARACTERISTIC K2REI_EMEngModelRefUB_CA "标定数据对应发动机型号" ASCII 0x39B29C RL_UBYTE 0 nse_ident 0 255 NUMBER 34 /end CHARACTERISTIC
/begin CHARACTERISTIC K2REI_EMVehModelRefUB_CA "标定数据对应整车型号      " ASCII 0x39B2C0 RL_UBYTE 0 nse_ident 0 255 NUMBER 34 /end CHARACTERISTIC
/begin CHARACTERISTIC K2REI_EMInfoProgramS_CA "ECU内部基本信息" ASCII 0x39B2E4 RL_UBYTE 0 nse_ident 0 255 NUMBER 156 /end CHARACTERISTIC
/begin CHARACTERISTIC K2REI_EMIdxEPIDUB_CA "用于客户识别的软件版本号       " ASCII 0x39B3F8 RL_UBYTE 0 nse_ident 0 255 NUMBER 20 /end CHARACTERISTIC
/begin CHARACTERISTIC K2REI_VMVehModelUB_CA "整车型号" ASCII 0x39B380 RL_UBYTE 0 nse_ident 0 255 NUMBER 34 /end CHARACTERISTIC
/begin CHARACTERISTIC K2REI_VMECUSWVERUB_CA "客户定义的 ECU 软件版本" ASCII 0x39B3A4 RL_UBYTE 0 nse_ident 0 255 NUMBER 64 /end CHARACTERISTIC
/begin CHARACTERISTIC K2REI_EMNumSoftwareUB_CA "ECU制造商软件序列号" ASCII 0x39B40C RL_UBYTE 0 nse_ident 0 255 NUMBER 10 /end CHARACTERISTIC
/begin CHARACTERISTIC tbox_poweronandoffstatus_delay_C "Tbox数据更新下电延时" VALUE 0x39E6DE RL_UBYTE 0 nse_basic 0 255 /end CHARACTERISTIC
/begin CHARACTERISTIC tbox_functionswitch_C "Tbox功能(锁车，围栏）使能" VALUE 0x39E6DF RL_UBYTE 0 nse_basic 0 255 /end CHARACTERISTIC
/begin CHARACTERISTIC Inj_type_switch_C "喷油器参数选择开关" VALUE 0x39E6A9 RL_UBYTE 0 nse_basic 0 255 /end CHARACTERISTIC
/begin CHARACTERISTIC Watchdog_Timeout_C "看门狗溢出时间" VALUE 0x39EEC0 RL_UWORD 0 nse_basic 500 65535 /end CHARACTERISTIC
/begin CHARACTERISTIC Fuel_phiTDC1_C "1缸上止点角度值标定" VALUE 0x39E6AC RL_UWORD 0 nse_basic 0 65535 /end CHARACTERISTIC
/begin CHARACTERISTIC xcp_channel_sw_C "XCP通道选择" VALUE 0x39E6E3 RL_UBYTE 0 nse_basic 0 2 /end CHARACTERISTIC
/begin CHARACTERISTIC j1939_channel_sw_C "J1939通道选择" VALUE 0x39E6E4 RL_UBYTE 0 nse_basic 0 2 /end CHARACTERISTIC
/begin CHARACTERISTIC can_1_baudrate_C "CAN1通道的波特率标定值" VALUE 0x39E6E6 RL_UWORD 0 nse_basic 0 65535 /end CHARACTERISTIC
/begin CHARACTERISTIC can_2_baudrate_C "CAN2通道的波特率标定值" VALUE 0x39E6E8 RL_UWORD 0 nse_basic 0 65535 /end CHARACTERISTIC
/begin CHARACTERISTIC NOT_DIAG_PREHEAT_ERRLIGHT_TO_GND_C "预热指示灯和故障指示灯对地短路检测标定" VALUE 0x39E6A8 RL_UBYTE 0 nse_basic 0 1 /end CHARACTERISTIC
/begin CHARACTERISTIC tbox_infoswitch_C "Tbox数据发送" VALUE 0x39E6E0 RL_UBYTE 0 nse_basic 0 1 /end CHARACTERISTIC
/begin CHARACTERISTIC InSwitchK30_SpdDem_NPos_C "输入端口K30复用选择" VALUE 0x39E6D3 RL_UBYTE 0 nse_basic 0 1 /end CHARACTERISTIC
/begin CHARACTERISTIC InSwitchK44_RMTAPP2_OilP_C "输入端口K44复用选择" VALUE 0x39E6D4 RL_UBYTE 0 nse_basic 0 1 /end CHARACTERISTIC
/begin CHARACTERISTIC DaqData_Update_Sel_C "XCP数据更新任务选择     (0 - 10ms  ; 1-10ms_s4)" VALUE 0x39E6EA RL_UBYTE 0 nse_basic 0 1 /end CHARACTERISTIC
/begin CHARACTERISTIC Gps_type_C "GPS tbox需求类型，枚举类型，1==LinYi临工项目, 2==XuZhou徐工项目" VAL_BLK 0x39E6E2 RL_UBYTE 0 Gps_type_conv 1 2 /end CHARACTERISTIC
/begin CHARACTERISTIC Gps_swtFun_C "Gps tbox功能运行开关，量产软件中默认关闭" VAL_BLK 0x39E6E1 RL_UBYTE 0 Gps_switch_fun_conv 0 1 /end CHARACTERISTIC
/begin CHARACTERISTIC fee_write_cnt_C "下电写E2的写入次数，必须为1，可以通过增大写入次数用于注入ECC故障" VALUE 0x39E6EB RL_UBYTE 0 nse_basic 0 255 /end CHARACTERISTIC
/begin CHARACTERISTIC fm_sw_C "用于开启freemaster调试功能，默认必须为非1（默认禁止开启此功能）" VALUE 0x39E6EC RL_UBYTE 0 nse_basic 0 255 /end CHARACTERISTIC
/begin CHARACTERISTIC j1939_lld_dtc2spn_CA "SPN标定" VAL_BLK 0x39E6F0 RL_ULONG 0 nse_basic 0 4294967295 NUMBER 400 /end CHARACTERISTIC
/begin CHARACTERISTIC j1939_lld_dtc2fmi_CA "FMI标定" VAL_BLK 0x39ED30 RL_UBYTE 0 nse_basic 0 255 NUMBER 400 /end CHARACTERISTIC
/begin CHARACTERISTIC Blank_Tooth_C "曲轴滤波齿标定量" VALUE 0x39E6C9 RL_UBYTE 0 nse_basic 0 255 /end CHARACTERISTIC
/begin CHARACTERISTIC auto_retry_C "驱动诊断故障计数器" VALUE 0x39E6ED RL_UBYTE 0 nse_basic 0 255 /end CHARACTERISTIC
/begin CHARACTERISTIC sw_retry_C "空闲诊断故障计数器" VALUE 0x39E6EE RL_UBYTE 0 nse_basic 0 255 /end CHARACTERISTIC
/begin CHARACTERISTIC injerr_eliminate_cnt_C "喷油驱动故障恢复计数器" VALUE 0x39E6EF RL_UBYTE 0 nse_basic 0 255 /end CHARACTERISTIC
/begin CHARACTERISTIC LowLevelInhibitInj_C "喷油驱动有故障底层禁止喷油 1->禁止(默认)  0->使能" VALUE 0x39E6AE RL_UBYTE 0 nse_basic 0 1 /end CHARACTERISTIC
/begin COMPU_METHOD nse_basic "f() = x" RAT_FUNC "%10.0" "-" COEFFS 0 1 0 0 0 1 /end COMPU_METHOD
/begin COMPU_METHOD nse_second "f() = x" RAT_FUNC "%10.0" "s" COEFFS 0 1 0 0 0 1 /end COMPU_METHOD
/begin COMPU_METHOD nse_FIdVerb "FId List" TAB_VERB "%10.0" "-" COMPU_TAB_REF nse_FIdVerb /end COMPU_METHOD
/begin COMPU_METHOD nse_ident "f() = x" IDENTICAL "%25.25" "-" /end COMPU_METHOD
/begin COMPU_METHOD nse_DFCVerb "DFC List" TAB_VERB "%10.0" "-" COMPU_TAB_REF nse_DFCVerb /end COMPU_METHOD
/begin COMPU_METHOD nse_DFESstVerb "DFES st List" TAB_VERB "%10.0" "-" COMPU_TAB_REF nse_DFESstVerb /end COMPU_METHOD
/begin COMPU_METHOD nse_min "f() = x" RAT_FUNC "%10.0" "min" COEFFS 0 1 0 0 0 1 /end COMPU_METHOD
/begin COMPU_METHOD Gps_type_conv "" TAB_VERB "%10.0" "" COMPU_TAB_REF Gps_type_conv /end COMPU_METHOD
/begin COMPU_METHOD Gps_switch_fun_conv "" TAB_VERB "%10.0" "" COMPU_TAB_REF Gps_switch_fun_conv /end COMPU_METHOD
/begin COMPU_METHOD nse_div1000 "f() = x/1000" RAT_FUNC "%10.2" "%" COEFFS 0 1000 0 0 0 1 /end COMPU_METHOD
/begin RECORD_LAYOUT RL_UBYTE FNC_VALUES 1 UBYTE COLUMN_DIR DIRECT /end RECORD_LAYOUT
/begin RECORD_LAYOUT RL_BYTE FNC_VALUES 1 SBYTE COLUMN_DIR DIRECT /end RECORD_LAYOUT
/begin RECORD_LAYOUT RL_UWORD FNC_VALUES 1 UWORD COLUMN_DIR DIRECT /end RECORD_LAYOUT
/begin RECORD_LAYOUT RL_SWORD FNC_VALUES 1 SWORD COLUMN_DIR DIRECT /end RECORD_LAYOUT
/begin RECORD_LAYOUT RL_ULONG FNC_VALUES 1 ULONG COLUMN_DIR DIRECT /end RECORD_LAYOUT
/begin RECORD_LAYOUT RL_LONG FNC_VALUES 1 SLONG COLUMN_DIR DIRECT /end RECORD_LAYOUT
/begin MEASUREMENT DSM_bRailPSS " " UBYTE nse_basic 0 0 0 255 ECU_ADDRESS 0x40021BC0 /end MEASUREMENT
/begin MEASUREMENT DSM_bRailPSubsVal " " UBYTE nse_basic 0 0 0 255 ECU_ADDRESS 0x40021BC1 /end MEASUREMENT
/begin MEASUREMENT DSM_bEngDemTrqLimErr1 " " UBYTE nse_basic 0 0 0 255 ECU_ADDRESS 0x40021BC2 /end MEASUREMENT
/begin MEASUREMENT DSM_bEngDemTrqLimErr2 " " UBYTE nse_basic 0 0 0 255 ECU_ADDRESS 0x40021BC3 /end MEASUREMENT
/begin MEASUREMENT DSM_bEngDemTrqLimErr3 " " UBYTE nse_basic 0 0 0 255 ECU_ADDRESS 0x40021BC4 /end MEASUREMENT
/begin MEASUREMENT DSM_bEngDemTrqLimErr4 " " UBYTE nse_basic 0 0 0 255 ECU_ADDRESS 0x40021BC5 /end MEASUREMENT
/begin MEASUREMENT DSM_bEngPrtNLimErr " " UBYTE nse_basic 0 0 0 255 ECU_ADDRESS 0x40021BC6 /end MEASUREMENT
/begin MEASUREMENT DSM_bEngPrtOvhtPrv " " UBYTE nse_basic 0 0 0 255 ECU_ADDRESS 0x40021BC7 /end MEASUREMENT
/begin MEASUREMENT DSM_bCEngDsTSS " " UBYTE nse_basic 0 0 0 255 ECU_ADDRESS 0x40021BC8 /end MEASUREMENT
/begin MEASUREMENT DSM_bHLSDemDfrstI " " UBYTE nse_basic 0 0 0 255 ECU_ADDRESS 0x40021BC9 /end MEASUREMENT
/begin MEASUREMENT DSM_bHLSDemUndrBrk " " UBYTE nse_basic 0 0 0 255 ECU_ADDRESS 0x40021BCA /end MEASUREMENT
/begin MEASUREMENT DSM_bHLSDemSetPLoDrvAwy " " UBYTE nse_basic 0 0 0 255 ECU_ADDRESS 0x40021BCB /end MEASUREMENT
/begin MEASUREMENT DSM_bHLSDemStrtCEngDsT " " UBYTE nse_basic 0 0 0 255 ECU_ADDRESS 0x40021BCC /end MEASUREMENT
/begin MEASUREMENT DSM_bHLSDemStrtOilT " " UBYTE nse_basic 0 0 0 255 ECU_ADDRESS 0x40021BCD /end MEASUREMENT
/begin MEASUREMENT DSM_bCoEngNrml2Strt " " UBYTE nse_basic 0 0 0 255 ECU_ADDRESS 0x40021BCE /end MEASUREMENT
/begin MEASUREMENT DSM_bAPP1SigPath " " UBYTE nse_basic 0 0 0 255 ECU_ADDRESS 0x40021BCF /end MEASUREMENT
/begin MEASUREMENT DSM_bAPP2SigPath " " UBYTE nse_basic 0 0 0 255 ECU_ADDRESS 0x40021AEC /end MEASUREMENT
/begin MEASUREMENT DSM_bAPPBrkDef " " UBYTE nse_basic 0 0 0 255 ECU_ADDRESS 0x40021AED /end MEASUREMENT
/begin MEASUREMENT DSM_bAPPVel " " UBYTE nse_basic 0 0 0 255 ECU_ADDRESS 0x40021AEE /end MEASUREMENT
/begin MEASUREMENT DSM_bAccPedTrqLim " " UBYTE nse_basic 0 0 0 255 ECU_ADDRESS 0x40021AEF /end MEASUREMENT
/begin MEASUREMENT DSM_bAccPedNMaxLim " " UBYTE nse_basic 0 0 0 255 ECU_ADDRESS 0x40021AF0 /end MEASUREMENT
/begin MEASUREMENT DSM_bAccPedNMinLim " " UBYTE nse_basic 0 0 0 255 ECU_ADDRESS 0x40021AF1 /end MEASUREMENT
/begin MEASUREMENT DSM_bAccPedNMinLimBrkApp " " UBYTE nse_basic 0 0 0 255 ECU_ADDRESS 0x40021AF2 /end MEASUREMENT
/begin MEASUREMENT DSM_bAccPed_PTSL " " UBYTE nse_basic 0 0 0 255 ECU_ADDRESS 0x40021AF3 /end MEASUREMENT
/begin MEASUREMENT DSM_bASDdc " " UBYTE nse_basic 0 0 0 255 ECU_ADDRESS 0x40021AF4 /end MEASUREMENT
/begin MEASUREMENT DSM_bRailClsdPRV " " UBYTE nse_basic 0 0 0 255 ECU_ADDRESS 0x40021AF5 /end MEASUREMENT
/begin MEASUREMENT DSM_bRailCtlLimp " " UBYTE nse_basic 0 0 0 255 ECU_ADDRESS 0x40021AF6 /end MEASUREMENT
/begin MEASUREMENT DSM_bRailMeUnCtlUpLim " " UBYTE nse_basic 0 0 0 255 ECU_ADDRESS 0x40021AF7 /end MEASUREMENT
/begin MEASUREMENT DSM_bRailMeUn0Rls " " UBYTE nse_basic 0 0 0 255 ECU_ADDRESS 0x40021AF8 /end MEASUREMENT
/begin MEASUREMENT DSM_bRailMeUn0Blk " " UBYTE nse_basic 0 0 0 255 ECU_ADDRESS 0x40021AF9 /end MEASUREMENT
/begin MEASUREMENT DSM_bRailMeUn2Rls " " UBYTE nse_basic 0 0 0 255 ECU_ADDRESS 0x40021AFA /end MEASUREMENT
/begin MEASUREMENT DSM_bRailMeUn2Blk " " UBYTE nse_basic 0 0 0 255 ECU_ADDRESS 0x40021AFB /end MEASUREMENT
/begin MEASUREMENT DSM_bRailMeUn22Rls " " UBYTE nse_basic 0 0 0 255 ECU_ADDRESS 0x40021AFC /end MEASUREMENT
/begin MEASUREMENT DSM_bRailMeUn22Blk " " UBYTE nse_basic 0 0 0 255 ECU_ADDRESS 0x40021AFD /end MEASUREMENT
/begin MEASUREMENT DSM_bRailMeUn3Rls " " UBYTE nse_basic 0 0 0 255 ECU_ADDRESS 0x40021AFE /end MEASUREMENT
/begin MEASUREMENT DSM_bRailMeUn3Blk " " UBYTE nse_basic 0 0 0 255 ECU_ADDRESS 0x40021AFF /end MEASUREMENT
/begin MEASUREMENT DSM_bRailMeUn4Rls " " UBYTE nse_basic 0 0 0 255 ECU_ADDRESS 0x40021B00 /end MEASUREMENT
/begin MEASUREMENT DSM_bRailMeUn4Blk " " UBYTE nse_basic 0 0 0 255 ECU_ADDRESS 0x40021B01 /end MEASUREMENT
/begin MEASUREMENT DSM_bRailMeUn42Rls " " UBYTE nse_basic 0 0 0 255 ECU_ADDRESS 0x40021B02 /end MEASUREMENT
/begin MEASUREMENT DSM_bRailMeUn42Blk " " UBYTE nse_basic 0 0 0 255 ECU_ADDRESS 0x40021B03 /end MEASUREMENT
/begin MEASUREMENT DSM_bRailMeUn7Rls " " UBYTE nse_basic 0 0 0 255 ECU_ADDRESS 0x40021B04 /end MEASUREMENT
/begin MEASUREMENT DSM_bRailMeUn7Blk " " UBYTE nse_basic 0 0 0 255 ECU_ADDRESS 0x40021B05 /end MEASUREMENT
/begin MEASUREMENT DSM_bRailMeUn8Rls " " UBYTE nse_basic 0 0 0 255 ECU_ADDRESS 0x40021B06 /end MEASUREMENT
/begin MEASUREMENT DSM_bRailMeUn8Blk " " UBYTE nse_basic 0 0 0 255 ECU_ADDRESS 0x40021B07 /end MEASUREMENT
/begin MEASUREMENT DSM_bRailMeUn10Rls " " UBYTE nse_basic 0 0 0 255 ECU_ADDRESS 0x40021B08 /end MEASUREMENT
/begin MEASUREMENT DSM_bRailMeUn10Blk " " UBYTE nse_basic 0 0 0 255 ECU_ADDRESS 0x40021B09 /end MEASUREMENT
/begin MEASUREMENT DSM_bRailMeUnErrMaxFlwDlv " " UBYTE nse_basic 0 0 0 255 ECU_ADDRESS 0x40021B0A /end MEASUREMENT
/begin MEASUREMENT DSM_bRailSetPointRed " " UBYTE nse_basic 0 0 0 255 ECU_ADDRESS 0x40021B0B /end MEASUREMENT
/begin MEASUREMENT DSM_bRailSetPointLim " " UBYTE nse_basic 0 0 0 255 ECU_ADDRESS 0x40021B0C /end MEASUREMENT
/begin MEASUREMENT DSM_bMeUnRot " " UBYTE nse_basic 0 0 0 255 ECU_ADDRESS 0x40021B0D /end MEASUREMENT
/begin MEASUREMENT DSM_bMeUnFrzl " " UBYTE nse_basic 0 0 0 255 ECU_ADDRESS 0x40021B0E /end MEASUREMENT
/begin MEASUREMENT DSM_bBattUSRC " " UBYTE nse_basic 0 0 0 255 ECU_ADDRESS 0x40021B0F /end MEASUREMENT
/begin MEASUREMENT DSM_bMRlyStk " " UBYTE nse_basic 0 0 0 255 ECU_ADDRESS 0x40021B10 /end MEASUREMENT
/begin MEASUREMENT DSM_bClth " " UBYTE nse_basic 0 0 0 255 ECU_ADDRESS 0x40021B11 /end MEASUREMENT
/begin MEASUREMENT DSM_bEnvPSS " " UBYTE nse_basic 0 0 0 255 ECU_ADDRESS 0x40021B12 /end MEASUREMENT
/begin MEASUREMENT DSM_bEnvTSS " " UBYTE nse_basic 0 0 0 255 ECU_ADDRESS 0x40021B13 /end MEASUREMENT
/begin MEASUREMENT DSM_bVehVMon " " UBYTE nse_basic 0 0 0 255 ECU_ADDRESS 0x40021B14 /end MEASUREMENT
/begin MEASUREMENT DSM_bSSPIntkVUs " " UBYTE nse_basic 0 0 0 255 ECU_ADDRESS 0x40021B15 /end MEASUREMENT
/begin MEASUREMENT DSM_bPIntkVUsEnvPPls " " UBYTE nse_basic 0 0 0 255 ECU_ADDRESS 0x40021B16 /end MEASUREMENT
/begin MEASUREMENT DSM_bOilPSwmpSSErr " " UBYTE nse_basic 0 0 0 255 ECU_ADDRESS 0x40021B17 /end MEASUREMENT
/begin MEASUREMENT DSM_bOilTSS " " UBYTE nse_basic 0 0 0 255 ECU_ADDRESS 0x40021B18 /end MEASUREMENT
/begin MEASUREMENT DSM_bCoEngPthETZr " " UBYTE nse_basic 0 0 0 255 ECU_ADDRESS 0x40021B19 /end MEASUREMENT
/begin MEASUREMENT DSM_bCoEngPthFlQnt " " UBYTE nse_basic 0 0 0 255 ECU_ADDRESS 0x40021B1A /end MEASUREMENT
/begin MEASUREMENT DSM_bCoEngPthRPMin " " UBYTE nse_basic 0 0 0 255 ECU_ADDRESS 0x40021B1B /end MEASUREMENT
/begin MEASUREMENT DSM_bCoEngPthClsThr " " UBYTE nse_basic 0 0 0 255 ECU_ADDRESS 0x40021B1C /end MEASUREMENT
/begin MEASUREMENT DSM_bCoEngPthLpSysOff " " UBYTE nse_basic 0 0 0 255 ECU_ADDRESS 0x40021B1D /end MEASUREMENT
/begin MEASUREMENT DSM_bCoEngPthClsEGR " " UBYTE nse_basic 0 0 0 255 ECU_ADDRESS 0x40021B1E /end MEASUREMENT
/begin MEASUREMENT DSM_bCoEngPthTrqZr " " UBYTE nse_basic 0 0 0 255 ECU_ADDRESS 0x40021B1F /end MEASUREMENT
/begin MEASUREMENT DSM_bFlSysDens " " UBYTE nse_basic 0 0 0 255 ECU_ADDRESS 0x40021B20 /end MEASUREMENT
/begin MEASUREMENT DSM_bCoVehPrpLimErr " " UBYTE nse_basic 0 0 0 255 ECU_ADDRESS 0x40021B21 /end MEASUREMENT
/begin MEASUREMENT DSM_bSubsValPrtTrqDfftl " " UBYTE nse_basic 0 0 0 255 ECU_ADDRESS 0x40021B22 /end MEASUREMENT
/begin MEASUREMENT DSM_bFrzPrtTrqDfftl " " UBYTE nse_basic 0 0 0 255 ECU_ADDRESS 0x40021B23 /end MEASUREMENT
/begin MEASUREMENT DSM_bSubsValRatTrqDfftl " " UBYTE nse_basic 0 0 0 255 ECU_ADDRESS 0x40021B24 /end MEASUREMENT
/begin MEASUREMENT DSM_bPTGripMnlClth " " UBYTE nse_basic 0 0 0 255 ECU_ADDRESS 0x40021B25 /end MEASUREMENT
/begin MEASUREMENT DSM_bPTTrqRatCANPtd " " UBYTE nse_basic 0 0 0 255 ECU_ADDRESS 0x40021B26 /end MEASUREMENT
/begin MEASUREMENT DSM_bTraAddAirCANPtd " " UBYTE nse_basic 0 0 0 255 ECU_ADDRESS 0x40021B27 /end MEASUREMENT
/begin MEASUREMENT DSM_bTraAddClntCANPtd " " UBYTE nse_basic 0 0 0 255 ECU_ADDRESS 0x40021B28 /end MEASUREMENT
/begin MEASUREMENT DSM_bTraGearDet " " UBYTE nse_basic 0 0 0 255 ECU_ADDRESS 0x40021B29 /end MEASUREMENT
/begin MEASUREMENT DSM_bTraRtnIntfcIdlSetP " " UBYTE nse_basic 0 0 0 255 ECU_ADDRESS 0x40021B2A /end MEASUREMENT
/begin MEASUREMENT DSM_bAFSSRC " " UBYTE nse_basic 0 0 0 255 ECU_ADDRESS 0x40021B2B /end MEASUREMENT
/begin MEASUREMENT DSM_bAFSFrzAirMs " " UBYTE nse_basic 0 0 0 255 ECU_ADDRESS 0x40021B2C /end MEASUREMENT
/begin MEASUREMENT DSM_bAFSActrTst " " UBYTE nse_basic 0 0 0 255 ECU_ADDRESS 0x40021B2D /end MEASUREMENT
/begin MEASUREMENT DSM_bAFSPlSetyDrft " " UBYTE nse_basic 0 0 0 255 ECU_ADDRESS 0x40021B2E /end MEASUREMENT
/begin MEASUREMENT DSM_bAFSSysErr " " UBYTE nse_basic 0 0 0 255 ECU_ADDRESS 0x40021B2F /end MEASUREMENT
/begin MEASUREMENT DSM_bAFS " " UBYTE nse_basic 0 0 0 255 ECU_ADDRESS 0x40021B30 /end MEASUREMENT
/begin MEASUREMENT DSM_bCoordADCO " " UBYTE nse_basic 0 0 0 255 ECU_ADDRESS 0x40021B31 /end MEASUREMENT
/begin MEASUREMENT DSM_bTAFSSigMonRls " " UBYTE nse_basic 0 0 0 255 ECU_ADDRESS 0x40021B32 /end MEASUREMENT
/begin MEASUREMENT DSM_bAirCSwt " " UBYTE nse_basic 0 0 0 255 ECU_ADDRESS 0x40021B33 /end MEASUREMENT
/begin MEASUREMENT DSM_bRailBlkSht " " UBYTE nse_basic 0 0 0 255 ECU_ADDRESS 0x40021B34 /end MEASUREMENT
/begin MEASUREMENT DSM_bAirCtlBstPresCor " " UBYTE nse_basic 0 0 0 255 ECU_ADDRESS 0x40021B35 /end MEASUREMENT
/begin MEASUREMENT DSM_bAirCtl " " UBYTE nse_basic 0 0 0 255 ECU_ADDRESS 0x40021B36 /end MEASUREMENT
/begin MEASUREMENT DSM_bAirCtlEGR " " UBYTE nse_basic 0 0 0 255 ECU_ADDRESS 0x40021B37 /end MEASUREMENT
/begin MEASUREMENT DSM_bAirCtlTVA " " UBYTE nse_basic 0 0 0 255 ECU_ADDRESS 0x40021B38 /end MEASUREMENT
/begin MEASUREMENT DSM_bAirCtlCmpntActv " " UBYTE nse_basic 0 0 0 255 ECU_ADDRESS 0x40021B39 /end MEASUREMENT
/begin MEASUREMENT DSM_bAirCtlGovDvt " " UBYTE nse_basic 0 0 0 255 ECU_ADDRESS 0x40021B3A /end MEASUREMENT
/begin MEASUREMENT DSM_bEGRVlvSSpMon " " UBYTE nse_basic 0 0 0 255 ECU_ADDRESS 0x40021B3B /end MEASUREMENT
/begin MEASUREMENT DSM_bEGRVlvPhysRng " " UBYTE nse_basic 0 0 0 255 ECU_ADDRESS 0x40021B3C /end MEASUREMENT
/begin MEASUREMENT DSM_bEGRVlvGovOn " " UBYTE nse_basic 0 0 0 255 ECU_ADDRESS 0x40021B3D /end MEASUREMENT
/begin MEASUREMENT DSM_bEGRVlvClnUp " " UBYTE nse_basic 0 0 0 255 ECU_ADDRESS 0x40021B3E /end MEASUREMENT
/begin MEASUREMENT DSM_bEGRVlvModVal " " UBYTE nse_basic 0 0 0 255 ECU_ADDRESS 0x40021B3F /end MEASUREMENT
/begin MEASUREMENT DSM_bEGRVlvReplVal " " UBYTE nse_basic 0 0 0 255 ECU_ADDRESS 0x40021B40 /end MEASUREMENT
/begin MEASUREMENT DSM_bEGRVlvOfsLrnInhib " " UBYTE nse_basic 0 0 0 255 ECU_ADDRESS 0x40021B41 /end MEASUREMENT
/begin MEASUREMENT DSM_bAirHtCEngDsT " " UBYTE nse_basic 0 0 0 255 ECU_ADDRESS 0x40021B42 /end MEASUREMENT
/begin MEASUREMENT DSM_bAirHtFuelT " " UBYTE nse_basic 0 0 0 255 ECU_ADDRESS 0x40021B43 /end MEASUREMENT
/begin MEASUREMENT DSM_bAirHtOilT " " UBYTE nse_basic 0 0 0 255 ECU_ADDRESS 0x40021B44 /end MEASUREMENT
/begin MEASUREMENT DSM_bAirHtEnvT " " UBYTE nse_basic 0 0 0 255 ECU_ADDRESS 0x40021B45 /end MEASUREMENT
/begin MEASUREMENT DSM_bAirHtCACDs " " UBYTE nse_basic 0 0 0 255 ECU_ADDRESS 0x40021B46 /end MEASUREMENT
/begin MEASUREMENT DSM_bAirHtAFST " " UBYTE nse_basic 0 0 0 255 ECU_ADDRESS 0x40021B47 /end MEASUREMENT
/begin MEASUREMENT DSM_bAirHtIntkVUsT " " UBYTE nse_basic 0 0 0 255 ECU_ADDRESS 0x40021B48 /end MEASUREMENT
/begin MEASUREMENT DSM_bT50 " " UBYTE nse_basic 0 0 0 255 ECU_ADDRESS 0x40021B49 /end MEASUREMENT
/begin MEASUREMENT DSM_bRmtAPP1SigPath " " UBYTE nse_basic 0 0 0 255 ECU_ADDRESS 0x40021B4A /end MEASUREMENT
/begin MEASUREMENT DSM_bRmtAPP2SigPath " " UBYTE nse_basic 0 0 0 255 ECU_ADDRESS 0x40021B4B /end MEASUREMENT
/begin MEASUREMENT DSM_bRmtAPPBrkDef " " UBYTE nse_basic 0 0 0 255 ECU_ADDRESS 0x40021B4C /end MEASUREMENT
/begin MEASUREMENT DSM_bRmtAPPVel " " UBYTE nse_basic 0 0 0 255 ECU_ADDRESS 0x40021B4D /end MEASUREMENT
/begin MEASUREMENT DSM_bFanCtl " " UBYTE nse_basic 0 0 0 255 ECU_ADDRESS 0x40021B4E /end MEASUREMENT
/begin MEASUREMENT DSM_bFanCtl2 " " UBYTE nse_basic 0 0 0 255 ECU_ADDRESS 0x40021B4F /end MEASUREMENT
/begin MEASUREMENT DSM_bFanCtlCor " " UBYTE nse_basic 0 0 0 255 ECU_ADDRESS 0x40021B50 /end MEASUREMENT
/begin MEASUREMENT DSM_bFanCtlCor2 " " UBYTE nse_basic 0 0 0 255 ECU_ADDRESS 0x40021B51 /end MEASUREMENT
/begin MEASUREMENT DSM_bFansVelCor " " UBYTE nse_basic 0 0 0 255 ECU_ADDRESS 0x40021B52 /end MEASUREMENT
/begin MEASUREMENT DSM_bGlbDaLSumvXPtd " " UBYTE nse_basic 0 0 0 255 ECU_ADDRESS 0x40021B53 /end MEASUREMENT
/begin MEASUREMENT EngPrtOvrSpd_DSM " " UBYTE nse_basic 0 0 0 255 ECU_ADDRESS 0x40021B54 /end MEASUREMENT
/begin MEASUREMENT CEngDsT_bSRCMaxDeb_DSM " " UBYTE nse_basic 0 0 0 255 ECU_ADDRESS 0x40021B55 /end MEASUREMENT
/begin MEASUREMENT CEngDsT_bSRCMinDeb_DSM " " UBYTE nse_basic 0 0 0 255 ECU_ADDRESS 0x40021B56 /end MEASUREMENT
/begin MEASUREMENT CEngDsT_bPhysRngHiDeb_DSM " " UBYTE nse_basic 0 0 0 255 ECU_ADDRESS 0x40021B57 /end MEASUREMENT
/begin MEASUREMENT CEngDsT_bPhysRngLoDeb_DSM " " UBYTE nse_basic 0 0 0 255 ECU_ADDRESS 0x40021B58 /end MEASUREMENT
/begin MEASUREMENT APP_bSRCHigh1Deb_DSM " " UBYTE nse_basic 0 0 0 255 ECU_ADDRESS 0x40021B59 /end MEASUREMENT
/begin MEASUREMENT APP_bSRCLow1Deb_DSM " " UBYTE nse_basic 0 0 0 255 ECU_ADDRESS 0x40021B5A /end MEASUREMENT
/begin MEASUREMENT APP_bSRCHigh2Deb_DSM " " UBYTE nse_basic 0 0 0 255 ECU_ADDRESS 0x40021B5B /end MEASUREMENT
/begin MEASUREMENT APP_bSRCLow2Deb_DSM " " UBYTE nse_basic 0 0 0 255 ECU_ADDRESS 0x40021B5C /end MEASUREMENT
/begin MEASUREMENT APP_bSyncDeb_DSM " " UBYTE nse_basic 0 0 0 255 ECU_ADDRESS 0x40021B5D /end MEASUREMENT
/begin MEASUREMENT DFC_RailMeUn0_DSM " " UBYTE nse_basic 0 0 0 255 ECU_ADDRESS 0x40021B5E /end MEASUREMENT
/begin MEASUREMENT DFC_RailMeUn2_DSM " " UBYTE nse_basic 0 0 0 255 ECU_ADDRESS 0x40021B5F /end MEASUREMENT
/begin MEASUREMENT DFC_RailMeUn22_DSM " " UBYTE nse_basic 0 0 0 255 ECU_ADDRESS 0x40021B60 /end MEASUREMENT
/begin MEASUREMENT DFC_RailMeUn3_DSM " " UBYTE nse_basic 0 0 0 255 ECU_ADDRESS 0x40021B61 /end MEASUREMENT
/begin MEASUREMENT DFC_RailMeUn4_DSM " " UBYTE nse_basic 0 0 0 255 ECU_ADDRESS 0x40021B62 /end MEASUREMENT
/begin MEASUREMENT DFC_RailMeUn42_DSM " " UBYTE nse_basic 0 0 0 255 ECU_ADDRESS 0x40021B63 /end MEASUREMENT
/begin MEASUREMENT DFC_RailMeUn7_DSM " " UBYTE nse_basic 0 0 0 255 ECU_ADDRESS 0x40021B64 /end MEASUREMENT
/begin MEASUREMENT DFC_RailMeUn8_DSM " " UBYTE nse_basic 0 0 0 255 ECU_ADDRESS 0x40021B65 /end MEASUREMENT
/begin MEASUREMENT DFC_RailMeUn10_DSM " " UBYTE nse_basic 0 0 0 255 ECU_ADDRESS 0x40021B66 /end MEASUREMENT
/begin MEASUREMENT MeUn_bSRCMaxDeb_DSM " " UBYTE nse_basic 0 0 0 255 ECU_ADDRESS 0x40021B67 /end MEASUREMENT
/begin MEASUREMENT MeUn_bSRCMinDeb_DSM " " UBYTE nse_basic 0 0 0 255 ECU_ADDRESS 0x40021B68 /end MEASUREMENT
/begin MEASUREMENT BattU_bSRCMaxDeb_DSM " " UBYTE nse_basic 0 0 0 255 ECU_ADDRESS 0x40021B69 /end MEASUREMENT
/begin MEASUREMENT BattU_bSRCMinDeb_DSM " " UBYTE nse_basic 0 0 0 255 ECU_ADDRESS 0x40021B6A /end MEASUREMENT
/begin MEASUREMENT BattU_bPhysRngLoDeb_DSM " " UBYTE nse_basic 0 0 0 255 ECU_ADDRESS 0x40021B6B /end MEASUREMENT
/begin MEASUREMENT BattU_bPhysRngHiDeb_DSM " " UBYTE nse_basic 0 0 0 255 ECU_ADDRESS 0x40021B6C /end MEASUREMENT
/begin MEASUREMENT MRly_bStkRlyDeb_DSM " " UBYTE nse_basic 0 0 0 255 ECU_ADDRESS 0x40021B6D /end MEASUREMENT
/begin MEASUREMENT MRly_bErlyOpngDeb_DSM " " UBYTE nse_basic 0 0 0 255 ECU_ADDRESS 0x40021B6E /end MEASUREMENT
/begin MEASUREMENT SSpMon_bSRCMaxDeb_DSM " " UBYTE nse_basic 0 0 0 255 ECU_ADDRESS 0x40021B6F /end MEASUREMENT
/begin MEASUREMENT SSpMon_bSRCMinDeb_DSM " " UBYTE nse_basic 0 0 0 255 ECU_ADDRESS 0x40021B70 /end MEASUREMENT
/begin MEASUREMENT SSpMon_bSRCMaxDeb1_DSM " " UBYTE nse_basic 0 0 0 255 ECU_ADDRESS 0x40021B71 /end MEASUREMENT
/begin MEASUREMENT SSpMon_bSRCMinDeb1_DSM " " UBYTE nse_basic 0 0 0 255 ECU_ADDRESS 0x40021B72 /end MEASUREMENT
/begin MEASUREMENT DFC_BrkNpl_DSM " " UBYTE nse_basic 0 0 0 255 ECU_ADDRESS 0x40021B73 /end MEASUREMENT
/begin MEASUREMENT DFC_ClthNpl_DSM " " UBYTE nse_basic 0 0 0 255 ECU_ADDRESS 0x40021B74 /end MEASUREMENT
/begin MEASUREMENT EnvP_bSRCMaxDeb_DSM " " UBYTE nse_basic 0 0 0 255 ECU_ADDRESS 0x40021B75 /end MEASUREMENT
/begin MEASUREMENT EnvP_bSRCMinDeb_DSM " " UBYTE nse_basic 0 0 0 255 ECU_ADDRESS 0x40021B76 /end MEASUREMENT
/begin MEASUREMENT EnvP_bPhysRngHiDeb_DSM " " UBYTE nse_basic 0 0 0 255 ECU_ADDRESS 0x40021B77 /end MEASUREMENT
/begin MEASUREMENT EnvP_bPhysRngLoDeb_DSM " " UBYTE nse_basic 0 0 0 255 ECU_ADDRESS 0x40021B78 /end MEASUREMENT
/begin MEASUREMENT EnvT_bSRCMaxDeb_DSM " " UBYTE nse_basic 0 0 0 255 ECU_ADDRESS 0x40021B79 /end MEASUREMENT
/begin MEASUREMENT EnvT_bSRCMinDeb_DSM " " UBYTE nse_basic 0 0 0 255 ECU_ADDRESS 0x40021B7A /end MEASUREMENT
/begin MEASUREMENT EnvT_bPhysRngHiDeb_DSM " " UBYTE nse_basic 0 0 0 255 ECU_ADDRESS 0x40021B7B /end MEASUREMENT
/begin MEASUREMENT EnvT_bPhysRngLoDeb_DSM " " UBYTE nse_basic 0 0 0 255 ECU_ADDRESS 0x40021B7C /end MEASUREMENT
/begin MEASUREMENT Air_bSRCPIntkVUsMaxDeb_DSM " " UBYTE nse_basic 0 0 0 255 ECU_ADDRESS 0x40021B7D /end MEASUREMENT
/begin MEASUREMENT Air_bSRCPIntkVUsMinDeb_DSM " " UBYTE nse_basic 0 0 0 255 ECU_ADDRESS 0x40021B7E /end MEASUREMENT
/begin MEASUREMENT Air_bPhysRngPIntkVUsHiDeb_DSM " " UBYTE nse_basic 0 0 0 255 ECU_ADDRESS 0x40021B7F /end MEASUREMENT
/begin MEASUREMENT Air_bPhysRngPIntkVUsLoDeb_DSM " " UBYTE nse_basic 0 0 0 255 ECU_ADDRESS 0x40021B80 /end MEASUREMENT
/begin MEASUREMENT Air_bPlsPIntkVUsMaxDeb_DSM " " UBYTE nse_basic 0 0 0 255 ECU_ADDRESS 0x40021B81 /end MEASUREMENT
/begin MEASUREMENT Air_bPlsPIntkVUsMinDeb_DSM " " UBYTE nse_basic 0 0 0 255 ECU_ADDRESS 0x40021B82 /end MEASUREMENT
/begin MEASUREMENT Air_bSRCTIntkVUsMaxDeb_DSM " " UBYTE nse_basic 0 0 0 255 ECU_ADDRESS 0x40021B83 /end MEASUREMENT
/begin MEASUREMENT Air_bSRCTIntkVUsMinDeb_DSM " " UBYTE nse_basic 0 0 0 255 ECU_ADDRESS 0x40021B84 /end MEASUREMENT
/begin MEASUREMENT FuelT_bSRCMaxDeb_DSM " " UBYTE nse_basic 0 0 0 255 ECU_ADDRESS 0x40021B85 /end MEASUREMENT
/begin MEASUREMENT FuelT_bSRCMinDeb_DSM " " UBYTE nse_basic 0 0 0 255 ECU_ADDRESS 0x40021B86 /end MEASUREMENT
/begin MEASUREMENT FuelT_bPlsMaxDeb_DSM " " UBYTE nse_basic 0 0 0 255 ECU_ADDRESS 0x40021B87 /end MEASUREMENT
/begin MEASUREMENT FuelT_bPlsMinDeb_DSM " " UBYTE nse_basic 0 0 0 255 ECU_ADDRESS 0x40021B88 /end MEASUREMENT
/begin MEASUREMENT OilP_bSRCMaxDeb_DSM " " UBYTE nse_basic 0 0 0 255 ECU_ADDRESS 0x40021B89 /end MEASUREMENT
/begin MEASUREMENT OilP_bSRCMinDeb_DSM " " UBYTE nse_basic 0 0 0 255 ECU_ADDRESS 0x40021B8A /end MEASUREMENT
/begin MEASUREMENT OilP_bPhysRngHiDeb_DSM " " UBYTE nse_basic 0 0 0 255 ECU_ADDRESS 0x40021B8B /end MEASUREMENT
/begin MEASUREMENT OilP_bPhysRngLoDeb_DSM " " UBYTE nse_basic 0 0 0 255 ECU_ADDRESS 0x40021B8C /end MEASUREMENT
/begin MEASUREMENT OilT_bSRCMaxDeb_DSM " " UBYTE nse_basic 0 0 0 255 ECU_ADDRESS 0x40021B8D /end MEASUREMENT
/begin MEASUREMENT OilT_bSRCMinDeb_DSM " " UBYTE nse_basic 0 0 0 255 ECU_ADDRESS 0x40021B8E /end MEASUREMENT
/begin MEASUREMENT OilT_bPlsDeb_DSM " " UBYTE nse_basic 0 0 0 255 ECU_ADDRESS 0x40021B8F /end MEASUREMENT
/begin MEASUREMENT CoETS_bLimInfo_DSM " " UBYTE nse_basic 0 0 0 255 ECU_ADDRESS 0x40021B90 /end MEASUREMENT
/begin MEASUREMENT TCPrt_bTrbChOvrSpd_DSM " " UBYTE nse_basic 0 0 0 255 ECU_ADDRESS 0x40021B91 /end MEASUREMENT
/begin MEASUREMENT VehV_bMaxChkDeb_DSM " " UBYTE nse_basic 0 0 0 255 ECU_ADDRESS 0x40021B92 /end MEASUREMENT
/begin MEASUREMENT DFC_VehVPlaus_DSM " " UBYTE nse_basic 0 0 0 255 ECU_ADDRESS 0x40021B93 /end MEASUREMENT
/begin MEASUREMENT EGRVlv_bSRCMaxDeb_DSM " " UBYTE nse_basic 0 0 0 255 ECU_ADDRESS 0x40021B94 /end MEASUREMENT
/begin MEASUREMENT EGRVlv_bSRCMinDeb_DSM " " UBYTE nse_basic 0 0 0 255 ECU_ADDRESS 0x40021B95 /end MEASUREMENT
/begin MEASUREMENT AFS_bSRCRawMaxDeb_DSM " " UBYTE nse_basic 0 0 0 255 ECU_ADDRESS 0x40021B96 /end MEASUREMENT
/begin MEASUREMENT AFS_bSRCRawMinDeb_DSM " " UBYTE nse_basic 0 0 0 255 ECU_ADDRESS 0x40021B97 /end MEASUREMENT
/begin MEASUREMENT AFS_bPlausMinDeb_DSM " " UBYTE nse_basic 0 0 0 255 ECU_ADDRESS 0x40021B98 /end MEASUREMENT
/begin MEASUREMENT AFS_bPlausMaxDeb_DSM " " UBYTE nse_basic 0 0 0 255 ECU_ADDRESS 0x40021B99 /end MEASUREMENT
/begin MEASUREMENT AFS_bAFSDrftIdlAdjVal_DSM " " UBYTE nse_basic 0 0 0 255 ECU_ADDRESS 0x40021B9A /end MEASUREMENT
/begin MEASUREMENT AFS_bAFSDrftLdAdjVal_DSM " " UBYTE nse_basic 0 0 0 255 ECU_ADDRESS 0x40021B9B /end MEASUREMENT
/begin MEASUREMENT AFS_bAFSDrftAdjPlausNPL_DSM " " UBYTE nse_basic 0 0 0 255 ECU_ADDRESS 0x40021B9C /end MEASUREMENT
/begin MEASUREMENT AFS_bAFSDrftAdjPlausMax_DSM " " UBYTE nse_basic 0 0 0 255 ECU_ADDRESS 0x40021B9D /end MEASUREMENT
/begin MEASUREMENT Air_bDtyCycHiDebTAFS_DSM " " UBYTE nse_basic 0 0 0 255 ECU_ADDRESS 0x40021B9E /end MEASUREMENT
/begin MEASUREMENT Air_bDtyCycLoDebTAFS_DSM " " UBYTE nse_basic 0 0 0 255 ECU_ADDRESS 0x40021B9F /end MEASUREMENT
/begin MEASUREMENT Air_bPerHiDebTAFS_DSM " " UBYTE nse_basic 0 0 0 255 ECU_ADDRESS 0x40021BA0 /end MEASUREMENT
/begin MEASUREMENT Air_bPerLoDebTAFS_DSM " " UBYTE nse_basic 0 0 0 255 ECU_ADDRESS 0x40021BA1 /end MEASUREMENT
/begin MEASUREMENT PTOSwt_bSRCMinDeb_DSM " " UBYTE nse_basic 0 0 0 255 ECU_ADDRESS 0x40021BA2 /end MEASUREMENT
/begin MEASUREMENT PTOSwt_bSRCMaxDeb_DSM " " UBYTE nse_basic 0 0 0 255 ECU_ADDRESS 0x40021BA3 /end MEASUREMENT
/begin MEASUREMENT PTOSwt_bNpl_DSM " " UBYTE nse_basic 0 0 0 255 ECU_ADDRESS 0x40021BA4 /end MEASUREMENT
/begin MEASUREMENT AirCtl_bGovDvtMax_DSM " " UBYTE nse_basic 0 0 0 255 ECU_ADDRESS 0x40021BA5 /end MEASUREMENT
/begin MEASUREMENT AirCtl_bGovDvtMin_DSM " " UBYTE nse_basic 0 0 0 255 ECU_ADDRESS 0x40021BA6 /end MEASUREMENT
/begin MEASUREMENT EGRVlv_bPhysRngHiDeb_DSM " " UBYTE nse_basic 0 0 0 255 ECU_ADDRESS 0x40021BA7 /end MEASUREMENT
/begin MEASUREMENT EGRVlv_bPhysRngLoDeb_DSM " " UBYTE nse_basic 0 0 0 255 ECU_ADDRESS 0x40021BA8 /end MEASUREMENT
/begin MEASUREMENT EGRVlv_bJamVlvClsd_DSM " " UBYTE nse_basic 0 0 0 255 ECU_ADDRESS 0x40021BA9 /end MEASUREMENT
/begin MEASUREMENT EGRVlv_bJamVlvOpn_DSM " " UBYTE nse_basic 0 0 0 255 ECU_ADDRESS 0x40021BAA /end MEASUREMENT
/begin MEASUREMENT EGRVlv_bEGRVlvLgTDrft_DSM " " UBYTE nse_basic 0 0 0 255 ECU_ADDRESS 0x40021BAB /end MEASUREMENT
/begin MEASUREMENT EGRVlv_bEGRVlvOfsPlaus_DSM " " UBYTE nse_basic 0 0 0 255 ECU_ADDRESS 0x40021BAC /end MEASUREMENT
/begin MEASUREMENT EGRVlv_bEGRVlvShTDrft_DSM " " UBYTE nse_basic 0 0 0 255 ECU_ADDRESS 0x40021BAD /end MEASUREMENT
/begin MEASUREMENT EGRVlv_bEGRVlvOfsLrnJamVlv_DSM " " UBYTE nse_basic 0 0 0 255 ECU_ADDRESS 0x40021BAE /end MEASUREMENT
/begin MEASUREMENT EGRVlv_bGovDvtMaxDeb_DSM " " UBYTE nse_basic 0 0 0 255 ECU_ADDRESS 0x40021BAF /end MEASUREMENT
/begin MEASUREMENT EGRVlv_bGovDvtMinDeb_DSM " " UBYTE nse_basic 0 0 0 255 ECU_ADDRESS 0x40021BB0 /end MEASUREMENT
/begin MEASUREMENT RailP_bSRCMaxDeb_DSM " " UBYTE nse_basic 0 0 0 255 ECU_ADDRESS 0x40021BB1 /end MEASUREMENT
/begin MEASUREMENT RailP_bSRCMinDeb_DSM " " UBYTE nse_basic 0 0 0 255 ECU_ADDRESS 0x40021BB2 /end MEASUREMENT
/begin MEASUREMENT DFC_stT50Err_DSM " " UBYTE nse_basic 0 0 0 255 ECU_ADDRESS 0x40021BB3 /end MEASUREMENT
/begin MEASUREMENT PRVRPOutOfRng_DSM " " UBYTE nse_basic 0 0 0 255 ECU_ADDRESS 0x40021BB4 /end MEASUREMENT
/begin MEASUREMENT PRV_ctOpnMax_DSM " " UBYTE nse_basic 0 0 0 255 ECU_ADDRESS 0x40021BB5 /end MEASUREMENT
/begin MEASUREMENT PRV_tiOpnMax_DSM " " UBYTE nse_basic 0 0 0 255 ECU_ADDRESS 0x40021BB6 /end MEASUREMENT
/begin MEASUREMENT PRVOpn_DSM " " UBYTE nse_basic 0 0 0 255 ECU_ADDRESS 0x40021BB7 /end MEASUREMENT
/begin MEASUREMENT PRVwearout_DSM " " UBYTE nse_basic 0 0 0 255 ECU_ADDRESS 0x40021BB8 /end MEASUREMENT
/begin MEASUREMENT RmtAPP_bSRCHigh1Deb_DSM " " UBYTE nse_basic 0 0 0 255 ECU_ADDRESS 0x40021BB9 /end MEASUREMENT
/begin MEASUREMENT RmtAPP_bSRCLow1Deb_DSM " " UBYTE nse_basic 0 0 0 255 ECU_ADDRESS 0x40021BBA /end MEASUREMENT
/begin MEASUREMENT RmtAPP_bSRCHigh2Deb_DSM " " UBYTE nse_basic 0 0 0 255 ECU_ADDRESS 0x40021BBB /end MEASUREMENT
/begin MEASUREMENT RmtAPP_bSRCLow2Deb_DSM " " UBYTE nse_basic 0 0 0 255 ECU_ADDRESS 0x40021BBC /end MEASUREMENT
/begin MEASUREMENT RmtAPP_bSyncDeb_DSM " " UBYTE nse_basic 0 0 0 255 ECU_ADDRESS 0x40021BBD /end MEASUREMENT
/begin MEASUREMENT Air_bVoltHiDebTAFS_DSM " " UBYTE nse_basic 0 0 0 255 ECU_ADDRESS 0x40021BBE /end MEASUREMENT
/begin MEASUREMENT Air_bVoltLoDebTAFS_DSM " " UBYTE nse_basic 0 0 0 255 ECU_ADDRESS 0x40021BBF /end MEASUREMENT
/begin CHARACTERISTIC DINH_FId.DFC_EngPrtOvrSpd "part of DFC-FId relation matrix" VAL_BLK 0x39C13A RL_UWORD 0 nse_FIdVerb 0 400 MATRIX_DIM 10 1 1 /end CHARACTERISTIC
/begin CHARACTERISTIC DINH_FId.DFC_CEngDsTSRCMax "part of DFC-FId relation matrix" VAL_BLK 0x39C14E RL_UWORD 0 nse_FIdVerb 0 400 MATRIX_DIM 10 1 1 /end CHARACTERISTIC
/begin CHARACTERISTIC DINH_FId.DFC_CEngDsTSRCMin "part of DFC-FId relation matrix" VAL_BLK 0x39C162 RL_UWORD 0 nse_FIdVerb 0 400 MATRIX_DIM 10 1 1 /end CHARACTERISTIC
/begin CHARACTERISTIC DINH_FId.DFC_CEngDsTPhysRngHi "part of DFC-FId relation matrix" VAL_BLK 0x39C176 RL_UWORD 0 nse_FIdVerb 0 400 MATRIX_DIM 10 1 1 /end CHARACTERISTIC
/begin CHARACTERISTIC DINH_FId.DFC_CEngDsTPhysRngLo "part of DFC-FId relation matrix" VAL_BLK 0x39C18A RL_UWORD 0 nse_FIdVerb 0 400 MATRIX_DIM 10 1 1 /end CHARACTERISTIC
/begin CHARACTERISTIC DINH_FId.DFC_SRCHighAPP1 "part of DFC-FId relation matrix" VAL_BLK 0x39C19E RL_UWORD 0 nse_FIdVerb 0 400 MATRIX_DIM 10 1 1 /end CHARACTERISTIC
/begin CHARACTERISTIC DINH_FId.DFC_SRCLowAPP1 "part of DFC-FId relation matrix" VAL_BLK 0x39C1B2 RL_UWORD 0 nse_FIdVerb 0 400 MATRIX_DIM 10 1 1 /end CHARACTERISTIC
/begin CHARACTERISTIC DINH_FId.DFC_SRCHighAPP2 "part of DFC-FId relation matrix" VAL_BLK 0x39C1C6 RL_UWORD 0 nse_FIdVerb 0 400 MATRIX_DIM 10 1 1 /end CHARACTERISTIC
/begin CHARACTERISTIC DINH_FId.DFC_SRCLowAPP2 "part of DFC-FId relation matrix" VAL_BLK 0x39C1DA RL_UWORD 0 nse_FIdVerb 0 400 MATRIX_DIM 10 1 1 /end CHARACTERISTIC
/begin CHARACTERISTIC DINH_FId.DFC_SyncAPP "part of DFC-FId relation matrix" VAL_BLK 0x39C1EE RL_UWORD 0 nse_FIdVerb 0 400 MATRIX_DIM 10 1 1 /end CHARACTERISTIC
/begin CHARACTERISTIC DINH_FId.DFC_RailMeUn0 "part of DFC-FId relation matrix" VAL_BLK 0x39C202 RL_UWORD 0 nse_FIdVerb 0 400 MATRIX_DIM 10 1 1 /end CHARACTERISTIC
/begin CHARACTERISTIC DINH_FId.DFC_RailMeUn2 "part of DFC-FId relation matrix" VAL_BLK 0x39C216 RL_UWORD 0 nse_FIdVerb 0 400 MATRIX_DIM 10 1 1 /end CHARACTERISTIC
/begin CHARACTERISTIC DINH_FId.DFC_RailMeUn22 "part of DFC-FId relation matrix" VAL_BLK 0x39C22A RL_UWORD 0 nse_FIdVerb 0 400 MATRIX_DIM 10 1 1 /end CHARACTERISTIC
/begin CHARACTERISTIC DINH_FId.DFC_RailMeUn3 "part of DFC-FId relation matrix" VAL_BLK 0x39C23E RL_UWORD 0 nse_FIdVerb 0 400 MATRIX_DIM 10 1 1 /end CHARACTERISTIC
/begin CHARACTERISTIC DINH_FId.DFC_RailMeUn4 "part of DFC-FId relation matrix" VAL_BLK 0x39C252 RL_UWORD 0 nse_FIdVerb 0 400 MATRIX_DIM 10 1 1 /end CHARACTERISTIC
/begin CHARACTERISTIC DINH_FId.DFC_RailMeUn42 "part of DFC-FId relation matrix" VAL_BLK 0x39C266 RL_UWORD 0 nse_FIdVerb 0 400 MATRIX_DIM 10 1 1 /end CHARACTERISTIC
/begin CHARACTERISTIC DINH_FId.DFC_RailMeUn7 "part of DFC-FId relation matrix" VAL_BLK 0x39C27A RL_UWORD 0 nse_FIdVerb 0 400 MATRIX_DIM 10 1 1 /end CHARACTERISTIC
/begin CHARACTERISTIC DINH_FId.DFC_RailMeUn8 "part of DFC-FId relation matrix" VAL_BLK 0x39C28E RL_UWORD 0 nse_FIdVerb 0 400 MATRIX_DIM 10 1 1 /end CHARACTERISTIC
/begin CHARACTERISTIC DINH_FId.DFC_RailMeUn10 "part of DFC-FId relation matrix" VAL_BLK 0x39C2A2 RL_UWORD 0 nse_FIdVerb 0 400 MATRIX_DIM 10 1 1 /end CHARACTERISTIC
/begin CHARACTERISTIC DINH_FId.DFC_MeUnSRCMax "part of DFC-FId relation matrix" VAL_BLK 0x39C2B6 RL_UWORD 0 nse_FIdVerb 0 400 MATRIX_DIM 10 1 1 /end CHARACTERISTIC
/begin CHARACTERISTIC DINH_FId.DFC_MeUnSRCMin "part of DFC-FId relation matrix" VAL_BLK 0x39C2CA RL_UWORD 0 nse_FIdVerb 0 400 MATRIX_DIM 10 1 1 /end CHARACTERISTIC
/begin CHARACTERISTIC DINH_FId.DFC_BattUSRCMax "part of DFC-FId relation matrix" VAL_BLK 0x39C2DE RL_UWORD 0 nse_FIdVerb 0 400 MATRIX_DIM 10 1 1 /end CHARACTERISTIC
/begin CHARACTERISTIC DINH_FId.DFC_BattUSRCMin "part of DFC-FId relation matrix" VAL_BLK 0x39C2F2 RL_UWORD 0 nse_FIdVerb 0 400 MATRIX_DIM 10 1 1 /end CHARACTERISTIC
/begin CHARACTERISTIC DINH_FId.DFC_BattULo "part of DFC-FId relation matrix" VAL_BLK 0x39C306 RL_UWORD 0 nse_FIdVerb 0 400 MATRIX_DIM 10 1 1 /end CHARACTERISTIC
/begin CHARACTERISTIC DINH_FId.DFC_BattUHi "part of DFC-FId relation matrix" VAL_BLK 0x39C31A RL_UWORD 0 nse_FIdVerb 0 400 MATRIX_DIM 10 1 1 /end CHARACTERISTIC
/begin CHARACTERISTIC DINH_FId.DFC_MRlyStk "part of DFC-FId relation matrix" VAL_BLK 0x39C32E RL_UWORD 0 nse_FIdVerb 0 400 MATRIX_DIM 10 1 1 /end CHARACTERISTIC
/begin CHARACTERISTIC DINH_FId.DFC_MRlyErlyOpng "part of DFC-FId relation matrix" VAL_BLK 0x39C342 RL_UWORD 0 nse_FIdVerb 0 400 MATRIX_DIM 10 1 1 /end CHARACTERISTIC
/begin CHARACTERISTIC DINH_FId.DFC_SSpMonSplyMax "part of DFC-FId relation matrix" VAL_BLK 0x39C356 RL_UWORD 0 nse_FIdVerb 0 400 MATRIX_DIM 10 1 1 /end CHARACTERISTIC
/begin CHARACTERISTIC DINH_FId.DFC_SSpMonSplyMin "part of DFC-FId relation matrix" VAL_BLK 0x39C36A RL_UWORD 0 nse_FIdVerb 0 400 MATRIX_DIM 10 1 1 /end CHARACTERISTIC
/begin CHARACTERISTIC DINH_FId.DFC_SSpMonSply1Max "part of DFC-FId relation matrix" VAL_BLK 0x39C37E RL_UWORD 0 nse_FIdVerb 0 400 MATRIX_DIM 10 1 1 /end CHARACTERISTIC
/begin CHARACTERISTIC DINH_FId.DFC_SSpMonSply1Min "part of DFC-FId relation matrix" VAL_BLK 0x39C392 RL_UWORD 0 nse_FIdVerb 0 400 MATRIX_DIM 10 1 1 /end CHARACTERISTIC
/begin CHARACTERISTIC DINH_FId.DFC_BrkNpl "part of DFC-FId relation matrix" VAL_BLK 0x39C3A6 RL_UWORD 0 nse_FIdVerb 0 400 MATRIX_DIM 10 1 1 /end CHARACTERISTIC
/begin CHARACTERISTIC DINH_FId.DFC_ClthNpl "part of DFC-FId relation matrix" VAL_BLK 0x39C3BA RL_UWORD 0 nse_FIdVerb 0 400 MATRIX_DIM 10 1 1 /end CHARACTERISTIC
/begin CHARACTERISTIC DINH_FId.DFC_EnvPSRCMax "part of DFC-FId relation matrix" VAL_BLK 0x39C3CE RL_UWORD 0 nse_FIdVerb 0 400 MATRIX_DIM 10 1 1 /end CHARACTERISTIC
/begin CHARACTERISTIC DINH_FId.DFC_EnvPSRCMin "part of DFC-FId relation matrix" VAL_BLK 0x39C3E2 RL_UWORD 0 nse_FIdVerb 0 400 MATRIX_DIM 10 1 1 /end CHARACTERISTIC
/begin CHARACTERISTIC DINH_FId.DFC_EnvPPhysRngHi "part of DFC-FId relation matrix" VAL_BLK 0x39C3F6 RL_UWORD 0 nse_FIdVerb 0 400 MATRIX_DIM 10 1 1 /end CHARACTERISTIC
/begin CHARACTERISTIC DINH_FId.DFC_EnvPPhysRngLo "part of DFC-FId relation matrix" VAL_BLK 0x39C40A RL_UWORD 0 nse_FIdVerb 0 400 MATRIX_DIM 10 1 1 /end CHARACTERISTIC
/begin CHARACTERISTIC DINH_FId.DFC_EnvTSRCMax "part of DFC-FId relation matrix" VAL_BLK 0x39C41E RL_UWORD 0 nse_FIdVerb 0 400 MATRIX_DIM 10 1 1 /end CHARACTERISTIC
/begin CHARACTERISTIC DINH_FId.DFC_EnvTSRCMin "part of DFC-FId relation matrix" VAL_BLK 0x39C432 RL_UWORD 0 nse_FIdVerb 0 400 MATRIX_DIM 10 1 1 /end CHARACTERISTIC
/begin CHARACTERISTIC DINH_FId.DFC_EnvTPhysRngHi "part of DFC-FId relation matrix" VAL_BLK 0x39C446 RL_UWORD 0 nse_FIdVerb 0 400 MATRIX_DIM 10 1 1 /end CHARACTERISTIC
/begin CHARACTERISTIC DINH_FId.DFC_EnvTPhysRngLo "part of DFC-FId relation matrix" VAL_BLK 0x39C45A RL_UWORD 0 nse_FIdVerb 0 400 MATRIX_DIM 10 1 1 /end CHARACTERISTIC
/begin CHARACTERISTIC DINH_FId.DFC_PIntkVUsSRCMax "part of DFC-FId relation matrix" VAL_BLK 0x39C46E RL_UWORD 0 nse_FIdVerb 0 400 MATRIX_DIM 10 1 1 /end CHARACTERISTIC
/begin CHARACTERISTIC DINH_FId.DFC_PIntkVUsSRCMin "part of DFC-FId relation matrix" VAL_BLK 0x39C482 RL_UWORD 0 nse_FIdVerb 0 400 MATRIX_DIM 10 1 1 /end CHARACTERISTIC
/begin CHARACTERISTIC DINH_FId.DFC_PIntkVUsPhysRngHi "part of DFC-FId relation matrix" VAL_BLK 0x39C496 RL_UWORD 0 nse_FIdVerb 0 400 MATRIX_DIM 10 1 1 /end CHARACTERISTIC
/begin CHARACTERISTIC DINH_FId.DFC_PIntkVUsPhysRngLo "part of DFC-FId relation matrix" VAL_BLK 0x39C4AA RL_UWORD 0 nse_FIdVerb 0 400 MATRIX_DIM 10 1 1 /end CHARACTERISTIC
/begin CHARACTERISTIC DINH_FId.DFC_PIntkVUsPlsHi "part of DFC-FId relation matrix" VAL_BLK 0x39C4BE RL_UWORD 0 nse_FIdVerb 0 400 MATRIX_DIM 10 1 1 /end CHARACTERISTIC
/begin CHARACTERISTIC DINH_FId.DFC_PIntkVUsPlsLo "part of DFC-FId relation matrix" VAL_BLK 0x39C4D2 RL_UWORD 0 nse_FIdVerb 0 400 MATRIX_DIM 10 1 1 /end CHARACTERISTIC
/begin CHARACTERISTIC DINH_FId.DFC_TIntkVUsSRCMax "part of DFC-FId relation matrix" VAL_BLK 0x39C4E6 RL_UWORD 0 nse_FIdVerb 0 400 MATRIX_DIM 10 1 1 /end CHARACTERISTIC
/begin CHARACTERISTIC DINH_FId.DFC_TIntkVUsSRCMin "part of DFC-FId relation matrix" VAL_BLK 0x39C4FA RL_UWORD 0 nse_FIdVerb 0 400 MATRIX_DIM 10 1 1 /end CHARACTERISTIC
/begin CHARACTERISTIC DINH_FId.DFC_FuelTSRCMax "part of DFC-FId relation matrix" VAL_BLK 0x39C50E RL_UWORD 0 nse_FIdVerb 0 400 MATRIX_DIM 10 1 1 /end CHARACTERISTIC
/begin CHARACTERISTIC DINH_FId.DFC_FuelTSRCMin "part of DFC-FId relation matrix" VAL_BLK 0x39C522 RL_UWORD 0 nse_FIdVerb 0 400 MATRIX_DIM 10 1 1 /end CHARACTERISTIC
/begin CHARACTERISTIC DINH_FId.DFC_FuelTVDPlausHi "part of DFC-FId relation matrix" VAL_BLK 0x39C536 RL_UWORD 0 nse_FIdVerb 0 400 MATRIX_DIM 10 1 1 /end CHARACTERISTIC
/begin CHARACTERISTIC DINH_FId.DFC_FuelTVDPlausLo "part of DFC-FId relation matrix" VAL_BLK 0x39C54A RL_UWORD 0 nse_FIdVerb 0 400 MATRIX_DIM 10 1 1 /end CHARACTERISTIC
/begin CHARACTERISTIC DINH_FId.DFC_OilPSwmpSRCMax "part of DFC-FId relation matrix" VAL_BLK 0x39C55E RL_UWORD 0 nse_FIdVerb 0 400 MATRIX_DIM 10 1 1 /end CHARACTERISTIC
/begin CHARACTERISTIC DINH_FId.DFC_OilPSwmpSRCMin "part of DFC-FId relation matrix" VAL_BLK 0x39C572 RL_UWORD 0 nse_FIdVerb 0 400 MATRIX_DIM 10 1 1 /end CHARACTERISTIC
/begin CHARACTERISTIC DINH_FId.DFC_OilPSwmpPhysRngHi "part of DFC-FId relation matrix" VAL_BLK 0x39C586 RL_UWORD 0 nse_FIdVerb 0 400 MATRIX_DIM 10 1 1 /end CHARACTERISTIC
/begin CHARACTERISTIC DINH_FId.DFC_OilPSwmpPhysRngLo "part of DFC-FId relation matrix" VAL_BLK 0x39C59A RL_UWORD 0 nse_FIdVerb 0 400 MATRIX_DIM 10 1 1 /end CHARACTERISTIC
/begin CHARACTERISTIC DINH_FId.DFC_OilTSRCMax "part of DFC-FId relation matrix" VAL_BLK 0x39C5AE RL_UWORD 0 nse_FIdVerb 0 400 MATRIX_DIM 10 1 1 /end CHARACTERISTIC
/begin CHARACTERISTIC DINH_FId.DFC_OilTSRCMin "part of DFC-FId relation matrix" VAL_BLK 0x39C5C2 RL_UWORD 0 nse_FIdVerb 0 400 MATRIX_DIM 10 1 1 /end CHARACTERISTIC
/begin CHARACTERISTIC DINH_FId.DFC_OilTVDPlaus "part of DFC-FId relation matrix" VAL_BLK 0x39C5D6 RL_UWORD 0 nse_FIdVerb 0 400 MATRIX_DIM 10 1 1 /end CHARACTERISTIC
/begin CHARACTERISTIC DINH_FId.DFC_CoETSLimInfo "part of DFC-FId relation matrix" VAL_BLK 0x39C5EA RL_UWORD 0 nse_FIdVerb 0 400 MATRIX_DIM 10 1 1 /end CHARACTERISTIC
/begin CHARACTERISTIC DINH_FId.DFC_TrbChOvrSpd "part of DFC-FId relation matrix" VAL_BLK 0x39C5FE RL_UWORD 0 nse_FIdVerb 0 400 MATRIX_DIM 10 1 1 /end CHARACTERISTIC
/begin CHARACTERISTIC DINH_FId.DFC_VehVMax "part of DFC-FId relation matrix" VAL_BLK 0x39C612 RL_UWORD 0 nse_FIdVerb 0 400 MATRIX_DIM 10 1 1 /end CHARACTERISTIC
/begin CHARACTERISTIC DINH_FId.DFC_VehVPlaus "part of DFC-FId relation matrix" VAL_BLK 0x39C626 RL_UWORD 0 nse_FIdVerb 0 400 MATRIX_DIM 10 1 1 /end CHARACTERISTIC
/begin CHARACTERISTIC DINH_FId.DFC_EGRVlvSRCMax "part of DFC-FId relation matrix" VAL_BLK 0x39C63A RL_UWORD 0 nse_FIdVerb 0 400 MATRIX_DIM 10 1 1 /end CHARACTERISTIC
/begin CHARACTERISTIC DINH_FId.DFC_EGRVlvSRCMin "part of DFC-FId relation matrix" VAL_BLK 0x39C64E RL_UWORD 0 nse_FIdVerb 0 400 MATRIX_DIM 10 1 1 /end CHARACTERISTIC
/begin CHARACTERISTIC DINH_FId.DFC_USELESS_67 "part of DFC-FId relation matrix" VAL_BLK 0x39C662 RL_UWORD 0 nse_FIdVerb 0 400 MATRIX_DIM 10 1 1 /end CHARACTERISTIC
/begin CHARACTERISTIC DINH_FId.DFC_USELESS_68 "part of DFC-FId relation matrix" VAL_BLK 0x39C676 RL_UWORD 0 nse_FIdVerb 0 400 MATRIX_DIM 10 1 1 /end CHARACTERISTIC
/begin CHARACTERISTIC DINH_FId.DFC_USELESS_69 "part of DFC-FId relation matrix" VAL_BLK 0x39C68A RL_UWORD 0 nse_FIdVerb 0 400 MATRIX_DIM 10 1 1 /end CHARACTERISTIC
/begin CHARACTERISTIC DINH_FId.DFC_USELESS_70 "part of DFC-FId relation matrix" VAL_BLK 0x39C69E RL_UWORD 0 nse_FIdVerb 0 400 MATRIX_DIM 10 1 1 /end CHARACTERISTIC
/begin CHARACTERISTIC DINH_FId.DFC_AFSSigErr "part of DFC-FId relation matrix" VAL_BLK 0x39C6B2 RL_UWORD 0 nse_FIdVerb 0 400 MATRIX_DIM 10 1 1 /end CHARACTERISTIC
/begin CHARACTERISTIC DINH_FId.DFC_AFSSRCRawMin "part of DFC-FId relation matrix" VAL_BLK 0x39C6C6 RL_UWORD 0 nse_FIdVerb 0 400 MATRIX_DIM 10 1 1 /end CHARACTERISTIC
/begin CHARACTERISTIC DINH_FId.DFC_AFSSetyDrftMin "part of DFC-FId relation matrix" VAL_BLK 0x39C6DA RL_UWORD 0 nse_FIdVerb 0 400 MATRIX_DIM 10 1 1 /end CHARACTERISTIC
/begin CHARACTERISTIC DINH_FId.DFC_AFSSetyDrftMax "part of DFC-FId relation matrix" VAL_BLK 0x39C6EE RL_UWORD 0 nse_FIdVerb 0 400 MATRIX_DIM 10 1 1 /end CHARACTERISTIC
/begin CHARACTERISTIC DINH_FId.DFC_AFSDrftIdlAdjVal "part of DFC-FId relation matrix" VAL_BLK 0x39C702 RL_UWORD 0 nse_FIdVerb 0 400 MATRIX_DIM 10 1 1 /end CHARACTERISTIC
/begin CHARACTERISTIC DINH_FId.DFC_AFSDrftLdAdjVal "part of DFC-FId relation matrix" VAL_BLK 0x39C716 RL_UWORD 0 nse_FIdVerb 0 400 MATRIX_DIM 10 1 1 /end CHARACTERISTIC
/begin CHARACTERISTIC DINH_FId.DFC_AFSDrftAdjPlausNPL "part of DFC-FId relation matrix" VAL_BLK 0x39C72A RL_UWORD 0 nse_FIdVerb 0 400 MATRIX_DIM 10 1 1 /end CHARACTERISTIC
/begin CHARACTERISTIC DINH_FId.DFC_AFSDrftAdjPlausMax "part of DFC-FId relation matrix" VAL_BLK 0x39C73E RL_UWORD 0 nse_FIdVerb 0 400 MATRIX_DIM 10 1 1 /end CHARACTERISTIC
/begin CHARACTERISTIC DINH_FId.DFC_TAFSDtyCycHi "part of DFC-FId relation matrix" VAL_BLK 0x39C752 RL_UWORD 0 nse_FIdVerb 0 400 MATRIX_DIM 10 1 1 /end CHARACTERISTIC
/begin CHARACTERISTIC DINH_FId.DFC_TAFSDtyCycLo "part of DFC-FId relation matrix" VAL_BLK 0x39C766 RL_UWORD 0 nse_FIdVerb 0 400 MATRIX_DIM 10 1 1 /end CHARACTERISTIC
/begin CHARACTERISTIC DINH_FId.DFC_TAFSPerHi "part of DFC-FId relation matrix" VAL_BLK 0x39C77A RL_UWORD 0 nse_FIdVerb 0 400 MATRIX_DIM 10 1 1 /end CHARACTERISTIC
/begin CHARACTERISTIC DINH_FId.DFC_TAFSPerLo "part of DFC-FId relation matrix" VAL_BLK 0x39C78E RL_UWORD 0 nse_FIdVerb 0 400 MATRIX_DIM 10 1 1 /end CHARACTERISTIC
/begin CHARACTERISTIC DINH_FId.DFC_MinPTOSwt "part of DFC-FId relation matrix" VAL_BLK 0x39C7A2 RL_UWORD 0 nse_FIdVerb 0 400 MATRIX_DIM 10 1 1 /end CHARACTERISTIC
/begin CHARACTERISTIC DINH_FId.DFC_MaxPTOSwt "part of DFC-FId relation matrix" VAL_BLK 0x39C7B6 RL_UWORD 0 nse_FIdVerb 0 400 MATRIX_DIM 10 1 1 /end CHARACTERISTIC
/begin CHARACTERISTIC DINH_FId.DFC_NplPTOSwt "part of DFC-FId relation matrix" VAL_BLK 0x39C7CA RL_UWORD 0 nse_FIdVerb 0 400 MATRIX_DIM 10 1 1 /end CHARACTERISTIC
/begin CHARACTERISTIC DINH_FId.DFC_AirCtl_bGovDvtMax "part of DFC-FId relation matrix" VAL_BLK 0x39C7DE RL_UWORD 0 nse_FIdVerb 0 400 MATRIX_DIM 10 1 1 /end CHARACTERISTIC
/begin CHARACTERISTIC DINH_FId.DFC_AirCtl_bGovDvtMin "part of DFC-FId relation matrix" VAL_BLK 0x39C7F2 RL_UWORD 0 nse_FIdVerb 0 400 MATRIX_DIM 10 1 1 /end CHARACTERISTIC
/begin CHARACTERISTIC DINH_FId.DFC_EGRVlv_bEGRVlvLgTDrft "part of DFC-FId relation matrix" VAL_BLK 0x39C806 RL_UWORD 0 nse_FIdVerb 0 400 MATRIX_DIM 10 1 1 /end CHARACTERISTIC
/begin CHARACTERISTIC DINH_FId.DFC_EGRVlv_bEGRVlvOfsLrnJamVlv "part of DFC-FId relation matrix" VAL_BLK 0x39C81A RL_UWORD 0 nse_FIdVerb 0 400 MATRIX_DIM 10 1 1 /end CHARACTERISTIC
/begin CHARACTERISTIC DINH_FId.DFC_EGRVlv_bEGRVlvOfsPlaus "part of DFC-FId relation matrix" VAL_BLK 0x39C82E RL_UWORD 0 nse_FIdVerb 0 400 MATRIX_DIM 10 1 1 /end CHARACTERISTIC
/begin CHARACTERISTIC DINH_FId.DFC_EGRVlv_bEGRVlvShTDrft "part of DFC-FId relation matrix" VAL_BLK 0x39C842 RL_UWORD 0 nse_FIdVerb 0 400 MATRIX_DIM 10 1 1 /end CHARACTERISTIC
/begin CHARACTERISTIC DINH_FId.DFC_EGRVlv_bJamVlvClsd "part of DFC-FId relation matrix" VAL_BLK 0x39C856 RL_UWORD 0 nse_FIdVerb 0 400 MATRIX_DIM 10 1 1 /end CHARACTERISTIC
/begin CHARACTERISTIC DINH_FId.DFC_EGRVlv_bJamVlvOpn "part of DFC-FId relation matrix" VAL_BLK 0x39C86A RL_UWORD 0 nse_FIdVerb 0 400 MATRIX_DIM 10 1 1 /end CHARACTERISTIC
/begin CHARACTERISTIC DINH_FId.DFC_EGRVlv_bPhysRngHiDeb "part of DFC-FId relation matrix" VAL_BLK 0x39C87E RL_UWORD 0 nse_FIdVerb 0 400 MATRIX_DIM 10 1 1 /end CHARACTERISTIC
/begin CHARACTERISTIC DINH_FId.DFC_EGRVlv_bPhysRngLoDeb "part of DFC-FId relation matrix" VAL_BLK 0x39C892 RL_UWORD 0 nse_FIdVerb 0 400 MATRIX_DIM 10 1 1 /end CHARACTERISTIC
/begin CHARACTERISTIC DINH_FId.DFC_EGRVlv_bGovDvtMaxDeb "part of DFC-FId relation matrix" VAL_BLK 0x39C8A6 RL_UWORD 0 nse_FIdVerb 0 400 MATRIX_DIM 10 1 1 /end CHARACTERISTIC
/begin CHARACTERISTIC DINH_FId.DFC_EGRVlv_bGovDvtMinDeb "part of DFC-FId relation matrix" VAL_BLK 0x39C8BA RL_UWORD 0 nse_FIdVerb 0 400 MATRIX_DIM 10 1 1 /end CHARACTERISTIC
/begin CHARACTERISTIC DINH_FId.DFC_PRVOpn "part of DFC-FId relation matrix" VAL_BLK 0x39C8CE RL_UWORD 0 nse_FIdVerb 0 400 MATRIX_DIM 10 1 1 /end CHARACTERISTIC
/begin CHARACTERISTIC DINH_FId.DFC_PRVRPOutOfRng "part of DFC-FId relation matrix" VAL_BLK 0x39C8E2 RL_UWORD 0 nse_FIdVerb 0 400 MATRIX_DIM 10 1 1 /end CHARACTERISTIC
/begin CHARACTERISTIC DINH_FId.DFC_PRV_ctOpnMax "part of DFC-FId relation matrix" VAL_BLK 0x39C8F6 RL_UWORD 0 nse_FIdVerb 0 400 MATRIX_DIM 10 1 1 /end CHARACTERISTIC
/begin CHARACTERISTIC DINH_FId.DFC_PRV_tiOpnMax "part of DFC-FId relation matrix" VAL_BLK 0x39C90A RL_UWORD 0 nse_FIdVerb 0 400 MATRIX_DIM 10 1 1 /end CHARACTERISTIC
/begin CHARACTERISTIC DINH_FId.DFC_PRVwearout "part of DFC-FId relation matrix" VAL_BLK 0x39C91E RL_UWORD 0 nse_FIdVerb 0 400 MATRIX_DIM 10 1 1 /end CHARACTERISTIC
/begin CHARACTERISTIC DINH_FId.DFC_DFC_stT50Err "part of DFC-FId relation matrix" VAL_BLK 0x39C932 RL_UWORD 0 nse_FIdVerb 0 400 MATRIX_DIM 10 1 1 /end CHARACTERISTIC
/begin CHARACTERISTIC DINH_FId.DFC_RmtAPP_bSRCHigh1Deb "part of DFC-FId relation matrix" VAL_BLK 0x39C946 RL_UWORD 0 nse_FIdVerb 0 400 MATRIX_DIM 10 1 1 /end CHARACTERISTIC
/begin CHARACTERISTIC DINH_FId.DFC_RmtAPP_bSRCHigh2Deb "part of DFC-FId relation matrix" VAL_BLK 0x39C95A RL_UWORD 0 nse_FIdVerb 0 400 MATRIX_DIM 10 1 1 /end CHARACTERISTIC
/begin CHARACTERISTIC DINH_FId.DFC_RmtAPP_bSRCLow1Deb "part of DFC-FId relation matrix" VAL_BLK 0x39C96E RL_UWORD 0 nse_FIdVerb 0 400 MATRIX_DIM 10 1 1 /end CHARACTERISTIC
/begin CHARACTERISTIC DINH_FId.DFC_RmtAPP_bSRCLow2Deb "part of DFC-FId relation matrix" VAL_BLK 0x39C982 RL_UWORD 0 nse_FIdVerb 0 400 MATRIX_DIM 10 1 1 /end CHARACTERISTIC
/begin CHARACTERISTIC DINH_FId.DFC_RmtAPP_bSyncDeb "part of DFC-FId relation matrix" VAL_BLK 0x39C996 RL_UWORD 0 nse_FIdVerb 0 400 MATRIX_DIM 10 1 1 /end CHARACTERISTIC
/begin CHARACTERISTIC DINH_FId.DFC_RailP_bSRCMaxDeb "part of DFC-FId relation matrix" VAL_BLK 0x39C9AA RL_UWORD 0 nse_FIdVerb 0 400 MATRIX_DIM 10 1 1 /end CHARACTERISTIC
/begin CHARACTERISTIC DINH_FId.DFC_RailP_bSRCMinDeb "part of DFC-FId relation matrix" VAL_BLK 0x39C9BE RL_UWORD 0 nse_FIdVerb 0 400 MATRIX_DIM 10 1 1 /end CHARACTERISTIC
/begin CHARACTERISTIC DINH_FId.DFC_Air_bVoltHiDebTAFS "part of DFC-FId relation matrix" VAL_BLK 0x39C9D2 RL_UWORD 0 nse_FIdVerb 0 400 MATRIX_DIM 10 1 1 /end CHARACTERISTIC
/begin CHARACTERISTIC DINH_FId.DFC_Air_bVoltLoDebTAFS "part of DFC-FId relation matrix" VAL_BLK 0x39C9E6 RL_UWORD 0 nse_FIdVerb 0 400 MATRIX_DIM 10 1 1 /end CHARACTERISTIC
/begin CHARACTERISTIC DINH_FId.DFC_USELESS_113 "part of DFC-FId relation matrix" VAL_BLK 0x39C9FA RL_UWORD 0 nse_FIdVerb 0 400 MATRIX_DIM 10 1 1 /end CHARACTERISTIC
/begin CHARACTERISTIC DINH_FId.DFC_USELESS_114 "part of DFC-FId relation matrix" VAL_BLK 0x39CA0E RL_UWORD 0 nse_FIdVerb 0 400 MATRIX_DIM 10 1 1 /end CHARACTERISTIC
/begin CHARACTERISTIC DINH_FId.DFC_USELESS_115 "part of DFC-FId relation matrix" VAL_BLK 0x39CA22 RL_UWORD 0 nse_FIdVerb 0 400 MATRIX_DIM 10 1 1 /end CHARACTERISTIC
/begin CHARACTERISTIC DINH_FId.DFC_LSD_AirConditionRelay_SCB "part of DFC-FId relation matrix" VAL_BLK 0x39D0DA RL_UWORD 0 nse_FIdVerb 0 400 MATRIX_DIM 10 1 1 /end CHARACTERISTIC
/begin CHARACTERISTIC DINH_FId.DFC_LSD_AirConditionRelay_OL "part of DFC-FId relation matrix" VAL_BLK 0x39D0EE RL_UWORD 0 nse_FIdVerb 0 400 MATRIX_DIM 10 1 1 /end CHARACTERISTIC
/begin CHARACTERISTIC DINH_FId.DFC_LSD_AirConditionRelay_SCG "part of DFC-FId relation matrix" VAL_BLK 0x39D102 RL_UWORD 0 nse_FIdVerb 0 400 MATRIX_DIM 10 1 1 /end CHARACTERISTIC
/begin CHARACTERISTIC DINH_FId.DFC_LSD_FuelHeat_SCB "part of DFC-FId relation matrix" VAL_BLK 0x39D116 RL_UWORD 0 nse_FIdVerb 0 400 MATRIX_DIM 10 1 1 /end CHARACTERISTIC
/begin CHARACTERISTIC DINH_FId.DFC_LSD_FuelHeat_OL "part of DFC-FId relation matrix" VAL_BLK 0x39D12A RL_UWORD 0 nse_FIdVerb 0 400 MATRIX_DIM 10 1 1 /end CHARACTERISTIC
/begin CHARACTERISTIC DINH_FId.DFC_LSD_FuelHeat_SCG "part of DFC-FId relation matrix" VAL_BLK 0x39D13E RL_UWORD 0 nse_FIdVerb 0 400 MATRIX_DIM 10 1 1 /end CHARACTERISTIC
/begin CHARACTERISTIC DINH_FId.DFC_LSD_WFLGT_SCB "part of DFC-FId relation matrix" VAL_BLK 0x39D152 RL_UWORD 0 nse_FIdVerb 0 400 MATRIX_DIM 10 1 1 /end CHARACTERISTIC
/begin CHARACTERISTIC DINH_FId.DFC_LSD_WFLGT_OL "part of DFC-FId relation matrix" VAL_BLK 0x39D166 RL_UWORD 0 nse_FIdVerb 0 400 MATRIX_DIM 10 1 1 /end CHARACTERISTIC
/begin CHARACTERISTIC DINH_FId.DFC_LSD_WFLGT_SCG "part of DFC-FId relation matrix" VAL_BLK 0x39D17A RL_UWORD 0 nse_FIdVerb 0 400 MATRIX_DIM 10 1 1 /end CHARACTERISTIC
/begin CHARACTERISTIC DINH_FId.DFC_LSD_VNT_SCB "part of DFC-FId relation matrix" VAL_BLK 0x39D18E RL_UWORD 0 nse_FIdVerb 0 400 MATRIX_DIM 10 1 1 /end CHARACTERISTIC
/begin CHARACTERISTIC DINH_FId.DFC_LSD_VNT_OL "part of DFC-FId relation matrix" VAL_BLK 0x39D1A2 RL_UWORD 0 nse_FIdVerb 0 400 MATRIX_DIM 10 1 1 /end CHARACTERISTIC
/begin CHARACTERISTIC DINH_FId.DFC_LSD_VNT_SCG "part of DFC-FId relation matrix" VAL_BLK 0x39D1B6 RL_UWORD 0 nse_FIdVerb 0 400 MATRIX_DIM 10 1 1 /end CHARACTERISTIC
/begin CHARACTERISTIC DINH_FId.DFC_LSD_ENGN_SCB "part of DFC-FId relation matrix" VAL_BLK 0x39D1CA RL_UWORD 0 nse_FIdVerb 0 400 MATRIX_DIM 10 1 1 /end CHARACTERISTIC
/begin CHARACTERISTIC DINH_FId.DFC_LSD_ENGN_OL "part of DFC-FId relation matrix" VAL_BLK 0x39D1DE RL_UWORD 0 nse_FIdVerb 0 400 MATRIX_DIM 10 1 1 /end CHARACTERISTIC
/begin CHARACTERISTIC DINH_FId.DFC_LSD_ENGN_SCG "part of DFC-FId relation matrix" VAL_BLK 0x39D1F2 RL_UWORD 0 nse_FIdVerb 0 400 MATRIX_DIM 10 1 1 /end CHARACTERISTIC
/begin CHARACTERISTIC DINH_FId.DFC_LSD_FANL_SCB "part of DFC-FId relation matrix" VAL_BLK 0x39D206 RL_UWORD 0 nse_FIdVerb 0 400 MATRIX_DIM 10 1 1 /end CHARACTERISTIC
/begin CHARACTERISTIC DINH_FId.DFC_LSD_FANL_OL "part of DFC-FId relation matrix" VAL_BLK 0x39D21A RL_UWORD 0 nse_FIdVerb 0 400 MATRIX_DIM 10 1 1 /end CHARACTERISTIC
/begin CHARACTERISTIC DINH_FId.DFC_LSD_FANL_SCG "part of DFC-FId relation matrix" VAL_BLK 0x39D22E RL_UWORD 0 nse_FIdVerb 0 400 MATRIX_DIM 10 1 1 /end CHARACTERISTIC
/begin CHARACTERISTIC DINH_FId.DFC_LSD_ERRLGT_SCB "part of DFC-FId relation matrix" VAL_BLK 0x39D242 RL_UWORD 0 nse_FIdVerb 0 400 MATRIX_DIM 10 1 1 /end CHARACTERISTIC
/begin CHARACTERISTIC DINH_FId.DFC_LSD_ERRLGT_OL "part of DFC-FId relation matrix" VAL_BLK 0x39D256 RL_UWORD 0 nse_FIdVerb 0 400 MATRIX_DIM 10 1 1 /end CHARACTERISTIC
/begin CHARACTERISTIC DINH_FId.DFC_LSD_ERRLGT_SCG "part of DFC-FId relation matrix" VAL_BLK 0x39D26A RL_UWORD 0 nse_FIdVerb 0 400 MATRIX_DIM 10 1 1 /end CHARACTERISTIC
/begin CHARACTERISTIC DINH_FId.DFC_LSD_OBDLGT_SCB "part of DFC-FId relation matrix" VAL_BLK 0x39D27E RL_UWORD 0 nse_FIdVerb 0 400 MATRIX_DIM 10 1 1 /end CHARACTERISTIC
/begin CHARACTERISTIC DINH_FId.DFC_LSD_OBDLGT_OL "part of DFC-FId relation matrix" VAL_BLK 0x39D292 RL_UWORD 0 nse_FIdVerb 0 400 MATRIX_DIM 10 1 1 /end CHARACTERISTIC
/begin CHARACTERISTIC DINH_FId.DFC_LSD_OBDLGT_SCG "part of DFC-FId relation matrix" VAL_BLK 0x39D2A6 RL_UWORD 0 nse_FIdVerb 0 400 MATRIX_DIM 10 1 1 /end CHARACTERISTIC
/begin CHARACTERISTIC DINH_FId.DFC_LSD_EGR_SCB "part of DFC-FId relation matrix" VAL_BLK 0x39D2BA RL_UWORD 0 nse_FIdVerb 0 400 MATRIX_DIM 10 1 1 /end CHARACTERISTIC
/begin CHARACTERISTIC DINH_FId.DFC_LSD_EGR_OL "part of DFC-FId relation matrix" VAL_BLK 0x39D2CE RL_UWORD 0 nse_FIdVerb 0 400 MATRIX_DIM 10 1 1 /end CHARACTERISTIC
/begin CHARACTERISTIC DINH_FId.DFC_LSD_EGR_SCG "part of DFC-FId relation matrix" VAL_BLK 0x39D2E2 RL_UWORD 0 nse_FIdVerb 0 400 MATRIX_DIM 10 1 1 /end CHARACTERISTIC
/begin CHARACTERISTIC DINH_FId.DFC_LSD_FANH_SCB "part of DFC-FId relation matrix" VAL_BLK 0x39D2F6 RL_UWORD 0 nse_FIdVerb 0 400 MATRIX_DIM 10 1 1 /end CHARACTERISTIC
/begin CHARACTERISTIC DINH_FId.DFC_LSD_FANH_OL "part of DFC-FId relation matrix" VAL_BLK 0x39D30A RL_UWORD 0 nse_FIdVerb 0 400 MATRIX_DIM 10 1 1 /end CHARACTERISTIC
/begin CHARACTERISTIC DINH_FId.DFC_LSD_FANH_SCG "part of DFC-FId relation matrix" VAL_BLK 0x39D31E RL_UWORD 0 nse_FIdVerb 0 400 MATRIX_DIM 10 1 1 /end CHARACTERISTIC
/begin CHARACTERISTIC DINH_FId.DFC_LSD_ClntDsp_SCB "part of DFC-FId relation matrix" VAL_BLK 0x39D332 RL_UWORD 0 nse_FIdVerb 0 400 MATRIX_DIM 10 1 1 /end CHARACTERISTIC
/begin CHARACTERISTIC DINH_FId.DFC_LSD_ClntDsp_OL "part of DFC-FId relation matrix" VAL_BLK 0x39D346 RL_UWORD 0 nse_FIdVerb 0 400 MATRIX_DIM 10 1 1 /end CHARACTERISTIC
/begin CHARACTERISTIC DINH_FId.DFC_LSD_ClntDsp_SCG "part of DFC-FId relation matrix" VAL_BLK 0x39D35A RL_UWORD 0 nse_FIdVerb 0 400 MATRIX_DIM 10 1 1 /end CHARACTERISTIC
/begin CHARACTERISTIC DINH_FId.DFC_LSD_F_V_SCB "part of DFC-FId relation matrix" VAL_BLK 0x39D36E RL_UWORD 0 nse_FIdVerb 0 400 MATRIX_DIM 10 1 1 /end CHARACTERISTIC
/begin CHARACTERISTIC DINH_FId.DFC_LSD_F_V_OL "part of DFC-FId relation matrix" VAL_BLK 0x39D382 RL_UWORD 0 nse_FIdVerb 0 400 MATRIX_DIM 10 1 1 /end CHARACTERISTIC
/begin CHARACTERISTIC DINH_FId.DFC_LSD_F_V_SCG "part of DFC-FId relation matrix" VAL_BLK 0x39D396 RL_UWORD 0 nse_FIdVerb 0 400 MATRIX_DIM 10 1 1 /end CHARACTERISTIC
/begin CHARACTERISTIC DINH_FId.DFC_LSD_VCV_SCB "part of DFC-FId relation matrix" VAL_BLK 0x39D3AA RL_UWORD 0 nse_FIdVerb 0 400 MATRIX_DIM 10 1 1 /end CHARACTERISTIC
/begin CHARACTERISTIC DINH_FId.DFC_LSD_VCV_OL "part of DFC-FId relation matrix" VAL_BLK 0x39D3BE RL_UWORD 0 nse_FIdVerb 0 400 MATRIX_DIM 10 1 1 /end CHARACTERISTIC
/begin CHARACTERISTIC DINH_FId.DFC_LSD_VCV_SCG "part of DFC-FId relation matrix" VAL_BLK 0x39D3D2 RL_UWORD 0 nse_FIdVerb 0 400 MATRIX_DIM 10 1 1 /end CHARACTERISTIC
/begin CHARACTERISTIC DINH_FId.DFC_LSD_START_SCB "part of DFC-FId relation matrix" VAL_BLK 0x39D3E6 RL_UWORD 0 nse_FIdVerb 0 400 MATRIX_DIM 10 1 1 /end CHARACTERISTIC
/begin CHARACTERISTIC DINH_FId.DFC_LSD_START_OL "part of DFC-FId relation matrix" VAL_BLK 0x39D3FA RL_UWORD 0 nse_FIdVerb 0 400 MATRIX_DIM 10 1 1 /end CHARACTERISTIC
/begin CHARACTERISTIC DINH_FId.DFC_LSD_START_SCG "part of DFC-FId relation matrix" VAL_BLK 0x39D40E RL_UWORD 0 nse_FIdVerb 0 400 MATRIX_DIM 10 1 1 /end CHARACTERISTIC
/begin CHARACTERISTIC DINH_FId.DFC_LSD_GLWLP_SCB "part of DFC-FId relation matrix" VAL_BLK 0x39D422 RL_UWORD 0 nse_FIdVerb 0 400 MATRIX_DIM 10 1 1 /end CHARACTERISTIC
/begin CHARACTERISTIC DINH_FId.DFC_LSD_GLWLP_OL "part of DFC-FId relation matrix" VAL_BLK 0x39D436 RL_UWORD 0 nse_FIdVerb 0 400 MATRIX_DIM 10 1 1 /end CHARACTERISTIC
/begin CHARACTERISTIC DINH_FId.DFC_LSD_GLWLP_SCG "part of DFC-FId relation matrix" VAL_BLK 0x39D44A RL_UWORD 0 nse_FIdVerb 0 400 MATRIX_DIM 10 1 1 /end CHARACTERISTIC
/begin CHARACTERISTIC DINH_FId.DFC_LSD_GLWRLY_SCB "part of DFC-FId relation matrix" VAL_BLK 0x39D45E RL_UWORD 0 nse_FIdVerb 0 400 MATRIX_DIM 10 1 1 /end CHARACTERISTIC
/begin CHARACTERISTIC DINH_FId.DFC_LSD_GLWRLY_OL "part of DFC-FId relation matrix" VAL_BLK 0x39D472 RL_UWORD 0 nse_FIdVerb 0 400 MATRIX_DIM 10 1 1 /end CHARACTERISTIC
/begin CHARACTERISTIC DINH_FId.DFC_LSD_GLWRLY_SCG "part of DFC-FId relation matrix" VAL_BLK 0x39D486 RL_UWORD 0 nse_FIdVerb 0 400 MATRIX_DIM 10 1 1 /end CHARACTERISTIC
/begin CHARACTERISTIC DINH_FId.DFC_LSD_VDD_OVERVOL "part of DFC-FId relation matrix" VAL_BLK 0x39D49A RL_UWORD 0 nse_FIdVerb 0 400 MATRIX_DIM 10 1 1 /end CHARACTERISTIC
/begin CHARACTERISTIC DINH_FId.DFC_LSD_VDD_UNDERVOL "part of DFC-FId relation matrix" VAL_BLK 0x39D4AE RL_UWORD 0 nse_FIdVerb 0 400 MATRIX_DIM 10 1 1 /end CHARACTERISTIC
/begin CHARACTERISTIC DINH_FId.DFC_MC33816_DRIVER_OT "part of DFC-FId relation matrix" VAL_BLK 0x39D4C2 RL_UWORD 0 nse_FIdVerb 0 400 MATRIX_DIM 10 1 1 /end CHARACTERISTIC
/begin CHARACTERISTIC DINH_FId.DFC_MC33816_INJ_CYL1SHORT "part of DFC-FId relation matrix" VAL_BLK 0x39D4D6 RL_UWORD 0 nse_FIdVerb 0 400 MATRIX_DIM 10 1 1 /end CHARACTERISTIC
/begin CHARACTERISTIC DINH_FId.DFC_MC33816_INJ_CYL2SHORT "part of DFC-FId relation matrix" VAL_BLK 0x39D4EA RL_UWORD 0 nse_FIdVerb 0 400 MATRIX_DIM 10 1 1 /end CHARACTERISTIC
/begin CHARACTERISTIC DINH_FId.DFC_MC33816_INJ_CYL3SHORT "part of DFC-FId relation matrix" VAL_BLK 0x39D4FE RL_UWORD 0 nse_FIdVerb 0 400 MATRIX_DIM 10 1 1 /end CHARACTERISTIC
/begin CHARACTERISTIC DINH_FId.DFC_MC33816_INJ_CYL4SHORT "part of DFC-FId relation matrix" VAL_BLK 0x39D512 RL_UWORD 0 nse_FIdVerb 0 400 MATRIX_DIM 10 1 1 /end CHARACTERISTIC
/begin CHARACTERISTIC DINH_FId.DFC_MC33816_INJ_CYL5SHORT "part of DFC-FId relation matrix" VAL_BLK 0x39D526 RL_UWORD 0 nse_FIdVerb 0 400 MATRIX_DIM 10 1 1 /end CHARACTERISTIC
/begin CHARACTERISTIC DINH_FId.DFC_MC33816_INJ_CYL6SHORT "part of DFC-FId relation matrix" VAL_BLK 0x39D53A RL_UWORD 0 nse_FIdVerb 0 400 MATRIX_DIM 10 1 1 /end CHARACTERISTIC
/begin CHARACTERISTIC DINH_FId.DFC_MC33816_INJ_CYL1OPEN "part of DFC-FId relation matrix" VAL_BLK 0x39D54E RL_UWORD 0 nse_FIdVerb 0 400 MATRIX_DIM 10 1 1 /end CHARACTERISTIC
/begin CHARACTERISTIC DINH_FId.DFC_MC33816_INJ_CYL2OPEN "part of DFC-FId relation matrix" VAL_BLK 0x39D562 RL_UWORD 0 nse_FIdVerb 0 400 MATRIX_DIM 10 1 1 /end CHARACTERISTIC
/begin CHARACTERISTIC DINH_FId.DFC_MC33816_INJ_CYL3OPEN "part of DFC-FId relation matrix" VAL_BLK 0x39D576 RL_UWORD 0 nse_FIdVerb 0 400 MATRIX_DIM 10 1 1 /end CHARACTERISTIC
/begin CHARACTERISTIC DINH_FId.DFC_MC33816_INJ_CYL4OPEN "part of DFC-FId relation matrix" VAL_BLK 0x39D58A RL_UWORD 0 nse_FIdVerb 0 400 MATRIX_DIM 10 1 1 /end CHARACTERISTIC
/begin CHARACTERISTIC DINH_FId.DFC_MC33816_INJ_CYL5OPEN "part of DFC-FId relation matrix" VAL_BLK 0x39D59E RL_UWORD 0 nse_FIdVerb 0 400 MATRIX_DIM 10 1 1 /end CHARACTERISTIC
/begin CHARACTERISTIC DINH_FId.DFC_MC33816_INJ_CYL6OPEN "part of DFC-FId relation matrix" VAL_BLK 0x39D5B2 RL_UWORD 0 nse_FIdVerb 0 400 MATRIX_DIM 10 1 1 /end CHARACTERISTIC
/begin CHARACTERISTIC DINH_FId.DFC_MC33816_INJ_CYL1_HOLD_ERR "part of DFC-FId relation matrix" VAL_BLK 0x39D5C6 RL_UWORD 0 nse_FIdVerb 0 400 MATRIX_DIM 10 1 1 /end CHARACTERISTIC
/begin CHARACTERISTIC DINH_FId.DFC_MC33816_INJ_CYL2_HOLD_ERR "part of DFC-FId relation matrix" VAL_BLK 0x39D5DA RL_UWORD 0 nse_FIdVerb 0 400 MATRIX_DIM 10 1 1 /end CHARACTERISTIC
/begin CHARACTERISTIC DINH_FId.DFC_MC33816_INJ_CYL3_HOLD_ERR "part of DFC-FId relation matrix" VAL_BLK 0x39D5EE RL_UWORD 0 nse_FIdVerb 0 400 MATRIX_DIM 10 1 1 /end CHARACTERISTIC
/begin CHARACTERISTIC DINH_FId.DFC_MC33816_INJ_CYL4_HOLD_ERR "part of DFC-FId relation matrix" VAL_BLK 0x39D602 RL_UWORD 0 nse_FIdVerb 0 400 MATRIX_DIM 10 1 1 /end CHARACTERISTIC
/begin CHARACTERISTIC DINH_FId.DFC_MC33816_INJ_CYL5_HOLD_ERR "part of DFC-FId relation matrix" VAL_BLK 0x39D616 RL_UWORD 0 nse_FIdVerb 0 400 MATRIX_DIM 10 1 1 /end CHARACTERISTIC
/begin CHARACTERISTIC DINH_FId.DFC_MC33816_INJ_CYL6_HOLD_ERR "part of DFC-FId relation matrix" VAL_BLK 0x39D62A RL_UWORD 0 nse_FIdVerb 0 400 MATRIX_DIM 10 1 1 /end CHARACTERISTIC
/begin CHARACTERISTIC DINH_FId.DFC_MC33816_INJ_CYL1_BOOST_ERR "part of DFC-FId relation matrix" VAL_BLK 0x39D63E RL_UWORD 0 nse_FIdVerb 0 400 MATRIX_DIM 10 1 1 /end CHARACTERISTIC
/begin CHARACTERISTIC DINH_FId.DFC_MC33816_INJ_CYL2_BOOST_ERR "part of DFC-FId relation matrix" VAL_BLK 0x39D652 RL_UWORD 0 nse_FIdVerb 0 400 MATRIX_DIM 10 1 1 /end CHARACTERISTIC
/begin CHARACTERISTIC DINH_FId.DFC_MC33816_INJ_CYL3_BOOST_ERR "part of DFC-FId relation matrix" VAL_BLK 0x39D666 RL_UWORD 0 nse_FIdVerb 0 400 MATRIX_DIM 10 1 1 /end CHARACTERISTIC
/begin CHARACTERISTIC DINH_FId.DFC_MC33816_INJ_CYL4_BOOST_ERR "part of DFC-FId relation matrix" VAL_BLK 0x39D67A RL_UWORD 0 nse_FIdVerb 0 400 MATRIX_DIM 10 1 1 /end CHARACTERISTIC
/begin CHARACTERISTIC DINH_FId.DFC_MC33816_INJ_CYL5_BOOST_ERR "part of DFC-FId relation matrix" VAL_BLK 0x39D68E RL_UWORD 0 nse_FIdVerb 0 400 MATRIX_DIM 10 1 1 /end CHARACTERISTIC
/begin CHARACTERISTIC DINH_FId.DFC_MC33816_INJ_CYL6_BOOST_ERR "part of DFC-FId relation matrix" VAL_BLK 0x39D6A2 RL_UWORD 0 nse_FIdVerb 0 400 MATRIX_DIM 10 1 1 /end CHARACTERISTIC
/begin CHARACTERISTIC DINH_FId.DFC_HBRIGE_POWER_FAIL "part of DFC-FId relation matrix" VAL_BLK 0x39D6B6 RL_UWORD 0 nse_FIdVerb 0 400 MATRIX_DIM 10 1 1 /end CHARACTERISTIC
/begin CHARACTERISTIC DINH_FId.DFC_HBRIGE_SCB "part of DFC-FId relation matrix" VAL_BLK 0x39D6CA RL_UWORD 0 nse_FIdVerb 0 400 MATRIX_DIM 10 1 1 /end CHARACTERISTIC
/begin CHARACTERISTIC DINH_FId.DFC_HBRIGE_SCG "part of DFC-FId relation matrix" VAL_BLK 0x39D6DE RL_UWORD 0 nse_FIdVerb 0 400 MATRIX_DIM 10 1 1 /end CHARACTERISTIC
/begin CHARACTERISTIC DINH_FId.DFC_HBRIGE_OL "part of DFC-FId relation matrix" VAL_BLK 0x39D6F2 RL_UWORD 0 nse_FIdVerb 0 400 MATRIX_DIM 10 1 1 /end CHARACTERISTIC
/begin CHARACTERISTIC DINH_FId.DFC_HBRIGE_TEMP_ERR "part of DFC-FId relation matrix" VAL_BLK 0x39D706 RL_UWORD 0 nse_FIdVerb 0 400 MATRIX_DIM 10 1 1 /end CHARACTERISTIC
/begin CHARACTERISTIC DINH_FId.DFC_ETPU_NOCRANK "part of DFC-FId relation matrix" VAL_BLK 0x39D71A RL_UWORD 0 nse_FIdVerb 0 400 MATRIX_DIM 10 1 1 /end CHARACTERISTIC
/begin CHARACTERISTIC DINH_FId.DFC_ETPU_NOCAM "part of DFC-FId relation matrix" VAL_BLK 0x39D72E RL_UWORD 0 nse_FIdVerb 0 400 MATRIX_DIM 10 1 1 /end CHARACTERISTIC
/begin CHARACTERISTIC DINH_FId.DFC_LSD_LAMP_OIL_WATER_SCB "part of DFC-FId relation matrix" VAL_BLK 0x39D742 RL_UWORD 0 nse_FIdVerb 0 400 MATRIX_DIM 10 1 1 /end CHARACTERISTIC
/begin CHARACTERISTIC DINH_FId.DFC_LSD_LAMP_OIL_WATER_OL "part of DFC-FId relation matrix" VAL_BLK 0x39D756 RL_UWORD 0 nse_FIdVerb 0 400 MATRIX_DIM 10 1 1 /end CHARACTERISTIC
/begin CHARACTERISTIC DINH_FId.DFC_LSD_LAMP_OIL_WATER_SCG "part of DFC-FId relation matrix" VAL_BLK 0x39D76A RL_UWORD 0 nse_FIdVerb 0 400 MATRIX_DIM 10 1 1 /end CHARACTERISTIC
/begin CHARACTERISTIC DINH_FId.DFC_LSD_FUL_CONSUMPT_SCB "part of DFC-FId relation matrix" VAL_BLK 0x39D77E RL_UWORD 0 nse_FIdVerb 0 400 MATRIX_DIM 10 1 1 /end CHARACTERISTIC
/begin CHARACTERISTIC DINH_FId.DFC_LSD_FUL_CONSUMPT_OL "part of DFC-FId relation matrix" VAL_BLK 0x39D792 RL_UWORD 0 nse_FIdVerb 0 400 MATRIX_DIM 10 1 1 /end CHARACTERISTIC
/begin CHARACTERISTIC DINH_FId.DFC_LSD_FUL_CONSUMPT_SCG "part of DFC-FId relation matrix" VAL_BLK 0x39D7A6 RL_UWORD 0 nse_FIdVerb 0 400 MATRIX_DIM 10 1 1 /end CHARACTERISTIC
/begin CHARACTERISTIC DINH_FId.DFC_LSD_OvrTemp "part of DFC-FId relation matrix" VAL_BLK 0x39D7BA RL_UWORD 0 nse_FIdVerb 0 400 MATRIX_DIM 10 1 1 /end CHARACTERISTIC
/begin CHARACTERISTIC DINH_FId.DFC_MC33816_INJ_CYL1_OTHER_ERR "part of DFC-FId relation matrix" VAL_BLK 0x39D7CE RL_UWORD 0 nse_FIdVerb 0 400 MATRIX_DIM 10 1 1 /end CHARACTERISTIC
/begin CHARACTERISTIC DINH_FId.DFC_MC33816_INJ_CYL2_OTHER_ERR "part of DFC-FId relation matrix" VAL_BLK 0x39D7E2 RL_UWORD 0 nse_FIdVerb 0 400 MATRIX_DIM 10 1 1 /end CHARACTERISTIC
/begin CHARACTERISTIC DINH_FId.DFC_MC33816_INJ_CYL3_OTHER_ERR "part of DFC-FId relation matrix" VAL_BLK 0x39D7F6 RL_UWORD 0 nse_FIdVerb 0 400 MATRIX_DIM 10 1 1 /end CHARACTERISTIC
/begin CHARACTERISTIC DINH_FId.DFC_MC33816_INJ_CYL4_OTHER_ERR "part of DFC-FId relation matrix" VAL_BLK 0x39D80A RL_UWORD 0 nse_FIdVerb 0 400 MATRIX_DIM 10 1 1 /end CHARACTERISTIC
/begin CHARACTERISTIC DINH_FId.DFC_MC33816_INJ_CYL5_OTHER_ERR "part of DFC-FId relation matrix" VAL_BLK 0x39D81E RL_UWORD 0 nse_FIdVerb 0 400 MATRIX_DIM 10 1 1 /end CHARACTERISTIC
/begin CHARACTERISTIC DINH_FId.DFC_MC33816_INJ_CYL6_OTHER_ERR "part of DFC-FId relation matrix" VAL_BLK 0x39D832 RL_UWORD 0 nse_FIdVerb 0 400 MATRIX_DIM 10 1 1 /end CHARACTERISTIC
/begin CHARACTERISTIC DINH_FId.DFC_ETPU_PHASE_ERR "part of DFC-FId relation matrix" VAL_BLK 0x39D846 RL_UWORD 0 nse_FIdVerb 0 400 MATRIX_DIM 10 1 1 /end CHARACTERISTIC
/begin CHARACTERISTIC DINH_FId.DFC_CAN1BUSOFF_ERR "part of DFC-FId relation matrix" VAL_BLK 0x39D85A RL_UWORD 0 nse_FIdVerb 0 400 MATRIX_DIM 10 1 1 /end CHARACTERISTIC
/begin CHARACTERISTIC DINH_FId.DFC_CAN2BUSOFF_ERR "part of DFC-FId relation matrix" VAL_BLK 0x39D86E RL_UWORD 0 nse_FIdVerb 0 400 MATRIX_DIM 10 1 1 /end CHARACTERISTIC
/begin CHARACTERISTIC DINH_FId.DFC_EEP_PROGRAM_ERR "part of DFC-FId relation matrix" VAL_BLK 0x39D882 RL_UWORD 0 nse_FIdVerb 0 400 MATRIX_DIM 10 1 1 /end CHARACTERISTIC
/begin CHARACTERISTIC DINH_FId.DFC_EEP_ERASE_ERR "part of DFC-FId relation matrix" VAL_BLK 0x39D896 RL_UWORD 0 nse_FIdVerb 0 400 MATRIX_DIM 10 1 1 /end CHARACTERISTIC
/begin CHARACTERISTIC DINH_FId.DFC_EEP_NOSPACE_ERR "part of DFC-FId relation matrix" VAL_BLK 0x39D8AA RL_UWORD 0 nse_FIdVerb 0 400 MATRIX_DIM 10 1 1 /end CHARACTERISTIC
/begin COMPU_VTAB nse_DFCVerb "" TAB_VERB 217 0 "--" 1 "DFC_EngPrtOvrSpd" 2 "DFC_CEngDsTSRCMax" 3 "DFC_CEngDsTSRCMin" 4 "DFC_CEngDsTPhysRngHi" 5 "DFC_CEngDsTPhysRngLo" 6 "DFC_SRCHighAPP1" 7 "DFC_SRCLowAPP1" 8 "DFC_SRCHighAPP2" 9 "DFC_SRCLowAPP2" 10 "DFC_SyncAPP" 11 "DFC_RailMeUn0" 12 "DFC_RailMeUn2" 13 "DFC_RailMeUn22" 14 "DFC_RailMeUn3" 15 "DFC_RailMeUn4" 16 "DFC_RailMeUn42" 17 "DFC_RailMeUn7" 18 "DFC_RailMeUn8" 19 "DFC_RailMeUn10" 20 "DFC_MeUnSRCMax" 21 "DFC_MeUnSRCMin" 22 "DFC_BattUSRCMax" 23 "DFC_BattUSRCMin" 24 "DFC_BattULo" 25 "DFC_BattUHi" 26 "DFC_MRlyStk" 27 "DFC_MRlyErlyOpng" 28 "DFC_SSpMonSplyMax" 29 "DFC_SSpMonSplyMin" 30 "DFC_SSpMonSply1Max" 31 "DFC_SSpMonSply1Min" 32 "DFC_BrkNpl" 33 "DFC_ClthNpl" 34 "DFC_EnvPSRCMax" 35 "DFC_EnvPSRCMin" 36 "DFC_EnvPPhysRngHi" 37 "DFC_EnvPPhysRngLo" 38 "DFC_EnvTSRCMax" 39 "DFC_EnvTSRCMin" 40 "DFC_EnvTPhysRngHi" 41 "DFC_EnvTPhysRngLo" 42 "DFC_PIntkVUsSRCMax" 43 "DFC_PIntkVUsSRCMin" 44 "DFC_PIntkVUsPhysRngHi" 45 "DFC_PIntkVUsPhysRngLo" 46 "DFC_PIntkVUsPlsHi" 47 "DFC_PIntkVUsPlsLo" 48 "DFC_TIntkVUsSRCMax" 49 "DFC_TIntkVUsSRCMin" 50 "DFC_FuelTSRCMax" 51 "DFC_FuelTSRCMin" 52 "DFC_FuelTVDPlausHi" 53 "DFC_FuelTVDPlausLo" 54 "DFC_OilPSwmpSRCMax" 55 "DFC_OilPSwmpSRCMin" 56 "DFC_OilPSwmpPhysRngHi" 57 "DFC_OilPSwmpPhysRngLo" 58 "DFC_OilTSRCMax" 59 "DFC_OilTSRCMin" 60 "DFC_OilTVDPlaus" 61 "DFC_CoETSLimInfo" 62 "DFC_TrbChOvrSpd" 63 "DFC_VehVMax" 64 "DFC_VehVPlaus" 65 "DFC_EGRVlvSRCMax" 66 "DFC_EGRVlvSRCMin" 67 "DFC_USELESS_67" 68 "DFC_USELESS_68" 69 "DFC_USELESS_69" 70 "DFC_USELESS_70" 71 "DFC_AFSSigErr" 72 "DFC_AFSSRCRawMin" 73 "DFC_AFSSetyDrftMin" 74 "DFC_AFSSetyDrftMax" 75 "DFC_AFSDrftIdlAdjVal" 76 "DFC_AFSDrftLdAdjVal" 77 "DFC_AFSDrftAdjPlausNPL" 78 "DFC_AFSDrftAdjPlausMax" 79 "DFC_TAFSDtyCycHi" 80 "DFC_TAFSDtyCycLo" 81 "DFC_TAFSPerHi" 82 "DFC_TAFSPerLo" 83 "DFC_MinPTOSwt" 84 "DFC_MaxPTOSwt" 85 "DFC_NplPTOSwt" 86 "DFC_AirCtl_bGovDvtMax" 87 "DFC_AirCtl_bGovDvtMin" 88 "DFC_EGRVlv_bEGRVlvLgTDrft" 89 "DFC_EGRVlv_bEGRVlvOfsLrnJamVlv" 90 "DFC_EGRVlv_bEGRVlvOfsPlaus" 91 "DFC_EGRVlv_bEGRVlvShTDrft" 92 "DFC_EGRVlv_bJamVlvClsd" 93 "DFC_EGRVlv_bJamVlvOpn" 94 "DFC_EGRVlv_bPhysRngHiDeb" 95 "DFC_EGRVlv_bPhysRngLoDeb" 96 "DFC_EGRVlv_bGovDvtMaxDeb" 97 "DFC_EGRVlv_bGovDvtMinDeb" 98 "DFC_PRVOpn" 99 "DFC_PRVRPOutOfRng" 100 "DFC_PRV_ctOpnMax" 101 "DFC_PRV_tiOpnMax" 102 "DFC_PRVwearout" 103 "DFC_DFC_stT50Err" 104 "DFC_RmtAPP_bSRCHigh1Deb" 105 "DFC_RmtAPP_bSRCHigh2Deb" 106 "DFC_RmtAPP_bSRCLow1Deb" 107 "DFC_RmtAPP_bSRCLow2Deb" 108 "DFC_RmtAPP_bSyncDeb" 109 "DFC_RailP_bSRCMaxDeb" 110 "DFC_RailP_bSRCMinDeb" 111 "DFC_Air_bVoltHiDebTAFS" 112 "DFC_Air_bVoltLoDebTAFS" 113 "DFC_USELESS_113" 114 "DFC_USELESS_114" 115 "DFC_USELESS_115" 201 "DFC_LSD_AirConditionRelay_SCB" 202 "DFC_LSD_AirConditionRelay_OL" 203 "DFC_LSD_AirConditionRelay_SCG" 204 "DFC_LSD_FuelHeat_SCB" 205 "DFC_LSD_FuelHeat_OL" 206 "DFC_LSD_FuelHeat_SCG" 207 "DFC_LSD_WFLGT_SCB" 208 "DFC_LSD_WFLGT_OL" 209 "DFC_LSD_WFLGT_SCG" 210 "DFC_LSD_VNT_SCB" 211 "DFC_LSD_VNT_OL" 212 "DFC_LSD_VNT_SCG" 213 "DFC_LSD_ENGN_SCB" 214 "DFC_LSD_ENGN_OL" 215 "DFC_LSD_ENGN_SCG" 216 "DFC_LSD_FANL_SCB" 217 "DFC_LSD_FANL_OL" 218 "DFC_LSD_FANL_SCG" 219 "DFC_LSD_ERRLGT_SCB" 220 "DFC_LSD_ERRLGT_OL" 221 "DFC_LSD_ERRLGT_SCG" 222 "DFC_LSD_OBDLGT_SCB" 223 "DFC_LSD_OBDLGT_OL" 224 "DFC_LSD_OBDLGT_SCG" 225 "DFC_LSD_EGR_SCB" 226 "DFC_LSD_EGR_OL" 227 "DFC_LSD_EGR_SCG" 228 "DFC_LSD_FANH_SCB" 229 "DFC_LSD_FANH_OL" 230 "DFC_LSD_FANH_SCG" 231 "DFC_LSD_ClntDsp_SCB" 232 "DFC_LSD_ClntDsp_OL" 233 "DFC_LSD_ClntDsp_SCG" 234 "DFC_LSD_F_V_SCB" 235 "DFC_LSD_F_V_OL" 236 "DFC_LSD_F_V_SCG" 237 "DFC_LSD_VCV_SCB" 238 "DFC_LSD_VCV_OL" 239 "DFC_LSD_VCV_SCG" 240 "DFC_LSD_START_SCB" 241 "DFC_LSD_START_OL" 242 "DFC_LSD_START_SCG" 243 "DFC_LSD_GLWLP_SCB" 244 "DFC_LSD_GLWLP_OL" 245 "DFC_LSD_GLWLP_SCG" 246 "DFC_LSD_GLWRLY_SCB" 247 "DFC_LSD_GLWRLY_OL" 248 "DFC_LSD_GLWRLY_SCG" 249 "DFC_LSD_VDD_OVERVOL" 250 "DFC_LSD_VDD_UNDERVOL" 251 "DFC_MC33816_DRIVER_OT" 252 "DFC_MC33816_INJ_CYL1SHORT" 253 "DFC_MC33816_INJ_CYL2SHORT" 254 "DFC_MC33816_INJ_CYL3SHORT" 255 "DFC_MC33816_INJ_CYL4SHORT" 256 "DFC_MC33816_INJ_CYL5SHORT" 257 "DFC_MC33816_INJ_CYL6SHORT" 258 "DFC_MC33816_INJ_CYL1OPEN" 259 "DFC_MC33816_INJ_CYL2OPEN" 260 "DFC_MC33816_INJ_CYL3OPEN" 261 "DFC_MC33816_INJ_CYL4OPEN" 262 "DFC_MC33816_INJ_CYL5OPEN" 263 "DFC_MC33816_INJ_CYL6OPEN" 264 "DFC_MC33816_INJ_CYL1_HOLD_ERR" 265 "DFC_MC33816_INJ_CYL2_HOLD_ERR" 266 "DFC_MC33816_INJ_CYL3_HOLD_ERR" 267 "DFC_MC33816_INJ_CYL4_HOLD_ERR" 268 "DFC_MC33816_INJ_CYL5_HOLD_ERR" 269 "DFC_MC33816_INJ_CYL6_HOLD_ERR" 270 "DFC_MC33816_INJ_CYL1_BOOST_ERR" 271 "DFC_MC33816_INJ_CYL2_BOOST_ERR" 272 "DFC_MC33816_INJ_CYL3_BOOST_ERR" 273 "DFC_MC33816_INJ_CYL4_BOOST_ERR" 274 "DFC_MC33816_INJ_CYL5_BOOST_ERR" 275 "DFC_MC33816_INJ_CYL6_BOOST_ERR" 276 "DFC_HBRIGE_POWER_FAIL" 277 "DFC_HBRIGE_SCB" 278 "DFC_HBRIGE_SCG" 279 "DFC_HBRIGE_OL" 280 "DFC_HBRIGE_TEMP_ERR" 281 "DFC_ETPU_NOCRANK" 282 "DFC_ETPU_NOCAM" 283 "DFC_LSD_LAMP_OIL_WATER_SCB" 284 "DFC_LSD_LAMP_OIL_WATER_OL" 285 "DFC_LSD_LAMP_OIL_WATER_SCG" 286 "DFC_LSD_FUL_CONSUMPT_SCB" 287 "DFC_LSD_FUL_CONSUMPT_OL" 288 "DFC_LSD_FUL_CONSUMPT_SCG" 289 "DFC_LSD_OvrTemp" 290 "DFC_MC33816_INJ_CYL1_OTHER_ERR" 291 "DFC_MC33816_INJ_CYL2_OTHER_ERR" 292 "DFC_MC33816_INJ_CYL3_OTHER_ERR" 293 "DFC_MC33816_INJ_CYL4_OTHER_ERR" 294 "DFC_MC33816_INJ_CYL5_OTHER_ERR" 295 "DFC_MC33816_INJ_CYL6_OTHER_ERR" 296 "DFC_ETPU_PHASE_ERR" 297 "DFC_CAN1BUSOFF_ERR" 298 "DFC_CAN2BUSOFF_ERR" 299 "DFC_EEP_PROGRAM_ERR" 300 "DFC_EEP_ERASE_ERR" 301 "DFC_EEP_NOSPACE_ERR" DEFAULT_VALUE "--" /end COMPU_VTAB
/begin COMPU_VTAB nse_FIdVerb "" TAB_VERB 131 0 "--" 1 "FId_RailPSS" 2 "FId_RailPSubsVal" 3 "FId_EngDemTrqLimErr1" 4 "FId_EngDemTrqLimErr2" 5 "FId_EngDemTrqLimErr3" 6 "FId_EngDemTrqLimErr4" 7 "FId_EngPrtNLimErr" 8 "FId_EngPrtOvhtPrv" 9 "FId_CEngDsTSS" 10 "FId_HLSDemDfrstI" 11 "FId_HLSDemUndrBrk" 12 "FId_HLSDemSetPLoDrvAwy" 13 "FId_HLSDemStrtCEngDsT" 14 "FId_HLSDemStrtOilT" 15 "FId_CoEngNrml2Strt" 16 "FId_APP1SigPath" 17 "FId_APP2SigPath" 18 "FId_APPBrkDef" 19 "FId_APPVel" 20 "FId_AccPedTrqLim" 21 "FId_AccPedNMaxLim" 22 "FId_AccPedNMinLim" 23 "FId_AccPedNMinLimBrkApp" 24 "FId_AccPed_PTSL" 25 "FId_ASDdc" 26 "FId_RailClsdPRV" 27 "FId_RailCtlLimp" 28 "FId_RailMeUnCtlUpLim" 29 "FId_RailMeUn0Rls" 30 "FId_RailMeUn0Blk" 31 "FId_RailMeUn2Rls" 32 "FId_RailMeUn2Blk" 33 "FId_RailMeUn22Rls" 34 "FId_RailMeUn22Blk" 35 "FId_RailMeUn3Rls" 36 "FId_RailMeUn3Blk" 37 "FId_RailMeUn4Rls" 38 "FId_RailMeUn4Blk" 39 "FId_RailMeUn42Rls" 40 "FId_RailMeUn42Blk" 41 "FId_RailMeUn7Rls" 42 "FId_RailMeUn7Blk" 43 "FId_RailMeUn8Rls" 44 "FId_RailMeUn8Blk" 45 "FId_RailMeUn10Rls" 46 "FId_RailMeUn10Blk" 47 "FId_RailMeUnErrMaxFlwDlv" 48 "FId_RailSetPointRed" 49 "FId_RailSetPointLim" 50 "FId_MeUnRot" 51 "FId_MeUnFrzI" 52 "FId_BattUSRC" 53 "FId_MRlyStk" 54 "FId_Clth" 55 "FId_EnvPSS" 56 "FId_EnvTSS" 57 "FId_VehVMon" 58 "FId_SSPIntkVUs" 59 "FId_PIntkVUsEnvPPls" 60 "FId_OilPSwmpSSErr" 61 "FId_OilTSS" 62 "FId_CoEngPthETZr" 63 "FId_CoEngPthFlQnt" 64 "FId_CoEngPthRPMin" 65 "FId_CoEngPthClsThr" 66 "FId_CoEngPthLpSysOff" 67 "FId_CoEngPthClsEGR" 68 "FId_CoEngPthTrqZr" 69 "FId_AirHtCEngDsT" 70 "FId_AirHtFuelT" 71 "FId_AirHtOilT" 72 "FId_AirHtEnvT" 73 "FId_AirHtCACDs" 74 "FId_FlSysDens" 75 "FId_CoVehPrpLimErr" 76 "FId_SubsValPrtTrqDfftl" 77 "FId_FrzPrtTrqDfftl" 78 "FId_SubsValRatTrqDfftl" 79 "FId_PTGripMnlClth" 80 "FId_PTTrqRatCANPtd" 81 "FId_TraAddAirCANPtd" 82 "FId_TraAddClntCANPtd" 83 "FId_TraGearDet" 84 "FId_TraRtnIntfcIdlSetP" 85 "FId_AirCtl" 86 "FId_AirCtlEGR" 87 "FId_AirCtlTVA" 88 "FId_AirCtlCmpntActv" 89 "FId_AirCtlGovDvt" 90 "FId_AirCtlBstPresCor" 91 "FId_AFSSRC" 92 "FId_AFSFrzAirMs" 93 "FId_AFSActrTst" 94 "FId_AFSPlSetyDrft" 95 "FId_AFSSysErr" 96 "FId_AFS" 97 "FId_CoordADCO" 98 "FId_TAFSSigMonRls" 99 "FId_AirCSwt" 100 "FId_RailBlkSht" 101 "FId_EGRVlvClnUp" 102 "FId_EGRVlvGovOn" 103 "FId_EGRVlvModVal" 104 "FId_EGRVlvOfsLrnInhib" 105 "FId_EGRVlvPhysRng" 106 "FId_EGRVlvReplVal" 107 "FId_EGRVlvSSpMon" 108 "FId_RmtAPP1SigPath" 109 "FId_RmtAPP2SigPath" 110 "FId_RmtAPPBrkDef" 111 "FId_RmtAPPVel" 112 "FId_T50" 113 "FId_FanCtl" 114 "FId_FanCtl2" 115 "FId_FanCtlCor" 116 "FId_FanCtlCor2" 117 "FId_FansVelCor" 118 "FId_AirHtAFST" 119 "FId_AirHtIntkVUsT" 120 "FId_USELESS_120" 121 "FId_USELESS_121" 122 "FId_USELESS_122" 123 "FId_USELESS_123" 124 "FId_USELESS_124" 125 "FId_USELESS_125" 126 "FId_USELESS_126" 127 "FId_USELESS_127" 128 "FId_USELESS_128" 129 "FId_USELESS_129" 130 "FId_GlbDaLSumvXPtd" DEFAULT_VALUE "--" /end COMPU_VTAB
/begin COMPU_VTAB nse_DFESstVerb "" TAB_VERB 7 0 "DFES_NOENTRY" 2 "DFES_PENDING" 3 "DFES_DEBOUNCED" 4 "DFES_SVCHISTORY" 5 "DFES_HEALING" 6 "DFES_HISTORY" 7 "DFES_HISTORYPEND" DEFAULT_VALUE "--" /end COMPU_VTAB
/begin CHARACTERISTIC EnvP_pTransf_CUR "This is SW-CALPRM" CURVE 0x3893A8 Lookup1D_WORD 0 AirPressure_kPa 0.0 1200.0
 /begin AXIS_DESCR COM_AXIS EnvP_uRaw Ad_mv 6 0.0 5000.0 AXIS_PTS_REF EnvP_pTransf_CURX /end AXIS_DESCR
/end CHARACTERISTIC
/begin CHARACTERISTIC EnvP_tiMaxDefDeb_C "debounce time" VALUE 0x3893C0 Scalar_ULONG 0 Debounce_ms 0.0 65535.0 /end CHARACTERISTIC
/begin CHARACTERISTIC EnvP_tiMaxOKDeb_C "debounce time" VALUE 0x3893C4 Scalar_ULONG 0 Debounce_ms 0.0 65535.0 /end CHARACTERISTIC
/begin CHARACTERISTIC EnvP_tiMinDefDeb_C "debounce time" VALUE 0x3893C8 Scalar_ULONG 0 Debounce_ms 0.0 65535.0 /end CHARACTERISTIC
/begin CHARACTERISTIC EnvP_tiMinOKDeb_C "debounce time" VALUE 0x3893CC Scalar_ULONG 0 Debounce_ms 0.0 65535.0 /end CHARACTERISTIC
/begin CHARACTERISTIC EnvP_tiPhysRngHiDefDeb_C "debounce time" VALUE 0x3893D0 Scalar_ULONG 0 Debounce_ms 0.0 65535.0 /end CHARACTERISTIC
/begin CHARACTERISTIC EnvP_tiPhysRngHiOKDeb_C "debounce time" VALUE 0x3893D4 Scalar_ULONG 0 Debounce_ms 0.0 65535.0 /end CHARACTERISTIC
/begin CHARACTERISTIC EnvP_tiPhysRngLoDefDeb_C "debounce time" VALUE 0x3893D8 Scalar_ULONG 0 Debounce_ms 0.0 65535.0 /end CHARACTERISTIC
/begin CHARACTERISTIC EnvP_tiPhysRngLoOKDeb_C "debounce time" VALUE 0x3893DC Scalar_ULONG 0 Debounce_ms 0.0 65535.0 /end CHARACTERISTIC
/begin CHARACTERISTIC EnvP_uSRCMax_C "Structure to hold SRC thresholds for adc voltage value of environment air pressure / Threshold for SRC -Max detection" VALUE 0x3893E0 Scalar_SWORD 0 Ad_mv 0.0 5000.0 /end CHARACTERISTIC
/begin CHARACTERISTIC EnvP_uSRCMin_C "Structure to hold SRC thresholds for adc voltage value of environment air pressure / Threshold for SRC -Min detection" VALUE 0x3893E2 Scalar_SWORD 0 Ad_mv 0.0 5000.0 /end CHARACTERISTIC
/begin CHARACTERISTIC EnvP_pPhysRngMax_C "Structure for Physical Range Check / Maximum threshold for the Sensed value." VALUE 0x3893A2 Scalar_SWORD 0 AirPressure_kPa 0.0 1200.0 /end CHARACTERISTIC
/begin CHARACTERISTIC EnvP_pPhysRngMin_C "Structure for Physical Range Check / Minimum threshold for the Sensed value." VALUE 0x3893A4 Scalar_SWORD 0 AirPressure_kPa 0.0 1200.0 /end CHARACTERISTIC
/begin AXIS_PTS EnvP_pTransf_CURX "EnvP_uRaw" 0x3893B4 EnvP_uRaw Lookup1D_X_WORD 0 Ad_mv 6 0.0 5000.0 /end AXIS_PTS
/begin CHARACTERISTIC EnvP_RmpSlpNeg_C "Structure for Ramp slope / negative ramp slope" VALUE 0x38939C Scalar_SWORD 0 AirPressure_kPa_s -1200.0 1200.0 /end CHARACTERISTIC
/begin CHARACTERISTIC EnvP_RmpSlpPos_C "Structure for Ramp slope / Slope if the ramp has to be increased" VALUE 0x38939E Scalar_SWORD 0 AirPressure_kPa_s -1200.0 1200.0 /end CHARACTERISTIC
/begin CHARACTERISTIC EnvP_pTransStgDfl_C "Default replacement value" VALUE 0x3893A6 Scalar_SWORD 0 AirPressure_kPa 0.0 1200.0 /end CHARACTERISTIC
/begin CHARACTERISTIC SigTst_pEnvP_C "Switch for environment pressure by hand" VALUE 0x39803E Scalar_SWORD 0 AirPressure_kPa 0.0 1200.0 /end CHARACTERISTIC
/begin CHARACTERISTIC EnvP_facPT1_C "PT1 filter time factor" VALUE 0x3893A0 Scalar_UWORD 0 PT_fac 0.0 99.9985 /end CHARACTERISTIC
/begin CHARACTERISTIC SigTst_swtEnvP_C "Set environment pressure by hand" VALUE 0x398076 Scalar_UBYTE 0 Switch_conv 0 1 /end CHARACTERISTIC
/begin CHARACTERISTIC EnvT_tTransf_CUR "Transformation curve from voltage to temperature" CURVE 0x3893F0 Lookup1D_WORD 0 Temp_deg -200.0 200.0
 /begin AXIS_DESCR COM_AXIS EnvT_uRaw Ad_mv 25 0.0 5000.0 AXIS_PTS_REF EnvT_tTransf_CURX /end AXIS_DESCR
/end CHARACTERISTIC
/begin CHARACTERISTIC EnvT_tiMaxDefDeb_C "debounce time" VALUE 0x389454 Scalar_ULONG 0 Debounce_ms 0.0 65535.0 /end CHARACTERISTIC
/begin CHARACTERISTIC EnvT_tiMaxOKDeb_C "debounce time" VALUE 0x389458 Scalar_ULONG 0 Debounce_ms 0.0 65535.0 /end CHARACTERISTIC
/begin CHARACTERISTIC EnvT_tiMinDefDeb_C "debounce time" VALUE 0x38945C Scalar_ULONG 0 Debounce_ms 0.0 65535.0 /end CHARACTERISTIC
/begin CHARACTERISTIC EnvT_tiMinOKDeb_C "debounce time" VALUE 0x389460 Scalar_ULONG 0 Debounce_ms 0.0 65535.0 /end CHARACTERISTIC
/begin CHARACTERISTIC EnvT_tiPhysRngHiDefDeb_C "debounce time" VALUE 0x389464 Scalar_ULONG 0 Debounce_ms 0.0 65535.0 /end CHARACTERISTIC
/begin CHARACTERISTIC EnvT_tiPhysRngHiOKDeb_C "debounce time" VALUE 0x389468 Scalar_ULONG 0 Debounce_ms 0.0 65535.0 /end CHARACTERISTIC
/begin CHARACTERISTIC EnvT_tiPhysRngLoDefDeb_C "debounce time" VALUE 0x38946C Scalar_ULONG 0 Debounce_ms 0.0 65535.0 /end CHARACTERISTIC
/begin CHARACTERISTIC EnvT_tiPhysRngLoOKDeb_C "debounce time" VALUE 0x389470 Scalar_ULONG 0 Debounce_ms 0.0 65535.0 /end CHARACTERISTIC
/begin CHARACTERISTIC EnvT_uSRCMax_C "Structure containing min and max values for SRC / Threshold for SRC -Max detection SRC -Max detection" VALUE 0x389474 Scalar_SWORD 0 Ad_mv 0.0 5000.0 /end CHARACTERISTIC
/begin CHARACTERISTIC EnvT_uSRCMin_C "Structure containing min and max values for SRC / Threshold for SRC -Min detection" VALUE 0x389476 Scalar_SWORD 0 Ad_mv 0.0 5000.0 /end CHARACTERISTIC
/begin CHARACTERISTIC EnvT_tPhysRngMax_C "Structure for Physical Range Check / Maximum threshold for the Sensed value." VALUE 0x3893EA Scalar_SWORD 0 Temp_deg -200.0 200.0 /end CHARACTERISTIC
/begin CHARACTERISTIC EnvT_tPhysRngMin_C "Structure for Physical Range Check / Minimum threshold for the Sensed value." VALUE 0x3893EC Scalar_SWORD 0 Temp_deg -200.0 200.0 /end CHARACTERISTIC
/begin AXIS_PTS EnvT_tTransf_CURX "EnvT_uRaw" 0x389422 EnvT_uRaw Lookup1D_X_WORD 0 Ad_mv 25 0.0 5000.0 /end AXIS_PTS
/begin CHARACTERISTIC EnvT_RmpSlpNeg_C "Structure for Ramp slope / negative ramp slope" VALUE 0x3893E4 Scalar_SWORD 0 Temp_deg_s -200.0 200.0 /end CHARACTERISTIC
/begin CHARACTERISTIC EnvT_RmpSlpPos_C "Structure for Ramp slope / Slope if the ramp has to be increased" VALUE 0x3893E6 Scalar_SWORD 0 Temp_deg_s -200.0 200.0 /end CHARACTERISTIC
/begin CHARACTERISTIC EnvT_tTransStgDfl_C "Default replacement value" VALUE 0x3893EE Scalar_SWORD 0 Temp_deg -200.0 200.0 /end CHARACTERISTIC
/begin CHARACTERISTIC SigTst_tEnvT_C "Switch for environment temperature by hand" VALUE 0x39809C Scalar_SWORD 0 Temp_deg -200.0 200.0 /end CHARACTERISTIC
/begin CHARACTERISTIC EnvT_facPT1_C "PT1 filter time factor" VALUE 0x3893E8 Scalar_UWORD 0 PT_fac 0.0 99.9985 /end CHARACTERISTIC
/begin CHARACTERISTIC SigTst_swtEnvT_C "Set environment temperature by hand" VALUE 0x398077 Scalar_UBYTE 0 Switch_conv 0 1 /end CHARACTERISTIC
/begin CHARACTERISTIC FuelConsDspl_rCnv_CUR "Transformation curve for setpoint to dutycycle conversion for FuelConsDspl" CURVE 0x389D12 Lookup1D_WORD 0 DutyCycle_rate 0.0 100.0
 /begin AXIS_DESCR COM_AXIS FlSys_dvolFlCons FlCon_L_h 25 0.0 327.0 AXIS_PTS_REF FuelConsDspl_rCnv_CURX /end AXIS_DESCR
/end CHARACTERISTIC
/begin CHARACTERISTIC FuelConsDspl_tiPer_C "Class Instance for PWM / Reference value for period duration (small type to limit dynamic range)" VALUE 0x389D7C Scalar_LONG 0 Time_PwmHigh_us -1.07374182E+8 1.07374182E+8 /end CHARACTERISTIC
/begin CHARACTERISTIC FuelConsDspl_stEna_C "Application parameter to enable or disable the powerstage" VALUE 0x389D76 Scalar_UWORD 0 State_uint16 0.0 65535.0 /end CHARACTERISTIC
/begin CHARACTERISTIC FuelConsDspl_stPsDiaDisbl_C "Application parameter to disable powerstage diagnosis of FuelConsDspl at different engine states and battery conditions" VALUE 0x389D78 Scalar_UWORD 0 State_uint16 0.0 65535.0 /end CHARACTERISTIC
/begin CHARACTERISTIC FuelConsDspl_stPsDisbl_C "Application parameter to disable powerstage of FuelConsDspl during different engine states and battery conditions" VALUE 0x389D7A Scalar_UWORD 0 State_uint16 0.0 65535.0 /end CHARACTERISTIC
/begin CHARACTERISTIC FuelConsDspl_O_P_C "Fue consumption indication output signal" VALUE 0x389D0E Scalar_SWORD 0 DutyCycle_rate 0.0 100.0 /end CHARACTERISTIC
/begin CHARACTERISTIC FuelConsDspl_bSwtPrs_C "Status for switch to active test demand of fuel consumption display" VALUE 0x389D11 Scalar_BOOLEAN 0 boolean 0.0 1.0 /end CHARACTERISTIC
/begin CHARACTERISTIC FuelConsDspl_PwmOut_swtBattCor_C "Class Instance for PWM Output / Switch to enable battery correction" VALUE 0x389D10 Scalar_UBYTE 0 Switch_conv 0 1 /end CHARACTERISTIC
/begin AXIS_PTS FuelConsDspl_rCnv_CURX "FlSys_dvolFlCons/ fuel consumption" 0x389D44 FlSys_dvolFlCons Lookup1D_X_WORD 0 FlCon_L_h 25 0.0 327.0 /end AXIS_PTS
/begin CHARACTERISTIC Gbx_NPosDeb_tiHiLo_C "Structure to hold Parameters for deboucing of gear nuetural position signal/Time for a High to Low transition" VALUE 0x389E18 Scalar_ULONG 0 Debounce_ms 0.0 65535.0 /end CHARACTERISTIC
/begin CHARACTERISTIC Gbx_NPosDeb_tiLoHi_C "Structure to hold Parameters for deboucing of gear nuetural position signal/Time for a Low to High transition" VALUE 0x389E1C Scalar_ULONG 0 Debounce_ms 0.0 65536.0 /end CHARACTERISTIC
/begin CHARACTERISTIC GlwLmp_stPsDiaDisbl_C "Application parameter to disable diagnosis of power stage for glow lamp actuator under certain battery and engine conditions" VALUE 0x389E34 Scalar_UWORD 0 State_uint16 0.0 65535.0 /end CHARACTERISTIC
/begin CHARACTERISTIC GlwLmp_stPsDisbl_C "Application parameter to disable power stage for glow lamp actuator under certain battery and engine conditions" VALUE 0x389E36 Scalar_UWORD 0 State_uint16 0.0 65535.0 /end CHARACTERISTIC
/begin CHARACTERISTIC SigTst_stGlwLmp_C "manual lamp state" VALUE 0x398061 Scalar_BOOLEAN 0 boolean 0.0 1.0 /end CHARACTERISTIC
/begin CHARACTERISTIC SigTst_swtGlwLmp_C "switch of manual lamp state" VALUE 0x39807C Scalar_UBYTE 0 Switch_conv 0 1 /end CHARACTERISTIC
/begin CHARACTERISTIC OilPLmp_tiDebABSPos_C "ABS braking Off indicator time" VALUE 0x39557C Scalar_ULONG 0 uint32 0.0 4.294967295E+9 /end CHARACTERISTIC
/begin CHARACTERISTIC OilPLmp_tiInactv1_C "During the Startup1 braking Off indicator time" VALUE 0x395580 Scalar_ULONG 0 uint32 0.0 4.294967295E+9 /end CHARACTERISTIC
/begin CHARACTERISTIC OilPLmp_tiInactv2_C "During the Startup2 braking Off indicator time" VALUE 0x395584 Scalar_ULONG 0 uint32 0.0 4.294967295E+9 /end CHARACTERISTIC
/begin CHARACTERISTIC OilPLmp_tiStrt_C "a time calibration value" VALUE 0x395588 Scalar_ULONG 0 uint32 0.0 4.294967295E+9 /end CHARACTERISTIC
/begin CHARACTERISTIC OilPLmp_aMin_C "The engine speed least acceleration hresholds" VALUE 0x39556E Scalar_UWORD 0 uint16 0.0 65535.0 /end CHARACTERISTIC
/begin CHARACTERISTIC OilPLmp_nStrt1_C "engine speed exceeds the threshold1" VALUE 0x395570 Scalar_UWORD 0 uint16 0.0 65535.0 /end CHARACTERISTIC
/begin CHARACTERISTIC OilPLmp_nStrt2_C "engine speed exceeds the threshold2" VALUE 0x395572 Scalar_UWORD 0 uint16 0.0 65535.0 /end CHARACTERISTIC
/begin CHARACTERISTIC OilPLmp_stPsDiaDisbl_C "Powerstage diagnosis disabling" VALUE 0x395574 Scalar_UWORD 0 uint16 0.0 65535.0 /end CHARACTERISTIC
/begin CHARACTERISTIC OilPLmp_stPsDisbl_C "Powerstage Disabling" VALUE 0x395576 Scalar_UWORD 0 uint16 0.0 65535.0 /end CHARACTERISTIC
/begin CHARACTERISTIC OilPLmp_vMin_C "The engine speed least hresholds" VALUE 0x39558C Scalar_UWORD 0 uint16 0.0 65535.0 /end CHARACTERISTIC
/begin CHARACTERISTIC OILP_STOILPRESOPT_SY_C "The system constant" VALUE 0x39556C Scalar_BOOLEAN 0 boolean 0.0 1.0 /end CHARACTERISTIC
/begin CHARACTERISTIC OilPLmp_swtStrt_C "During the Startup" VALUE 0x395578 Scalar_BOOLEAN 0 boolean 0.0 1.0 /end CHARACTERISTIC
/begin CHARACTERISTIC PTOEnblSwt_tiDebHiLo_C "debounce Time for a High to Low  transition" VALUE 0x395744 Scalar_ULONG 0 Debounce_ms 0.0 65535.0 /end CHARACTERISTIC
/begin CHARACTERISTIC PTOEnblSwt_tiDebLoHi_C "debounce Time for a Low to High transition" VALUE 0x395748 Scalar_ULONG 0 Debounce_ms 0.0 65535.0 /end CHARACTERISTIC
/begin CHARACTERISTIC PTOEnblSwt_stDflVal_C "Default value for the PTO enable switch status" VALUE 0x395740 Scalar_BOOLEAN 0 boolean 0.0 1.0 /end CHARACTERISTIC
/begin CHARACTERISTIC PTOEnblSwt_swtSigSel_C "Signal source selection for the PTO enable switch status" VALUE 0x395741 Scalar_UBYTE 0 Switch_conv 0 1 /end CHARACTERISTIC
/begin CHARACTERISTIC MoFPTO_uTransf_CUR "Curve for linearising the ADC voltage" CURVE 0x39554A Lookup1D_WORD 0 Ad_mv 0.0 5000.0
 /begin AXIS_DESCR COM_AXIS PTOSwt_uRaw Ad_mv 4 0.0 5000.0 AXIS_PTS_REF MoFPTO_uTransf_CURX /end AXIS_DESCR
/end CHARACTERISTIC
/begin CHARACTERISTIC PTOSwt_tiMaxDebDef_C "DDRC / Duration of defect debouncing for check DFC_MaxPTOSwt" VALUE 0x395750 Scalar_ULONG 0 Debounce_ms 0.0 65535.0 /end CHARACTERISTIC
/begin CHARACTERISTIC PTOSwt_tiMaxDebOk_C "DDRC / Duration of healing debouncing for check DFC_MaxPTOSwt" VALUE 0x395754 Scalar_ULONG 0 Debounce_ms 0.0 65535.0 /end CHARACTERISTIC
/begin CHARACTERISTIC PTOSwt_tiMinDebDef_C "DDRC / Duration of defect debouncing for check DFC_MinPTOSwt" VALUE 0x395758 Scalar_ULONG 0 Debounce_ms 0.0 65535.0 /end CHARACTERISTIC
/begin CHARACTERISTIC PTOSwt_tiMinDebOk_C "DDRC / Duration of healing debouncing for check DFC_MinPTOSwt" VALUE 0x39575C Scalar_ULONG 0 Debounce_ms 0.0 65535.0 /end CHARACTERISTIC
/begin CHARACTERISTIC PTOSwt_tiNplDebDef_C "DDRC / Duration of defect debouncing for check DFC_NplPTOSwt" VALUE 0x395760 Scalar_ULONG 0 Debounce_ms 0.0 65535.0 /end CHARACTERISTIC
/begin CHARACTERISTIC PTOSwt_tiNplDebOK_C "DDRC / Duration of healing debouncing for check DFC_NplPTOSwt" VALUE 0x395764 Scalar_ULONG 0 Debounce_ms 0.0 65535.0 /end CHARACTERISTIC
/begin CHARACTERISTIC MoFPTO_uThresCalMsgA_CA "message to level 1 for Calibration array to realize the PTO switch setting based on ADC voltageacceleration monitoring" VAL_BLK 0x395536 Scalar_SWORD 0 Ad_mv 0.0 5000.0 NUMBER 10 /end CHARACTERISTIC
/begin CHARACTERISTIC PTOSwt_uSRCMax_C "upper voltage threshold to recognize SRC max error" VALUE 0x395768 Scalar_SWORD 0 Ad_mv 0.0 5000.0 /end CHARACTERISTIC
/begin CHARACTERISTIC PTOSwt_uSRCMin_C "lower voltage threshold to recognize SRC min error" VALUE 0x39576A Scalar_SWORD 0 Ad_mv 0.0 5000.0 /end CHARACTERISTIC
/begin AXIS_PTS MoFPTO_uTransf_CURX "Transformation axis to linearise the ADC voltage" 0x395552 PTOSwt_uRaw Lookup1D_X_WORD 0 Ad_mv 4 0.0 5000.0 /end AXIS_PTS
/begin CHARACTERISTIC PTOSwt_stDfl_C "Default value of the switch state when there is an error" VALUE 0x39574E Scalar_UBYTE 0 State_uint8 0.0 255.0 /end CHARACTERISTIC
/begin CHARACTERISTIC SigTst_stPTOSwt "Set PTO switch state by hand" VALUE 0x398063 Scalar_UBYTE 0 State_uint8 0.0 255.0 /end CHARACTERISTIC
/begin CHARACTERISTIC PTOSwt_bDfl_C "Default value when PTO enable switch is not active" VALUE 0x39574C Scalar_BOOLEAN 0 boolean 0.0 1.0 /end CHARACTERISTIC
/begin CHARACTERISTIC PTOSwt_bEnblSwt_C "Switch to active PTO enable switch" VALUE 0x39574D Scalar_BOOLEAN 0 boolean 0.0 1.0 /end CHARACTERISTIC
/begin CHARACTERISTIC SigTst_swtPTOSwt "Switch to select PTO switch value" VALUE 0x398087 Scalar_UBYTE 0 Switch_conv 0 1 /end CHARACTERISTIC
/begin CHARACTERISTIC RmtAPP_tiAliveDebHiLo_C "Debounce times for alive detection of RmtAPP / Time for a High to Low transition" VALUE 0x397CB8 Scalar_ULONG 0 Debounce_ms 0.0 1000.0 /end CHARACTERISTIC
/begin CHARACTERISTIC RmtAPP_tiAliveDebLoHi_C "Debounce times for alive detection of RmtAPP / Time for a Low to High transition" VALUE 0x397CBC Scalar_ULONG 0 Debounce_ms 0.0 1000.0 /end CHARACTERISTIC
/begin CHARACTERISTIC RmtAPP_drLimNeg_C "Ramp slope for substitutevalue in case of RmtAPP/Brake plausibilityerror / negative ramp slope" VALUE 0x397C7C Scalar_LONG 0 Accpedal_rate_s -200.0 200.0 /end CHARACTERISTIC
/begin CHARACTERISTIC RmtAPP_drLimPos_C "Ramp slope for substitutevalue in case of RmtAPP/Brake plausibilityerror / Slope if the ramp has to be increased" VALUE 0x397C80 Scalar_LONG 0 Accpedal_rate_s -200.0 200.0 /end CHARACTERISTIC
/begin CHARACTERISTIC RmtAPP_drLimpMax_C "Limit for RmtAPP gradient in limphome mode" VALUE 0x397C84 Scalar_LONG 0 Accpedal_rate_s -200.0 200.0 /end CHARACTERISTIC
/begin CHARACTERISTIC RmtAPP_rLimpMax_C "Limit for RmtAPP value in limphome mode" VALUE 0x397CA0 Scalar_SWORD 0 Accpedal_rate 0.0 100.0 /end CHARACTERISTIC
/begin CHARACTERISTIC RmtAPP_rPlaMaxVal_C "Maximum RmtAPP value when plausibility with brake failed" VALUE 0x397CA2 Scalar_SWORD 0 Accpedal_rate 0.0 100.0 /end CHARACTERISTIC
/begin CHARACTERISTIC RmtAPP_rThresAliveDet_C "RmtAPP threshold for alive detection" VALUE 0x397CAC Scalar_SWORD 0 Accpedal_rate 0.0 100.0 /end CHARACTERISTIC
/begin CHARACTERISTIC RmtAPP_swtAliveDetEna_C "Switch to enable alive detection" VALUE 0x397CAF Scalar_UBYTE 0 Switch_conv 0 1 /end CHARACTERISTIC
/begin CHARACTERISTIC RmtAPP_swtPlaChkEna_C "Switch to enable plausibility check with brake" VALUE 0x397CB4 Scalar_UBYTE 0 Switch_conv 0 1 /end CHARACTERISTIC
/begin CHARACTERISTIC RmtAPP_tiSRCHighDefDeb_C "debounce time" VALUE 0x397CD0 Scalar_ULONG 0 Debounce_ms 0.0 1000.0 /end CHARACTERISTIC
/begin CHARACTERISTIC RmtAPP_tiSRCHighOKDeb_C "debounce time" VALUE 0x397CD4 Scalar_ULONG 0 Debounce_ms 0.0 1000.0 /end CHARACTERISTIC
/begin CHARACTERISTIC RmtAPP_tiSRCLowDefDeb_C "debounce time" VALUE 0x397CD8 Scalar_ULONG 0 Debounce_ms 0.0 1000.0 /end CHARACTERISTIC
/begin CHARACTERISTIC RmtAPP_tiSRCLowOKDeb_C "debounce time" VALUE 0x397CDC Scalar_ULONG 0 Debounce_ms 0.0 1000.0 /end CHARACTERISTIC
/begin CHARACTERISTIC RmtAPP_uRaw1Def_C "Substitute value for sensor 1 defect" VALUE 0x397CE8 Scalar_SWORD 0 Ad_mv 0.0 5000.0 /end CHARACTERISTIC
/begin CHARACTERISTIC RmtAPP_uRaw1SRCHigh_C "voltage upper threshold of channel 1" VALUE 0x397CEA Scalar_SWORD 0 Ad_mv 0.0 5000.0 /end CHARACTERISTIC
/begin CHARACTERISTIC RmtAPP_uRaw1SRCLow_C "voltage lower threshold of channel 1" VALUE 0x397CEC Scalar_SWORD 0 Ad_mv 0.0 5000.0 /end CHARACTERISTIC
/begin CHARACTERISTIC RmtAPP_uRaw2Def_C "Substitute value for sensor 2 defect" VALUE 0x397CEE Scalar_SWORD 0 Ad_mv 0.0 5000.0 /end CHARACTERISTIC
/begin CHARACTERISTIC RmtAPP_uRaw2SRCHigh_C "voltage upper threshold of channel 2" VALUE 0x397CF2 Scalar_SWORD 0 Ad_mv 0.0 5000.0 /end CHARACTERISTIC
/begin CHARACTERISTIC RmtAPP_uRaw2SRCLow_C "voltage lower threshold of channel 2" VALUE 0x397CF4 Scalar_SWORD 0 Ad_mv 0.0 5000.0 /end CHARACTERISTIC
/begin CHARACTERISTIC MoFRmtAPP_dRawSigFac_C "Factor between the voltage of APP1 and APP2" VALUE 0x39555A Scalar_SWORD 0 Factor 0.0 8.0 /end CHARACTERISTIC
/begin CHARACTERISTIC RmtAPP_stAPPChannelNum_C "RmtAPP Channel number: 0-1Channel   1-2Channels" VALUE 0x397CAE Scalar_BOOLEAN 0 boolean 0.0 1.0 /end CHARACTERISTIC
/begin CHARACTERISTIC RmtAPP_uKDHighAPP_C "Upper threshold for kickdown hysteresis" VALUE 0x397CE4 Scalar_SWORD 0 Ad_mv 0.0 5000.0 /end CHARACTERISTIC
/begin CHARACTERISTIC RmtAPP_uKDLowAPP_C "Lower threshold for kickdown hysteresis" VALUE 0x397CE6 Scalar_SWORD 0 Ad_mv 0.0 5000.0 /end CHARACTERISTIC
/begin CHARACTERISTIC SigTst_stRmtAPPKickDown_C "Status of RmtAPP kickdown test signal" VALUE 0x398064 Scalar_BOOLEAN 0 boolean 0.0 1.0 /end CHARACTERISTIC
/begin CHARACTERISTIC SigTst_swtRmtAPPKickDown_C "Switch to test the Kickdown status" VALUE 0x398090 Scalar_UBYTE 0 Switch_conv 0 1 /end CHARACTERISTIC
/begin CHARACTERISTIC MoFRmtAPP_uSync_CUR "Curve to calculate permitted maximum for difference of signal voltages of sensor 1 and sensor 2" CURVE 0x395564 Lookup1D_WORD 0 Ad_mv 0.0 5000.0
 /begin AXIS_DESCR COM_AXIS RmtAPP_uMin12half_mp Ad_mv 2 0.0 5000.0 AXIS_PTS_REF MoFRmtAPP_uSync_CURX /end AXIS_DESCR
/end CHARACTERISTIC
/begin CHARACTERISTIC RmtAPP_PlaAPPDefDeb_C "debounce time fot the defect detection of sync check" VALUE 0x397C74 Scalar_ULONG 0 Debounce_ms 0.0 1000.0 /end CHARACTERISTIC
/begin CHARACTERISTIC RmtAPP_PlaAPPDefOK_C "debounce time for the healing of sync check" VALUE 0x397C78 Scalar_ULONG 0 Debounce_ms 0.0 1000.0 /end CHARACTERISTIC
/begin CHARACTERISTIC RmtAPP_uSyncMin_C "Minimum voltage to enable sync check" VALUE 0x397CF6 Scalar_SWORD 0 Ad_mv 0.0 5000.0 /end CHARACTERISTIC
/begin AXIS_PTS MoFRmtAPP_uSync_CURX "Curve axis for calculate permitted maximum for difference of signal voltages of sensor 1 and sensor 2" 0x395568 RmtAPP_uMin12half_mp Lookup1D_X_WORD 0 Ad_mv 2 0.0 5000.0 /end AXIS_PTS
/begin CHARACTERISTIC RmtAPP_tiGradCondDebHiLo_C "Debounce times for Gradient condition for RmtAPP/Brake plausibility / Time for a High to Low transition" VALUE 0x397CC0 Scalar_ULONG 0 Debounce_ms 0.0 1000.0 /end CHARACTERISTIC
/begin CHARACTERISTIC RmtAPP_tiGradCondDebLoHi_C "Debounce times for Gradient condition for RmtAPP/Brake plausibility / Time for a Low to High transition" VALUE 0x397CC4 Scalar_ULONG 0 Debounce_ms 0.0 1000.0 /end CHARACTERISTIC
/begin CHARACTERISTIC RmtAPP_tiPlaBrkDetDeb_C "Debounce time for detection of RmtAPP/Brake plausibility" VALUE 0x397CC8 Scalar_ULONG 0 Debounce_ms 0.0 1000.0 /end CHARACTERISTIC
/begin CHARACTERISTIC RmtAPP_tiPlaBrkRstDeb_C "Debounce Time for reset of plausibility error with brake" VALUE 0x397CCC Scalar_ULONG 0 Debounce_ms 0.0 1000.0 /end CHARACTERISTIC
/begin CHARACTERISTIC RmtAPP_drUnFltLim_C "Threshold for RmtAPP gradient to reset plausibility with brake" VALUE 0x397C8C Scalar_LONG 0 Accpedal_rate_s -200.0 200.0 /end CHARACTERISTIC
/begin CHARACTERISTIC RmtAPP_nLim_C "threshold for engine speed to skip security check" VALUE 0x397C9E Scalar_SWORD 0 EngSpeed_rpm 0.0 6000.0 /end CHARACTERISTIC
/begin CHARACTERISTIC RmtAPP_vLim_C "threshold for vehicle speed to skip security check" VALUE 0x397CF8 Scalar_SWORD 0 VehSpeed_km_h 0.0 200.0 /end CHARACTERISTIC
/begin CHARACTERISTIC RmtAPP_swtAppGradEna_C "Switch to enable reset plausibility with brake by RmtAPP gradient" VALUE 0x397CB0 Scalar_UBYTE 0 Switch_conv 0 1 /end CHARACTERISTIC
/begin CHARACTERISTIC RmtAPP_swtBrkDet_C "Switch to choose brake signal detection by value or edge" VALUE 0x397CB1 Scalar_UBYTE 0 Switch_conv 0 1 /end CHARACTERISTIC
/begin CHARACTERISTIC RmtAPP_swtRstCon_C "Switch to choose reset condition for plausibility" VALUE 0x397CB5 Scalar_UBYTE 0 Switch_conv 0 1 /end CHARACTERISTIC
/begin CHARACTERISTIC RmtAPP_duLimErrPos_C "error ramp within the selction of mastersignal /positive ramp slope" VALUE 0x397C90 Scalar_SWORD 0 Ad_mv_s 0.0 5000.0 /end CHARACTERISTIC
/begin CHARACTERISTIC RmtAPP_uAPPDef_C "Substitute value if both sensors are defect" VALUE 0x397CE0 Scalar_SWORD 0 Ad_mv 0.0 5000.0 /end CHARACTERISTIC
/begin CHARACTERISTIC RmtAPP_uRaw2Offset_C "Offset for sensor signal 2" VALUE 0x397CF0 Scalar_SWORD 0 Ad_mv 0.0 5000.0 /end CHARACTERISTIC
/begin CHARACTERISTIC MoFRmtAPP_rLinAPPCURCalMsgA_CUR "the physical value of accpedal" CURVE 0x39555C Lookup1D_WORD 0 Accpedal_rate 0.0 100.0
 /begin AXIS_DESCR COM_AXIS RmtAPP_uUnJit_mp Ad_mv 2 0.0 5000.0 AXIS_PTS_REF MoFRmtAPP_rLinAPPCURCalMsgA_CURX /end AXIS_DESCR
/end CHARACTERISTIC
/begin CHARACTERISTIC RmtAPP_drLinRmp_C "Permissible amount of accpedal value when vehicle quits limp mode" VALUE 0x397C88 Scalar_LONG 0 Accpedal_rate_s -200.0 200.0 /end CHARACTERISTIC
/begin CHARACTERISTIC RmtAPP_uJitter_C "Threshold for unjittering" VALUE 0x397CE2 Scalar_SWORD 0 Ad_mv 0.0 5000.0 /end CHARACTERISTIC
/begin CHARACTERISTIC RmtAPP_rThrFltLowNeg_C "Threshold for low/mid-range Filter parameter falling signal" VALUE 0x397CA4 Scalar_SWORD 0 Accpedal_rate 0.0 100.0 /end CHARACTERISTIC
/begin CHARACTERISTIC RmtAPP_rThrFltLowPos_C "Threshold for low/mid-range Filter parameter rising signal" VALUE 0x397CA6 Scalar_SWORD 0 Accpedal_rate 0.0 100.0 /end CHARACTERISTIC
/begin CHARACTERISTIC RmtAPP_rThrFltMidNeg_C "Threshold for mid/high-range Filter parameter falling signal" VALUE 0x397CA8 Scalar_SWORD 0 Accpedal_rate 0.0 100.0 /end CHARACTERISTIC
/begin CHARACTERISTIC RmtAPP_rThrFltMidPos_C "Threshold for mid/high-range Filter parameter rising signal" VALUE 0x397CAA Scalar_SWORD 0 Accpedal_rate 0.0 100.0 /end CHARACTERISTIC
/begin CHARACTERISTIC SigTst_rRmtAPP_C "set the accpedal value" VALUE 0x398058 Scalar_SWORD 0 Accpedal_rate 0.0 100.0 /end CHARACTERISTIC
/begin CHARACTERISTIC RmtAPP_facLowNegPT1_C "Filter parameter falling signal low range" VALUE 0x397C92 Scalar_UWORD 0 PT_fac 0.0 99.9985 /end CHARACTERISTIC
/begin CHARACTERISTIC RmtAPP_facLowPosPT1_C "Filter parameter rising signal low range" VALUE 0x397C94 Scalar_UWORD 0 PT_fac 0.0 99.9985 /end CHARACTERISTIC
/begin CHARACTERISTIC RmtAPP_facMidNegPT1_C "Filter parameter falling signal mid range" VALUE 0x397C96 Scalar_UWORD 0 PT_fac 0.0 99.9985 /end CHARACTERISTIC
/begin CHARACTERISTIC RmtAPP_facMidPosPT1_C "Filter parameter rising signal mid range" VALUE 0x397C98 Scalar_UWORD 0 PT_fac 0.0 99.9985 /end CHARACTERISTIC
/begin CHARACTERISTIC RmtAPP_facUppNegPT1_C "Filter parameter falling signal high range" VALUE 0x397C9A Scalar_UWORD 0 PT_fac 0.0 99.9985 /end CHARACTERISTIC
/begin CHARACTERISTIC RmtAPP_facUppPosPT1_C "Filter parameter rising signal high range" VALUE 0x397C9C Scalar_UWORD 0 PT_fac 0.0 99.9985 /end CHARACTERISTIC
/begin CHARACTERISTIC RmtAPP_swtEnaFlt_C "Switch to enable PT1" VALUE 0x397CB2 Scalar_UBYTE 0 Switch_conv 0 1 /end CHARACTERISTIC
/begin CHARACTERISTIC RmtAPP_swtEnaUnJit_C "Switch to enable unjittering" VALUE 0x397CB3 Scalar_UBYTE 0 Switch_conv 0 1 /end CHARACTERISTIC
/begin CHARACTERISTIC SigTst_swtRmtAPP_C "Switch to set accpedal value" VALUE 0x398091 Scalar_UBYTE 0 Switch_conv 0 1 /end CHARACTERISTIC
/begin AXIS_PTS MoFRmtAPP_rLinAPPCURCalMsgA_CURX "accpedal axis" 0x395560 RmtAPP_uUnJit_mp Lookup1D_X_WORD 0 Ad_mv 2 0.0 5000.0 /end AXIS_PTS
/begin CHARACTERISTIC SpdDemSwt_tiDebHiLo_C "Parameter structure for debounce times of main brake switch / Time for a High to Low transition" VALUE 0x39A3F4 Scalar_ULONG 0 Debounce_ms 0.0 65535.0 /end CHARACTERISTIC
/begin CHARACTERISTIC SpdDemSwt_tiDebLoHi_C "Parameter structure for debounce times of main brake switch / Time for a Low to High transition" VALUE 0x39A3F8 Scalar_ULONG 0 Debounce_ms 0.0 65535.0 /end CHARACTERISTIC
/begin CHARACTERISTIC SigTst_stSpdDemSwt_C "switch to select speed demand signal source" VALUE 0x398065 Scalar_BOOLEAN 0 boolean 0.0 1.0 /end CHARACTERISTIC
/begin CHARACTERISTIC SpdDemSwt_stEnable "switch to enable speed demand signal source" VALUE 0x39A3F0 Scalar_BOOLEAN 0 boolean 0.0 1.0 /end CHARACTERISTIC
/begin CHARACTERISTIC SigTst_swtSpdDemSwt_C "set peed demand signal value by hand" VALUE 0x398095 Scalar_UBYTE 0 Switch_conv 0 1 /end CHARACTERISTIC
/begin CHARACTERISTIC SpdGovSwt_tiDebHiLo_C "debounce Time for a High to Low  transition" VALUE 0x39A400 Scalar_ULONG 0 Debounce_ms 0.0 65535.0 /end CHARACTERISTIC
/begin CHARACTERISTIC SpdGovSwt_tiDebLoHi_C "debounce Time for a Low to High transition" VALUE 0x39A404 Scalar_ULONG 0 Debounce_ms 0.0 65535.0 /end CHARACTERISTIC
/begin CHARACTERISTIC SigTst_stSpdGovDflVal_C "sigtst value for the speed governor switch status" VALUE 0x398066 Scalar_BOOLEAN 0 boolean 0.0 1.0 /end CHARACTERISTIC
/begin CHARACTERISTIC SpdGovSwt_stDflVal_C "Default value for the speed governor switch status" VALUE 0x39A3FC Scalar_BOOLEAN 0 boolean 0.0 1.0 /end CHARACTERISTIC
/begin CHARACTERISTIC SigTst_swtSpdGovSwt_C "Signal source selection for the speed governor switch status" VALUE 0x398096 Scalar_UBYTE 0 Switch_conv 0 1 /end CHARACTERISTIC
/begin CHARACTERISTIC TClntDspl_tiPer_C "Class Instance for PWM / Reference value for period duration (small type to limit dynamic range)" VALUE 0x39ADEC Scalar_LONG 0 Time_PwmHigh_us -1.07374182E+8 1.07374182E+8 /end CHARACTERISTIC
/begin CHARACTERISTIC TClntDspl_stEna_C "Application parameter to enable or disable the powerstage" VALUE 0x39ADE6 Scalar_UWORD 0 State_uint16 0.0 65535.0 /end CHARACTERISTIC
/begin CHARACTERISTIC TClntDspl_stPsDiaDisbl_C "Application parameter to disable powerstage diagnosis of TClntDspl at different engine states and battery conditions" VALUE 0x39ADE8 Scalar_UWORD 0 State_uint16 0.0 65535.0 /end CHARACTERISTIC
/begin CHARACTERISTIC TClntDspl_stPsDisbl_C "Application parameter to disable powerstage of TClntDspl during different engine states and battery conditions" VALUE 0x39ADEA Scalar_UWORD 0 State_uint16 0.0 65535.0 /end CHARACTERISTIC
/begin CHARACTERISTIC TClntDspl_rCnv_CURX "CEngDsT_t" VAL_BLK 0x39ADB4 Scalar_SWORD 0 Temp_deg -50.0 200.0 NUMBER 25 /end CHARACTERISTIC
/begin CHARACTERISTIC TClntDspl_O_P_ATS "Coolant temperature indication output signal" VALUE 0x39ADB0 Scalar_SWORD 0 DutyCycle_rate 0.0 100.0 /end CHARACTERISTIC
/begin CHARACTERISTIC TClntDspl_bSwtPrs_C "Status for switch to active test demand of coolant temperature display" VALUE 0x39ADB3 Scalar_BOOLEAN 0 boolean 0.0 1.0 /end CHARACTERISTIC
/begin CHARACTERISTIC TClntDspl_PwmOut_swtBattCor_C "Class Instance for PWM Output / Switch to enable battery correction" VALUE 0x39ADB2 Scalar_UBYTE 0 Switch_conv 0 1 /end CHARACTERISTIC
/begin CHARACTERISTIC VehV_ImpPerDist_C "application value of the k-factor" VALUE 0x39B184 Scalar_SWORD 0 VehV_ImpPerMeter 1.0 32.0 /end CHARACTERISTIC
/begin CHARACTERISTIC VehV_numImpCrdSh_C "Number of Cardan shaft pulses" VALUE 0x39B194 Scalar_SWORD 0 VehV_ImpPerCrdSh 1.0 32.0 /end CHARACTERISTIC
/begin CHARACTERISTIC VehV_bSwtPrs_C "sensor switch" VALUE 0x39B186 Scalar_BOOLEAN 0 boolean 0.0 1.0 /end CHARACTERISTIC
/begin CHARACTERISTIC VehV_tiDebMonPla_C "Time window for which the engine torque and the engine speed are monitored for detection of plausibility error of the vehicle speed" VALUE 0x39B198 Scalar_ULONG 0 Debounce_ms 0.0 65535.0 /end CHARACTERISTIC
/begin CHARACTERISTIC VehV_trqThresPla_C "Engine torque threshold for detecting the plausibility error in vehicle speed" VALUE 0x39B19C Scalar_SWORD 0 Trq_Nm -1000.0 1000.0 /end CHARACTERISTIC
/begin CHARACTERISTIC SigTst_nCrdSh_C "Cardan shaft speed for signal test" VALUE 0x398038 Scalar_SWORD 0 EngSpeed_rpm 0.0 6000.0 /end CHARACTERISTIC
/begin CHARACTERISTIC VehV_nCrdShDfl_C "Default value of cardan shaft speed" VALUE 0x39B18E Scalar_SWORD 0 EngSpeed_rpm 0.0 6000.0 /end CHARACTERISTIC
/begin CHARACTERISTIC VehV_nMinCrdSh_C "Minimum speed threshold for recording the cardan shaft speed" VALUE 0x39B190 Scalar_SWORD 0 EngSpeed_rpm 0.0 6000.0 /end CHARACTERISTIC
/begin CHARACTERISTIC VehV_nThresPla_C "Engine speed threshold for detecting the plausibility error in vehicle speed" VALUE 0x39B192 Scalar_SWORD 0 EngSpeed_rpm 0.0 6000.0 /end CHARACTERISTIC
/begin CHARACTERISTIC SigTst_vVehV_C "Vehicle speed for signal test" VALUE 0x3980B6 Scalar_SWORD 0 VehSpeed_km_h 0.0 250.0 /end CHARACTERISTIC
/begin CHARACTERISTIC VehV_vDfl_C "Default vehicle speed value in case the sensed vehicle speed crosses Min or Max limits" VALUE 0x39B19E Scalar_SWORD 0 VehSpeed_km_h 0.0 250.0 /end CHARACTERISTIC
/begin CHARACTERISTIC VehV_vMax_C "Vehicle speed maximum limit" VALUE 0x39B1A0 Scalar_SWORD 0 VehSpeed_km_h 0.0 250.0 /end CHARACTERISTIC
/begin CHARACTERISTIC VehV_vMin_C "Vehicle speed minimum limit" VALUE 0x39B1A2 Scalar_SWORD 0 VehSpeed_km_h 0.0 250.0 /end CHARACTERISTIC
/begin CHARACTERISTIC VehV_vThresPla_C "Vehicle speed threshold for detecting the plausibility error in vehicle speed" VALUE 0x39B1A4 Scalar_SWORD 0 VehSpeed_km_h 0.0 250.0 /end CHARACTERISTIC
/begin CHARACTERISTIC VehV_facAPT1_C "PT1 filter factor constant for filtering the raw value of vehicle acceleration" VALUE 0x39B188 Scalar_UWORD 0 PT_fac 0.0 99.9 /end CHARACTERISTIC
/begin CHARACTERISTIC VehV_facNCrdShPT1_C "PT1 Filter factor constant for Cardan shaft speed " VALUE 0x39B18A Scalar_UWORD 0 PT_fac 0.0 99.9 /end CHARACTERISTIC
/begin CHARACTERISTIC VehV_facVPT1_C "PT1 filter factor constant for the vehicle speed" VALUE 0x39B18C Scalar_UWORD 0 PT_fac 0.0 99.9 /end CHARACTERISTIC
/begin CHARACTERISTIC SigTst_swtCrDSh "Switch for Cardan shaft speed by hand" VALUE 0x398074 Scalar_UBYTE 0 Switch_conv 0 1 /end CHARACTERISTIC
/begin CHARACTERISTIC SigTst_swtVehV "Switch for Vehicle speed by hand" VALUE 0x398099 Scalar_UBYTE 0 Switch_conv 0 1 /end CHARACTERISTIC
/begin CHARACTERISTIC VehV_swtTrqSel_C "Switch for the selection of the engine torque calculation method" VALUE 0x39B196 Scalar_UBYTE 0 Switch_conv 0 1 /end CHARACTERISTIC
/begin MEASUREMENT EnvP_bSRCMax "SRC-Max error of Environment pressure sensor" UBYTE boolean 0 0 0.0 1.0 ECU_ADDRESS 0x40022C3A /end MEASUREMENT
/begin MEASUREMENT EnvP_bSRCMin "SRC-Min error of Environment pressure sensor" UBYTE boolean 0 0 0.0 1.0 ECU_ADDRESS 0x40022C3B /end MEASUREMENT
/begin MEASUREMENT EnvP_bPhysRngHi "Physical-High of Environment pressure sensor" UBYTE boolean 0 0 0.0 1.0 ECU_ADDRESS 0x40022C3C /end MEASUREMENT
/begin MEASUREMENT EnvP_bPhysRngLo "Physical-Low of Environment pressure sensor" UBYTE boolean 0 0 0.0 1.0 ECU_ADDRESS 0x40022C3D /end MEASUREMENT
/begin MEASUREMENT EnvT_bSRCMax "SRC-Max error of Environment pressure sensor" UBYTE boolean 0 0 0.0 1.0 ECU_ADDRESS 0x40022C48 /end MEASUREMENT
/begin MEASUREMENT EnvT_bSRCMin "SRC-Min error of Environment pressure sensor" UBYTE boolean 0 0 0.0 1.0 ECU_ADDRESS 0x40022C49 /end MEASUREMENT
/begin MEASUREMENT EnvT_bPhysRngHi "Physical-High of Environment pressure sensor" UBYTE boolean 0 0 0.0 1.0 ECU_ADDRESS 0x40022C4A /end MEASUREMENT
/begin MEASUREMENT EnvT_bPhysRngLo "Physical-Low of Environment pressure sensor" UBYTE boolean 0 0 0.0 1.0 ECU_ADDRESS 0x40022C4B /end MEASUREMENT
/begin MEASUREMENT GlwLmp_stShutOffPs "Digital output shutoff state" UBYTE boolean 0 0 0.0 1.0 ECU_ADDRESS 0x40022D47 /end MEASUREMENT
/begin MEASUREMENT OilPLmp_bVehV "车速和发动机转速判断油压" UBYTE boolean 0 0 0.0 1.0 ECU_ADDRESS 0x400230FE /end MEASUREMENT
/begin MEASUREMENT OilPLmp_bEngstar "发动机转速判断油压，启动1" UBYTE boolean 0 0 0.0 1.0 ECU_ADDRESS 0x400230FF /end MEASUREMENT
/begin MEASUREMENT OilPLmp_bPSwmp "油压状态" UBYTE boolean 0 0 0.0 1.0 ECU_ADDRESS 0x40023100 /end MEASUREMENT
/begin MEASUREMENT OilPLmp_bCoEng "发动机状态判断油压" UBYTE boolean 0 0 0.0 1.0 ECU_ADDRESS 0x40023101 /end MEASUREMENT
/begin MEASUREMENT MoFPTO_swtPos_mp "Measurement point to indicate PTO switch position" UBYTE uint8 0 0 0.0 255.0 ECU_ADDRESS 0x40023156 /end MEASUREMENT
/begin MEASUREMENT RmtAPP_rPla_mp "RmtAPP value after plausibility check with brake" SWORD Accpedal_rate 0 0 0.0 100.0 ECU_ADDRESS 0x40023224 /end MEASUREMENT
/begin MEASUREMENT RmtAPP_rUnLim_mp "RmtAPP value not limited by alive detection" SWORD Accpedal_rate 0 0 0.0 100.0 ECU_ADDRESS 0x40023226 /end MEASUREMENT
/begin MEASUREMENT RmtAPP_stAlive_mp "State of APP alive detection of APP" UBYTE boolean 0 0 0.0 1.0 ECU_ADDRESS 0x40023228 /end MEASUREMENT
/begin MEASUREMENT RmtAPP_bSRCHigh1 "Status temporary SRC-High error Sensor 1" UBYTE boolean 0 0 0.0 1.0 ECU_ADDRESS 0x40023234 /end MEASUREMENT
/begin MEASUREMENT RmtAPP_bSRCLow1 "Status temporary SRC-Low error Sensor 1" UBYTE boolean 0 0 0.0 1.0 ECU_ADDRESS 0x40023235 /end MEASUREMENT
/begin MEASUREMENT RmtAPP_bSRCHigh2 "Status temporary SRC-High error Sensor 2" UBYTE boolean 0 0 0.0 1.0 ECU_ADDRESS 0x40023236 /end MEASUREMENT
/begin MEASUREMENT RmtAPP_bSRCLow2 "Status temporary SRC-Low error Sensor 2" UBYTE boolean 0 0 0.0 1.0 ECU_ADDRESS 0x40023237 /end MEASUREMENT
/begin MEASUREMENT RmtAPP_uDiff_mp "Difference between signal voltages of sensor 1 and sensor 2" SWORD Ad_mv 0 0 0.0 5000.0 ECU_ADDRESS 0x4002323A /end MEASUREMENT
/begin MEASUREMENT RmtAPP_uMin12half_mp "Minimum of signal 1 and signal 2 in range of signal 2" SWORD Ad_mv 0 0 0.0 5000.0 ECU_ADDRESS 0x4002323C /end MEASUREMENT
/begin MEASUREMENT RmtAPP_uDiffMax_mp "Permitted maximum for difference of signal voltages of sensor 1 and sensor 2" SWORD Ad_mv 0 0 0.0 5000.0 ECU_ADDRESS 0x4002323E /end MEASUREMENT
/begin MEASUREMENT RmtAPP_stAPP_mp "State of detection accelerate" UBYTE boolean 0 0 0.0 1.0 ECU_ADDRESS 0x40023240 /end MEASUREMENT
/begin MEASUREMENT RmtAPP_stBrk_mp "State of detection brake" UBYTE boolean 0 0 0.0 1.0 ECU_ADDRESS 0x40023241 /end MEASUREMENT
/begin MEASUREMENT RmtAPP_stTempErr_mp "Status for temporary errors" UBYTE boolean 0 0 0.0 1.0 ECU_ADDRESS 0x40023242 /end MEASUREMENT
/begin MEASUREMENT RmtAPP_rUnFlt_mp "Unfiltered RmtAPP value" SWORD Accpedal_rate 0 0 0.0 100.0 ECU_ADDRESS 0x40023248 /end MEASUREMENT
/begin MEASUREMENT RmtAPP_facPT1 "Filter time" UWORD PT_fac 0 0 0.0 99.9985 ECU_ADDRESS 0x4002324A /end MEASUREMENT
/begin MEASUREMENT VehV_nCrdShUnFlt_mp "unfiltered value of cardan schaft speed" SWORD EngSpeed_rpm 0 0 0.0 6000.0 ECU_ADDRESS 0x40023446 /end MEASUREMENT
/begin MEASUREMENT VehV_vUnFlt_mp "Unfiltered vehicle speed" SWORD VehSpeed_km_h 0 0 0.0 250.0 ECU_ADDRESS 0x40023448 /end MEASUREMENT
/begin MEASUREMENT VehV_aUnFlt_mp "unfiltered value of vehicle acceleration" SWORD Acc_m_s2 0 0 -32.7 32.7 ECU_ADDRESS 0x4002344A /end MEASUREMENT
/begin MEASUREMENT VehV_bPlaChkDeb "status of plausibility check of the engine speed and torque against the vehicle speed" UBYTE boolean 0 0 0.0 1.0 ECU_ADDRESS 0x4002344C /end MEASUREMENT
/begin COMPU_METHOD EngSpeed_rpm "f(x)=(c1*X*X+c2*X+c3)/(c4*X*X+c5*X+c6)" RAT_FUNC "%6.1" "rpm" COEFFS 0 2.000 0.000 0 0 1.000 /end COMPU_METHOD
/begin COMPU_METHOD State_uint8 "f(x)=(c1*X*X+c2*X+c3)/(c4*X*X+c5*X+c6)" RAT_FUNC "%3.0" "" COEFFS 0 1 0 0 0 1 /end COMPU_METHOD
/begin COMPU_METHOD State_uint16 "f(x)=(c1*X*X+c2*X+c3)/(c4*X*X+c5*X+c6)" RAT_FUNC "%5.0" "" COEFFS 0 1 0 0 0 1 /end COMPU_METHOD
/begin COMPU_METHOD Trq_Nm "f(x)=(c1*X*X+c2*X+c3)/(c4*X*X+c5*X+c6)" RAT_FUNC "%0.3" "Nm" COEFFS 0 10.000 0.000 0 0 1.000 /end COMPU_METHOD
/begin COMPU_METHOD AirPressure_kPa "f(x)=(c1*X*X+c2*X+c3)/(c4*X*X+c5*X+c6)" RAT_FUNC "%0.3" "kPa" COEFFS 0 10.000 0.000 0 0 1.000 /end COMPU_METHOD
/begin COMPU_METHOD boolean "f(x)=(c1*X*X+c2*X+c3)/(c4*X*X+c5*X+c6)" RAT_FUNC "%1.0" "" COEFFS 0 1 0 0 0 1 /end COMPU_METHOD
/begin COMPU_METHOD uint8 "f(x)=(c1*X*X+c2*X+c3)/(c4*X*X+c5*X+c6)" RAT_FUNC "%3.0" "" COEFFS 0 1 0 0 0 1 /end COMPU_METHOD
/begin COMPU_METHOD Time_PwmHigh_us "f(x)=(c1*X*X+c2*X+c3)/(c4*X*X+c5*X+c6)" RAT_FUNC "%0.3" "us" COEFFS 0 20.000 0.000 0 0 1.000 /end COMPU_METHOD
/begin COMPU_METHOD DutyCycle_rate "f(x)=(c1*X*X+c2*X+c3)/(c4*X*X+c5*X+c6)" RAT_FUNC "%0.3" "%" COEFFS 0 100.000 0.000 0 0 1.000 /end COMPU_METHOD
/begin COMPU_METHOD Ad_mv "f(x)=(c1*X*X+c2*X+c3)/(c4*X*X+c5*X+c6)" RAT_FUNC "%5.0" "mv" COEFFS 0 1 0 0 0 1 /end COMPU_METHOD
/begin COMPU_METHOD Debounce_ms "f(x)=(c1*X*X+c2*X+c3)/(c4*X*X+c5*X+c6)" RAT_FUNC "%10.0" "ms" COEFFS 0 1 0 0 0 1 /end COMPU_METHOD
/begin COMPU_METHOD Accpedal_rate_s "f(x)=(c1*X*X+c2*X+c3)/(c4*X*X+c5*X+c6)" RAT_FUNC "%0.3" "%/s" COEFFS 0 81.920 0.000 0 0 1.000 /end COMPU_METHOD
/begin COMPU_METHOD VehSpeed_km_h "f(x)=(c1*X*X+c2*X+c3)/(c4*X*X+c5*X+c6)" RAT_FUNC "%0.3" "km/h" COEFFS 0 100.000 0.000 0 0 1.000 /end COMPU_METHOD
/begin COMPU_METHOD FlCon_L_h "f(x)=(c1*X*X+c2*X+c3)/(c4*X*X+c5*X+c6)" RAT_FUNC "%0.3" "L/h" COEFFS 0 100.000 0.000 0 0 1.000 /end COMPU_METHOD
/begin COMPU_METHOD Temp_deg "f(x)=(c1*X*X+c2*X+c3)/(c4*X*X+c5*X+c6)" RAT_FUNC "%0.3" "deg" COEFFS 0 10.000 2731.400 0 0 1.000 /end COMPU_METHOD
/begin COMPU_METHOD Temp_deg_s "f(x)=(c1*X*X+c2*X+c3)/(c4*X*X+c5*X+c6)" RAT_FUNC "%0.3" "deg/s" COEFFS 0 10.000 2731.400 0 0 1.000 /end COMPU_METHOD
/begin COMPU_METHOD PT_fac "f(x)=(c1*X*X+c2*X+c3)/(c4*X*X+c5*X+c6)" RAT_FUNC "%0.3" "" COEFFS 0 655.360 0.000 0 0 1.000 /end COMPU_METHOD
/begin COMPU_METHOD Accpedal_rate "f(x)=(c1*X*X+c2*X+c3)/(c4*X*X+c5*X+c6)" RAT_FUNC "%0.3" "%" COEFFS 0 81.920 0.000 0 0 1.000 /end COMPU_METHOD
/begin COMPU_METHOD Acc_m_s2 "f(x)=(c1*X*X+c2*X+c3)/(c4*X*X+c5*X+c6)" RAT_FUNC "%0.3" "m/s^2" COEFFS 0 1000.000 0.000 0 0 1.000 /end COMPU_METHOD
/begin COMPU_METHOD Factor "f(x)=(c1*X*X+c2*X+c3)/(c4*X*X+c5*X+c6)" RAT_FUNC "%12.6" "" COEFFS 0 1024.000 0.000 0 0 1.000 /end COMPU_METHOD
/begin COMPU_METHOD Switch_conv "Enumerated data type: Switch_conv" TAB_VERB "%0.3" "" COMPU_TAB_REF VTAB_FOR_Switch_conv /end COMPU_METHOD
/begin COMPU_METHOD uint32 "f(x)=(c1*X*X+c2*X+c3)/(c4*X*X+c5*X+c6)" RAT_FUNC "%10.0" "" COEFFS 0 1 0 0 0 1 /end COMPU_METHOD
/begin COMPU_METHOD AirPressure_kPa_s "f(x)=(c1*X*X+c2*X+c3)/(c4*X*X+c5*X+c6)" RAT_FUNC "%0.3" "kPa/s" COEFFS 0 10.000 0.000 0 0 1.000 /end COMPU_METHOD
/begin COMPU_METHOD uint16 "f(x)=(c1*X*X+c2*X+c3)/(c4*X*X+c5*X+c6)" RAT_FUNC "%5.0" "" COEFFS 0 1 0 0 0 1 /end COMPU_METHOD
/begin COMPU_METHOD Ad_mv_s "f(x)=(c1*X*X+c2*X+c3)/(c4*X*X+c5*X+c6)" RAT_FUNC "%5.0" "mv/s" COEFFS 0 1 0 0 0 1 /end COMPU_METHOD
/begin COMPU_METHOD VehV_ImpPerMeter "f(x)=(c1*X*X+c2*X+c3)/(c4*X*X+c5*X+c6)" RAT_FUNC "%0.3" "Imp/m" COEFFS 0 100.000 0.000 0 0 1.000 /end COMPU_METHOD
/begin COMPU_METHOD VehV_ImpPerCrdSh "f(x)=(c1*X*X+c2*X+c3)/(c4*X*X+c5*X+c6)" RAT_FUNC "%0.3" "" COEFFS 0 100.000 0.000 0 0 1.000 /end COMPU_METHOD
/begin COMPU_VTAB VTAB_FOR_Switch_conv "Enumerated data type: Switch_conv" TAB_VERB 2 0 "OFF" 1 "ON" /end COMPU_VTAB
/begin GROUP Root_PRC_Debounce1 "EnvP_DD/PRC_Debounce"
 /begin REF_CHARACTERISTIC EnvP_pPhysRngMax_C EnvP_pPhysRngMin_C EnvP_tiPhysRngHiDefDeb_C EnvP_tiPhysRngHiOKDeb_C EnvP_tiPhysRngLoDefDeb_C EnvP_tiPhysRngLoOKDeb_C /end REF_CHARACTERISTIC
 /begin REF_MEASUREMENT EnvP_bPhysRngHi EnvP_bPhysRngLo /end REF_MEASUREMENT
/end GROUP
/begin GROUP Root_SRC_Debounce1 "EnvP_DD/SRC_Debounce"
 /begin REF_CHARACTERISTIC EnvP_pTransf_CUR EnvP_tiMaxDefDeb_C EnvP_tiMaxOKDeb_C EnvP_tiMinDefDeb_C EnvP_tiMinOKDeb_C EnvP_uSRCMax_C EnvP_uSRCMin_C /end REF_CHARACTERISTIC
 /begin REF_MEASUREMENT EnvP_bSRCMax EnvP_bSRCMin /end REF_MEASUREMENT
/end GROUP
/begin GROUP EnvP_VD "EnvP_VD"
 /begin REF_CHARACTERISTIC EnvP_RmpSlpNeg_C EnvP_RmpSlpPos_C EnvP_facPT1_C EnvP_pTransStgDfl_C SigTst_pEnvP_C SigTst_swtEnvP_C /end REF_CHARACTERISTIC
/end GROUP
/begin GROUP EnvT_DD "EnvT_DD" /begin SUB_GROUP Root_PRC_Debounce2 Root_SRC_Debounce2 /end SUB_GROUP /end GROUP
/begin GROUP Root_PRC_Debounce2 "EnvT_DD/PRC_Debounce"
 /begin REF_CHARACTERISTIC EnvT_tPhysRngMax_C EnvT_tPhysRngMin_C EnvT_tiPhysRngHiDefDeb_C EnvT_tiPhysRngHiOKDeb_C EnvT_tiPhysRngLoDefDeb_C EnvT_tiPhysRngLoOKDeb_C /end REF_CHARACTERISTIC
 /begin REF_MEASUREMENT EnvT_bPhysRngHi EnvT_bPhysRngLo /end REF_MEASUREMENT
/end GROUP
/begin GROUP Root_SRC_Debounce2 "EnvT_DD/SRC_Debounce"
 /begin REF_CHARACTERISTIC EnvT_tTransf_CUR EnvT_tiMaxDefDeb_C EnvT_tiMaxOKDeb_C EnvT_tiMinDefDeb_C EnvT_tiMinOKDeb_C EnvT_uSRCMax_C EnvT_uSRCMin_C /end REF_CHARACTERISTIC
 /begin REF_MEASUREMENT EnvT_bSRCMax EnvT_bSRCMin /end REF_MEASUREMENT
/end GROUP
/begin GROUP EnvT_VD "EnvT_VD"
 /begin REF_CHARACTERISTIC EnvT_RmpSlpNeg_C EnvT_RmpSlpPos_C EnvT_facPT1_C EnvT_tTransStgDfl_C SigTst_swtEnvT_C SigTst_tEnvT_C /end REF_CHARACTERISTIC
/end GROUP
/begin GROUP FuelConsDspl_DD "FuelConsDspl_DD"
 /begin REF_CHARACTERISTIC FuelConsDspl_O_P_C FuelConsDspl_PwmOut_swtBattCor_C FuelConsDspl_bSwtPrs_C FuelConsDspl_rCnv_CUR FuelConsDspl_stEna_C FuelConsDspl_stPsDiaDisbl_C FuelConsDspl_stPsDisbl_C FuelConsDspl_tiPer_C /end REF_CHARACTERISTIC
/end GROUP
/begin GROUP GbxNPos_DD "GbxNPos_DD" /begin REF_CHARACTERISTIC Gbx_NPosDeb_tiHiLo_C Gbx_NPosDeb_tiLoHi_C /end REF_CHARACTERISTIC /end GROUP
/begin GROUP GlwLmp_DD "GlwLmp_DD"
 /begin REF_CHARACTERISTIC GlwLmp_stPsDiaDisbl_C GlwLmp_stPsDisbl_C SigTst_stGlwLmp_C SigTst_swtGlwLmp_C /end REF_CHARACTERISTIC
 /begin REF_MEASUREMENT GlwLmp_stShutOffPs /end REF_MEASUREMENT
/end GROUP
/begin GROUP OilPLmp_DD "OilPLmp_DD" /begin SUB_GROUP Root_Device_Driver_for_Oil_pressure_lamp /end SUB_GROUP /end GROUP
/begin GROUP Root_Device_Driver_for_Oil_pressure_lamp "OilPLmp_DD/Device Driver for Oil pressure lamp"
 /begin SUB_GROUP S1_ABS_braking S1_During_the_Startup_ S1_Function_in_normal_mode S1_engine_is_in_afterrun S1_oil_pressure_status /end SUB_GROUP
/end GROUP
/begin GROUP S1_ABS_braking "OilPLmp_DD/Device Driver for Oil pressure lamp/ABS braking"
 /begin REF_CHARACTERISTIC OilPLmp_aMin_C OilPLmp_tiDebABSPos_C OilPLmp_tiInactv1_C OilPLmp_vMin_C /end REF_CHARACTERISTIC
 /begin REF_MEASUREMENT OilPLmp_bVehV /end REF_MEASUREMENT
/end GROUP
/begin GROUP S1_During_the_Startup_ "OilPLmp_DD/Device Driver for Oil pressure lamp/During the Startup "
 /begin SUB_GROUP S3_OilPLmp_swtStrt_C_Less_than_1 S3_OilPLmp_swtStrt_C__Greater_than_1 /end SUB_GROUP
 /begin REF_CHARACTERISTIC OilPLmp_swtStrt_C /end REF_CHARACTERISTIC
 /begin REF_MEASUREMENT OilPLmp_bEngstar /end REF_MEASUREMENT
/end GROUP
/begin GROUP S1_Function_in_normal_mode "OilPLmp_DD/Device Driver for Oil pressure lamp/Function in normal mode" /begin REF_CHARACTERISTIC OilPLmp_stPsDiaDisbl_C OilPLmp_stPsDisbl_C /end REF_CHARACTERISTIC /end GROUP
/begin GROUP S1_engine_is_in_afterrun "OilPLmp_DD/Device Driver for Oil pressure lamp/engine is in afterrun" /begin REF_MEASUREMENT OilPLmp_bCoEng /end REF_MEASUREMENT /end GROUP
/begin GROUP S1_oil_pressure_status "OilPLmp_DD/Device Driver for Oil pressure lamp/oil pressure status" /begin REF_CHARACTERISTIC OILP_STOILPRESOPT_SY_C /end REF_CHARACTERISTIC /begin REF_MEASUREMENT OilPLmp_bPSwmp /end REF_MEASUREMENT /end GROUP
/begin GROUP S3_OilPLmp_swtStrt_C__Greater_than_1 "OilPLmp_DD/Device Driver for Oil pressure lamp/During the Startup /OilPLmp_swtStrt_C  Greater than 1" /begin REF_CHARACTERISTIC OilPLmp_nStrt2_C OilPLmp_tiInactv2_C OilPLmp_tiStrt_C /end REF_CHARACTERISTIC /end GROUP
/begin GROUP S3_OilPLmp_swtStrt_C_Less_than_1 "OilPLmp_DD/Device Driver for Oil pressure lamp/During the Startup /OilPLmp_swtStrt_C Less than 1" /begin REF_CHARACTERISTIC OilPLmp_nStrt1_C OilPLmp_tiInactv2_C /end REF_CHARACTERISTIC /end GROUP
/begin GROUP PTOEnblSwt_DD "PTOEnblSwt_DD"
 /begin REF_CHARACTERISTIC PTOEnblSwt_stDflVal_C PTOEnblSwt_swtSigSel_C PTOEnblSwt_tiDebHiLo_C PTOEnblSwt_tiDebLoHi_C /end REF_CHARACTERISTIC
/end GROUP
/begin GROUP PTOSwt_DD "PTOSwt_DD" /begin SUB_GROUP Root_NplDebounce Root_SRCDebounce /end SUB_GROUP /end GROUP
/begin GROUP Root_NplDebounce "PTOSwt_DD/NplDebounce"
 /begin REF_CHARACTERISTIC MoFPTO_uThresCalMsgA_CA PTOSwt_tiNplDebDef_C PTOSwt_tiNplDebOK_C /end REF_CHARACTERISTIC
/end GROUP
/begin GROUP Root_SRCDebounce "PTOSwt_DD/SRCDebounce"
 /begin REF_CHARACTERISTIC MoFPTO_uTransf_CUR PTOSwt_tiMaxDebDef_C PTOSwt_tiMaxDebOk_C PTOSwt_tiMinDebDef_C PTOSwt_tiMinDebOk_C PTOSwt_uSRCMax_C PTOSwt_uSRCMin_C /end REF_CHARACTERISTIC
/end GROUP
/begin GROUP PTOSwt_VD "PTOSwt_VD"
 /begin REF_CHARACTERISTIC MoFPTO_uThresCalMsgA_CA PTOSwt_bDfl_C PTOSwt_bEnblSwt_C PTOSwt_stDfl_C SigTst_stPTOSwt SigTst_swtPTOSwt /end REF_CHARACTERISTIC
 /begin REF_MEASUREMENT MoFPTO_swtPos_mp /end REF_MEASUREMENT
/end GROUP
/begin GROUP RmtAPP_ChkSig "RmtAPP_ChkSig" /begin SUB_GROUP Root_Limp_Mode1 Root_Live_Detection1 Root_PlaBrk_Ramp1 /end SUB_GROUP /end GROUP
/begin GROUP Root_Limp_Mode1 "RmtAPP_ChkSig/Limp_Mode" /begin REF_CHARACTERISTIC RmtAPP_drLimpMax_C RmtAPP_rLimpMax_C /end REF_CHARACTERISTIC /begin REF_MEASUREMENT RmtAPP_rUnLim_mp /end REF_MEASUREMENT /end GROUP
/begin GROUP Root_Live_Detection1 "RmtAPP_ChkSig/Live_Detection"
 /begin REF_CHARACTERISTIC RmtAPP_rThresAliveDet_C RmtAPP_swtAliveDetEna_C RmtAPP_tiAliveDebHiLo_C RmtAPP_tiAliveDebLoHi_C /end REF_CHARACTERISTIC
 /begin REF_MEASUREMENT RmtAPP_stAlive_mp /end REF_MEASUREMENT
/end GROUP
/begin GROUP Root_PlaBrk_Ramp1 "RmtAPP_ChkSig/PlaBrk_Ramp"
 /begin REF_CHARACTERISTIC RmtAPP_drLimNeg_C RmtAPP_drLimPos_C RmtAPP_rPlaMaxVal_C RmtAPP_swtPlaChkEna_C /end REF_CHARACTERISTIC
 /begin REF_MEASUREMENT RmtAPP_rPla_mp /end REF_MEASUREMENT
/end GROUP
/begin GROUP RmtAPP_DD1 "RmtAPP_DD1" /begin SUB_GROUP Root_DSM_Check2 Root_Error_Reaction1 /end SUB_GROUP /end GROUP
/begin GROUP Root_DSM_Check2 "RmtAPP_DD1/DSM_Check"
 /begin REF_CHARACTERISTIC RmtAPP_tiSRCHighDefDeb_C RmtAPP_tiSRCHighOKDeb_C RmtAPP_tiSRCLowDefDeb_C RmtAPP_tiSRCLowOKDeb_C RmtAPP_uRaw1SRCHigh_C RmtAPP_uRaw1SRCLow_C /end REF_CHARACTERISTIC
 /begin REF_MEASUREMENT RmtAPP_bSRCHigh1 RmtAPP_bSRCLow1 /end REF_MEASUREMENT
/end GROUP
/begin GROUP Root_Error_Reaction1 "RmtAPP_DD1/Error_Reaction" /begin REF_CHARACTERISTIC RmtAPP_uRaw1Def_C /end REF_CHARACTERISTIC /end GROUP
/begin GROUP RmtAPP_DD2 "RmtAPP_DD2"
 /begin SUB_GROUP Root_DSM_Check3 Root_Error_Reaction2 Root_RmtAPP_ChannelGov /end SUB_GROUP
/end GROUP
/begin GROUP Root_DSM_Check3 "RmtAPP_DD2/DSM_Check"
 /begin REF_CHARACTERISTIC RmtAPP_tiSRCHighDefDeb_C RmtAPP_tiSRCHighOKDeb_C RmtAPP_tiSRCLowDefDeb_C RmtAPP_tiSRCLowOKDeb_C RmtAPP_uRaw2SRCHigh_C RmtAPP_uRaw2SRCLow_C /end REF_CHARACTERISTIC
 /begin REF_MEASUREMENT RmtAPP_bSRCHigh2 RmtAPP_bSRCLow2 /end REF_MEASUREMENT
/end GROUP
/begin GROUP Root_Error_Reaction2 "RmtAPP_DD2/Error_Reaction" /begin REF_CHARACTERISTIC RmtAPP_uRaw2Def_C /end REF_CHARACTERISTIC /end GROUP
/begin GROUP Root_RmtAPP_ChannelGov "RmtAPP_DD2/RmtAPP_ChannelGov" /begin REF_CHARACTERISTIC MoFRmtAPP_dRawSigFac_C RmtAPP_stAPPChannelNum_C /end REF_CHARACTERISTIC /end GROUP
/begin GROUP RmtAPP_Kickdown "RmtAPP_Kickdown" /begin SUB_GROUP Root_RmtAPP_ChannelGov1 /end SUB_GROUP
 /begin REF_CHARACTERISTIC MoFRmtAPP_dRawSigFac_C RmtAPP_uKDHighAPP_C RmtAPP_uKDLowAPP_C SigTst_stRmtAPPKickDown_C SigTst_swtRmtAPPKickDown_C /end REF_CHARACTERISTIC
/end GROUP
/begin GROUP Root_RmtAPP_ChannelGov1 "RmtAPP_Kickdown/RmtAPP_ChannelGov" /begin REF_CHARACTERISTIC MoFRmtAPP_dRawSigFac_C RmtAPP_stAPPChannelNum_C /end REF_CHARACTERISTIC /end GROUP
/begin GROUP RmtAPP_Plaus12 "RmtAPP_Plaus12" /begin SUB_GROUP Root_Sync_Calculation1 Root_Sync_Fault_Process1 /end SUB_GROUP /end GROUP
/begin GROUP Root_Sync_Calculation1 "RmtAPP_Plaus12/Sync_Calculation"
 /begin REF_CHARACTERISTIC MoFRmtAPP_dRawSigFac_C MoFRmtAPP_uSync_CUR RmtAPP_uSyncMin_C /end REF_CHARACTERISTIC
 /begin REF_MEASUREMENT RmtAPP_uDiffMax_mp RmtAPP_uDiff_mp RmtAPP_uMin12half_mp /end REF_MEASUREMENT
/end GROUP
/begin GROUP Root_Sync_Fault_Process1 "RmtAPP_Plaus12/Sync_Fault_Process" /begin REF_CHARACTERISTIC RmtAPP_PlaAPPDefDeb_C RmtAPP_PlaAPPDefOK_C /end REF_CHARACTERISTIC /end GROUP
/begin GROUP RmtAPP_PlausBrk "RmtAPP_PlausBrk" /begin SUB_GROUP Root_Plausibility_Detection1 Root_Release_Condition1 /end SUB_GROUP /end GROUP
/begin GROUP Root_Plausibility_Detection1 "RmtAPP_PlausBrk/Plausibility_Detection"
 /begin REF_CHARACTERISTIC RmtAPP_drUnFltLim_C RmtAPP_swtAppGradEna_C RmtAPP_swtBrkDet_C RmtAPP_swtRstCon_C RmtAPP_tiGradCondDebHiLo_C RmtAPP_tiGradCondDebLoHi_C /end REF_CHARACTERISTIC
 /begin REF_MEASUREMENT RmtAPP_stAPP_mp RmtAPP_stBrk_mp /end REF_MEASUREMENT
/end GROUP
/begin GROUP Root_Release_Condition1 "RmtAPP_PlausBrk/Release_Condition"
 /begin REF_CHARACTERISTIC RmtAPP_nLim_C RmtAPP_tiPlaBrkDetDeb_C RmtAPP_tiPlaBrkRstDeb_C RmtAPP_vLim_C /end REF_CHARACTERISTIC
/end GROUP
/begin GROUP RmtAPP_SelSig "RmtAPP_SelSig" /begin SUB_GROUP Root_Signal_Selection1 /end SUB_GROUP /end GROUP
/begin GROUP Root_Signal_Selection1 "RmtAPP_SelSig/Signal_Selection"
 /begin REF_CHARACTERISTIC MoFRmtAPP_dRawSigFac_C RmtAPP_duLimErrPos_C RmtAPP_uAPPDef_C RmtAPP_uRaw2Offset_C /end REF_CHARACTERISTIC
 /begin REF_MEASUREMENT RmtAPP_stTempErr_mp /end REF_MEASUREMENT
/end GROUP
/begin GROUP RmtAPP_VD "RmtAPP_VD" /begin SUB_GROUP Root_RmtAPP_UnJit Root_Signal_Filter1 Root__Linearisation /end SUB_GROUP /end GROUP
/begin GROUP Root__Linearisation "RmtAPP_VD/ Linearisation" /begin SUB_GROUP S1_RmtAPP_rUnFlt_inl /end SUB_GROUP
 /begin REF_CHARACTERISTIC MoFRmtAPP_rLinAPPCURCalMsgA_CUR SigTst_rRmtAPP_C SigTst_swtRmtAPP_C /end REF_CHARACTERISTIC
/end GROUP
/begin GROUP Root_RmtAPP_UnJit "RmtAPP_VD/RmtAPP_UnJit" /begin REF_CHARACTERISTIC RmtAPP_swtEnaUnJit_C RmtAPP_uJitter_C /end REF_CHARACTERISTIC /end GROUP
/begin GROUP Root_Signal_Filter1 "RmtAPP_VD/Signal_Filter" /begin SUB_GROUP S3_Filter_parameter_selection1 /end SUB_GROUP /begin REF_CHARACTERISTIC RmtAPP_swtEnaFlt_C /end REF_CHARACTERISTIC /end GROUP
/begin GROUP S1_RmtAPP_rUnFlt_inl "RmtAPP_VD/ Linearisation/RmtAPP_rUnFlt_inl" /begin REF_CHARACTERISTIC RmtAPP_drLinRmp_C /end REF_CHARACTERISTIC /begin REF_MEASUREMENT RmtAPP_rUnFlt_mp /end REF_MEASUREMENT /end GROUP
/begin GROUP S3_Filter_parameter_selection1 "RmtAPP_VD/Signal_Filter/Filter_parameter_selection"
 /begin REF_CHARACTERISTIC RmtAPP_facLowNegPT1_C RmtAPP_facLowPosPT1_C RmtAPP_facMidNegPT1_C RmtAPP_facMidPosPT1_C RmtAPP_facUppNegPT1_C RmtAPP_facUppPosPT1_C RmtAPP_rThrFltLowNeg_C RmtAPP_rThrFltLowPos_C RmtAPP_rThrFltMidNeg_C RmtAPP_rThrFltMidPos_C /end REF_CHARACTERISTIC
 /begin REF_MEASUREMENT RmtAPP_facPT1 /end REF_MEASUREMENT
/end GROUP
/begin GROUP SpdDemSwt_DD "SpdDemSwt_DD" /begin REF_CHARACTERISTIC SpdDemSwt_tiDebHiLo_C SpdDemSwt_tiDebLoHi_C /end REF_CHARACTERISTIC /end GROUP
/begin GROUP SpdDemSwt_VD "SpdDemSwt_VD"
 /begin REF_CHARACTERISTIC SigTst_stSpdDemSwt_C SigTst_swtSpdDemSwt_C SpdDemSwt_stEnable /end REF_CHARACTERISTIC
/end GROUP
/begin GROUP SpdGovSwt_DD "SpdGovSwt_DD" /begin SUB_GROUP Root_Speed_Governor_switch /end SUB_GROUP /end GROUP
/begin GROUP Root_Speed_Governor_switch "SpdGovSwt_DD/Speed Governor switch"
 /begin REF_CHARACTERISTIC SigTst_stSpdGovDflVal_C SigTst_swtSpdGovSwt_C SpdGovSwt_stDflVal_C SpdGovSwt_tiDebHiLo_C SpdGovSwt_tiDebLoHi_C /end REF_CHARACTERISTIC
/end GROUP
/begin GROUP TClntDspl_DD "TClntDspl_DD"
 /begin REF_CHARACTERISTIC TClntDspl_O_P_ATS TClntDspl_PwmOut_swtBattCor_C TClntDspl_bSwtPrs_C TClntDspl_rCnv_CURX TClntDspl_stEna_C TClntDspl_stPsDiaDisbl_C TClntDspl_stPsDisbl_C TClntDspl_tiPer_C /end REF_CHARACTERISTIC
/end GROUP
/begin GROUP VehV_DD "VehV_DD" /begin REF_CHARACTERISTIC VehV_ImpPerDist_C VehV_bSwtPrs_C VehV_numImpCrdSh_C /end REF_CHARACTERISTIC /end GROUP
/begin GROUP VehV_VD "VehV_VD" /begin SUB_GROUP Root_Monitoring Root_Signal_filter /end SUB_GROUP /end GROUP
/begin GROUP Root_Monitoring "VehV_VD/Monitoring"
 /begin REF_CHARACTERISTIC VehV_nThresPla_C VehV_swtTrqSel_C VehV_tiDebMonPla_C VehV_trqThresPla_C VehV_vMax_C VehV_vThresPla_C /end REF_CHARACTERISTIC
 /begin REF_MEASUREMENT VehV_bPlaChkDeb /end REF_MEASUREMENT
/end GROUP
/begin GROUP Root_Signal_filter "VehV_VD/Signal_filter"
 /begin REF_CHARACTERISTIC SigTst_nCrdSh_C SigTst_swtCrDSh SigTst_swtVehV SigTst_vVehV_C VehV_facAPT1_C VehV_facNCrdShPT1_C VehV_facVPT1_C VehV_nCrdShDfl_C VehV_nMinCrdSh_C VehV_vDfl_C VehV_vMin_C /end REF_CHARACTERISTIC
 /begin REF_MEASUREMENT VehV_aUnFlt_mp VehV_nCrdShUnFlt_mp VehV_vUnFlt_mp /end REF_MEASUREMENT
/end GROUP
/begin RECORD_LAYOUT Scalar_BOOLEAN FNC_VALUES 1 UBYTE COLUMN_DIR DIRECT /end RECORD_LAYOUT
/begin RECORD_LAYOUT Scalar_UBYTE FNC_VALUES 1 UBYTE COLUMN_DIR DIRECT /end RECORD_LAYOUT
/begin RECORD_LAYOUT Scalar_UWORD FNC_VALUES 1 UWORD COLUMN_DIR DIRECT /end RECORD_LAYOUT
/begin RECORD_LAYOUT Scalar_SWORD FNC_VALUES 1 SWORD COLUMN_DIR DIRECT /end RECORD_LAYOUT
/begin RECORD_LAYOUT Scalar_ULONG FNC_VALUES 1 ULONG COLUMN_DIR DIRECT /end RECORD_LAYOUT
/begin RECORD_LAYOUT Scalar_LONG FNC_VALUES 1 SLONG COLUMN_DIR DIRECT /end RECORD_LAYOUT
/begin RECORD_LAYOUT Lookup1D_WORD FNC_VALUES 1 SWORD COLUMN_DIR DIRECT /end RECORD_LAYOUT
/begin RECORD_LAYOUT Lookup1D_X_WORD AXIS_PTS_X 1 SWORD INDEX_INCR DIRECT /end RECORD_LAYOUT
/begin RECORD_LAYOUT Lookup2D_X_BOOLEAN AXIS_PTS_X 1 UBYTE INDEX_INCR DIRECT /end RECORD_LAYOUT
/begin RECORD_LAYOUT Lookup2D_UBYTE FNC_VALUES 1 UBYTE COLUMN_DIR DIRECT /end RECORD_LAYOUT
/begin RECORD_LAYOUT Lookup2D_X_UBYTE AXIS_PTS_X 1 UBYTE INDEX_INCR DIRECT /end RECORD_LAYOUT
/begin RECORD_LAYOUT Lookup2D_BYTE FNC_VALUES 1 SBYTE COLUMN_DIR DIRECT /end RECORD_LAYOUT
/begin RECORD_LAYOUT Lookup2D_X_UWORD AXIS_PTS_X 1 UWORD INDEX_INCR DIRECT /end RECORD_LAYOUT
/begin RECORD_LAYOUT Lookup2D_X_ULONG AXIS_PTS_X 1 ULONG INDEX_INCR DIRECT /end RECORD_LAYOUT
/begin RECORD_LAYOUT Lookup2D_LONG FNC_VALUES 1 SLONG COLUMN_DIR DIRECT /end RECORD_LAYOUT
/begin RECORD_LAYOUT Lookup2D_X_LONG AXIS_PTS_X 1 SLONG INDEX_INCR DIRECT /end RECORD_LAYOUT
/begin RECORD_LAYOUT Lookup2D_FLOAT32_IEEE FNC_VALUES 1 FLOAT32_IEEE COLUMN_DIR DIRECT /end RECORD_LAYOUT
/begin RECORD_LAYOUT Lookup2D_X_FLOAT32_IEEE AXIS_PTS_X 1 FLOAT32_IEEE INDEX_INCR DIRECT /end RECORD_LAYOUT
/begin RECORD_LAYOUT Lookup2D_FLOAT64_IEEE FNC_VALUES 1 FLOAT64_IEEE COLUMN_DIR DIRECT /end RECORD_LAYOUT
/begin RECORD_LAYOUT Lookup2D_X_FLOAT64_IEEE AXIS_PTS_X 1 FLOAT64_IEEE INDEX_INCR DIRECT /end RECORD_LAYOUT
/end MODULE
/end PROJECT
