ASAP2_VERSION 1 51
/begin PROJECT XCPDemo ""
/begin MODULE XCP ""
/begin MOD_COMMON "" BYTE_ORDER MSB_FIRST ALIGNMENT_BYTE 1 ALIGNMENT_WORD 1 ALIGNMENT_LONG 1 ALIGNMENT_FLOAT32_IEEE 1 ALIGNMENT_FLOAT64_IEEE 1 /end MOD_COMMON
/begin CHARACTERISTIC CoVeh_trqLim_CUR "limit torque curve when the CoVeh system error exists" CURVE 0x386800 Lookup1D_WORD 0 Trq_Nm -3000.0 3000.0
 /begin AXIS_DESCR COM_AXIS Epm_nEng EngSpeed_rpm 7 -12000.0 12000.0 AXIS_PTS_REF CoVeh_trqLim_CURX /end AXIS_DESCR
/end CHARACTERISTIC
/begin CHARACTERISTIC CoVeh_dtrqLimDwn_C "CoVeh_trqPrpLimErr is reduced to the output value of the limitation curve CoVeh_trqLim_CUR using a ramp function with this slope" VALUE 0x3867F8 Scalar_SWORD 0 Trq_Nm_s -3000.0 3000.0 /end CHARACTERISTIC
/begin CHARACTERISTIC CoVeh_dtrqLimUp_C "when the CoVeh system error is no longer present (FId_ CoVehPrpLimErr= TRUE), CoVeh_trqPrpLimErr is increased with this slope until CoVeh_trqDes is no longer limited by CoVeh_trqPrpLimErr" VALUE 0x3867FA Scalar_SWORD 0 Trq_Nm_s -3000.0 3000.0 /end CHARACTERISTIC
/begin CHARACTERISTIC CoVeh_bLimTboxFenceOut_C "flag for enable torque limit for fence out message from Tbox" VALUE 0x3867F6 Scalar_BOOLEAN 0 boolean 0.0 1.0 /end CHARACTERISTIC
/begin AXIS_PTS CoVeh_trqLim_CURX "axis of limit torque curve when the CoVeh system error exists" 0x38680E Epm_nEng Lookup1D_X_WORD 0 EngSpeed_rpm 7 -12000.0 12000.0 /end AXIS_PTS
/begin CHARACTERISTIC CoVeh_trqPrfmLimDes_C "Torque limitation from performence limiter" VALUE 0x38681C Scalar_SWORD 0 Trq_Nm -3000.0 3276.7 /end CHARACTERISTIC
/begin CHARACTERISTIC CoVeh_trqDesCompNoFl_C "compensation torque with the shares,which not slur by the drive behaviour filter" VALUE 0x3867FC Scalar_SWORD 0 Trq_Nm -3000.0 3000.0 /end CHARACTERISTIC
/begin CHARACTERISTIC CoVeh_trqDesCompVeh_C "Signal for compensation correction of wheel torque level (signal 1)" VALUE 0x3867FE Scalar_SWORD 0 Trq_Nm -3000.0 3000.0 /end CHARACTERISTIC
/begin CHARACTERISTIC ESS_trqDesAcs_C "Torque request from Electrical Supply System" VALUE 0x387748 Scalar_SWORD 0 Trq_Nm -3000.0 3276.7 /end CHARACTERISTIC
/begin CHARACTERISTIC ESS_trqResvAcs_C "Torque reserve due to on-board electrical system" VALUE 0x38774A Scalar_SWORD 0 Trq_Nm -3000.0 3276.7 /end CHARACTERISTIC
/begin CHARACTERISTIC ESS_nMax_C "Max. engine speed request from Electrical Supply System" VALUE 0x387744 Scalar_SWORD 0 EngSpeed_rpm -6000.0 6000.0 /end CHARACTERISTIC
/begin CHARACTERISTIC ESS_nMin_C "Min. engine speed request from Electrical Supply System" VALUE 0x387746 Scalar_SWORD 0 EngSpeed_rpm -6000.0 6000.0 /end CHARACTERISTIC
/begin CHARACTERISTIC GlbDa_LSum_lVehCHGECU_C "Initial distance when ECU changed" VALUE 0x389E2C Scalar_LONG 0 Length_Km 0.0 2.147483E+6 /end CHARACTERISTIC
/begin CHARACTERISTIC GlbDa_LSum_VehThreshold_C "Vehicle Speed Threshold to enable distance sum" VALUE 0x389E2A Scalar_SWORD 0 VehSpeed_km_h 0.0 250.0 /end CHARACTERISTIC
/begin CHARACTERISTIC TrbCh_n_C "Turbo charger speed" VALUE 0x39B180 Scalar_SWORD 0 Turbo_rpm -327679.0 327671.0 /end CHARACTERISTIC
/begin CHARACTERISTIC GlbDa_stTrqDem_C "contains highest prior function with torque demand" VALUE 0x389E30 Scalar_ULONG 0 State_uint32 0.0 4.294967295E+9 /end CHARACTERISTIC
/begin CHARACTERISTIC CoPT_tClntDesMax_C "Maximum desired coolent temperature of the impulse rope" VALUE 0x3867DE Scalar_SWORD 0 Temp_deg -150.0 150.0 /end CHARACTERISTIC
/begin CHARACTERISTIC CoPT_tClntDesMin_C "Minimun desired coolent temperature of the impulse rope" VALUE 0x3867E0 Scalar_SWORD 0 Temp_deg -150.0 150.0 /end CHARACTERISTIC
/begin CHARACTERISTIC CoPT_tiDebCurr_C "Debounce time for decreasing curr torque intervention of transmission" VALUE 0x3867E4 Scalar_ULONG 0 Debounce_ms 0.0 65535.0 /end CHARACTERISTIC
/begin CHARACTERISTIC CoPT_tiDebLead_C "Debounce time for decreasing lead torque intervention of transmission" VALUE 0x3867E8 Scalar_ULONG 0 Debounce_ms 0.0 65535.0 /end CHARACTERISTIC
/begin CHARACTERISTIC CoPT_dtrqCurrCorP_Neg_C "Ramp slope parameters for decreasing curr torque intervention of transmission. / negative ramp slope" VALUE 0x3867DA Scalar_SWORD 0 Trq_Nm_s -3000.0 3000.0 /end CHARACTERISTIC
/begin CHARACTERISTIC CoPT_dtrqCurrCorP_Pos_C "Ramp slope parameters for decreasing curr torque intervention of transmission. / Slope if the ramp has to be increased" VALUE 0x3867DC Scalar_SWORD 0 Trq_Nm_s -3000.0 3000.0 /end CHARACTERISTIC
/begin CHARACTERISTIC PT_bTrqConv_C "select switch for torque converter" VALUE 0x39576D Scalar_BOOLEAN 0 boolean 0.0 1.0 /end CHARACTERISTIC
/begin CHARACTERISTIC CoPT_trqDesCompEng_C "Application parameter for engine torque desired for compensation" VALUE 0x3867EC Scalar_SWORD 0 Trq_Nm -3276.0 3276.0 /end CHARACTERISTIC
/begin CHARACTERISTIC PT_trqCrSDCS_C "crankshaft torque for request decrcment" VALUE 0x395788 Scalar_SWORD 0 Trq_Nm -3000.0 3000.0 /end CHARACTERISTIC
/begin CHARACTERISTIC Conv_trqLd_C "Application parameter for torque load from the converter" VALUE 0x38681E Scalar_SWORD 0 Trq_Nm -3000.0 3000.0 /end CHARACTERISTIC
/begin CHARACTERISTIC Conv_trqResv_C "Torque reserve from the converter" VALUE 0x386820 Scalar_SWORD 0 Trq_Nm -3000.0 3000.0 /end CHARACTERISTIC
/begin CHARACTERISTIC Gbx_nIdlDes_C "Desired idle speed setpoint for AT gear box rpm" VALUE 0x389E20 Scalar_SWORD 0 EngSpeed_rpm -6000.0 6000.0 /end CHARACTERISTIC
/begin CHARACTERISTIC Gbx_rFanClgDem_C "Percentage of fan cooling demand" VALUE 0x389E22 Scalar_SWORD 0 Prc_100_rate -300.0 300.0 /end CHARACTERISTIC
/begin CHARACTERISTIC Gbx_rTrq_C "Transmission function information from Gearbox ECU(including Torque converter)" VALUE 0x389E24 Scalar_SWORD 0 TransRatio -100.0 100.0 /end CHARACTERISTIC
/begin CHARACTERISTIC Gbx_tClntDes_C "Setpoint value of the coolant temperature (via CAN)" VALUE 0x389E28 Scalar_SWORD 0 Temp_deg -150.0 300.0 /end CHARACTERISTIC
/begin CHARACTERISTIC Gbx_stOvrSpdDem_C "status of engine overspeed request" VALUE 0x389E26 Scalar_UBYTE 0 State_uint8 0.0 255.0 /end CHARACTERISTIC
/begin CHARACTERISTIC PT_tiDebClthStSlip_C "Debouncing time for the formation of the state \"clutch slips, debounced\" (manual clutch)." VALUE 0x395784 Scalar_ULONG 0 Debounce_ms 0.0 65535.0 /end CHARACTERISTIC
/begin CHARACTERISTIC PT_rClthSlipDeb_C "Analogue value for the state PT_bNoGrip = FALSE and clutch slips, debounced (manual clutch)." VALUE 0x39576E Scalar_SWORD 0 Prc_Fact100 -300.0 300.0 /end CHARACTERISTIC
/begin CHARACTERISTIC PT_rClthSlip_C "Analogue value for the state PT_bNoGrip = FALSE and clutch slips (manual clutch) or clutch is in a slip state / controlled operation (automated clutch)." VALUE 0x395770 Scalar_SWORD 0 Prc_Fact100 -300.0 300.0 /end CHARACTERISTIC
/begin CHARACTERISTIC PT_rGripDfl_C "Analog value for the state where none of the single bit messages is TRUE" VALUE 0x395772 Scalar_SWORD 0 Prc_Fact100 -300.0 300.0 /end CHARACTERISTIC
/begin CHARACTERISTIC PT_rGrip_C "Analog value for the state grip is for sure present (the converter lockup clutch / the automated or manual clutch is completely closed and PT_bNoGrip = FALSE)." VALUE 0x395774 Scalar_SWORD 0 Prc_Fact100 -300.0 300.0 /end CHARACTERISTIC
/begin CHARACTERISTIC PT_rNoGrip_C "Analog value for the state grip is for sure excluded" VALUE 0x395776 Scalar_SWORD 0 Prc_Fact100 -300.0 300.0 /end CHARACTERISTIC
/begin CHARACTERISTIC PT_vMinGrip_C "minimum vehicle speed for grip determination" VALUE 0x39578A Scalar_SWORD 0 VehSpeed_km_h 0.0 250.0 /end CHARACTERISTIC
/begin CHARACTERISTIC PT_GripCfg_CW "codeword for the configuration of the function PT_Grip" VALUE 0x39576C Scalar_UBYTE 0 State_uint8 0.0 255.0 /end CHARACTERISTIC
/begin CHARACTERISTIC PT_rTrqDfl_C "Default value for torque ratio" VALUE 0x395778 Scalar_SWORD 0 TransRatio -100.0 100.0 /end CHARACTERISTIC
/begin CHARACTERISTIC PT_rTrqMax_C "Application parameter for Maximum limitation of transmission Ratio" VALUE 0x39577A Scalar_SWORD 0 TransRatio -100.0 100.0 /end CHARACTERISTIC
/begin CHARACTERISTIC PT_rTrqMin_C "Application parameter for Minimum limitation of transmission Ratio" VALUE 0x39577C Scalar_SWORD 0 TransRatio -100.0 100.0 /end CHARACTERISTIC
/begin CHARACTERISTIC PT_vMinTrqRat_C "Minimum vehicle speed" VALUE 0x39578C Scalar_SWORD 0 VehSpeed_km_h 0.0 250.0 /end CHARACTERISTIC
/begin CHARACTERISTIC PT_swtDetTypeCAN_C "Determines if value is read from CAN or not" VALUE 0x395780 Scalar_UBYTE 0 Switch_conv 0 1 /end CHARACTERISTIC
/begin CHARACTERISTIC Tra_rClgDem_C "Parameter for the relative fan cooling capacity" VALUE 0x39AE52 Scalar_SWORD 0 Prc_100_rate -300.0 300.0 /end CHARACTERISTIC
/begin CHARACTERISTIC Tra_tClntDes_C "Calibratable coolant temperature - Set point value" VALUE 0x39AE96 Scalar_SWORD 0 Temp_deg -150.0 150.0 /end CHARACTERISTIC
/begin CHARACTERISTIC Tra_bCanAirCanPtd_C "condition relative fan cooling capacity from CAN" VALUE 0x39AE18 Scalar_BOOLEAN 0 boolean 0.0 1.0 /end CHARACTERISTIC
/begin CHARACTERISTIC Tra_bCanClntCanPtd_C "condition coolant temperature - set point value from CAN" VALUE 0x39AE19 Scalar_BOOLEAN 0 boolean 0.0 1.0 /end CHARACTERISTIC
/begin CHARACTERISTIC Tra_trqDblClthEngMax_C "Application parameter for minimum torque of systemdegratation Nm" VALUE 0x39AE98 Scalar_SWORD 0 Trq_Nm -3000.0 3000.0 /end CHARACTERISTIC
/begin CHARACTERISTIC Tra_trqDblClthVehMax_C "minimum torque of highest speed limitation Nm" VALUE 0x39AE9A Scalar_SWORD 0 Trq_Nm -3000.0 3000.0 /end CHARACTERISTIC
/begin CHARACTERISTIC Tra_rN2NGbxMax_C "Maximum limit of n/n ratio" VALUE 0x39AE54 Scalar_SWORD 0 TransRatio -100.0 100.0 /end CHARACTERISTIC
/begin CHARACTERISTIC Tra_rN2NGbxMin_C "Minimum limit of n/n ratio" VALUE 0x39AE56 Scalar_SWORD 0 TransRatio -100.0 100.0 /end CHARACTERISTIC
/begin CHARACTERISTIC Tra_rTransTable_CA "Array for the selection of gear ratio based on cardan shaft speed and engine speed" VAL_BLK 0x39AE58 Scalar_SWORD 0 TransRatio -100.0 100.0 NUMBER 26 /end CHARACTERISTIC
/begin CHARACTERISTIC Tra_nCrdShMin_C "Minimum Cardan Shaft Speed required to calculate n/n ratio" VALUE 0x39AE26 Scalar_SWORD 0 EngSpeed_rpm -6000.0 6000.0 /end CHARACTERISTIC
/begin CHARACTERISTIC Tra_nEngMin_C "Minimum rpm of engine" VALUE 0x39AE28 Scalar_SWORD 0 EngSpeed_rpm -6000.0 6000.0 /end CHARACTERISTIC
/begin CHARACTERISTIC Tra_rV2NDfl_C "Default value for quotient of velocity and rational speed" VALUE 0x39AE8C Scalar_SWORD 0 Tra_V2N_km_h_rpm -0.32768 0.32767 /end CHARACTERISTIC
/begin CHARACTERISTIC Tra_rV2NMax_C "Maximum limit for v/n ratio" VALUE 0x39AE8E Scalar_SWORD 0 Tra_V2N_km_h_rpm -0.32768 0.32767 /end CHARACTERISTIC
/begin CHARACTERISTIC Tra_rV2NMin_C "Minimum limit for v/n ratio" VALUE 0x39AE90 Scalar_SWORD 0 Tra_V2N_km_h_rpm -0.32768 0.32767 /end CHARACTERISTIC
/begin CHARACTERISTIC Tra_facN2NPT1_C "Filter factor constant for PT1 filtering of the n/n ratio" VALUE 0x39AE20 Scalar_UWORD 0 PT_fac 0.0 99.998 /end CHARACTERISTIC
/begin CHARACTERISTIC Tra_facNPT1_C "filter factor constant for the pre filtering of the engine speed for the calculation of the v/n ratio" VALUE 0x39AE22 Scalar_UWORD 0 PT_fac 0.0 99.998 /end CHARACTERISTIC
/begin CHARACTERISTIC Tra_facV2NPT1_C "filter factor constant for the filtering of the v/n ratio" VALUE 0x39AE24 Scalar_UWORD 0 PT_fac 0.0 99.998 /end CHARACTERISTIC
/begin CHARACTERISTIC Tra_GearWide_C "Actual fast gear rnn-window 200 - 101  = overlaping  100  = gap between gears" VALUE 0x39AE14 Scalar_SWORD 0 Fact1 0.0 200.0 /end CHARACTERISTIC
/begin CHARACTERISTIC Tra_rnFacCrdS_C "Multiplication factor for ratio of shaft speed to engine speed" VALUE 0x39AE92 Scalar_SWORD 0 Factor -30.0 30.0 /end CHARACTERISTIC
/begin CHARACTERISTIC Tra_SumGear_C "Position of highest used gear-rnn ( lowest gear ) in Tra_rTransTable_C" VALUE 0x39AE16 Scalar_BYTE 0 Tra_num -128.0 127.0 /end CHARACTERISTIC
/begin CHARACTERISTIC Tra_numGearDfl1_C "Fast Gear selection for rnn calculation by Tra_rTransTable_C during error" VALUE 0x39AE2E Scalar_BYTE 0 Tra_num -128.0 127.0 /end CHARACTERISTIC
/begin CHARACTERISTIC Tra_numGearDfl2_C "Gearbx_stGear selection during error . ( Fid_Gearbx_Geardet_mp )" VALUE 0x39AE2F Scalar_BYTE 0 Tra_num -128.0 127.0 /end CHARACTERISTIC
/begin CHARACTERISTIC Tra_numGearTable_CA "Array for the selection gear number based on cardan shaft speed and engine speed" VAL_BLK 0x39AE38 Scalar_BYTE 0 Tra_num -128.0 127.0 NUMBER 26 /end CHARACTERISTIC
/begin CHARACTERISTIC PT_stTraRevGear_C "Status if reverse gear is selected" VALUE 0x39577E Scalar_BOOLEAN 0 boolean 0.0 1.0 /end CHARACTERISTIC
/begin CHARACTERISTIC Tra_bStrtStopEnaDfl_C "Default value to enable start/stop function" VALUE 0x39AE1B Scalar_BOOLEAN 0 boolean 0.0 1.0 /end CHARACTERISTIC
/begin CHARACTERISTIC Tra_swtSrcCrdSSpdVal_C "Switch to select the cardan shaft speed from cardan shaft or CAN" VALUE 0x39AE95 Scalar_UBYTE 0 Switch_conv 0 1 /end CHARACTERISTIC
/begin CHARACTERISTIC Tra_trqLos_C "The gearbox torque loss" VALUE 0x39AEA6 Scalar_SWORD 0 Trq_Nm -3000.0 3000.0 /end CHARACTERISTIC
/begin CHARACTERISTIC Tra_trqMaxGearGrp1_CUR "Clutch torque limiting curve f(n) for gear group1" CURVE 0x39AEA8 Lookup1D_WORD 0 Trq_Nm -3000.0 3000.0
 /begin AXIS_DESCR COM_AXIS Epm_nEng EngSpeed_rpm 20 -6000.0 6000.0 AXIS_PTS_REF Tra_trqMaxGearGrp1_CURX /end AXIS_DESCR
/end CHARACTERISTIC
/begin CHARACTERISTIC Tra_trqMaxGearGrp2_CUR "Clutch torque limiting curve f(n) for gear group2" CURVE 0x39AEF8 Lookup1D_WORD 0 Trq_Nm -3000.0 3000.0
 /begin AXIS_DESCR COM_AXIS Epm_nEng EngSpeed_rpm 20 -6000.0 6000.0 AXIS_PTS_REF Tra_trqMaxGearGrp2_CURX /end AXIS_DESCR
/end CHARACTERISTIC
/begin CHARACTERISTIC Tra_trqMaxGearGrp3_CUR "Clutch torque limiting curve f(n) for gear group3" CURVE 0x39AF48 Lookup1D_WORD 0 Trq_Nm -3000.0 3000.0
 /begin AXIS_DESCR COM_AXIS Epm_nEng EngSpeed_rpm 20 -6000.0 6000.0 AXIS_PTS_REF Tra_trqMaxGearGrp3_CURX /end AXIS_DESCR
/end CHARACTERISTIC
/begin CHARACTERISTIC Tra_trqMaxGearGrp4_CUR "Clutch torque limiting curve f(n) for gear group4" CURVE 0x39AF98 Lookup1D_WORD 0 Trq_Nm -3000.0 3000.0
 /begin AXIS_DESCR COM_AXIS Epm_nEng EngSpeed_rpm 20 -6000.0 6000.0 AXIS_PTS_REF Tra_trqMaxGearGrp4_CURX /end AXIS_DESCR
/end CHARACTERISTIC
/begin CHARACTERISTIC Tra_trqMaxGearGrp5_CUR "Clutch torque limiting curve f(n) for gear group5" CURVE 0x39AFE8 Lookup1D_WORD 0 Trq_Nm -3000.0 3000.0
 /begin AXIS_DESCR COM_AXIS Epm_nEng EngSpeed_rpm 20 -6000.0 6000.0 AXIS_PTS_REF Tra_trqMaxGearGrp5_CURX /end AXIS_DESCR
/end CHARACTERISTIC
/begin CHARACTERISTIC Tra_trqMaxGearGrp6_CUR "Clutch torque limiting curve f(n) for gear group6" CURVE 0x39B038 Lookup1D_WORD 0 Trq_Nm -3000.0 3000.0
 /begin AXIS_DESCR COM_AXIS Epm_nEng EngSpeed_rpm 20 -6000.0 6000.0 AXIS_PTS_REF Tra_trqMaxGearGrp6_CURX /end AXIS_DESCR
/end CHARACTERISTIC
/begin CHARACTERISTIC Tra_trqPTOLim1_CUR " engine torque limiting" CURVE 0x39B088 Lookup1D_WORD 0 Trq_Nm -3000.0 3000.0
 /begin AXIS_DESCR COM_AXIS Epm_nEng EngSpeed_rpm 20 -6000.0 6000.0 AXIS_PTS_REF Tra_trqPTOLim1_CURX /end AXIS_DESCR
/end CHARACTERISTIC
/begin CHARACTERISTIC Tra_trqPTOLim2_CUR " engine torque limiting" CURVE 0x39B0D8 Lookup1D_WORD 0 Trq_Nm -3000.0 3000.0
 /begin AXIS_DESCR COM_AXIS Epm_nEng EngSpeed_rpm 20 -6000.0 6000.0 AXIS_PTS_REF Tra_trqPTOLim2_CURX /end AXIS_DESCR
/end CHARACTERISTIC
/begin CHARACTERISTIC Tra_trqPTOLim3_CUR " engine torque limiting" CURVE 0x39B128 Lookup1D_WORD 0 Trq_Nm -3000.0 3000.0
 /begin AXIS_DESCR COM_AXIS Epm_nEng EngSpeed_rpm 20 -6000.0 6000.0 AXIS_PTS_REF Tra_trqPTOLim3_CURX /end AXIS_DESCR
/end CHARACTERISTIC
/begin CHARACTERISTIC Tra_dtrqPTORmpP_Neg_C "negative ramp slope" VALUE 0x39AE1C Scalar_SWORD 0 Trq_Nm_s -3000.0 3000.0 /end CHARACTERISTIC
/begin CHARACTERISTIC Tra_dtrqPTORmpP_Pos_C "Slope if the ramp has to be increased" VALUE 0x39AE1E Scalar_SWORD 0 Trq_Nm_s -3000.0 3000.0 /end CHARACTERISTIC
/begin CHARACTERISTIC Tra_trqInMax_C "General torque maximum value" VALUE 0x39AEA0 Scalar_SWORD 0 Trq_Nm -3000.0 3000.0 /end CHARACTERISTIC
/begin CHARACTERISTIC Tra_trqWESDemLim0_C "Torque limitation at WESDem mode 0" VALUE 0x39B178 Scalar_SWORD 0 Trq_Nm -3000.0 3000.0 /end CHARACTERISTIC
/begin CHARACTERISTIC Tra_trqWESDemLim1_C "Torque limitation at WESDem mode 1" VALUE 0x39B17A Scalar_SWORD 0 Trq_Nm -3000.0 3000.0 /end CHARACTERISTIC
/begin CHARACTERISTIC Tra_trqWESDemLim2_C "Torque limitation at WESDem mode 2" VALUE 0x39B17C Scalar_SWORD 0 Trq_Nm -3000.0 3000.0 /end CHARACTERISTIC
/begin CHARACTERISTIC Tra_trqWESDemLim3_C "Torque limitation at WESDem mode 3" VALUE 0x39B17E Scalar_SWORD 0 Trq_Nm -3000.0 3000.0 /end CHARACTERISTIC
/begin CHARACTERISTIC Tra_numGearGrpThres1_C "Upper gear threshold for gear group depending torque limiting curve 1" VALUE 0x39AE30 Scalar_BYTE 0 Tra_num -128.0 127.0 /end CHARACTERISTIC
/begin CHARACTERISTIC Tra_numGearGrpThres2_C "Upper gear threshold for gear group depending torque limiting curve 2" VALUE 0x39AE31 Scalar_BYTE 0 Tra_num -128.0 127.0 /end CHARACTERISTIC
/begin CHARACTERISTIC Tra_numGearGrpThres3_C "Upper gear threshold for gear group depending torque limiting curve 3" VALUE 0x39AE32 Scalar_BYTE 0 Tra_num -128.0 127.0 /end CHARACTERISTIC
/begin CHARACTERISTIC Tra_numGearGrpThres4_C "Upper gear threshold for gear group depending torque limiting curve 4" VALUE 0x39AE33 Scalar_BYTE 0 Tra_num -128.0 127.0 /end CHARACTERISTIC
/begin CHARACTERISTIC Tra_numGearGrpThres5_C "Upper gear threshold for gear group depending torque limiting curve 5" VALUE 0x39AE34 Scalar_BYTE 0 Tra_num -128.0 127.0 /end CHARACTERISTIC
/begin CHARACTERISTIC Tra_swtPTOLim1KD_C "Switch to allow the kichdown override Tra_trqPTOLim1_CUR" VALUE 0x39AE94 Scalar_BOOLEAN 0 boolean 0.0 1.0 /end CHARACTERISTIC
/begin AXIS_PTS Tra_trqMaxGearGrp1_CURX "engine speed" 0x39AED0 Epm_nEng Lookup1D_X_WORD 0 EngSpeed_rpm 20 -6000.0 6000.0 /end AXIS_PTS
/begin AXIS_PTS Tra_trqMaxGearGrp2_CURX "engine speed" 0x39AF20 Epm_nEng Lookup1D_X_WORD 0 EngSpeed_rpm 20 -6000.0 6000.0 /end AXIS_PTS
/begin AXIS_PTS Tra_trqMaxGearGrp3_CURX "engine speed" 0x39AF70 Epm_nEng Lookup1D_X_WORD 0 EngSpeed_rpm 20 -6000.0 6000.0 /end AXIS_PTS
/begin AXIS_PTS Tra_trqMaxGearGrp4_CURX "engine speed" 0x39AFC0 Epm_nEng Lookup1D_X_WORD 0 EngSpeed_rpm 20 -6000.0 6000.0 /end AXIS_PTS
/begin AXIS_PTS Tra_trqMaxGearGrp5_CURX "engine speed" 0x39B010 Epm_nEng Lookup1D_X_WORD 0 EngSpeed_rpm 20 -6000.0 6000.0 /end AXIS_PTS
/begin AXIS_PTS Tra_trqMaxGearGrp6_CURX "engine speed" 0x39B060 Epm_nEng Lookup1D_X_WORD 0 EngSpeed_rpm 20 -6000.0 6000.0 /end AXIS_PTS
/begin AXIS_PTS Tra_trqPTOLim1_CURX "engine speed" 0x39B0B0 Epm_nEng Lookup1D_X_WORD 0 EngSpeed_rpm 20 -6000.0 6000.0 /end AXIS_PTS
/begin AXIS_PTS Tra_trqPTOLim2_CURX "engine speed" 0x39B100 Epm_nEng Lookup1D_X_WORD 0 EngSpeed_rpm 20 -6000.0 6000.0 /end AXIS_PTS
/begin AXIS_PTS Tra_trqPTOLim3_CURX "engine speed" 0x39B150 Epm_nEng Lookup1D_X_WORD 0 EngSpeed_rpm 20 -6000.0 6000.0 /end AXIS_PTS
/begin CHARACTERISTIC Tra_nMax_C "Maximum engine speed for gearbox" VALUE 0x39AE2A Scalar_SWORD 0 EngSpeed_rpm -6000.0 11000.0 /end CHARACTERISTIC
/begin CHARACTERISTIC Tra_nMin_C "minimum rotational speed for transmission" VALUE 0x39AE2C Scalar_SWORD 0 EngSpeed_rpm -6000.0 6000.0 /end CHARACTERISTIC
/begin CHARACTERISTIC Tra_bCANIdlSetP_C "Status gearbox low-idle speed increase via CAN" VALUE 0x39AE17 Scalar_BOOLEAN 0 boolean 0.0 1.0 /end CHARACTERISTIC
/begin CHARACTERISTIC Tra_bFltIdlSpdDes_C "Adopt status gearbox low-idle speed increase unfiltered or filtered" VALUE 0x39AE1A Scalar_BOOLEAN 0 boolean 0.0 1.0 /end CHARACTERISTIC
/begin CHARACTERISTIC Tra_trqDesMax_C "Decrement torque demand from gearbox" VALUE 0x39AE9C Scalar_SWORD 0 Trq_Nm -3000.0 3000.0 /end CHARACTERISTIC
/begin CHARACTERISTIC Tra_trqDesMin_C "Increment torque demand from gearbox" VALUE 0x39AE9E Scalar_SWORD 0 Trq_Nm -3000.0 3000.0 /end CHARACTERISTIC
/begin CHARACTERISTIC Tra_trqLeadMax_C "decrement lead torque demand from gearbox" VALUE 0x39AEA2 Scalar_SWORD 0 Trq_Nm -3000.0 3000.0 /end CHARACTERISTIC
/begin CHARACTERISTIC Tra_trqLeadMin_C "increment lead torque demand from gearbox" VALUE 0x39AEA4 Scalar_SWORD 0 Trq_Nm -3000.0 3000.0 /end CHARACTERISTIC
/begin CHARACTERISTIC PT_stTraType_C "Current transmission type" VALUE 0x39577F Scalar_UBYTE 0 PT_TraType_State_conv 0 4 /end CHARACTERISTIC
/begin CHARACTERISTIC TS_nMinAC_C "idle speed request" VALUE 0x39AE0C Scalar_SWORD 0 EngSpeed_rpm -12000.0 12000.0 /end CHARACTERISTIC
/begin CHARACTERISTIC TS_trqDesAcs_C "Desired Torque demand of the thermal system" VALUE 0x39AE10 Scalar_SWORD 0 Trq_Nm -3000.0 3276.7 /end CHARACTERISTIC
/begin CHARACTERISTIC TS_trqResvAcs_C "Torque reserve of the thermal system" VALUE 0x39AE12 Scalar_SWORD 0 Trq_Nm -3000.0 3276.7 /end CHARACTERISTIC
/begin CHARACTERISTIC TS_nMax_C "Highest engine speed requested by the thermal system" VALUE 0x39AE0A Scalar_SWORD 0 EngSpeed_rpm -12000.0 12000.0 /end CHARACTERISTIC
/begin CHARACTERISTIC TS_nMin_C "Lowest engine speed requested by the thermal system" VALUE 0x39AE0E Scalar_SWORD 0 EngSpeed_rpm -12000.0 12000.0 /end CHARACTERISTIC
/begin CHARACTERISTIC FanCtl_facCorSpd_MAP "System constants for the number of Xy co-ordinates for the map FANCTL_FACCORSPD_MAP" MAP 0x389AA6 Lookup2D_WORD 0 Factor 0.0 1.0
 /begin AXIS_DESCR COM_AXIS GlbDa_pEnv AirPressure_kPa 6 -3000.0 3000.0 AXIS_PTS_REF FanCtl_facCorSpd_MAPX /end AXIS_DESCR
 /begin AXIS_DESCR COM_AXIS GlbDa_tEnv Temp_deg 6 -50.0 150.0 AXIS_PTS_REF FanCtl_facCorSpd_MAPY /end AXIS_DESCR
/end CHARACTERISTIC
/begin CHARACTERISTIC FanCtl_nSpdDes_MAP "System constants for the number of XY co-ordinatesfor the map FANCTL_NSPDDES_MAP" MAP 0x389B66 Lookup2D_WORD 0 FanSpd_rpm -32768.0 32767.0
 /begin AXIS_DESCR COM_AXIS NO_INPUT_QUANTITY Prc_100_rate 6 -300.0 300.0 AXIS_PTS_REF FanCtl_nSpdDes_MAPX /end AXIS_DESCR
 /begin AXIS_DESCR COM_AXIS Epm_nEng EngSpeed_rpm 6 0.0 6000.0 AXIS_PTS_REF FanCtl_nSpdDes_MAPY /end AXIS_DESCR
/end CHARACTERISTIC
/begin CHARACTERISTIC FanCtl_facCorSpd2_MAP "System constants for the number of XY co-ordinates for the map FANCTL_FACCORSPD2_MAP" MAP 0x389A46 Lookup2D_WORD 0 Factor 0.0 1.0
 /begin AXIS_DESCR COM_AXIS GlbDa_pEnv AirPressure_kPa 6 -3000.0 3000.0 AXIS_PTS_REF FanCtl_facCorSpd2_MAPX /end AXIS_DESCR
 /begin AXIS_DESCR COM_AXIS GlbDa_tEnv Temp_deg 6 -50.0 150.0 AXIS_PTS_REF FanCtl_facCorSpd2_MAPY /end AXIS_DESCR
/end CHARACTERISTIC
/begin CHARACTERISTIC FanCtl_nSpdDes2_MAP "System constants for the number of XY co-ordinates for the map FANCTL_NSPDDES2_MAP" MAP 0x389B12 Lookup2D_WORD 0 FanSpd_rpm -32768.0 32767.0
 /begin AXIS_DESCR COM_AXIS NO_INPUT_QUANTITY Prc_100_rate 6 -300.0 300.0 AXIS_PTS_REF FanCtl_nSpdDes2_MAPX /end AXIS_DESCR
 /begin AXIS_DESCR FIX_AXIS Epm_nEng sfix16_En1 6 0.0 100.0 FIX_AXIS_PAR_DIST 0 40 6 /end AXIS_DESCR
/end CHARACTERISTIC
/begin CHARACTERISTIC FanCtl_tiTrqResv2_C "Time for reserve torque for Fan2" VALUE 0x389BEC Scalar_ULONG 0 State_uint32 0.0 4.294967295E+9 /end CHARACTERISTIC
/begin CHARACTERISTIC FanCtl_tiTrqResv_C "Time for reserve torque for Fan1" VALUE 0x389BF0 Scalar_ULONG 0 State_uint32 0.0 4.294967295E+9 /end CHARACTERISTIC
/begin CHARACTERISTIC FanCtl_tiAftRunMax_C "max fan afterrun time" VALUE 0x389BE4 Scalar_ULONG 0 EngTime_ms 0.0 4.294967295E+10 /end CHARACTERISTIC
/begin CHARACTERISTIC FanCtl_tiDelStrt_C "delay time to activte the fan after engine start" VALUE 0x389BE8 Scalar_ULONG 0 EngTime_ms 0.0 4.294967295E+10 /end CHARACTERISTIC
/begin CHARACTERISTIC FanCtl_nSpd2Win1L_C "lower limit: fan speed window 1 fan 1/fan 2" VALUE 0x389B06 Scalar_SWORD 0 FanSpd_rpm -32768.0 32767.0 /end CHARACTERISTIC
/begin CHARACTERISTIC FanCtl_nSpd2Win1R_C "upper limit: fan speed window 1 fan 1/fan 2" VALUE 0x389B08 Scalar_SWORD 0 FanSpd_rpm -32768.0 32767.0 /end CHARACTERISTIC
/begin CHARACTERISTIC FanCtl_nSpd2Win2L_C "lower limit: fan speed window 2 fan 1/fan 2" VALUE 0x389B0A Scalar_SWORD 0 FanSpd_rpm -32768.0 32767.0 /end CHARACTERISTIC
/begin CHARACTERISTIC FanCtl_nSpd2Win2R_C "upper limit: fan speed window 2 fan 1/fan 2" VALUE 0x389B0C Scalar_SWORD 0 FanSpd_rpm -32768.0 32767.0 /end CHARACTERISTIC
/begin CHARACTERISTIC FanCtl_nSpd2Win3L_C "lower limit: fan speed window 3 fan 1/fan 2" VALUE 0x389B0E Scalar_SWORD 0 FanSpd_rpm -32768.0 32767.0 /end CHARACTERISTIC
/begin CHARACTERISTIC FanCtl_nSpd2Win3R_C "upper limit: fan speed window 3 fan 1/fan 2" VALUE 0x389B10 Scalar_SWORD 0 FanSpd_rpm -32768.0 32767.0 /end CHARACTERISTIC
/begin CHARACTERISTIC FanCtl_nSpdFan2Max_C "Maximal fan speed fan 2" VALUE 0x389BC6 Scalar_SWORD 0 FanSpd_rpm -32768.0 32767.0 /end CHARACTERISTIC
/begin CHARACTERISTIC FanCtl_nSpdFanMax_C "Maximal fan speed fan 1" VALUE 0x389BC8 Scalar_SWORD 0 FanSpd_rpm -32768.0 32767.0 /end CHARACTERISTIC
/begin CHARACTERISTIC FanCtl_nSpdMin2_C "Hysteresis minimum: fan speed as minimal fan speed fan 2" VALUE 0x389BCA Scalar_SWORD 0 FanSpd_rpm -32768.0 32767.0 /end CHARACTERISTIC
/begin CHARACTERISTIC FanCtl_nSpdMinDelta2_C "Hysteresis delta: fan speed as minimal fan speed fan 2" VALUE 0x389BCC Scalar_SWORD 0 FanSpd_rpm -32768.0 32767.0 /end CHARACTERISTIC
/begin CHARACTERISTIC FanCtl_nSpdMinDelta_C "Hysteresis delta: fan speed as minimal fan speed fan1" VALUE 0x389BCE Scalar_SWORD 0 FanSpd_rpm -32768.0 32767.0 /end CHARACTERISTIC
/begin CHARACTERISTIC FanCtl_nSpdMin_C "Hysteresis minimum: fan speed as minimal fan speed fan 1" VALUE 0x389BD0 Scalar_SWORD 0 FanSpd_rpm -32768.0 32767.0 /end CHARACTERISTIC
/begin CHARACTERISTIC FanCtl_nSpdWin1L_C "low limit: window 1" VALUE 0x389BD2 Scalar_SWORD 0 FanSpd_rpm -32768.0 32767.0 /end CHARACTERISTIC
/begin CHARACTERISTIC FanCtl_nSpdWin1R_C "high limit: window 1" VALUE 0x389BD4 Scalar_SWORD 0 FanSpd_rpm -32768.0 32767.0 /end CHARACTERISTIC
/begin CHARACTERISTIC FanCtl_nSpdWin2L_C "low limit: window 2" VALUE 0x389BD6 Scalar_SWORD 0 FanSpd_rpm -32768.0 32767.0 /end CHARACTERISTIC
/begin CHARACTERISTIC FanCtl_nSpdWin2R_C "high limit: window 2" VALUE 0x389BD8 Scalar_SWORD 0 FanSpd_rpm -32768.0 32767.0 /end CHARACTERISTIC
/begin CHARACTERISTIC FanCtl_nSpdWin3L_C "low limit: window 3" VALUE 0x389BDA Scalar_SWORD 0 FanSpd_rpm -32768.0 32767.0 /end CHARACTERISTIC
/begin CHARACTERISTIC FanCtl_nSpdWin3R_C "high limit: window 3" VALUE 0x389BDC Scalar_SWORD 0 FanSpd_rpm -32768.0 32767.0 /end CHARACTERISTIC
/begin CHARACTERISTIC FanCtl_rClgDesARMin_C "low limit of abourt condition of fan afterrun dependent on colling request" VALUE 0x389BDE Scalar_SWORD 0 Prc_100_rate -300.0 300.0 /end CHARACTERISTIC
/begin CHARACTERISTIC FanCtl_rClgDesErr_C "cooling request in case of a error" VALUE 0x389BE0 Scalar_SWORD 0 Prc_100_rate -300.0 300.0 /end CHARACTERISTIC
/begin CHARACTERISTIC Fan_rHys2Hi_C "Low threshold of hysterisis to set digital fan powerstage output to true" VALUE 0x389C5E Scalar_SWORD 0 DutyCycle_rate -300.0 300.0 /end CHARACTERISTIC
/begin CHARACTERISTIC Fan_rHys2Lo_C "High threshold of hysterisis to set digital fan powerstage output to true" VALUE 0x389C60 Scalar_SWORD 0 DutyCycle_rate -300.0 300.0 /end CHARACTERISTIC
/begin CHARACTERISTIC Fan_rHysHi_C "High threshold of hysterisis to set digital fan powerstage output to true" VALUE 0x389C62 Scalar_SWORD 0 DutyCycle_rate -300.0 300.0 /end CHARACTERISTIC
/begin CHARACTERISTIC Fan_rHysLo_C "Low threshold of hysterisis to set digital fan powerstage output to true" VALUE 0x389C64 Scalar_SWORD 0 DutyCycle_rate -300.0 300.0 /end CHARACTERISTIC
/begin CHARACTERISTIC FanCtl_facCorErr_C "correction factor of fan in case of an error" VALUE 0x389A44 Scalar_SWORD 0 Factor 0.0 1.0 /end CHARACTERISTIC
/begin CHARACTERISTIC Fan_numFans_C "number of engine fan available" VALUE 0x389C04 Scalar_UBYTE 0 State_uint8 0.0 255.0 /end CHARACTERISTIC
/begin AXIS_PTS FanCtl_facCorSpd_MAPY "System constants for the number of Y co-ordinatesfor the map FANCTL_FACCORSPD_MAP" 0x389AFA GlbDa_tEnv Lookup2D_X_WORD 0 Temp_deg 6 -50.0 150.0 /end AXIS_PTS
/begin AXIS_PTS FanCtl_facCorSpd_MAPX "System constants for the number of X co-ordinatesfor the map FANCTL_FACCORSPD_MAP" 0x389AEE GlbDa_pEnv Lookup2D_X_WORD 0 AirPressure_kPa 6 -3000.0 3000.0 /end AXIS_PTS
/begin AXIS_PTS FanCtl_nSpdDes_MAPY "System constants for the number of Y co-ordinatesfor the map FANCTL_NSPDDES_MAP" 0x389BBA Epm_nEng Lookup2D_X_WORD 0 EngSpeed_rpm 6 0.0 6000.0 /end AXIS_PTS
/begin AXIS_PTS FanCtl_nSpdDes_MAPX "System constants for the number of X co-ordinatesfor the map FANCTL_NSPDDES_MAP" 0x389BAE NO_INPUT_QUANTITY Lookup2D_X_WORD 0 Prc_100_rate 6 -300.0 300.0 /end AXIS_PTS
/begin AXIS_PTS FanCtl_facCorSpd2_MAPY "System constants for the number of Y co-ordinates for the map FANCTL_FACCORSPD2_MAP" 0x389A9A GlbDa_tEnv Lookup2D_X_WORD 0 Temp_deg 6 -50.0 150.0 /end AXIS_PTS
/begin AXIS_PTS FanCtl_facCorSpd2_MAPX "System constants for the number of X co-ordinates for the map FANCTL_FACCORSPD2_MAP" 0x389A8E GlbDa_pEnv Lookup2D_X_WORD 0 AirPressure_kPa 6 -3000.0 3000.0 /end AXIS_PTS
/begin AXIS_PTS FanCtl_nSpdDes2_MAPX "System constants for the number of X co-ordinates for the map FANCTL_NSPDDES2_MAP" 0x389B5A NO_INPUT_QUANTITY Lookup2D_X_WORD 0 Prc_100_rate 6 -300.0 300.0 /end AXIS_PTS
/begin CHARACTERISTIC Fans_facVelCor_CUR "cooling by vehicle velocity/ cooling demand  fac" CURVE 0x389CB6 Lookup1D_WORD 0 Factor 0.0 1.0
 /begin AXIS_DESCR COM_AXIS VehV_v VehSpeed_km_h 6 0.0 250.0 AXIS_PTS_REF Fans_facVelCor_CURX /end AXIS_DESCR
/end CHARACTERISTIC
/begin CHARACTERISTIC Fans_RmpSlpNeg_C "Negative slope for fan cooling demand" VALUE 0x389CB0 Scalar_SWORD 0 DutyCycle_rate_s -327.68 327.67 /end CHARACTERISTIC
/begin CHARACTERISTIC Fans_RmpSlpPos_C "Positive slope for fan cooling demand" VALUE 0x389CB2 Scalar_SWORD 0 DutyCycle_rate_s -327.68 327.67 /end CHARACTERISTIC
/begin CHARACTERISTIC Fans_facVelCorErr_C "Adaptation value in case of error" VALUE 0x389CB4 Scalar_SWORD 0 Factor 0.0 1.0 /end CHARACTERISTIC
/begin AXIS_PTS Fans_facVelCor_CURX "Vehicle speed" 0x389CC2 VehV_v Lookup1D_X_WORD 0 VehSpeed_km_h 6 0.0 250.0 /end AXIS_PTS
/begin CHARACTERISTIC Fan_trqDem_CUR "Mapping between PWM signal of Fan_r1 and the resulting static torque demand Y" CURVE 0x389C94 Lookup1D_WORD 0 Trq_Nm -3000.0 3000.0
 /begin AXIS_DESCR COM_AXIS Fan_r DutyCycle_rate 6 0.0 100.0 AXIS_PTS_REF Fan_trqDem_CURX /end AXIS_DESCR
/end CHARACTERISTIC
/begin CHARACTERISTIC Fan_trqDem2_CUR "Mapping between PWM signal of Fan_r2 and the resulting static torque demand Y" CURVE 0x389C7C Lookup1D_WORD 0 Trq_Nm -3000.0 3000.0
 /begin AXIS_DESCR COM_AXIS Fan_r2 DutyCycle_rate 6 0.0 100.0 AXIS_PTS_REF Fan_trqDem2_CURX /end AXIS_DESCR
/end CHARACTERISTIC
/begin CHARACTERISTIC Fan_trqSplyDem2_C "Reserve Torque Demand for Fan 2" VALUE 0x389CAC Scalar_SWORD 0 Trq_Nm -3000.0 3000.0 /end CHARACTERISTIC
/begin CHARACTERISTIC Fan_trqSplyDem_C "Reserve Torque Demand for Fan 1" VALUE 0x389CAE Scalar_SWORD 0 Trq_Nm -3000.0 3000.0 /end CHARACTERISTIC
/begin CHARACTERISTIC Fan_facTrqDemFlt2PT1_C "Time Delay for Filtering of static Torque Demand of Fan2" VALUE 0x389C00 Scalar_UWORD 0 PT_fac 0.0 99.9985 /end CHARACTERISTIC
/begin CHARACTERISTIC Fan_facTrqDemFltPT1_C "Time Delay for Filtering of static Torque Demand of" VALUE 0x389C02 Scalar_UWORD 0 PT_fac 0.0 99.9985 /end CHARACTERISTIC
/begin AXIS_PTS Fan_trqDem_CURX "Mapping between PWM signal of Fan_r1 and the resulting static torque demand X" 0x389CA0 Fan_r Lookup1D_X_WORD 0 DutyCycle_rate 6 0.0 100.0 /end AXIS_PTS
/begin AXIS_PTS Fan_trqDem2_CURX "Mapping between PWM signal of Fan_r2 and the resulting static torque demand X" 0x389C88 Fan_r2 Lookup1D_X_WORD 0 DutyCycle_rate 6 0.0 100.0 /end AXIS_PTS
/begin CHARACTERISTIC DiffIO_trqPrtDfftl_C "Torque reduction for protection of the differential" VALUE 0x38684E Scalar_SWORD 0 Trq_Nm -3000.0 3000.0 /end CHARACTERISTIC
/begin CHARACTERISTIC Diff_dtrqRmpPNeg_C "Ramp slopes for differential protection moment / negative ramp slope" VALUE 0x386850 Scalar_SWORD 0 Trq_Nm_s -3000.0 3000.0 /end CHARACTERISTIC
/begin CHARACTERISTIC Diff_dtrqRmpPPos_C "Ramp slopes for differential protection moment / Slope if the ramp has to be increased" VALUE 0x386852 Scalar_SWORD 0 Trq_Nm_s -3000.0 3000.0 /end CHARACTERISTIC
/begin CHARACTERISTIC Diff_trqPrtErrLim_C "Substitute value for differential protective torque" VALUE 0x386856 Scalar_SWORD 0 Trq_Nm -3000.0 3000.0 /end CHARACTERISTIC
/begin CHARACTERISTIC DiffIO_rTrqDfftl_C "Differential conversion" VALUE 0x38684C Scalar_SWORD 0 TransRatio -300.0 300.0 /end CHARACTERISTIC
/begin CHARACTERISTIC Diff_rTrqDfftl_C "Defaultvalue for the Differential ratio" VALUE 0x386854 Scalar_SWORD 0 TransRatio -300.0 300.0 /end CHARACTERISTIC
/begin CHARACTERISTIC AccPed_trqLimMax_C "Maximum wheel torque in case of accelerator pedal error" VALUE 0x38224C Scalar_SWORD 0 Trq_Nm -3000.0 3000.0 /end CHARACTERISTIC
/begin CHARACTERISTIC AccPed_nMax_C "Maximum engine speed in case of accelerator pedal erro" VALUE 0x381FBC Scalar_SWORD 0 EngSpeed_rpm 0.0 6000.0 /end CHARACTERISTIC
/begin CHARACTERISTIC AccPed_nMinBrkApp_C "Minimum engine speed in case of accelerator pedal brake implausibility" VALUE 0x381FBE Scalar_SWORD 0 EngSpeed_rpm 0.0 6000.0 /end CHARACTERISTIC
/begin CHARACTERISTIC AccPed_nMinBrk_C "Minimum engine speed in case of accelerator pedal error and trodden brake" VALUE 0x381FC0 Scalar_SWORD 0 EngSpeed_rpm 0.0 6000.0 /end CHARACTERISTIC
/begin CHARACTERISTIC AccPed_nMinNoBrk_C "Minimum engine speed in case of accelerator pedal error and brake not applied" VALUE 0x381FC2 Scalar_SWORD 0 EngSpeed_rpm 0.0 6000.0 /end CHARACTERISTIC
/begin CHARACTERISTIC AccPed_rBrk50_CUR "percentage of engine brake torque" CURVE 0x381FC4 Lookup1D_WORD 0 Accpedal_rate 0.0 120.0
 /begin AXIS_DESCR COM_AXIS Epm_nEng EngSpeed_rpm 16 0.0 6000.0 AXIS_PTS_REF AccPed_rBrk50_CURX /end AXIS_DESCR
/end CHARACTERISTIC
/begin CHARACTERISTIC MoFDrDem_trqEngRev_MAP "inner torque for engaged reverse gear calculated from the accelerator pedal angle and the engine speed" MAP 0x3950B6 Lookup2D_WORD 0 Trq_Nm -3000.0 3000.0
 /begin AXIS_DESCR COM_AXIS Epm_nEng EngSpeed_rpm 16 0.0 6000.0 AXIS_PTS_REF MoFDrDem_trqEngRev_MAPX /end AXIS_DESCR
 /begin AXIS_DESCR COM_AXIS APP_r Accpedal_rate 16 0.0 120.0 AXIS_PTS_REF MoFDrDem_trqEngRev_MAPY /end AXIS_DESCR
/end CHARACTERISTIC
/begin CHARACTERISTIC MoFDrDem_trqEng_MAP "inner torque for disengaged reverse gear calculated from the accelerator pedal angle and the engine speed" MAP 0x3952F6 Lookup2D_WORD 0 Trq_Nm -3000.0 3000.0
 /begin AXIS_DESCR COM_AXIS Epm_nEng EngSpeed_rpm 16 0.0 6000.0 AXIS_PTS_REF MoFDrDem_trqEng_MAPX /end AXIS_DESCR
 /begin AXIS_DESCR COM_AXIS APP_r Accpedal_rate 16 0.0 120.0 AXIS_PTS_REF MoFDrDem_trqEng_MAPY /end AXIS_DESCR
/end CHARACTERISTIC
/begin CHARACTERISTIC AccPed_trqPrp_MAP "inner torque in mastershift operation calculated from the accelerator pedal angle and the vehicle speed" MAP 0x38224E Lookup2D_WORD 0 Trq_Nm -3000.0 3000.0
 /begin AXIS_DESCR COM_AXIS GlbDa_vX VehSpeed_km_h 16 0.0 255.0 AXIS_PTS_REF AccPed_trqPrp_MAPX /end AXIS_DESCR
 /begin AXIS_DESCR COM_AXIS APP_r Accpedal_rate 16 0.0 120.0 AXIS_PTS_REF AccPed_trqPrp_MAPY /end AXIS_DESCR
/end CHARACTERISTIC
/begin CHARACTERISTIC AccPed_trqDemThres_C "Threshold value of driver demand torque for status driver demand active" VALUE 0x38200A Scalar_SWORD 0 Trq_Nm -3000.0 3000.0 /end CHARACTERISTIC
/begin CHARACTERISTIC SigTst_trqAccPed_C "torque under test" VALUE 0x3980B4 Scalar_SWORD 0 Trq_Nm -3000.0 3000.0 /end CHARACTERISTIC
/begin CHARACTERISTIC AccPed_rThresPrp_C "Threshold between overrun and propulsion" VALUE 0x382004 Scalar_SWORD 0 Accpedal_rate 0.0 100.0 /end CHARACTERISTIC
/begin CHARACTERISTIC AccPed_rZero_C "ratio of APP, below which the resulting fuel quantity should be zero" VALUE 0x382006 Scalar_SWORD 0 Accpedal_rate 0.0 100.0 /end CHARACTERISTIC
/begin CHARACTERISTIC AccPed_facCompTot_C "Factor for complete compensation (cutoff ramp)" VALUE 0x381FB8 Scalar_SWORD 0 Factor -10.0 10.0 /end CHARACTERISTIC
/begin CHARACTERISTIC AccPed_swtBrkPrio_C "AccPed/EngBrk priority: (0:EngBrk wins, 1: pressed AccPed wins, >=2 last changed wins)" VALUE 0x382008 Scalar_UBYTE 0 State_uint8 0.0 255.0 /end CHARACTERISTIC
/begin CHARACTERISTIC SigTst_swtAccPed_C "switch of torque under test" VALUE 0x39806D Scalar_UBYTE 0 Switch_conv 0 1 /end CHARACTERISTIC
/begin AXIS_PTS AccPed_rBrk50_CURX "Average engine speed of one cylinder segment" 0x381FE4 Epm_nEng Lookup1D_X_WORD 0 EngSpeed_rpm 16 0.0 6000.0 /end AXIS_PTS
/begin AXIS_PTS MoFDrDem_trqEngRev_MAPY "Standardized accelerator pedal position" 0x3952D6 APP_r Lookup2D_X_WORD 0 Accpedal_rate 16 0.0 120.0 /end AXIS_PTS
/begin AXIS_PTS MoFDrDem_trqEngRev_MAPX "Average engine speed of one cylinder segment" 0x3952B6 Epm_nEng Lookup2D_X_WORD 0 EngSpeed_rpm 16 0.0 6000.0 /end AXIS_PTS
/begin AXIS_PTS MoFDrDem_trqEng_MAPY "Standardized accelerator pedal position" 0x395516 APP_r Lookup2D_X_WORD 0 Accpedal_rate 16 0.0 120.0 /end AXIS_PTS
/begin AXIS_PTS MoFDrDem_trqEng_MAPX "Average engine speed of one cylinder segment" 0x3954F6 Epm_nEng Lookup2D_X_WORD 0 EngSpeed_rpm 16 0.0 6000.0 /end AXIS_PTS
/begin AXIS_PTS AccPed_trqPrp_MAPY "Standardized accelerator pedal position" 0x38246E APP_r Lookup2D_X_WORD 0 Accpedal_rate 16 0.0 120.0 /end AXIS_PTS
/begin AXIS_PTS AccPed_trqPrp_MAPX "Longitudinal vehicle speed (X-direction)" 0x38244E GlbDa_vX Lookup2D_X_WORD 0 VehSpeed_km_h 16 0.0 255.0 /end AXIS_PTS
/begin CHARACTERISTIC AccPed_trqEngRev_MAP "inner torque for engaged reverse gear calculated from the accelerator pedal angle and the engine speed" MAP 0x38200C Lookup2D_WORD 0 Trq_Nm -3000.0 3000.0
 /begin AXIS_DESCR COM_AXIS Epm_nEng EngSpeed_rpm 16 0.0 6000.0 AXIS_PTS_REF AccPed_trqEngRev_MAPX /end AXIS_DESCR
 /begin AXIS_DESCR COM_AXIS APP_rUnFlt Accpedal_rate 16 0.0 120.0 AXIS_PTS_REF AccPed_trqEngRev_MAPY /end AXIS_DESCR
/end CHARACTERISTIC
/begin CHARACTERISTIC SigTst_trqAccPedLead_C "torque in lead path under test" VALUE 0x3980B2 Scalar_SWORD 0 Trq_Nm -3000.0 3000.0 /end CHARACTERISTIC
/begin CHARACTERISTIC SigTst_swtAccPedLead_C "switch of torque in lead path under test" VALUE 0x39806C Scalar_UBYTE 0 Switch_conv 0 1 /end CHARACTERISTIC
/begin AXIS_PTS AccPed_trqEngRev_MAPY "Standardized accelerator pedal position" 0x38222C APP_rUnFlt Lookup2D_X_WORD 0 Accpedal_rate 16 0.0 120.0 /end AXIS_PTS
/begin AXIS_PTS AccPed_trqEngRev_MAPX "Average engine speed of one cylinder segment" 0x38220C Epm_nEng Lookup2D_X_WORD 0 EngSpeed_rpm 16 0.0 6000.0 /end AXIS_PTS
/begin CHARACTERISTIC AccPed_dtrqDwnLim_MAP "Torque step limitation for falling ramp from the MAP AccPed_dtrqDwnLim_MAP" MAP 0x3818AE Lookup2D_WORD 0 Trq_Nm_s -3000.0 3000.0
 /begin AXIS_DESCR COM_AXIS NO_INPUT_QUANTITY Trq_Nm 22 -3200.0 3200.0 AXIS_PTS_REF AccPed_dtrqDwnLim_MAPX /end AXIS_DESCR
 /begin AXIS_DESCR COM_AXIS Tra_numGear Tra_num 19 -2.0 16.0 AXIS_PTS_REF AccPed_dtrqDwnLim_MAPY /end AXIS_DESCR
/end CHARACTERISTIC
/begin CHARACTERISTIC AccPed_dtrqUpLim_MAP "Torque step limitation for rising ramp from the map AccPed_dtrqUpLim_MAP" MAP 0x381C34 Lookup2D_WORD 0 Trq_Nm_s -3000.0 3000.0
 /begin AXIS_DESCR COM_AXIS NO_INPUT_QUANTITY Trq_Nm 22 -3200.0 3200.0 AXIS_PTS_REF AccPed_dtrqUpLim_MAPX /end AXIS_DESCR
 /begin AXIS_DESCR COM_AXIS Tra_numGear Tra_num 19 -2.0 16.0 AXIS_PTS_REF AccPed_dtrqUpLim_MAPY /end AXIS_DESCR
/end CHARACTERISTIC
/begin CHARACTERISTIC AccPed_dnMaxRmp_C "Maximum allowed threshold for engine speed acceleration" VALUE 0x3818AC Scalar_SWORD 0 EngSpeed_rpm_s -12000.0 12000.0 /end CHARACTERISTIC
/begin CHARACTERISTIC AccPed_nMaxRmp_C "The downward torque step limitation is switched off above this speed." VALUE 0x381FBA Scalar_SWORD 0 EngSpeed_rpm 0.0 6000.0 /end CHARACTERISTIC
/begin CHARACTERISTIC AccPed_swtStpLim_C "Switch to select propulsion torque step limitation-(1 -Select, 0 -deselect)" VALUE 0x382009 Scalar_UBYTE 0 Switch_conv 0 1 /end CHARACTERISTIC
/begin AXIS_PTS AccPed_dtrqDwnLim_MAPY "Current gear information" 0x381C20 Tra_numGear Lookup2D_X_BYTE 0 Tra_num 19 -2.0 16.0 /end AXIS_PTS
/begin AXIS_PTS AccPed_dtrqDwnLim_MAPX "Previous raster of Accped_trqDes" 0x381BF2 NO_INPUT_QUANTITY Lookup2D_X_WORD 0 Trq_Nm 22 -3200.0 3200.0 /end AXIS_PTS
/begin AXIS_PTS AccPed_dtrqUpLim_MAPY "Current gear information" 0x381FA4 Tra_numGear Lookup2D_X_BYTE 0 Tra_num 19 -2.0 16.0 /end AXIS_PTS
/begin AXIS_PTS AccPed_dtrqUpLim_MAPX "Previous raster of Accped_trqDes" 0x381F78 NO_INPUT_QUANTITY Lookup2D_X_WORD 0 Trq_Nm 22 -3200.0 3200.0 /end AXIS_PTS
/begin CHARACTERISTIC CoVMD_trqLLim_C "propulsion torque of longitudinal limter" VALUE 0x3867F4 Scalar_SWORD 0 Trq_Nm -3000.0 3000.0 /end CHARACTERISTIC
/begin CHARACTERISTIC DrvDem_nSetPLo_C "Minimal engine speed of DrvDem" VALUE 0x386D32 Scalar_SWORD 0 EngSpeed_rpm -12000.0 12000.0 /end CHARACTERISTIC
/begin CHARACTERISTIC CoVMD_facTrq_C "Adjustment factor for the frictional torque" VALUE 0x3867F2 Scalar_SWORD 0 Factor -30.0 30.0 /end CHARACTERISTIC
/begin CHARACTERISTIC VMD_swtVCMActv_C "Switch to enable/disable Vehicle control mode" VALUE 0x39B182 Scalar_UBYTE 0 Switch_conv 0 1 /end CHARACTERISTIC
/begin CHARACTERISTIC InjVlv_freqBlkShtMax_CUR "Max value of frequency of blankshot on Engine Speed" CURVE 0x394100 Lookup1D_UWORD 0 Freq_q1p0 0.0 65535.0
 /begin AXIS_DESCR COM_AXIS Epm_nEng EngSpeed_rpm 10 0.0 6000.0 AXIS_PTS_REF InjVlv_freqBlkShtMax_CURX /end AXIS_DESCR
/end CHARACTERISTIC
/begin CHARACTERISTIC InjVlv_tiETBlkShtAft_MAP "Map for determination of the blakshot energizing time depending on rail pressure and engine temperature of AfterRun" MAP 0x394544 Lookup2D_WORD 0 InjTime_us -13107.2 13106.8
 /begin AXIS_DESCR COM_AXIS RailP_pFlt RailPressure_bar 16 0.0 2000.0 AXIS_PTS_REF InjVlv_tiETBlkShtAft_MAPX /end AXIS_DESCR
 /begin AXIS_DESCR COM_AXIS EngDa_tEng Temp_deg 16 -1000.0 1000.0 AXIS_PTS_REF InjVlv_tiETBlkShtAft_MAPY /end AXIS_DESCR
/end CHARACTERISTIC
/begin CHARACTERISTIC InjVlv_tiETBlkSht_MAP "Map for determination of the blakshot energizing time depending on rail pressure and engine temperature" MAP 0x394788 Lookup2D_WORD 0 InjTime_us -13107.2 13106.8
 /begin AXIS_DESCR COM_AXIS RailP_pCurr RailPressure_bar 16 0.0 2000.0 AXIS_PTS_REF InjVlv_tiETBlkSht_MAPX /end AXIS_DESCR
 /begin AXIS_DESCR COM_AXIS EngDa_tEng Temp_deg 16 -1000.0 1000.0 AXIS_PTS_REF InjVlv_tiETBlkSht_MAPY /end AXIS_DESCR
/end CHARACTERISTIC
/begin CHARACTERISTIC InjVlv_freqBlkShtMin_C "Min value for blankshot frequency" VALUE 0x394128 Scalar_UWORD 0 Freq_q1p0 0.0 65535.0 /end CHARACTERISTIC
/begin CHARACTERISTIC SigTst_freqBlkSht_C "relacement values for blankshot frequency" VALUE 0x398032 Scalar_UWORD 0 Freq_q1p0 0.0 65535.0 /end CHARACTERISTIC
/begin CHARACTERISTIC InjVlv_tiETBlkShtMin_C "Threshold for minimal blankshot energizing time " VALUE 0x394784 Scalar_SWORD 0 InjTime_us -13107.2 13106.8 /end CHARACTERISTIC
/begin CHARACTERISTIC InjVlv_tiETBlkShtZFC_C "relacement values when no ZFC Fucntion" VALUE 0x394786 Scalar_SWORD 0 InjTime_us -13107.2 13106.8 /end CHARACTERISTIC
/begin CHARACTERISTIC InjVlv_phiBlkShtStrtMax_C "Max value of angle area for release Blankshots" VALUE 0x39414C Scalar_SWORD 0 Angle_CA -360.0 0.0 /end CHARACTERISTIC
/begin CHARACTERISTIC InjVlv_phiBlkShtStrtMin_C "Min value of angle area for release Blankshots" VALUE 0x39414E Scalar_SWORD 0 Angle_CA -360.0 0.0 /end CHARACTERISTIC
/begin CHARACTERISTIC InjVlv_phiBlkShtStrt_C "Start value of angle area for release Blankshots" VALUE 0x394150 Scalar_SWORD 0 Angle_CA -360.0 0.0 /end CHARACTERISTIC
/begin CHARACTERISTIC InjVlv_swtPlausBlkShtET_C "Label for activating or deactivating the blankshot plausibility function." VALUE 0x3942E2 Scalar_BOOLEAN 0 boolean 0.0 1.0 /end CHARACTERISTIC
/begin CHARACTERISTIC SigTst_swtFreqBlkSht_C "switch to activate replacement values for blankshot frequency" VALUE 0x39807A Scalar_UBYTE 0 Switch_conv 0 1 /end CHARACTERISTIC
/begin AXIS_PTS InjVlv_freqBlkShtMax_CURX "Xaixs of curve, Engine Speed" 0x394114 Epm_nEng Lookup1D_X_WORD 0 EngSpeed_rpm 10 0.0 6000.0 /end AXIS_PTS
/begin AXIS_PTS InjVlv_tiETBlkShtAft_MAPY "Yaxis of Map, Engine Temperature" 0x394764 EngDa_tEng Lookup2D_X_WORD 0 Temp_deg 16 -1000.0 1000.0 /end AXIS_PTS
/begin AXIS_PTS InjVlv_tiETBlkShtAft_MAPX "Xaxis of Map, Rail Pressure" 0x394744 RailP_pFlt Lookup2D_X_WORD 0 RailPressure_bar 16 0.0 2000.0 /end AXIS_PTS
/begin AXIS_PTS InjVlv_tiETBlkSht_MAPY "The Y axis of InjVlv_tiETBlkSht_MAP" 0x3949A8 EngDa_tEng Lookup2D_X_WORD 0 Temp_deg 16 -1000.0 1000.0 /end AXIS_PTS
/begin AXIS_PTS InjVlv_tiETBlkSht_MAPX "The X axis of InjVlv_tiETBlkSht_MAP" 0x394988 RailP_pCurr Lookup2D_X_WORD 0 RailPressure_bar 16 0.0 2000.0 /end AXIS_PTS
/begin CHARACTERISTIC InjVlv_tiCloseDelay_MAP "injector close delay time" MAP 0x3942E4 Lookup2D_WORD 0 InjTime_us -13107.0 13106.0
 /begin AXIS_DESCR COM_AXIS InjCtl_qSetUnBal FuelMass_mg_hub 14 -319.0 319.0 AXIS_PTS_REF InjVlv_tiCloseDelay_MAPX /end AXIS_DESCR
 /begin AXIS_DESCR COM_AXIS RailP_pFlt RailPressure_bar 14 0.0 2000.0 AXIS_PTS_REF InjVlv_tiCloseDelay_MAPY /end AXIS_DESCR
/end CHARACTERISTIC
/begin CHARACTERISTIC InjVlv_tiOpenDelay_MAP "injector open delay time" MAP 0x394C90 Lookup2D_WORD 0 InjTime_us -13107.0 13106.0
 /begin AXIS_DESCR COM_AXIS InjCtl_qSetUnBal FuelMass_mg_hub 14 -319.0 319.0 AXIS_PTS_REF InjVlv_tiOpenDelay_MAPX /end AXIS_DESCR
 /begin AXIS_DESCR COM_AXIS RailP_pFlt RailPressure_bar 14 0.0 2000.0 AXIS_PTS_REF InjVlv_tiOpenDelay_MAPY /end AXIS_DESCR
/end CHARACTERISTIC
/begin CHARACTERISTIC InjVlv_tiET_MAP "Map for converting from injection quantity to energizing time,Applies to all injections" MAP 0x3949C8 Lookup2D_WORD 0 InjTime_us -13107.0 13106.0
 /begin AXIS_DESCR COM_AXIS NO_INPUT_QUANTITY FuelMass_mg_hub 20 -319.0 319.0 AXIS_PTS_REF InjVlv_tiET_MAPX /end AXIS_DESCR
 /begin AXIS_DESCR COM_AXIS RailP_pCurr RailPressure_bar 16 0.0 2000.0 AXIS_PTS_REF InjVlv_tiET_MAPY /end AXIS_DESCR
/end CHARACTERISTIC
/begin CHARACTERISTIC InjVlv_pMin_CUR "Minium Rail pressure for MI1 based on Rail pressure" CURVE 0x39412C Lookup1D_WORD 0 RailPressure_bar 0.0 2000.0
 /begin AXIS_DESCR COM_AXIS EngDa_tEng Temp_deg 8 -50.0 150.0 AXIS_PTS_REF InjVlv_pMin_CURX /end AXIS_DESCR
/end CHARACTERISTIC
/begin CHARACTERISTIC InjVlv_qMI1Min_CUR "minimum fuel quantity curve for MI1" CURVE 0x394152 Lookup1D_WORD 0 FuelMass_mg_hub -319.0 319.0
 /begin AXIS_DESCR COM_AXIS RailP_pFlt RailPressure_bar 25 0.0 2000.0 AXIS_PTS_REF InjVlv_qMI1Min_CURX /end AXIS_DESCR
/end CHARACTERISTIC
/begin CHARACTERISTIC InjVlv_qPiI1Min_CUR "minimum fuel quantity curve for PiI1" CURVE 0x3941B6 Lookup1D_WORD 0 FuelMass_mg_hub -319.0 319.0
 /begin AXIS_DESCR COM_AXIS RailP_pFlt RailPressure_bar 25 0.0 2000.0 AXIS_PTS_REF InjVlv_qPiI1Min_CURX /end AXIS_DESCR
/end CHARACTERISTIC
/begin CHARACTERISTIC InjVlv_qPiI2Min_CUR "minimum fuel quantity curve for PiI2" CURVE 0x39421A Lookup1D_WORD 0 FuelMass_mg_hub -319.0 319.0
 /begin AXIS_DESCR COM_AXIS RailP_pFlt RailPressure_bar 25 0.0 2000.0 AXIS_PTS_REF InjVlv_qPiI2Min_CURX /end AXIS_DESCR
/end CHARACTERISTIC
/begin CHARACTERISTIC InjVlv_qPoI2Min_CUR "minimum fuel quantity curve for PoI2" CURVE 0x39427E Lookup1D_WORD 0 FuelMass_mg_hub -319.0 319.0
 /begin AXIS_DESCR COM_AXIS RailP_pFlt RailPressure_bar 25 0.0 2000.0 AXIS_PTS_REF InjVlv_qPoI2Min_CURX /end AXIS_DESCR
/end CHARACTERISTIC
/begin CHARACTERISTIC InjVlv_tiDiffMin_MAP "Minium injection interval between two injection" MAP 0x3944A4 Lookup2D_WORD 0 InjTime_us -13107.0 13106.0
 /begin AXIS_DESCR COM_AXIS RailP_pFlt RailPressure_bar 8 0.0 2000.0 AXIS_PTS_REF InjVlv_tiDiffMin_MAPX /end AXIS_DESCR
 /begin AXIS_DESCR COM_AXIS InjCrv_qMI1Des FuelMass_mg_hub 8 0.0 319.0 AXIS_PTS_REF InjVlv_tiDiffMin_MAPY /end AXIS_DESCR
/end CHARACTERISTIC
/begin CHARACTERISTIC InjVlv_pMin_C "Injector pressure threshold for releasing/inhibiting the injection" VALUE 0x39412A Scalar_SWORD 0 RailPressure_bar 0.0 2000.0 /end CHARACTERISTIC
/begin CHARACTERISTIC InjVlv_tiPseElec "Injector pause time for preventing collisions (during electric energizing)" VALUE 0x394E50 Scalar_SWORD 0 InjTime_us -13107.0 13106.0 /end CHARACTERISTIC
/begin CHARACTERISTIC SigTst_tiMI1ET_C "Set Value of energizing time for MI1" VALUE 0x3980A6 Scalar_SWORD 0 InjTime_us -13107.0 13106.0 /end CHARACTERISTIC
/begin CHARACTERISTIC SigTst_tiPOI2ET_C "Set Value of energizing time for PoI2" VALUE 0x3980A8 Scalar_SWORD 0 InjTime_us -13107.0 13106.0 /end CHARACTERISTIC
/begin CHARACTERISTIC SigTst_tiPiI1ET_C "Set Value of energizing time for PiI1" VALUE 0x3980AA Scalar_SWORD 0 InjTime_us -13107.0 13106.0 /end CHARACTERISTIC
/begin CHARACTERISTIC SigTst_tiPiI2ET_C "Set Value of energizing time for PiI2" VALUE 0x3980AE Scalar_SWORD 0 InjTime_us -13107.0 13106.0 /end CHARACTERISTIC
/begin CHARACTERISTIC SigTst_swtMI1ET_C "Switch for Set Value of energizing time for MI1" VALUE 0x39807E Scalar_UBYTE 0 Switch_conv 0 1 /end CHARACTERISTIC
/begin CHARACTERISTIC SigTst_swtPOI2ET_C "Switch for Set Value of energizing time for PoI2" VALUE 0x398086 Scalar_UBYTE 0 Switch_conv 0 1 /end CHARACTERISTIC
/begin CHARACTERISTIC SigTst_swtPiI1ET_C "Switch for Set Value of energizing time for PiI1" VALUE 0x398088 Scalar_UBYTE 0 Switch_conv 0 1 /end CHARACTERISTIC
/begin CHARACTERISTIC SigTst_swtPiI2ET_C "Switch for Set Value of energizing time for PiI2" VALUE 0x39808C Scalar_UBYTE 0 Switch_conv 0 1 /end CHARACTERISTIC
/begin AXIS_PTS InjVlv_tiCloseDelay_MAPY "injector close delay time" 0x394488 RailP_pFlt Lookup2D_X_WORD 0 RailPressure_bar 14 0.0 2000.0 /end AXIS_PTS
/begin AXIS_PTS InjVlv_tiCloseDelay_MAPX "injector close delay time" 0x39446C InjCtl_qSetUnBal Lookup2D_X_WORD 0 FuelMass_mg_hub 14 -319.0 319.0 /end AXIS_PTS
/begin AXIS_PTS InjVlv_tiOpenDelay_MAPY "injector open delay time" 0x394E34 RailP_pFlt Lookup2D_X_WORD 0 RailPressure_bar 14 0.0 2000.0 /end AXIS_PTS
/begin AXIS_PTS InjVlv_tiOpenDelay_MAPX "injector open delay time" 0x394E18 InjCtl_qSetUnBal Lookup2D_X_WORD 0 FuelMass_mg_hub 14 -319.0 319.0 /end AXIS_PTS
/begin AXIS_PTS InjVlv_tiET_MAPY "Map for converting from injection quantity to energizing time,Applies to all injections" 0x394C70 RailP_pCurr Lookup2D_X_WORD 0 RailPressure_bar 16 0.0 2000.0 /end AXIS_PTS
/begin AXIS_PTS InjVlv_tiET_MAPX "Map for converting from injection quantity to energizing time,Applies to all injections" 0x394C48 NO_INPUT_QUANTITY Lookup2D_X_WORD 0 FuelMass_mg_hub 20 -319.0 319.0 /end AXIS_PTS
/begin AXIS_PTS InjVlv_pMin_CURX "Engine Temperature" 0x39413C EngDa_tEng Lookup1D_X_WORD 0 Temp_deg 8 -50.0 150.0 /end AXIS_PTS
/begin AXIS_PTS InjVlv_qMI1Min_CURX "minimum fuel quantity curve for MI1" 0x394184 RailP_pFlt Lookup1D_X_WORD 0 RailPressure_bar 25 0.0 2000.0 /end AXIS_PTS
/begin AXIS_PTS InjVlv_qPiI1Min_CURX "minimum fuel quantity curve for PiI1" 0x3941E8 RailP_pFlt Lookup1D_X_WORD 0 RailPressure_bar 25 0.0 2000.0 /end AXIS_PTS
/begin AXIS_PTS InjVlv_qPiI2Min_CURX "minimum fuel quantity curve for PiI2" 0x39424C RailP_pFlt Lookup1D_X_WORD 0 RailPressure_bar 25 0.0 2000.0 /end AXIS_PTS
/begin AXIS_PTS InjVlv_qPoI2Min_CURX "minimum fuel quantity curve for PoI2" 0x3942B0 RailP_pFlt Lookup1D_X_WORD 0 RailPressure_bar 25 0.0 2000.0 /end AXIS_PTS
/begin AXIS_PTS InjVlv_tiDiffMin_MAPY "Minium injection interval between two injection" 0x394534 InjCrv_qMI1Des Lookup2D_X_WORD 0 FuelMass_mg_hub 8 0.0 319.0 /end AXIS_PTS
/begin AXIS_PTS InjVlv_tiDiffMin_MAPX "Minium injection interval between two injection" 0x394524 RailP_pFlt Lookup2D_X_WORD 0 RailPressure_bar 8 0.0 2000.0 /end AXIS_PTS
/begin CHARACTERISTIC AFS_tiRawSRCMaxDebDef_C "Debounce Time of SRC High Fault" VALUE 0x3809C0 Scalar_ULONG 0 Debounce_ms 0.0 65535.0 /end CHARACTERISTIC
/begin CHARACTERISTIC AFS_tiRawSRCMaxDebOk_C "Debounce Time of SRC High Heal" VALUE 0x3809C4 Scalar_ULONG 0 Debounce_ms 0.0 65535.0 /end CHARACTERISTIC
/begin CHARACTERISTIC AFS_tiRawSRCMinDebDef_C "Debounce Time of SRC Low Fault" VALUE 0x3809C8 Scalar_ULONG 0 Debounce_ms 0.0 65535.0 /end CHARACTERISTIC
/begin CHARACTERISTIC AFS_tiRawSRCMinDebOk_C "Debounce Time of SRC Low Heal" VALUE 0x3809CC Scalar_ULONG 0 Debounce_ms 0.0 65535.0 /end CHARACTERISTIC
/begin CHARACTERISTIC AFS_tiRawSRCHi_C "Upper threshold for air-mass SRC-high detection" VALUE 0x3809B8 Scalar_LONG 0 Time_PwmHigh_us 0.0 1.07374182E+8 /end CHARACTERISTIC
/begin CHARACTERISTIC AFS_tiRawSRCLo_C "Lower threshold for air-mass SRC-high detection" VALUE 0x3809BC Scalar_LONG 0 Time_PwmHigh_us 0.0 1.07374182E+8 /end CHARACTERISTIC
/begin CHARACTERISTIC AFS_facLPFiltPT1_C "Time constant to filter the air flow signal" VALUE 0x38043A Scalar_UWORD 0 PT_fac 0.0 99.9985 /end CHARACTERISTIC
/begin CHARACTERISTIC AFS_dmTransf_CUR "Transformation curve to convert the electrical AFS signal to physical air flow signal" CURVE 0x3802A6 Lookup1D_WORD 0 AirMassPerTime -8192.0 8191.0
 /begin AXIS_DESCR COM_AXIS AFS_tiTransfCrvIn_mp Time_PwmHigh_us 31 0.0 1.07374182E+8 AXIS_PTS_REF AFS_dmTransf_CURX /end AXIS_DESCR
/end CHARACTERISTIC
/begin CHARACTERISTIC AFS_numSmplMax_C "Maximum number of acquired samples for forced averaging" VALUE 0x3808E1 Scalar_UBYTE 0 State_uint8 0.0 255.0 /end CHARACTERISTIC
/begin AXIS_PTS AFS_dmTransf_CURX "Axis Points of Transform Curve" 0x3802E4 AFS_tiTransfCrvIn_mp Lookup1D_X_LONG 0 Time_PwmHigh_us 31 0.0 1.07374182E+8 /end AXIS_PTS
/begin CHARACTERISTIC AFS_dmAirSubsVal_MAP "substitute air mass flow map for AFS sensor not installed or fault" MAP 0x380062 Lookup2D_WORD 0 AirMassPerTime -8192.0 8191.0
 /begin AXIS_DESCR COM_AXIS InjCtl_qRaw FuelMass_mg_hub 16 -300.0 300.0 AXIS_PTS_REF AFS_dmAirSubsVal_MAPX /end AXIS_DESCR
 /begin AXIS_DESCR COM_AXIS Epm_nEng EngSpeed_rpm 16 -6000.0 6000.0 AXIS_PTS_REF AFS_dmAirSubsVal_MAPY /end AXIS_DESCR
/end CHARACTERISTIC
/begin CHARACTERISTIC AFS_facAirSubsEnvPCor_CUR "environment air pressure correction curve for substitute air mass flow map" CURVE 0x380372 Lookup1D_WORD 0 Prc_Fact10000 -3.2 3.2
 /begin AXIS_DESCR COM_AXIS EnvP_p AirPressure_kPa 15 0.0 1200.0 AXIS_PTS_REF AFS_facAirSubsEnvPCor_CURX /end AXIS_DESCR
/end CHARACTERISTIC
/begin CHARACTERISTIC AFS_facPlsCorBasEGRShOff_MAP "pulsation correction map for engine operation without EGR" MAP 0x380448 Lookup2D_WORD 0 Prc_Fact10000 -3.2 3.2
 /begin AXIS_DESCR COM_AXIS InjCtl_qSetUnBal FuelMass_mg_hub 16 -300.0 300.0 AXIS_PTS_REF AFS_facPlsCorBasEGRShOff_MAPX /end AXIS_DESCR
 /begin AXIS_DESCR COM_AXIS Epm_nEng EngSpeed_rpm 16 -6000.0 6000.0 AXIS_PTS_REF AFS_facPlsCorBasEGRShOff_MAPY /end AXIS_DESCR
/end CHARACTERISTIC
/begin CHARACTERISTIC AFS_facPlsCorBasEOMQnt2_MAP "additional pulsation correction maps based on engine speed nEngPlsCor and injection quantity qPlsCor" MAP 0x380688 Lookup2D_WORD 0 Prc_Fact10000 -3.2 3.2
 /begin AXIS_DESCR COM_AXIS InjCtl_qSetUnBal FuelMass_mg_hub 16 -300.0 300.0 AXIS_PTS_REF AFS_facPlsCorBasEOMQnt2_MAPX /end AXIS_DESCR
 /begin AXIS_DESCR COM_AXIS Epm_nEng EngSpeed_rpm 16 -6000.0 6000.0 AXIS_PTS_REF AFS_facPlsCorBasEOMQnt2_MAPY /end AXIS_DESCR
/end CHARACTERISTIC
/begin CHARACTERISTIC AFS_tiDlyEGRPPlSetyDrft_C "Time delay to debounce the Exhaust Gas Re-circulation valve position before starting the plausibility sensitivity drift test" VALUE 0x3809A8 Scalar_ULONG 0 Debounce_ms 0.0 65535.0 /end CHARACTERISTIC
/begin CHARACTERISTIC AFS_tiSetyDrftMaxDebDef_C "Debounce time for AFS signal Plaus Max Fault" VALUE 0x3809D0 Scalar_ULONG 0 Debounce_ms 0.0 65535.0 /end CHARACTERISTIC
/begin CHARACTERISTIC AFS_tiSetyDrftMaxDebOk_C "Debounce time for AFS signal Plaus Max Fault Heal" VALUE 0x3809D4 Scalar_ULONG 0 Debounce_ms 0.0 65535.0 /end CHARACTERISTIC
/begin CHARACTERISTIC AFS_tiSetyDrftMinDebDef_C "Debounce time for AFS signal Plaus Min Fault" VALUE 0x3809D8 Scalar_ULONG 0 Debounce_ms 0.0 65535.0 /end CHARACTERISTIC
/begin CHARACTERISTIC AFS_tiSetyDrftMinDebOk_C "Debounce time for AFS signal Plaus Min Fault Heal" VALUE 0x3809DC Scalar_ULONG 0 Debounce_ms 0.0 65535.0 /end CHARACTERISTIC
/begin CHARACTERISTIC AFS_tiDlySwtOnCor_C "Time duration of switch-on correction" VALUE 0x3809AC Scalar_ULONG 0 EngTime_ms 0.0 4.29496729E+8 /end CHARACTERISTIC
/begin CHARACTERISTIC SigTst_dmAFSVal_C "default value for air mass flow" VALUE 0x398030 Scalar_SWORD 0 AirMassPerTime -8192.0 8191.0 /end CHARACTERISTIC
/begin CHARACTERISTIC AFS_nAvrgThresHi_C "Upper engine speed threshold for plausibility check release" VALUE 0x3808D4 Scalar_SWORD 0 EngSpeed_rpm -6000.0 6000.0 /end CHARACTERISTIC
/begin CHARACTERISTIC AFS_nAvrgThresLo_C "Lower engine speed threshold for plausibility check release" VALUE 0x3808D6 Scalar_SWORD 0 EngSpeed_rpm -6000.0 6000.0 /end CHARACTERISTIC
/begin CHARACTERISTIC SigTst_mAirPerCyl_C "default value for air mass per cylinder" VALUE 0x398036 Scalar_SWORD 0 AirMass_mg_hub 0.0 16383.0 /end CHARACTERISTIC
/begin CHARACTERISTIC AFS_qRawOvrRunThresHi_C "Upper threshold of the injection quantity for the plausibility check release of the air mass sensor sensitivity drift" VALUE 0x3808F2 Scalar_SWORD 0 FuelMass_mg_hub -300.0 300.0 /end CHARACTERISTIC
/begin CHARACTERISTIC AFS_qRawOvrRunThresLo_C "Lower threshold of the injection quantity for the plausibility check release of the air mass sensor sensitivity drift" VALUE 0x3808F4 Scalar_SWORD 0 FuelMass_mg_hub -300.0 300.0 /end CHARACTERISTIC
/begin CHARACTERISTIC AFS_pAirThrLo_C "Environment air pressure threshold to release the plausibility sensitivity drift test" VALUE 0x3808E2 Scalar_SWORD 0 AirPressure_kPa 0.0 1200.0 /end CHARACTERISTIC
/begin CHARACTERISTIC AFS_pBstThresHi_C "Upper threshold of the filtered value of the boost pressure for plausibility check release" VALUE 0x3808EA Scalar_SWORD 0 AirPressure_kPa 0.0 1200.0 /end CHARACTERISTIC
/begin CHARACTERISTIC AFS_pBstThresLo_C "Lower threshold of the filtered value of the boost pressure for plausibility check release" VALUE 0x3808EC Scalar_SWORD 0 AirPressure_kPa 0.0 1200.0 /end CHARACTERISTIC
/begin CHARACTERISTIC AFS_rEGRThresHi_C "Upper threshold of the correction variable of the EGR-valve for plausibility check release of the air mass sensor sensitivity drift" VALUE 0x380982 Scalar_SWORD 0 Prc_100_rate 0.0 200.0 /end CHARACTERISTIC
/begin CHARACTERISTIC AFS_rEGRThresLo_C "Lower threshold of the correction variable of the EGR-valve for plausibility check release of the air mass sensor sensitivity drift" VALUE 0x380984 Scalar_SWORD 0 Prc_100_rate 0.0 200.0 /end CHARACTERISTIC
/begin CHARACTERISTIC AFS_rTVAThrHi_C "Throttle valve actuator position upper threshold to release the plausibility sensitivity drift test" VALUE 0x380986 Scalar_SWORD 0 Prc_100_rate 0.0 200.0 /end CHARACTERISTIC
/begin CHARACTERISTIC AFS_rTVAThrLo_C "Throttle valve actuator position lower threshold to release the plausibility sensitivity drift test" VALUE 0x380988 Scalar_SWORD 0 Prc_100_rate 0.0 200.0 /end CHARACTERISTIC
/begin CHARACTERISTIC AFS_dtAirThresHi_C "Upper threshold of the charge-air temperature change rate for the plausibility check release of the air mass sensor sensitivity drift" VALUE 0x380368 Scalar_SWORD 0 Temp_deg_s -1000.0 1000.0 /end CHARACTERISTIC
/begin CHARACTERISTIC AFS_dtAirThresLo_C "Lower threshold of the charge-air temperature change rate for the plausibility check release of the air mass sensor sensitivity drift" VALUE 0x38036A Scalar_SWORD 0 Temp_deg_s -1000.0 1000.0 /end CHARACTERISTIC
/begin CHARACTERISTIC AFS_tAirThresHi_C "Upper threshold of the induction air temperature" VALUE 0x380996 Scalar_SWORD 0 Temp_deg -1000.0 1000.0 /end CHARACTERISTIC
/begin CHARACTERISTIC AFS_tAirThresLo_C "Lower threshold of the induction air temperature" VALUE 0x380998 Scalar_SWORD 0 Temp_deg -1000.0 1000.0 /end CHARACTERISTIC
/begin CHARACTERISTIC AFS_tEngThresHi_C "Upper threshold of the temperature for the plausibility check release of the air mass sensor sensitivity drift" VALUE 0x38099A Scalar_SWORD 0 Temp_deg -1000.0 1000.0 /end CHARACTERISTIC
/begin CHARACTERISTIC AFS_tEngThresLo_C "Lower threshold of the temperature for the plausibility check release of the air mass sensor sensitivity drift" VALUE 0x38099C Scalar_SWORD 0 Temp_deg -1000.0 1000.0 /end CHARACTERISTIC
/begin CHARACTERISTIC AFS_facSwtOnCor_C "Switch-on correction factor" VALUE 0x3808CA Scalar_SWORD 0 Prc_Fact10000 -3.2 3.2 /end CHARACTERISTIC
/begin CHARACTERISTIC AFS_rAirThresIdlHi_C "Maximum sensitivity limit in low-idle operation" VALUE 0x380976 Scalar_SWORD 0 Prc_Fact10000 -3.2 3.2 /end CHARACTERISTIC
/begin CHARACTERISTIC AFS_rAirThresIdlLo_C "Minimum sensitivity limit in low-idle operation" VALUE 0x380978 Scalar_SWORD 0 Prc_Fact10000 -3.2 3.2 /end CHARACTERISTIC
/begin CHARACTERISTIC AFS_rAirThresLdHi_C "Maximum sensitivity limit in load operation" VALUE 0x38097A Scalar_SWORD 0 Prc_Fact10000 -3.2 3.2 /end CHARACTERISTIC
/begin CHARACTERISTIC AFS_rAirThresLdLo_C "Minimum sensitivity limit in loaded operation" VALUE 0x38097C Scalar_SWORD 0 Prc_Fact10000 -3.2 3.2 /end CHARACTERISTIC
/begin CHARACTERISTIC AFS_rAirThresOvrRunHi_C "Maximum sensitivity limit in overrun operation" VALUE 0x38097E Scalar_SWORD 0 Prc_Fact10000 -3.2 3.2 /end CHARACTERISTIC
/begin CHARACTERISTIC AFS_rAirThresOvrRunLo_C "Minimum sensitivity limit in overrun operation" VALUE 0x380980 Scalar_SWORD 0 Prc_Fact10000 -3.2 3.2 /end CHARACTERISTIC
/begin CHARACTERISTIC AFS_facAirNrmPT1_C "filter for the ratio of sensor value and model value" VALUE 0x380370 Scalar_UWORD 0 PT_fac 0.0 99.9985 /end CHARACTERISTIC
/begin CHARACTERISTIC AFS_numAirTemp_C "Index for selecting the induction charge-air temperature from the induction system temperature field" VALUE 0x3808DD Scalar_UBYTE 0 State_uint8 0.0 255.0 /end CHARACTERISTIC
/begin CHARACTERISTIC AFS_numEngTemp_C "Index for selection of coolant temperature from engine temperature field" VALUE 0x3808DE Scalar_UBYTE 0 State_uint8 0.0 255.0 /end CHARACTERISTIC
/begin CHARACTERISTIC AFS_swtEnaPlsCor_C "Switch to enable/disable pulsation correction on the sensed value of air mass flow." VALUE 0x38098C Scalar_UBYTE 0 Switch_conv 0 1 /end CHARACTERISTIC
/begin CHARACTERISTIC AFS_swtPlausChkIdl_C "Switch for activating the plausibility check in Idleload operation" VALUE 0x38098E Scalar_UBYTE 0 Switch_conv 0 1 /end CHARACTERISTIC
/begin CHARACTERISTIC AFS_swtPlausChkLd_C "Switch for activating the plausibility check in loaded operation" VALUE 0x38098F Scalar_UBYTE 0 Switch_conv 0 1 /end CHARACTERISTIC
/begin CHARACTERISTIC AFS_swtPlausChkOvrRun_C "Switch for activating the plausibility check in overrun operation" VALUE 0x380990 Scalar_UBYTE 0 Switch_conv 0 1 /end CHARACTERISTIC
/begin CHARACTERISTIC AFS_swtSensInstVal_C "Switch for air mass flow comes from sensor or substitute" VALUE 0x380991 Scalar_UBYTE 0 Switch_conv 0 1 /end CHARACTERISTIC
/begin CHARACTERISTIC SigTst_swtAFSSubsVal_C "Switch to the substitute value for air mass flow without MAF" VALUE 0x398068 Scalar_UBYTE 0 Switch_conv 0 1 /end CHARACTERISTIC
/begin CHARACTERISTIC SigTst_swtAFSVal_C "Switch to the default value for air mass flow" VALUE 0x398069 Scalar_UBYTE 0 Switch_conv 0 1 /end CHARACTERISTIC
/begin CHARACTERISTIC SigTst_swtAirPerCyl_C "Switch to the default value for air mass per cylinder" VALUE 0x39806F Scalar_UBYTE 0 Switch_conv 0 1 /end CHARACTERISTIC
/begin AXIS_PTS AFS_dmAirSubsVal_MAPY "Y Axis Points of Map" 0x380282 Epm_nEng Lookup2D_X_WORD 0 EngSpeed_rpm 16 -6000.0 6000.0 /end AXIS_PTS
/begin AXIS_PTS AFS_dmAirSubsVal_MAPX "X Axis Points of Map" 0x380262 InjCtl_qRaw Lookup2D_X_WORD 0 FuelMass_mg_hub 16 -300.0 300.0 /end AXIS_PTS
/begin AXIS_PTS AFS_facAirSubsEnvPCor_CURX "X Axis Points of curve" 0x380390 EnvP_p Lookup1D_X_WORD 0 AirPressure_kPa 15 0.0 1200.0 /end AXIS_PTS
/begin AXIS_PTS AFS_facPlsCorBasEGRShOff_MAPY "Y Axis Points of Map" 0x380668 Epm_nEng Lookup2D_X_WORD 0 EngSpeed_rpm 16 -6000.0 6000.0 /end AXIS_PTS
/begin AXIS_PTS AFS_facPlsCorBasEGRShOff_MAPX "X Axis Points of Map" 0x380648 InjCtl_qSetUnBal Lookup2D_X_WORD 0 FuelMass_mg_hub 16 -300.0 300.0 /end AXIS_PTS
/begin AXIS_PTS AFS_facPlsCorBasEOMQnt2_MAPY "Y Axis Points of Map" 0x3808A8 Epm_nEng Lookup2D_X_WORD 0 EngSpeed_rpm 16 -6000.0 6000.0 /end AXIS_PTS
/begin AXIS_PTS AFS_facPlsCorBasEOMQnt2_MAPX "X Axis Points of Map" 0x380888 InjCtl_qSetUnBal Lookup2D_X_WORD 0 FuelMass_mg_hub 16 -300.0 300.0 /end AXIS_PTS
/begin CHARACTERISTIC AFS_qWinLdAdjThresHi_CUR "Quantity High condition for the release of learning process" CURVE 0x3808F6 Lookup1D_WORD 0 FuelMass_mg_hub -300.0 300.0
 /begin AXIS_DESCR COM_AXIS Epm_nEng EngSpeed_rpm 16 -6000.0 6000.0 AXIS_PTS_REF AFS_qWinLdAdjThresHi_CURX /end AXIS_DESCR
/end CHARACTERISTIC
/begin CHARACTERISTIC AFS_qWinLdAdjThresLo_CUR "Quantity Low condition for the release of learning process" CURVE 0x380936 Lookup1D_WORD 0 FuelMass_mg_hub -300.0 300.0
 /begin AXIS_DESCR COM_AXIS Epm_nEng EngSpeed_rpm 16 -6000.0 6000.0 AXIS_PTS_REF AFS_qWinLdAdjThresLo_CURX /end AXIS_DESCR
/end CHARACTERISTIC
/begin CHARACTERISTIC AFS_facCorExtpIdl_CUR "The correction factor for sensor air mass values between zero and the air mass flow base point in the low idle range" CURVE 0x3803B0 Lookup1D_WORD 0 Prc_Fact10000 -3.2 3.2
 /begin AXIS_DESCR COM_AXIS AFS_facAirMsNrmIdl_mp Prc_Fact10000 16 -3.2 3.2 AXIS_PTS_REF AFS_facCorExtpIdl_CURX /end AXIS_DESCR
/end CHARACTERISTIC
/begin CHARACTERISTIC AFS_facCorExtpLd_CUR "The correction factor for a sensor air mass above the base point of the air mass flow in the load range" CURVE 0x3803F0 Lookup1D_WORD 0 Prc_Fact10000 -3.2 3.2
 /begin AXIS_DESCR COM_AXIS AFS_facAirMsNrmLd_mp Prc_Fact10000 16 -3.2 3.2 AXIS_PTS_REF AFS_facCorExtpLd_CURX /end AXIS_DESCR
/end CHARACTERISTIC
/begin CHARACTERISTIC AFS_tiAdjRlsDel_C "Time delay after actuator intervention to release the drift compensation in low-idle and load range" VALUE 0x3809A4 Scalar_ULONG 0 Debounce_ms 0.0 65535.0 /end CHARACTERISTIC
/begin CHARACTERISTIC AFS_tiIdlAdjRlsDeb "Debounce time parameters to the release the condition for idle value adjustment calculation" VALUE 0x3809B0 Scalar_ULONG 0 Debounce_ms 0.0 65535.0 /end CHARACTERISTIC
/begin CHARACTERISTIC AFS_tiLdAdjRlsDeb "Debounce time parameters to release the condition for load value adjustment calculation" VALUE 0x3809B4 Scalar_ULONG 0 Debounce_ms 0.0 65535.0 /end CHARACTERISTIC
/begin CHARACTERISTIC AFS_tiWtPenDeb "Debounce time Structure for water penetration detection" VALUE 0x3809E4 Scalar_ULONG 0 Debounce_ms 0.0 65535.0 /end CHARACTERISTIC
/begin CHARACTERISTIC AFS_tiStrtDelAdjRls_C "Start delay after reaching the engine state NORMAL to meet the environmental release conditions[ms]" VALUE 0x3809E0 Scalar_ULONG 0 EngTime_ms 0.0 4.29496729E+8 /end CHARACTERISTIC
/begin CHARACTERISTIC AFS_dmIdlAirMsLim_C "Air mass flow limit in the low-idle range for correction factor" VALUE 0x3802A2 Scalar_SWORD 0 AirMassPerTime -8192.0 8191.0 /end CHARACTERISTIC
/begin CHARACTERISTIC AFS_dmLdAirMsLim_C "Air mass flow limit in the load range for correction factor curve [kg/h]" VALUE 0x3802A4 Scalar_SWORD 0 AirMassPerTime -8192.0 8191.0 /end CHARACTERISTIC
/begin CHARACTERISTIC AFS_dpLdAdjThresHi_C "Maximum boost pressure gradient for releasing the drift compensation in the load range [hPa/s]" VALUE 0x380362 Scalar_SWORD 0 AirPressure_kPa_s -500.0 499.0 /end CHARACTERISTIC
/begin CHARACTERISTIC AFS_pBstAtmDiffLim_C "Maximum difference between atmospheric and boost preasure for low-idle release" VALUE 0x3808E4 Scalar_SWORD 0 AirPressure_kPa 0.0 1200.0 /end CHARACTERISTIC
/begin CHARACTERISTIC AFS_pBstLdAdjThresHi_C "Upper boost pressure threshold for releasing the drift compensation in the load range" VALUE 0x3808E6 Scalar_SWORD 0 AirPressure_kPa 0.0 1200.0 /end CHARACTERISTIC
/begin CHARACTERISTIC AFS_pBstLdAdjThresLo_C "Lower boost pressure threshold for releasing the drift compensation in the load range" VALUE 0x3808E8 Scalar_SWORD 0 AirPressure_kPa 0.0 1200.0 /end CHARACTERISTIC
/begin CHARACTERISTIC AFS_qCurrIdlAdjThresHi_C "Upper injection quantity threshold for releasing the drift compensation in the low-idle range [mg/-cyc]" VALUE 0x3808EE Scalar_SWORD 0 FuelMass_mg_hub -300.0 300.0 /end CHARACTERISTIC
/begin CHARACTERISTIC AFS_qCurrIdlAdjThresLo_C "Lower injection quantity threshold for releasing the drift compensation in the low-idle range [mg/-cyc]" VALUE 0x3808F0 Scalar_SWORD 0 FuelMass_mg_hub -300.0 300.0 /end CHARACTERISTIC
/begin CHARACTERISTIC AFS_dnEngLdAdjThresHi_C "Maximum engine speed gradient for releasing the drift compensation in the load range." VALUE 0x380360 Scalar_SWORD 0 EngSpeed_rpm_s 0.0 16383.0 /end CHARACTERISTIC
/begin CHARACTERISTIC AFS_nAvrgIdlAdjThresHi_C "Upper engine speed threshold for releasing the drift compensation in the low-idle range" VALUE 0x3808D0 Scalar_SWORD 0 EngSpeed_rpm -6000.0 6000.0 /end CHARACTERISTIC
/begin CHARACTERISTIC AFS_nAvrgIdlAdjThresLo_C "Lower engine speed threshold for releasing the drift compensation in the low-idle range" VALUE 0x3808D2 Scalar_SWORD 0 EngSpeed_rpm -6000.0 6000.0 /end CHARACTERISTIC
/begin CHARACTERISTIC AFS_nOvrnAdjMax_C "Upper engine speed threshold for releasing the drift compensation in overrun" VALUE 0x3808D8 Scalar_SWORD 0 EngSpeed_rpm -6000.0 6000.0 /end CHARACTERISTIC
/begin CHARACTERISTIC AFS_nOvrnAdjMin_C "Lower engine speed threshold for releasing the drift compensation in overrun" VALUE 0x3808DA Scalar_SWORD 0 EngSpeed_rpm -6000.0 6000.0 /end CHARACTERISTIC
/begin CHARACTERISTIC AFS_vOvrnAdjMin_C "Minimum vehicle speed for releasing the drift compensation in overrun" VALUE 0x3809E8 Scalar_SWORD 0 VehSpeed_km_h 0.0 255.0 /end CHARACTERISTIC
/begin CHARACTERISTIC AFS_vVehLdAdjThresHi_C "Upper vehicle speed threshold for releasing the drift compensation in the load range" VALUE 0x3809EA Scalar_SWORD 0 VehSpeed_km_h 0.0 255.0 /end CHARACTERISTIC
/begin CHARACTERISTIC AFS_vVehLdAdjThresLo_C "Lower vehicle speed threshold for releasing the drift compensation in the load range" VALUE 0x3809EC Scalar_SWORD 0 VehSpeed_km_h 0.0 255.0 /end CHARACTERISTIC
/begin CHARACTERISTIC AFS_tAirAdjRlsThresHi_C "Upper induction air temperature threshold to fulfill the environmental condition [deg C]" VALUE 0x380992 Scalar_SWORD 0 Temp_deg -1000.0 1000.0 /end CHARACTERISTIC
/begin CHARACTERISTIC AFS_tAirAdjRlsThresLo_C "Lower induction air temperature threshold to fulfill the environmental condition [deg C]" VALUE 0x380994 Scalar_SWORD 0 Temp_deg -1000.0 1000.0 /end CHARACTERISTIC
/begin CHARACTERISTIC AFS_tEnvAdjRlsThresHi_C "Upper environmental temperature threshold to fulfill the environmental condition [deg C]" VALUE 0x38099E Scalar_SWORD 0 Temp_deg -1000.0 1000.0 /end CHARACTERISTIC
/begin CHARACTERISTIC AFS_tEnvAdjRlsThresLo_C "Lower environmental temperature threshold to fulfill the environmental condition [deg C]" VALUE 0x3809A0 Scalar_SWORD 0 Temp_deg -1000.0 1000.0 /end CHARACTERISTIC
/begin CHARACTERISTIC AFS_dqLdAdjThresHi_C "Maximum quantity gradient for releasing the drift compensation in the load range" VALUE 0x380364 Scalar_SWORD 0 AFS_RmpInjMass_mg_stroke_s 0.0 99.0 /end CHARACTERISTIC
/begin CHARACTERISTIC AFS_facAirMsPT1_C "filter constant for filtering the air mass in drift compensation mode" VALUE 0x38036E Scalar_UWORD 0 PT_fac 0.0 99.9985 /end CHARACTERISTIC
/begin CHARACTERISTIC AFS_facBstPresPT1_C "Filter factor for boost pressure gradient" VALUE 0x3803AE Scalar_UWORD 0 PT_fac 0.0 99.9985 /end CHARACTERISTIC
/begin CHARACTERISTIC AFS_facCorFacPT1_C "fiter constant for filtering the correction factor in drift compensation mode" VALUE 0x380430 Scalar_UWORD 0 PT_fac 0.0 99.9985 /end CHARACTERISTIC
/begin CHARACTERISTIC AFS_facQntCurrPT1_C "Filter factor for injection quantity gradient" VALUE 0x3808C8 Scalar_UWORD 0 PT_fac 0.0 99.9985 /end CHARACTERISTIC
/begin CHARACTERISTIC AFS_facWtPenDetPT1_C "factor constant for filtering the gradient difference for water penetration detection" VALUE 0x3808CC Scalar_UWORD 0 PT_fac 0.0 99.9985 /end CHARACTERISTIC
/begin CHARACTERISTIC AFS_facnEngPT1_C "Filter factor for engine speed gradient" VALUE 0x3808CE Scalar_UWORD 0 PT_fac 0.0 99.9985 /end CHARACTERISTIC
/begin CHARACTERISTIC AFS_facAdjPlausDiff_C "Maximum difference between load range and low idle correction factor" VALUE 0x38036C Scalar_SWORD 0 Prc_Fact10000 -3.2 3.2 /end CHARACTERISTIC
/begin CHARACTERISTIC AFS_facIdlAdjPlausMax_C "Maximum plausible drift in positive range for correction factor in low idle" VALUE 0x380432 Scalar_SWORD 0 Prc_Fact10000 -3.2 3.2 /end CHARACTERISTIC
/begin CHARACTERISTIC AFS_facIdlAdjValMax_C "Maximum drift limt for correction factors in low idle" VALUE 0x380434 Scalar_SWORD 0 Prc_Fact10000 -3.2 3.2 /end CHARACTERISTIC
/begin CHARACTERISTIC AFS_facIdlAdjValMin_C "Minimum drift limt for correction factors in low idle" VALUE 0x380436 Scalar_SWORD 0 Prc_Fact10000 -3.2 3.2 /end CHARACTERISTIC
/begin CHARACTERISTIC AFS_facIdlAdjValStepLim_C "Step width limit for the correction factor in lowidle" VALUE 0x380438 Scalar_SWORD 0 Prc_Fact10000 -3.2 3.2 /end CHARACTERISTIC
/begin CHARACTERISTIC AFS_facLdAdjPlausMin_C "Maximum plausible drift in negative range for correction factor in load range" VALUE 0x38043C Scalar_SWORD 0 Prc_Fact10000 -3.2 3.2 /end CHARACTERISTIC
/begin CHARACTERISTIC AFS_facLdAdjValMax_C "Maximum drift limt for correction factor in load range." VALUE 0x38043E Scalar_SWORD 0 Prc_Fact10000 -3.2 3.2 /end CHARACTERISTIC
/begin CHARACTERISTIC AFS_facLdAdjValMin_C "Minimum drift limt for correction factor in load range." VALUE 0x380440 Scalar_SWORD 0 Prc_Fact10000 -3.2 3.2 /end CHARACTERISTIC
/begin CHARACTERISTIC AFS_facLdAdjValStepLim_C "Step width limit for the correction factor in the load range" VALUE 0x380442 Scalar_SWORD 0 Prc_Fact10000 -3.2 3.2 /end CHARACTERISTIC
/begin CHARACTERISTIC AFS_facLoThresIdlAdjVal_C "Minimum drift limit for the correction factor in the low-idle range" VALUE 0x380444 Scalar_SWORD 0 Prc_Fact10000 -3.2 3.2 /end CHARACTERISTIC
/begin CHARACTERISTIC AFS_facLoThresLdAdjVal_C "Minimum drift limit for the correction factor in the load range" VALUE 0x380446 Scalar_SWORD 0 Prc_Fact10000 -3.2 3.2 /end CHARACTERISTIC
/begin CHARACTERISTIC AFS_drWtPenDetThresHi_C "Upper factor threshold value for water penetration detection" VALUE 0x380366 Scalar_SWORD 0 Rmp_1_s -32.0 32.0 /end CHARACTERISTIC
/begin CHARACTERISTIC AFS_numOvrnAdjGearMin_C "Threshold for the minimum number of gear adjustments in Tra_numGear" VALUE 0x3808E0 Scalar_BYTE 0 Tra_num -128.0 127.0 /end CHARACTERISTIC
/begin CHARACTERISTIC AFS_numAirDrftComp_C "Index for selection of Air temperature from Induction System temperature field" VALUE 0x3808DC Scalar_UBYTE 0 State_uint8 0.0 255.0 /end CHARACTERISTIC
/begin CHARACTERISTIC AFS_numEnvTemp_C "Index for selection of environmental temperature" VALUE 0x3808DF Scalar_UBYTE 0 State_uint8 0.0 255.0 /end CHARACTERISTIC
/begin CHARACTERISTIC AFS_swtAdjPlausLim_C "Switch for selecting the correction factors for SRC and NPL check" VALUE 0x38098A Scalar_UBYTE 0 Switch_conv 0 1 /end CHARACTERISTIC
/begin CHARACTERISTIC AFS_swtAirMsCorRls_C "Software switch to enable the air mass correction(0: no correction, 1: correction is enabled)" VALUE 0x38098B Scalar_UBYTE 0 Switch_conv 0 1 /end CHARACTERISTIC
/begin CHARACTERISTIC AFS_swtLdAdjSel_C "Switch for selecting load range or overrun release conditions" VALUE 0x38098D Scalar_UBYTE 0 Switch_conv 0 1 /end CHARACTERISTIC
/begin AXIS_PTS AFS_qWinLdAdjThresHi_CURX "Axis Points of Curve" 0x380916 Epm_nEng Lookup1D_X_WORD 0 EngSpeed_rpm 16 -6000.0 6000.0 /end AXIS_PTS
/begin AXIS_PTS AFS_qWinLdAdjThresLo_CURX "Axis Points of Curve" 0x380956 Epm_nEng Lookup1D_X_WORD 0 EngSpeed_rpm 16 -6000.0 6000.0 /end AXIS_PTS
/begin AXIS_PTS AFS_facCorExtpIdl_CURX "Axis Points of Curve" 0x3803D0 AFS_facAirMsNrmIdl_mp Lookup1D_X_WORD 0 Prc_Fact10000 16 -3.2 3.2 /end AXIS_PTS
/begin AXIS_PTS AFS_facCorExtpLd_CURX "Axis Points of Curve" 0x380410 AFS_facAirMsNrmLd_mp Lookup1D_X_WORD 0 Prc_Fact10000 16 -3.2 3.2 /end AXIS_PTS
/begin CHARACTERISTIC Air_utTransfTAFS_CUR "Curve of transfer frequency signal to temperature for AFST sensor" CURVE 0x3864A8 Lookup1D_WORD 0 Temp_deg -200.0 200.0
 /begin AXIS_DESCR COM_AXIS Air_uRawTAFS Ad_mv 25 0.0 5000.0 AXIS_PTS_REF Air_utTransfTAFS_CURX /end AXIS_DESCR
/end CHARACTERISTIC
/begin CHARACTERISTIC Air_tTransfTAFS_CUR "Curve of transfer frequency signal to temperature for AFST sensor" CURVE 0x386358 Lookup1D_WORD 0 Temp_deg -200.0 200.0
 /begin AXIS_DESCR COM_AXIS Air_rRawTAFS DutyCycle_rate 25 0.0 100.0 AXIS_PTS_REF Air_tTransfTAFS_CURX /end AXIS_DESCR
/end CHARACTERISTIC
/begin CHARACTERISTIC Air_tiDtyCycHiTAFSDefDeb_C "Debounce Time for  Duty Cycle High Fault Confirm" VALUE 0x386420 Scalar_ULONG 0 Debounce_ms 0.0 65535.0 /end CHARACTERISTIC
/begin CHARACTERISTIC Air_tiDtyCycHiTAFSOKDeb_C "Debounce Time for  Duty Cycle High Fault Heal" VALUE 0x386424 Scalar_ULONG 0 Debounce_ms 0.0 65535.0 /end CHARACTERISTIC
/begin CHARACTERISTIC Air_tiDtyCycLoTAFSDefDeb_C "Debounce Time for  Duty Cycle Low Fault Confirm" VALUE 0x386428 Scalar_ULONG 0 Debounce_ms 0.0 65535.0 /end CHARACTERISTIC
/begin CHARACTERISTIC Air_tiDtyCycLoTAFSOKDeb_C "Debounce Time for  Duty Cycle Low Fault Heal" VALUE 0x38642C Scalar_ULONG 0 Debounce_ms 0.0 65535.0 /end CHARACTERISTIC
/begin CHARACTERISTIC Air_tiPerHiTAFSDefDeb_C "Debounce Time for  Period High Fault Confirm" VALUE 0x386440 Scalar_ULONG 0 Debounce_ms 0.0 65535.0 /end CHARACTERISTIC
/begin CHARACTERISTIC Air_tiPerHiTAFSOKDeb_C "Debounce Time for  Period High Fault Heal" VALUE 0x386444 Scalar_ULONG 0 Debounce_ms 0.0 65535.0 /end CHARACTERISTIC
/begin CHARACTERISTIC Air_tiPerLoTAFSDefDeb_C "Debounce Time for  Period Low Fault Confirm" VALUE 0x386448 Scalar_ULONG 0 Debounce_ms 0.0 65535.0 /end CHARACTERISTIC
/begin CHARACTERISTIC Air_tiPerLoTAFSOKDeb_C "Debounce Time for  Period Low Fault Heal" VALUE 0x38644C Scalar_ULONG 0 Debounce_ms 0.0 65535.0 /end CHARACTERISTIC
/begin CHARACTERISTIC Air_tiVoltHiTAFSDefDeb_C "Debounce Time for  Voltage High Fault Confirm" VALUE 0x38648C Scalar_ULONG 0 Debounce_ms 0.0 65535.0 /end CHARACTERISTIC
/begin CHARACTERISTIC Air_tiVoltHiTAFSOKDeb_C "Debounce Time for  Voltage High Fault Heal" VALUE 0x386490 Scalar_ULONG 0 Debounce_ms 0.0 65535.0 /end CHARACTERISTIC
/begin CHARACTERISTIC Air_tiVoltLoTAFSDefDeb_C "Debounce Time for  Voltage Low Fault Confirm" VALUE 0x386494 Scalar_ULONG 0 Debounce_ms 0.0 65535.0 /end CHARACTERISTIC
/begin CHARACTERISTIC Air_tiVoltLoTAFSOKDeb_C "Debounce Time for  Voltage Low Fault Heal" VALUE 0x386498 Scalar_ULONG 0 Debounce_ms 0.0 65535.0 /end CHARACTERISTIC
/begin CHARACTERISTIC Air_tiPerRefTAFS_C "Reference time period for the calculation of frequency drift in the oscilator in case of BOSCH HFM6 sensor with RC oscillator." VALUE 0x386450 Scalar_LONG 0 Time_Period_HFM6 -107373.0 107374.0 /end CHARACTERISTIC
/begin CHARACTERISTIC Air_tiRefSigPerMaxTAFS_C "Air temperature reference period maximum limit" VALUE 0x386474 Scalar_LONG 0 Time_Period_HFM6 0.0 60.0 /end CHARACTERISTIC
/begin CHARACTERISTIC Air_tiRefSigPerMinTAFS_C "Air temperature reference period minimum limit" VALUE 0x386478 Scalar_LONG 0 Time_Period_HFM6 0.0 60.0 /end CHARACTERISTIC
/begin CHARACTERISTIC Air_uVoltMaxTAFS_C "Maximum threshold value for Voltage from the temperature sensor at HFM position" VALUE 0x3864A4 Scalar_SWORD 0 Ad_mv 0.0 5000.0 /end CHARACTERISTIC
/begin CHARACTERISTIC Air_uVoltMinTAFS_C "Minimum threshold value for Voltage from the temperature sensor at HFM position" VALUE 0x3864A6 Scalar_SWORD 0 Ad_mv 0.0 5000.0 /end CHARACTERISTIC
/begin CHARACTERISTIC Air_rDtyCycMaxTAFS_C "Maximum threshold value for duty cycle for the PWM signal from the temperature sensor at HFM position" VALUE 0x38634E Scalar_SWORD 0 DutyCycle_rate 0.0 100.0 /end CHARACTERISTIC
/begin CHARACTERISTIC Air_rDtyCycMinTAFS_C "Minimum threshold value for duty cycle for the PWM signal from the temperature sensor at HFM position" VALUE 0x386350 Scalar_SWORD 0 DutyCycle_rate 0.0 100.0 /end CHARACTERISTIC
/begin CHARACTERISTIC Air_facPerCorTAFS_C "Period correction factor for air mass signal in case of HFM6 with crystal oscillator or errors in air temperature signal." VALUE 0x38633A Scalar_SWORD 0 Fact8192 -4.0 3.9999 /end CHARACTERISTIC
/begin CHARACTERISTIC Air_bDtyOrUType_C "choose to use Duty cycle value or voltage value" VALUE 0x38632E Scalar_BOOLEAN 0 boolean 0.0 1.0 /end CHARACTERISTIC
/begin CHARACTERISTIC Air_swtOscSelTAFS_C "Switch to select the oscillator type for the HFM6 sensor (hex 1 is RC oscillator/hex 0 is Crystal oscillator)." VALUE 0x386352 Scalar_BOOLEAN 0 boolean 0.0 1.0 /end CHARACTERISTIC
/begin AXIS_PTS Air_utTransfTAFS_CURX "Axis Points of Curve" 0x3864DA Air_uRawTAFS Lookup1D_X_WORD 0 Ad_mv 25 0.0 5000.0 /end AXIS_PTS
/begin AXIS_PTS Air_tTransfTAFS_CURX "Axis Points of Curve" 0x38638A Air_rRawTAFS Lookup1D_X_WORD 0 DutyCycle_rate 25 0.0 100.0 /end AXIS_PTS
/begin CHARACTERISTIC Air_RmpSlpTAFSNeg_C "Structure for Ramp slope / negative ramp slope" VALUE 0x386326 Scalar_SWORD 0 Temp_deg_s -200.0 200.0 /end CHARACTERISTIC
/begin CHARACTERISTIC Air_RmpSlpTAFSPos_C "Structure for Ramp slope / Slope if the ramp has to be increased" VALUE 0x386328 Scalar_SWORD 0 Temp_deg_s -200.0 200.0 /end CHARACTERISTIC
/begin CHARACTERISTIC Air_tTransStgTAFSDfl_C "Structure containing fixed replacement values and the status word to decide the response in case of errors air temperature sensor at HFM / Fixed replacement value" VALUE 0x386354 Scalar_SWORD 0 Temp_deg -200.0 200.0 /end CHARACTERISTIC
/begin CHARACTERISTIC SigTst_tTAFS_C "Switch for air temperature by hand" VALUE 0x3980A4 Scalar_SWORD 0 Temp_deg -200.0 200.0 /end CHARACTERISTIC
/begin CHARACTERISTIC Air_facPT1TAFS_C "Filter Coffecient for TAFS" VALUE 0x386336 Scalar_UWORD 0 PT_fac 0.0 99.9985 /end CHARACTERISTIC
/begin CHARACTERISTIC SigTst_swtTAFS_C "Set air temperature by hand" VALUE 0x398097 Scalar_UBYTE 0 Switch_conv 0 1 /end CHARACTERISTIC
/begin CHARACTERISTIC EGRVlv_rCnvHb_MAP "Pulsation correction map" MAP 0x386E12 Lookup2D_WORD 0 Prc_100_rate -100.0 100.0
 /begin AXIS_DESCR COM_AXIS Epm_nEng EngSpeed_rpm 16 0.0 6000.0 AXIS_PTS_REF EGRVlv_rCnvHb_MAPY /end AXIS_DESCR
 /begin AXIS_DESCR COM_AXIS EGRVlv_rCnvInHb_mp Prc_100_rate 16 -100.0 100.0 AXIS_PTS_REF EGRVlv_rCnvHb_MAPX /end AXIS_DESCR
/end CHARACTERISTIC
/begin CHARACTERISTIC EGRVlv_rCnvPsNrmHb_CUR "Normalized correction curve" CURVE 0x387292 Lookup1D_WORD 0 Prc_100_rate -100.0 100.0
 /begin AXIS_DESCR COM_AXIS EGRVlv_rPsHb Prc_100_rate 16 -100.0 100.0 AXIS_PTS_REF EGRVlv_rCnvPsNrmHb_CURX /end AXIS_DESCR
/end CHARACTERISTIC
/begin CHARACTERISTIC EGRVlv_rCnvPWM_MAP "Pulsation correction map" MAP 0x387052 Lookup2D_WORD 0 Prc_100_rate -100.0 100.0
 /begin AXIS_DESCR COM_AXIS Epm_nEng EngSpeed_rpm 16 0.0 6000.0 AXIS_PTS_REF EGRVlv_rCnvPWM_MAPY /end AXIS_DESCR
 /begin AXIS_DESCR COM_AXIS EGRVlv_rCnvInPWM_mp Prc_100_rate 16 -100.0 100.0 AXIS_PTS_REF EGRVlv_rCnvPWM_MAPX /end AXIS_DESCR
/end CHARACTERISTIC
/begin CHARACTERISTIC EGRVlv_rCnvPsNrmPWM_CUR "Normalized correction curve" CURVE 0x3872D2 Lookup1D_WORD 0 Prc_100_rate -100.0 100.0
 /begin AXIS_DESCR COM_AXIS EGRVlv_rPsPWM Prc_100_rate 16 -100.0 100.0 AXIS_PTS_REF EGRVlv_rCnvPsNrmPWM_CURX /end AXIS_DESCR
/end CHARACTERISTIC
/begin CHARACTERISTIC EGRVlv_tiPs_C "signal period duration" VALUE 0x387568 Scalar_LONG 0 Time_PwmHigh_us -1.07374182E+8 1.07374182E+8 /end CHARACTERISTIC
/begin CHARACTERISTIC EGRVlv_stPwrStgDiaDis_C "Mask to select power stage diagnosis disable conditions" VALUE 0x3874F8 Scalar_UWORD 0 uint16 0.0 65535.0 /end CHARACTERISTIC
/begin CHARACTERISTIC EGRVlv_stPwrStgDis_C "Mask to select power stage disable conditions" VALUE 0x3874FA Scalar_UWORD 0 uint16 0.0 65535.0 /end CHARACTERISTIC
/begin CHARACTERISTIC EGRVlv_rPwmOutMax_C "Devlib diagnosis parameter structure / Maximum threshold for the duty cycle" VALUE 0x387478 Scalar_SWORD 0 Prc_100_rate -100.0 100.0 /end CHARACTERISTIC
/begin CHARACTERISTIC EGRVlv_rPwmOutMin_C "Devlib diagnosis parameter structure / Minimum threshold for the duty cycle" VALUE 0x38747A Scalar_SWORD 0 Prc_100_rate -100.0 100.0 /end CHARACTERISTIC
/begin CHARACTERISTIC EGRVlv_facCorStrt_C "Correction factor compensation in Start state" VALUE 0x386D80 Scalar_SWORD 0 Factor -32.0 31.9 /end CHARACTERISTIC
/begin CHARACTERISTIC EGRVlv_facBattCorFacFlt_C "PT1 filter factor for the battery voltage correction filter" VALUE 0x386D7E Scalar_UWORD 0 PT_fac 0.0 99.9985 /end CHARACTERISTIC
/begin CHARACTERISTIC EGRVlv_swtHwSel_C "Switch to select between CJ945/TLE6244 and CJ230/TLE7209 power stages" VALUE 0x387500 Scalar_BOOLEAN 0 boolean 0.0 1.0 /end CHARACTERISTIC
/begin CHARACTERISTIC EGRVlv_swtPwmOutBattCor_C "Devlib diagnosis parameter structure / Switch to enable battery correction" VALUE 0x387502 Scalar_BOOLEAN 0 boolean 0.0 1.0 /end CHARACTERISTIC
/begin AXIS_PTS EGRVlv_rCnvHb_MAPX "X Axis Points of Map" 0x387012 EGRVlv_rCnvInHb_mp Lookup2D_X_WORD 0 Prc_100_rate 16 -100.0 100.0 /end AXIS_PTS
/begin AXIS_PTS EGRVlv_rCnvHb_MAPY "Y Axis Points of Map" 0x387032 Epm_nEng Lookup2D_X_WORD 0 EngSpeed_rpm 16 0.0 6000.0 /end AXIS_PTS
/begin AXIS_PTS EGRVlv_rCnvPsNrmHb_CURX "X Axis Points of curve" 0x3872B2 EGRVlv_rPsHb Lookup1D_X_WORD 0 Prc_100_rate 16 -100.0 100.0 /end AXIS_PTS
/begin AXIS_PTS EGRVlv_rCnvPWM_MAPX "X Axis Points of Map" 0x387252 EGRVlv_rCnvInPWM_mp Lookup2D_X_WORD 0 Prc_100_rate 16 -100.0 100.0 /end AXIS_PTS
/begin AXIS_PTS EGRVlv_rCnvPWM_MAPY "Y Axis Points of Map" 0x387272 Epm_nEng Lookup2D_X_WORD 0 EngSpeed_rpm 16 0.0 6000.0 /end AXIS_PTS
/begin AXIS_PTS EGRVlv_rCnvPsNrmPWM_CURX "X Axis Points of curve" 0x3872F2 EGRVlv_rPsPWM Lookup1D_X_WORD 0 Prc_100_rate 16 -100.0 100.0 /end AXIS_PTS
/begin CHARACTERISTIC EGRVlv_rTransf_CUR "Transformation curve to convert the voltage value to positon value" CURVE 0x38748E Lookup1D_WORD 0 Prc_100_rate -100.0 100.0
 /begin AXIS_DESCR COM_AXIS EGRVlv_uRaw Ad_mv 25 0.0 5000.0 AXIS_PTS_REF EGRVlv_rTransf_CURX /end AXIS_DESCR
/end CHARACTERISTIC
/begin CHARACTERISTIC EGRVlv_tiMaxDefDeb_C "Debounce time for checking heal of EGRVlv_bSRCMaxDeb" VALUE 0x387540 Scalar_ULONG 0 Debounce_ms 0.0 65535.0 /end CHARACTERISTIC
/begin CHARACTERISTIC EGRVlv_tiMaxOKDeb_C "Debounce time for checking heal of EGRVlv_bSRCMaxDeb" VALUE 0x387544 Scalar_ULONG 0 Debounce_ms 0.0 65535.0 /end CHARACTERISTIC
/begin CHARACTERISTIC EGRVlv_tiMinDefDeb_C "Debounce time for checking heal of EGRVlv_bSRCMinDeb" VALUE 0x387548 Scalar_ULONG 0 Debounce_ms 0.0 65535.0 /end CHARACTERISTIC
/begin CHARACTERISTIC EGRVlv_tiMinOKDeb_C "Debounce time for checking heal of EGRVlv_bSRCMinDeb" VALUE 0x38754C Scalar_ULONG 0 Debounce_ms 0.0 65535.0 /end CHARACTERISTIC
/begin CHARACTERISTIC EGRVlv_tiPhysRngHiDefDeb_C "Debounce time for checking heal of EGRVlv_bPhysRngHiDeb" VALUE 0x387558 Scalar_ULONG 0 Debounce_ms 0.0 65535.0 /end CHARACTERISTIC
/begin CHARACTERISTIC EGRVlv_tiPhysRngHiOKDeb_C "Debounce time for checking heal of EGRVlv_bPhysRngHiDeb" VALUE 0x38755C Scalar_ULONG 0 Debounce_ms 0.0 65535.0 /end CHARACTERISTIC
/begin CHARACTERISTIC EGRVlv_tiPhysRngLoDefDeb_C "Debounce time for checking heal of EGRVlv_bPhysRngLoDeb" VALUE 0x387560 Scalar_ULONG 0 Debounce_ms 0.0 65535.0 /end CHARACTERISTIC
/begin CHARACTERISTIC EGRVlv_tiPhysRngLoOKDeb_C "Debounce time for checking heal of EGRVlv_bPhysRngLoDeb" VALUE 0x387564 Scalar_ULONG 0 Debounce_ms 0.0 65535.0 /end CHARACTERISTIC
/begin CHARACTERISTIC EGRVlv_uSRCMax_C "Class for default values for signal range check analog input / Threshold for SRC -Max detection" VALUE 0x38757C Scalar_SWORD 0 Ad_mv 0.0 5000.0 /end CHARACTERISTIC
/begin CHARACTERISTIC EGRVlv_uSRCMin_C "Class for default values for signal range check analog input / Threshold for SRC -Min detection" VALUE 0x38757E Scalar_SWORD 0 Ad_mv 0.0 5000.0 /end CHARACTERISTIC
/begin CHARACTERISTIC EGRVlv_rAdapDiffPlausLgT_C "Long time drift threshold" VALUE 0x386E04 Scalar_SWORD 0 Prc_100_rate -100.0 100.0 /end CHARACTERISTIC
/begin CHARACTERISTIC EGRVlv_rCmpNewCtlUn_C "Default value for the new ECU" VALUE 0x386E10 Scalar_SWORD 0 Prc_100_rate -100.0 100.0 /end CHARACTERISTIC
/begin AXIS_PTS EGRVlv_rTransf_CURX "Transformation aixs to convert the voltage value to positon value" 0x3874C0 EGRVlv_uRaw Lookup1D_X_WORD 0 Ad_mv 25 0.0 5000.0 /end AXIS_PTS
/begin CHARACTERISTIC EGRVlv_tiGovDvtMaxDebDef_C "Debounce time for checking heal of EGRVlv_bGovDvtMaxDeb" VALUE 0x387528 Scalar_ULONG 0 Debounce_ms 0.0 65535.0 /end CHARACTERISTIC
/begin CHARACTERISTIC EGRVlv_tiGovDvtMaxDebOk_C "Debounce time for checking heal of EGRVlv_bGovDvtMaxDeb" VALUE 0x38752C Scalar_ULONG 0 Debounce_ms 0.0 65535.0 /end CHARACTERISTIC
/begin CHARACTERISTIC EGRVlv_tiGovDvtMinDebDef_C "Debounce time for checking heal of EGRVlv_bGovDvtMinDeb" VALUE 0x387530 Scalar_ULONG 0 Debounce_ms 0.0 65535.0 /end CHARACTERISTIC
/begin CHARACTERISTIC EGRVlv_tiGovDvtMinDebOk_C "Debounce time for checking heal of EGRVlv_bGovDvtMinDeb" VALUE 0x387534 Scalar_ULONG 0 Debounce_ms 0.0 65535.0 /end CHARACTERISTIC
/begin CHARACTERISTIC EGRVlv_drActDvtHi_C "EGR position gradient to undetect deviation fault" VALUE 0x386D70 Scalar_LONG 0 EGR_rate_s -1000.0 1000.0 /end CHARACTERISTIC
/begin CHARACTERISTIC EGRVlv_drActDvt_C "EGR position gradient to detect deviation fault" VALUE 0x386D74 Scalar_LONG 0 EGR_rate_s -1000.0 1000.0 /end CHARACTERISTIC
/begin CHARACTERISTIC EGRVlv_rDvtMax_C "Threshold for detection of positive governor deviation" VALUE 0x38737E Scalar_SWORD 0 Prc_100_rate -100.0 100.0 /end CHARACTERISTIC
/begin CHARACTERISTIC EGRVlv_rDvtMin_C "Threshold for detection of negative governor deviation" VALUE 0x387380 Scalar_SWORD 0 Prc_100_rate -100.0 100.0 /end CHARACTERISTIC
/begin CHARACTERISTIC EGRVlv_tEngHi_C "Upper temperature threshold for the release of the monitoring of abnormality in the EGR regulation" VALUE 0x38750A Scalar_SWORD 0 Temp_deg -3000.0 3000.0 /end CHARACTERISTIC
/begin CHARACTERISTIC EGRVlv_tEngLo_C "Lower temperature threshold for the release of the monitoring of abnormality in the EGR regulation" VALUE 0x38750C Scalar_SWORD 0 Temp_deg -3000.0 3000.0 /end CHARACTERISTIC
/begin CHARACTERISTIC EGRVlv_facdrActFlt_C "Factor of the PT1 filter" VALUE 0x386D88 Scalar_UWORD 0 PT_fac 0.0 99.9985 /end CHARACTERISTIC
/begin CHARACTERISTIC EGRVlv_numMonEngTemp_C "Index for selecting the engine temperature" VALUE 0x386DF6 Scalar_UBYTE 0 State_uint8 0.0 255.0 /end CHARACTERISTIC
/begin CHARACTERISTIC EGRVlv_swtGovByp_C "Switch for bypassing the position controller" VALUE 0x3874FF Scalar_BOOLEAN 0 boolean 0.0 1.0 /end CHARACTERISTIC
/begin MEASUREMENT CoVeh_trqLim_mp "System error limitation torque (wheel torque)" SWORD Trq_Nm 0 0 -3000.0 3000.0 ECU_ADDRESS 0x40022252 /end MEASUREMENT
/begin MEASUREMENT GlbDa_lTotDstVeh_EEP "" SLONG sfix32_Sp001 0 0 -2.147483648E+6 2.147483647E+6 ECU_ADDRESS 0x4002FBF8 /end MEASUREMENT
/begin MEASUREMENT GlbDa_lTotDst_EEP "" SLONG sfix32_Sp001 0 0 -2.147483648E+6 2.147483647E+6 ECU_ADDRESS 0x4002FBF4 /end MEASUREMENT
/begin MEASUREMENT CoPT_trqDesDecMin_mp "Torque request after decreasing transmission intervention" SWORD Trq_Nm 0 0 -3000.0 3000.0 ECU_ADDRESS 0x40022244 /end MEASUREMENT
/begin MEASUREMENT CoPT_trqDesIncMax_mp "Torque request after increasing transmission intervention" SWORD Trq_Nm 0 0 -3000.0 3000.0 ECU_ADDRESS 0x40022246 /end MEASUREMENT
/begin MEASUREMENT PT_rTrqTmp1_mp "Measuringpoint for intermediate result-value 1 for PT_rTrq" SWORD TransRatio 0 0 -100.0 100.0 ECU_ADDRESS 0x40023120 /end MEASUREMENT
/begin MEASUREMENT PT_rTrqTmp2_mp "Measuringpoint for intermediate result-value 2 for PT_rTrq" SWORD TransRatio 0 0 -100.0 100.0 ECU_ADDRESS 0x40023122 /end MEASUREMENT
/begin MEASUREMENT PT_rTrq_mp "Unfiltered Powertrain torque ratio(without ramping)" SWORD TransRatio 0 0 -100.0 100.0 ECU_ADDRESS 0x40023124 /end MEASUREMENT
/begin MEASUREMENT Tra_rN2NUnflt_mp "un-filtered n/n ratio" SWORD TransRatio 0 0 -100.0 100.0 ECU_ADDRESS 0x4002342A /end MEASUREMENT
/begin MEASUREMENT PT_rTraN2N "Cardan shaft speed to engine speed ratio" SWORD TransRatio 0 0 -100.0 100.0 ECU_ADDRESS 0x4002342C /end MEASUREMENT
/begin MEASUREMENT Tra_rnnDiffUpLim_mp "upper threshold value of the current gear ratio" SWORD TransRatio 0 0 -100.0 100.0 ECU_ADDRESS 0x4002342E /end MEASUREMENT
/begin MEASUREMENT Tra_rnnDiffLowLim_mp "upper rnn-window-range of actual fast gear : Gearbx_numGearFast" SWORD TransRatio 0 0 -100.0 100.0 ECU_ADDRESS 0x40023430 /end MEASUREMENT
/begin MEASUREMENT Tra_nEngFlt_mp "Low-pass filtered engine speed" SWORD EngSpeed_rpm 0 0 -6000.0 6000.0 ECU_ADDRESS 0x40023432 /end MEASUREMENT
/begin MEASUREMENT Tra_rV2NUnFlt_mp "Non-filtered v/n ratio" SWORD Tra_V2N_km_h_rpm 0 0 -0.32768 0.32767 ECU_ADDRESS 0x40023434 /end MEASUREMENT
/begin MEASUREMENT Tra_trqPrtGear_mp "Measuring point of torque value gear path" SWORD Trq_Nm 0 0 -3000.0 3000.0 ECU_ADDRESS 0x40023436 /end MEASUREMENT
/begin MEASUREMENT Tra_trqPrtJmpStrt_mp "Jump start limiting torque" SWORD Trq_Nm 0 0 -3000.0 3000.0 ECU_ADDRESS 0x40023438 /end MEASUREMENT
/begin MEASUREMENT Tra_trqWESDemLimRaw "Application parameter for Torque limitation from WESDem, based on its working mode" SWORD Trq_Nm 0 0 -3000.0 3000.0 ECU_ADDRESS 0x4002343A /end MEASUREMENT
/begin MEASUREMENT Tra_trqPTOLimRaw_mp "Gearbox input torque limitation raw value based on PTO state" SWORD Trq_Nm 0 0 -3000.0 3000.0 ECU_ADDRESS 0x4002343C /end MEASUREMENT
/begin MEASUREMENT Tra_trqLimRaw_mp "Current PTO and WESDem torque limitation before ramp" SWORD Trq_Nm 0 0 -3000.0 3000.0 ECU_ADDRESS 0x4002343E /end MEASUREMENT
/begin MEASUREMENT Tra_trqPTOInMax_mp "Gearbox input torque limitation value after ramp,depending on PTO state and WESDem mode" SWORD Trq_Nm 0 0 -3000.0 3000.0 ECU_ADDRESS 0x40023440 /end MEASUREMENT
/begin MEASUREMENT Tra_numGearGrp "Application parameter for Gear group number based on current gear information" SBYTE Tra_num 0 0 -128.0 127.0 ECU_ADDRESS 0x40023442 /end MEASUREMENT
/begin MEASUREMENT FanCtl_nSpdDes_mp "Sensed fan speed monitor" SWORD FanSpd_rpm 0 0 0.0 32767.0 ECU_ADDRESS 0x40022CB4 /end MEASUREMENT
/begin MEASUREMENT FanCtl_nSpd_mp "Sensed fan speed monitor after limit" SWORD FanSpd_rpm 0 0 0.0 32767.0 ECU_ADDRESS 0x40022CB6 /end MEASUREMENT
/begin MEASUREMENT FanCtl_nSpdDes2_mp "Sensed fan speed monitor" SWORD FanSpd_rpm 0 0 0.0 32767.0 ECU_ADDRESS 0x40022CB8 /end MEASUREMENT
/begin MEASUREMENT FanCtl_nSpd2_mp "Sensed fan speed monitor after limit 2" SWORD FanSpd_rpm 0 0 0.0 32767.0 ECU_ADDRESS 0x40022CBA /end MEASUREMENT
/begin MEASUREMENT FanCtl_rSpdFan_mp "set point duty cycle percentage" SWORD DutyCycle_rate 0 0 0.0 100.0 ECU_ADDRESS 0x40022CBC /end MEASUREMENT
/begin MEASUREMENT FanCtl_rSpdFan2_mp "set point duty cycle percentage" SWORD DutyCycle_rate 0 0 0.0 100.0 ECU_ADDRESS 0x40022CBE /end MEASUREMENT
/begin MEASUREMENT FanCtl_stFanCtl_mp "Cooling fan stop or not state" UBYTE uint8 0 0 0.0 255.0 ECU_ADDRESS 0x40022CC0 /end MEASUREMENT
/begin MEASUREMENT Fans_trqDemResv1_mp "Torque reserve for cooling fan monitor 1" SWORD Trq_Nm 0 0 -3000.0 3000.0 ECU_ADDRESS 0x40022CD0 /end MEASUREMENT
/begin MEASUREMENT Fans_trqDemResv2_mp "Torque consumed by Fan monitor 1" SWORD Trq_Nm 0 0 -3000.0 3000.0 ECU_ADDRESS 0x40022CD2 /end MEASUREMENT
/begin MEASUREMENT Fans_trqCons1_mp "Torque reserve for cooling fan monitor 2" SWORD Trq_Nm 0 0 -3000.0 3000.0 ECU_ADDRESS 0x40022CD4 /end MEASUREMENT
/begin MEASUREMENT Fans_trqCons2_mp "Torque consumed by Fan monitor 2" SWORD Trq_Nm 0 0 -3000.0 3000.0 ECU_ADDRESS 0x40022CD6 /end MEASUREMENT
/begin MEASUREMENT Prp_trqDes_mp "Set point torque with stability interventions on transmission output torque level" SWORD Trq_Nm 0 0 -3000.0 3000.0 ECU_ADDRESS 0x40023116 /end MEASUREMENT
/begin MEASUREMENT VehMot_trqDesLead_mp "setpoint Lead torque for propulsion (transmission output torque)" SWORD Trq_Nm 0 0 -3000.0 3000.0 ECU_ADDRESS 0x40023118 /end MEASUREMENT
/begin MEASUREMENT AccPed_trqDesOvrRun_mp "Driver command torque overrun part setpoint path" SWORD Trq_Nm 0 0 -3000.0 3000.0 ECU_ADDRESS 0x40021E96 /end MEASUREMENT
/begin MEASUREMENT AccPed_trqDesBefComp_mp "Driver demand torque before compensation" SWORD Trq_Nm 0 0 -3000.0 3000.0 ECU_ADDRESS 0x40021E98 /end MEASUREMENT
/begin MEASUREMENT AccPed_trqDesComp_mp "driver's demand without limit Nm" SWORD Trq_Nm 0 0 -3000.0 3000.0 ECU_ADDRESS 0x40021E9A /end MEASUREMENT
/begin MEASUREMENT AccPed_trqLeadComp_mp "driver's demand lead without limit Nm" SWORD Trq_Nm 0 0 -3000.0 3000.0 ECU_ADDRESS 0x40021E9E /end MEASUREMENT
/begin MEASUREMENT AccPed_dtrqDwnLim_mp "Torque step limitation for falling ramp from the MAP AccPed_dtrqDwnLim_MAP" SWORD Trq_Nm_s 0 0 -3000.0 3000.0 ECU_ADDRESS 0x40021EA2 /end MEASUREMENT
/begin MEASUREMENT AccPed_dtrqUpLim_mp "Torque step limitation for rising ramp from the map AccPed_dtrqUpLim_MAP" SWORD Trq_Nm_s 0 0 -3000.0 3000.0 ECU_ADDRESS 0x40021EA4 /end MEASUREMENT
/begin MEASUREMENT AccPed_trqSumUpLimDes_mp "measuring point for AccPed_trqDes + AccPed_dtrqUpLim_mp*DT" SWORD Trq_Nm 0 0 -3000.0 3000.0 ECU_ADDRESS 0x40021EA6 /end MEASUREMENT
/begin MEASUREMENT AccPed_trqSumDwnLimDes_mp "measuring point for AccPed_trqDes + AccPed_dtrqDwnLim_mp*DT" SWORD Trq_Nm 0 0 -3000.0 3000.0 ECU_ADDRESS 0x40021EA8 /end MEASUREMENT
/begin MEASUREMENT VMD_trqDesInThres_mp "Lead torque from driver and Variable Engine Speed Governor Nm" SWORD Trq_Nm 0 0 -3000.0 3000.0 ECU_ADDRESS 0x40022258 /end MEASUREMENT
/begin MEASUREMENT VMD_nsetplocomp_mp "Compare of Minimum engine speed" UBYTE boolean 0 0 0.0 1.0 ECU_ADDRESS 0x4002225A /end MEASUREMENT
/begin MEASUREMENT VMD_appr_mp "Compare of  app" UBYTE boolean 0 0 0.0 1.0 ECU_ADDRESS 0x4002225B /end MEASUREMENT
/begin MEASUREMENT VMD_trqdescomp_mp "Compare of torque" UBYTE boolean 0 0 0.0 1.0 ECU_ADDRESS 0x4002225C /end MEASUREMENT
/begin MEASUREMENT VMD_accpedstbrkdes_mp "Compare of status of brake pedal" UBYTE boolean 0 0 0.0 1.0 ECU_ADDRESS 0x4002225D /end MEASUREMENT
/begin MEASUREMENT VMD_swtTrqSel_mp "Driver demand - Cruise control torque selection switch" UBYTE boolean 0 0 0.0 1.0 ECU_ADDRESS 0x4002225E /end MEASUREMENT
/begin MEASUREMENT InjVlv_tiBlkShtETMax_mp "measuring points blankshot execution control / Maximal blankshot energizing time" SWORD InjTime_us 0 0 -13107.2 13106.8 ECU_ADDRESS 0x40022F40 /end MEASUREMENT
/begin MEASUREMENT InjVlv_bBlkShtEnbOverrun "flag to indicate blank shot enable or not on Overrun" UBYTE boolean 0 0 0.0 1.0 ECU_ADDRESS 0x40022F42 /end MEASUREMENT
/begin MEASUREMENT InjVlv_bBlkShtEnbAftrun "flag to indicate blank shot enable or not on Afterrun" UBYTE boolean 0 0 0.0 1.0 ECU_ADDRESS 0x40022F43 /end MEASUREMENT
/begin MEASUREMENT InjVlv_qMI1Min_mp "Start of energizing correction factor for MI1 based on Rail pressure" SWORD FuelMass_mg_hub 0 0 -319.0 319.0 ECU_ADDRESS 0x40022F44 /end MEASUREMENT
/begin MEASUREMENT InjVlv_qPiI1Min_mp "Start of energizing correction for PiI1 based on Rail pressure" SWORD FuelMass_mg_hub 0 0 -319.0 319.0 ECU_ADDRESS 0x40022F46 /end MEASUREMENT
/begin MEASUREMENT InjVlv_qPoI2Min_mp "Start of energizing correction for PoI2 based on Rail pressure" SWORD FuelMass_mg_hub 0 0 -319.0 319.0 ECU_ADDRESS 0x40022F48 /end MEASUREMENT
/begin MEASUREMENT InjVlv_qPiI2Min_mp "Start of energizing correction for PiI2 based on Rail pressure" SWORD FuelMass_mg_hub 0 0 -319.0 319.0 ECU_ADDRESS 0x40022F4A /end MEASUREMENT
/begin MEASUREMENT InjVlv_pMin_mp "Minium Rail pressure for MI1 based on Rail pressure" SWORD RailPressure_bar 0 0 0.0 2000.0 ECU_ADDRESS 0x40022F4C /end MEASUREMENT
/begin MEASUREMENT InjVlv_tiSOEDynCor_mp "injector open delay time" SWORD InjTime_us 0 0 -13107.0 13106.0 ECU_ADDRESS 0x40022F4E /end MEASUREMENT
/begin MEASUREMENT InjVlv_tiEOEDynCor_mp "injector close delay time" SWORD InjTime_us 0 0 -13107.0 13106.0 ECU_ADDRESS 0x40022F50 /end MEASUREMENT
/begin MEASUREMENT InjVlv_tiETMI1NoCor_mp "Start of energizing for MI1 without correction" SWORD InjTime_us 0 0 -13107.0 13106.0 ECU_ADDRESS 0x40022F52 /end MEASUREMENT
/begin MEASUREMENT InjVlv_tiETPiI1NoCor_mp "Start of energizing for PiI1 without correction" SWORD InjTime_us 0 0 -13107.0 13106.0 ECU_ADDRESS 0x40022F54 /end MEASUREMENT
/begin MEASUREMENT InjVlv_tiETPoI2NoCor_mp "Start of energizing for PoI2 without correction" SWORD InjTime_us 0 0 -13107.0 13106.0 ECU_ADDRESS 0x40022F56 /end MEASUREMENT
/begin MEASUREMENT InjVlv_tiETPiI2NoCor_mp "Start of energizing for PiI2 without correction" SWORD InjTime_us 0 0 -13107.0 13106.0 ECU_ADDRESS 0x40022F58 /end MEASUREMENT
/begin MEASUREMENT InjVlv_tiPiIDiffMin_mp "Interval time of Minium injection of PiI" SWORD InjTime_us 0 0 -13107.0 13106.0 ECU_ADDRESS 0x40022F5A /end MEASUREMENT
/begin MEASUREMENT InjVlv_tiPoI2DiffMin_mp "Interval time of Minium injection  of PoI2" SWORD InjTime_us 0 0 -13107.0 13106.0 ECU_ADDRESS 0x40022F5C /end MEASUREMENT
/begin MEASUREMENT InjVlv_stPresMin "State of Minium Rail pressure base on engine temperature" UBYTE boolean 0 0 0.0 1.0 ECU_ADDRESS 0x40022F5E /end MEASUREMENT
/begin MEASUREMENT InjVlv_stMI1QntMin "State of Minium injection quantity of MI1" UBYTE boolean 0 0 0.0 1.0 ECU_ADDRESS 0x40022F5F /end MEASUREMENT
/begin MEASUREMENT InjVlv_stPiI1QntMin "State of Minium injection quantity of PiI1" UBYTE boolean 0 0 0.0 1.0 ECU_ADDRESS 0x40022F60 /end MEASUREMENT
/begin MEASUREMENT InjVlv_stPoI2QntMin "State of Minium injection quantity of PoI2" UBYTE boolean 0 0 0.0 1.0 ECU_ADDRESS 0x40022F61 /end MEASUREMENT
/begin MEASUREMENT InjVlv_stPiI2QntMin "State of Minium injection quantity of PiI2" UBYTE boolean 0 0 0.0 1.0 ECU_ADDRESS 0x40022F62 /end MEASUREMENT
/begin MEASUREMENT AFS_tiTransfCrvIn_mp "Measuring point for input to the AFS curve that converts period to air mass flow" SLONG Time_PwmHigh_us 0 0 0.0 1.07374182E+8 ECU_ADDRESS 0x40021EC0 /end MEASUREMENT
/begin MEASUREMENT AFS_dmSensRaw "Sensed air mass flow Raw" SWORD AirMassPerTime 0 0 -8192.0 8191.0 ECU_ADDRESS 0x40021EC4 /end MEASUREMENT
/begin MEASUREMENT AFS_dmSensAvr_mp "Sensed air mass flow Raw" SWORD AirMassPerTime 0 0 -8192.0 8191.0 ECU_ADDRESS 0x40021EC6 /end MEASUREMENT
/begin MEASUREMENT AFS_dmSubsVal_mp "Substitute value for air flow signal from the map" SWORD AirMassPerTime 0 0 -8192.0 8191.0 ECU_ADDRESS 0x40021ECC /end MEASUREMENT
/begin MEASUREMENT AFS_dmAirSubsVal_mp "Substitute value for air flow signal from the map" SWORD AirMassPerTime 0 0 -8192.0 8191.0 ECU_ADDRESS 0x40021ECE /end MEASUREMENT
/begin MEASUREMENT AFS_dmAirFrz_mp "Frozen value of air flow signal in case of errors" SWORD AirMassPerTime 0 0 -8192.0 8191.0 ECU_ADDRESS 0x40021ED0 /end MEASUREMENT
/begin MEASUREMENT AFS_dmSensCorr_mp "Air flow signal after switch on correction" SWORD AirMassPerTime 0 0 -8192.0 8191.0 ECU_ADDRESS 0x40021ED2 /end MEASUREMENT
/begin MEASUREMENT AFS_dmComp_mp "Total drift compensated air mass flow for AFS" SWORD AirMassPerTime 0 0 -8192.0 8191.0 ECU_ADDRESS 0x40021ED4 /end MEASUREMENT
/begin MEASUREMENT AFS_tEngMon_mp "Temperature from engine temperature field" SWORD Temp_deg 0 0 -1000.0 1000.0 ECU_ADDRESS 0x40021ED6 /end MEASUREMENT
/begin MEASUREMENT AFS_tAirMon_mp "Temperature from induction air system temperature field" SWORD Temp_deg 0 0 -1000.0 1000.0 ECU_ADDRESS 0x40021ED8 /end MEASUREMENT
/begin MEASUREMENT AFS_facSwtOnCor_mp "Switch-on correction factor" SWORD Prc_Fact10000 0 0 -3.2 3.2 ECU_ADDRESS 0x40021EDA /end MEASUREMENT
/begin MEASUREMENT AFS_facPlsCorBasEGRShOff_mp "Measurement point for the pulsation correction factor when there is a EGR shut off" SWORD Prc_Fact10000 0 0 -3.2 3.2 ECU_ADDRESS 0x40021EDC /end MEASUREMENT
/begin MEASUREMENT AFS_rNorm_mp "Ratio of modeled air flow signal to the sensed air flow signal" SWORD Prc_Fact10000 0 0 -3.2 3.2 ECU_ADDRESS 0x40021EDE /end MEASUREMENT
/begin MEASUREMENT AFS_rAirThresPlausMin_mp "Minimum sensitivity drift limit" SWORD Prc_Fact10000 0 0 -3.2 3.2 ECU_ADDRESS 0x40021EE0 /end MEASUREMENT
/begin MEASUREMENT AFS_rAirThresPlausMax_mp "Maximum sensitivity drift limit" SWORD Prc_Fact10000 0 0 -3.2 3.2 ECU_ADDRESS 0x40021EE2 /end MEASUREMENT
/begin MEASUREMENT AFS_stPlChkRls_mp "Partial release status of the plausibility check of the sensitivity drift" UBYTE boolean 0 0 0.0 1.0 ECU_ADDRESS 0x40021EE4 /end MEASUREMENT
/begin MEASUREMENT AFS_stOvrRunRls_mp "Partial release of status of the plausibility check of the sensitivity drift in overrun operation" UBYTE boolean 0 0 0.0 1.0 ECU_ADDRESS 0x40021EE5 /end MEASUREMENT
/begin MEASUREMENT AFS_stMon_mp "Status of monitoring of the sensitivity drift" ULONG State_uint32 0 0 0.0 4.294967295E+9 ECU_ADDRESS 0x40021EE8 /end MEASUREMENT
/begin MEASUREMENT AFS_stOvrnAdjRlsCon_mp "Measuring point indicating the status of the individual release conditions in overrun monitoring." UWORD State_uint16 0 0 0.0 65535.0 ECU_ADDRESS 0x40021EEC /end MEASUREMENT
/begin MEASUREMENT AFS_dmAirMsFlt_mp "Air mass flow after PT1-filtering [kg/h]" SWORD AirMassPerTime 0 0 -8192.0 8191.0 ECU_ADDRESS 0x40021EEE /end MEASUREMENT
/begin MEASUREMENT AFS_dmAirDrftComp "Compensated Air mass value for the drift" SWORD AirMassPerTime 0 0 -8192.0 8191.0 ECU_ADDRESS 0x40021EF0 /end MEASUREMENT
/begin MEASUREMENT AFS_dmLdAirMs_mp "Air mass flow in the load range [kg/h]" SWORD AirMassPerTime 0 0 -8192.0 8191.0 ECU_ADDRESS 0x40021EF2 /end MEASUREMENT
/begin MEASUREMENT AFS_dmIdlAirMs_mp "Air mass flow in the low-idle range [kg/h]" SWORD AirMassPerTime 0 0 -8192.0 8191.0 ECU_ADDRESS 0x40021EF4 /end MEASUREMENT
/begin MEASUREMENT AFS_dpIntValAbs_mp "Absolute value of change over time of the boost pressure [hPa/s]" SWORD AirPressure_kPa_s 0 0 -500.0 499.0 ECU_ADDRESS 0x40021EF6 /end MEASUREMENT
/begin MEASUREMENT AFS_dpIntValAbsFlt_mp "Absolute value of change over time of the boost pressure after filtering [hPa/s]" SWORD AirPressure_kPa_s 0 0 -500.0 499.0 ECU_ADDRESS 0x40021EF8 /end MEASUREMENT
/begin MEASUREMENT AFS_qWinLdAdjThresLo_mp "Measuring point for the lower threshold of the injection mass window in load conditions" SWORD FuelMass_mg_hub 0 0 -300.0 300.0 ECU_ADDRESS 0x40021EFA /end MEASUREMENT
/begin MEASUREMENT AFS_qWinLdAdjThresHi_mp "Measuring point for the upper threshold of the injection mass window in load conditions" SWORD FuelMass_mg_hub 0 0 -300.0 300.0 ECU_ADDRESS 0x40021EFC /end MEASUREMENT
/begin MEASUREMENT AFS_dnEngAbs_mp "Absolute change of engine speed" SWORD EngSpeed_rpm_s 0 0 -6000.0 6000.0 ECU_ADDRESS 0x40021EFE /end MEASUREMENT
/begin MEASUREMENT AFS_dnEngAbsFlt_mp "Filtered absolute change of engine speed" SWORD EngSpeed_rpm_s 0 0 -6000.0 6000.0 ECU_ADDRESS 0x40021F00 /end MEASUREMENT
/begin MEASUREMENT AFS_tAirDrftComp_mp "Induction air temperature" SWORD Temp_deg 0 0 -1000.0 1000.0 ECU_ADDRESS 0x40021F02 /end MEASUREMENT
/begin MEASUREMENT AFS_tEnvTemp_mp "Environmental temperature selected from induction air system temperature field" SWORD Temp_deg 0 0 -1000.0 1000.0 ECU_ADDRESS 0x40021F04 /end MEASUREMENT
/begin MEASUREMENT AFS_dqCurrAbs_mp "Absolute change of injection quantity" SWORD AFS_RmpInjMass_mg_stroke_s 0 0 0.0 99.0 ECU_ADDRESS 0x40021F06 /end MEASUREMENT
/begin MEASUREMENT AFS_dqCurrAbsFlt_mp "Filtered Absolute change of injection quantity" SWORD AFS_RmpInjMass_mg_stroke_s 0 0 0.0 99.0 ECU_ADDRESS 0x40021F08 /end MEASUREMENT
/begin MEASUREMENT AFS_facCalcVal_mp "Calculated air mass correction factor" SWORD Prc_Fact10000 0 0 -3.2 3.2 ECU_ADDRESS 0x40021F0A /end MEASUREMENT
/begin MEASUREMENT AFS_facCalcValFlt_mp "Calculated air mass correction factor after PT1-filtering" SWORD Prc_Fact10000 0 0 -3.2 3.2 ECU_ADDRESS 0x40021F0C /end MEASUREMENT
/begin MEASUREMENT AFS_facIdlAdjVal_mp "Low-idle correction factor of the drift compensation" SWORD Prc_Fact10000 0 0 -3.2 3.2 ECU_ADDRESS 0x40021F0E /end MEASUREMENT
/begin MEASUREMENT AFS_facLdAdjVal_mp "Load correction factor of the drift compensation" SWORD Prc_Fact10000 0 0 -3.2 3.2 ECU_ADDRESS 0x40021F10 /end MEASUREMENT
/begin MEASUREMENT AFS_facAirMsNrmIdl_mp "input to curve AFS_facCorExtpIdl_CUR" SWORD Prc_Fact10000 0 0 -3.2 3.2 ECU_ADDRESS 0x40021F12 /end MEASUREMENT
/begin MEASUREMENT AFS_facAirMsNrmLd_mp "input to curve AFS_facCorExtpLd_CUR" SWORD Prc_Fact10000 0 0 -3.2 3.2 ECU_ADDRESS 0x40021F14 /end MEASUREMENT
/begin MEASUREMENT AFS_facCorIpo_mp "Resulting range of the correction curve" SWORD Prc_Fact10000 0 0 -3.2 3.2 ECU_ADDRESS 0x40021F16 /end MEASUREMENT
/begin MEASUREMENT AFS_facLdAdjValUnLim_mp "Air mass correction factor in the load range ahead of step limitation" SWORD Prc_Fact10000 0 0 -3.2 3.2 ECU_ADDRESS 0x40021F18 /end MEASUREMENT
/begin MEASUREMENT AFS_facIdlAdjValUnLim_mp "Air mass correction factor in the low-idle range ahead of step limitation" SWORD Prc_Fact10000 0 0 -3.2 3.2 ECU_ADDRESS 0x40021F1A /end MEASUREMENT
/begin MEASUREMENT AFS_facCalcLdAdjVal_mp "Calculated air mass correction factor in the load range" SWORD Prc_Fact10000 0 0 -3.2 3.2 ECU_ADDRESS 0x40021F1C /end MEASUREMENT
/begin MEASUREMENT AFS_facCalcIdlAdjVal_mp "Calculated air mass correction factor in low-idle" SWORD Prc_Fact10000 0 0 -3.2 3.2 ECU_ADDRESS 0x40021F1E /end MEASUREMENT
/begin MEASUREMENT AFS_drWtPenDet_mp "Relative signal change difference for water penetration detection [1/s]" SWORD Rmp_1_s 0 0 -32.0 32.0 ECU_ADDRESS 0x40021F20 /end MEASUREMENT
/begin MEASUREMENT AFS_drWtPenDetFlt_mp "Filtered signal difference for water penetration" SWORD Rmp_1_s 0 0 -32.0 32.0 ECU_ADDRESS 0x40021F22 /end MEASUREMENT
/begin MEASUREMENT AFS_stEnvCon_mp "State of environment conditions for releasing the correction value calculation" UBYTE State_uint8 0 0 0.0 255.0 ECU_ADDRESS 0x40021F24 /end MEASUREMENT
/begin MEASUREMENT AFS_stIdlAdjRlsCon_mp "State of the release conditions for correction value calculation at low-idle" UBYTE State_uint8 0 0 0.0 255.0 ECU_ADDRESS 0x40021F25 /end MEASUREMENT
/begin MEASUREMENT AFS_stLdAdjRlsCon_mp "State of the release conditions for correction value calculation in the load range" UBYTE State_uint8 0 0 0.0 255.0 ECU_ADDRESS 0x40021F26 /end MEASUREMENT
/begin MEASUREMENT AFS_stIntpRng_mp "Range of current compensated air mass" UBYTE State_uint8 0 0 0.0 255.0 ECU_ADDRESS 0x40021F27 /end MEASUREMENT
/begin MEASUREMENT AFS_stRstLoDrftThres_mp "Deactivation state of the minimum drift limits" UBYTE boolean 0 0 0.0 1.0 ECU_ADDRESS 0x40021F28 /end MEASUREMENT
/begin MEASUREMENT AFS_stAdjRlsEnvCon "Monitoring of the environmental release conditions" UBYTE boolean 0 0 0.0 1.0 ECU_ADDRESS 0x40021F29 /end MEASUREMENT
/begin MEASUREMENT AFS_stIdlAdjRlsUnDeb "Monitoring of the release conditions for the base correction factor value calculation in low-idle" UBYTE boolean 0 0 0.0 1.0 ECU_ADDRESS 0x40021F2A /end MEASUREMENT
/begin MEASUREMENT AFS_stADCO_mp "Measuring point indicating whether the AFS drift compensation in overrun can be started or not." UBYTE boolean 0 0 0.0 1.0 ECU_ADDRESS 0x40021F2B /end MEASUREMENT
/begin MEASUREMENT AFS_stLdAdjRlsUnDeb "Monitoring of the release conditions for the base correction factor value calculation in the load range" UBYTE boolean 0 0 0.0 1.0 ECU_ADDRESS 0x40021F2C /end MEASUREMENT
/begin MEASUREMENT AFS_stOvrAdjRlsUnDeb "Monitoring of the release conditions for the calculation of drift correction value during overrun" UBYTE boolean 0 0 0.0 1.0 ECU_ADDRESS 0x40021F2D /end MEASUREMENT
/begin MEASUREMENT AFS_stAdjRlsDel_mp "Status of the release delay for correction value calculation" UBYTE boolean 0 0 0.0 1.0 ECU_ADDRESS 0x40021F2E /end MEASUREMENT
/begin MEASUREMENT AFS_stIdlAdjRls "Status of idle release condition" UBYTE boolean 0 0 0.0 1.0 ECU_ADDRESS 0x40021F2F /end MEASUREMENT
/begin MEASUREMENT AFS_stLdAdjRls "Status of load release condition" UBYTE boolean 0 0 0.0 1.0 ECU_ADDRESS 0x40021F30 /end MEASUREMENT
/begin MEASUREMENT AFS_stWtPenDet_mp "Status of the water penetration detection" UBYTE boolean 0 0 0.0 1.0 ECU_ADDRESS 0x40021F31 /end MEASUREMENT
/begin MEASUREMENT AFS_stWtPenDetDeb_mp "Status of the water penetration detection after debouncing" UBYTE boolean 0 0 0.0 1.0 ECU_ADDRESS 0x40021F32 /end MEASUREMENT
/begin MEASUREMENT AFS_stCurrAdj "state of whether correction factors are updating or not" UBYTE boolean 0 0 0.0 1.0 ECU_ADDRESS 0x40021F33 /end MEASUREMENT
/begin MEASUREMENT AFS_stCurrLdAdj "Debounced status of load release condition" UBYTE boolean 0 0 0.0 1.0 ECU_ADDRESS 0x40021F34 /end MEASUREMENT
/begin MEASUREMENT AFS_stCurrIdlAdj "Debounced status of the idle release condition" UBYTE boolean 0 0 0.0 1.0 ECU_ADDRESS 0x40021F35 /end MEASUREMENT
/begin MEASUREMENT AFS_facIdlAdjVal_EEP "" SWORD Prc_Fact10000 0 0 -3.2768 3.2767 ECU_ADDRESS 0x4002FBD2 /end MEASUREMENT
/begin MEASUREMENT AFS_facLdAdjVal_EEP "" SWORD Prc_Fact10000 0 0 -3.2768 3.2767 ECU_ADDRESS 0x4002FBD4 /end MEASUREMENT
/begin MEASUREMENT Air_bRefSigPerHiTAFS "soft fault of TAFS Period High" UBYTE boolean 0 0 0.0 1.0 ECU_ADDRESS 0x40021F36 /end MEASUREMENT
/begin MEASUREMENT Air_bRefSigPerLoTAFS "soft fault of TAFS Period Low" UBYTE boolean 0 0 0.0 1.0 ECU_ADDRESS 0x40021F37 /end MEASUREMENT
/begin MEASUREMENT Air_bDtyCycHiTAFS "soft fault of TAFS Duty Cycle High" UBYTE boolean 0 0 0.0 1.0 ECU_ADDRESS 0x40021F38 /end MEASUREMENT
/begin MEASUREMENT Air_bDtyCycLoTAFS "soft fault of TAFS Duty Cycle Low" UBYTE boolean 0 0 0.0 1.0 ECU_ADDRESS 0x40021F39 /end MEASUREMENT
/begin MEASUREMENT Air_bVoltHiTAFS "soft fault of TAFS Voltage High" UBYTE boolean 0 0 0.0 1.0 ECU_ADDRESS 0x40021F3A /end MEASUREMENT
/begin MEASUREMENT Air_bVoltLoTAFS "soft fault of TAFS Voltage Low" UBYTE boolean 0 0 0.0 1.0 ECU_ADDRESS 0x40021F3B /end MEASUREMENT
/begin MEASUREMENT EGRVlv_rCnvInHb_mp "Measurement point for input of the curve" SWORD Prc_100_rate 0 0 -100.0 100.0 ECU_ADDRESS 0x40022AF8 /end MEASUREMENT
/begin MEASUREMENT EGRVlv_rCnvHb_mp "Measurement point for output of the curve for single flow implementation" SWORD Prc_100_rate 0 0 -100.0 100.0 ECU_ADDRESS 0x40022AFA /end MEASUREMENT
/begin MEASUREMENT EGRVlv_rPsHb "Duty cycle to power stage" SWORD Prc_100_rate 0 0 -100.0 100.0 ECU_ADDRESS 0x40022AFC /end MEASUREMENT
/begin MEASUREMENT EGRVlv_rPsNrmHb "Normalized value of EGRVLv_rPSNrm" SWORD Prc_100_rate 0 0 -100.0 100.0 ECU_ADDRESS 0x40022AFE /end MEASUREMENT
/begin MEASUREMENT EGRVlv_rCnvInPWM_mp "Measurement point for input of the curve" SWORD Prc_100_rate 0 0 -100.0 100.0 ECU_ADDRESS 0x40022B00 /end MEASUREMENT
/begin MEASUREMENT EGRVlv_rCnvPWM_mp "Measurement point for output of the curve for single flow implementation" SWORD Prc_100_rate 0 0 -100.0 100.0 ECU_ADDRESS 0x40022B02 /end MEASUREMENT
/begin MEASUREMENT EGRVlv_rPsPWM "Duty cycle to power stage" SWORD Prc_100_rate 0 0 -100.0 100.0 ECU_ADDRESS 0x40022B04 /end MEASUREMENT
/begin MEASUREMENT EGRVlv_rPsNrmPWM "Normalized value of EGRVLv_rPSNrm" SWORD Prc_100_rate 0 0 -100.0 100.0 ECU_ADDRESS 0x40022B06 /end MEASUREMENT
/begin MEASUREMENT EGRVlv_facCorFltHb_mp "Measurement point for battery correction factor for single flow implementation" SWORD Factor 0 0 -32.0 31.9 ECU_ADDRESS 0x40022B08 /end MEASUREMENT
/begin MEASUREMENT EGRVlv_facCorFltPWM_mp "Measurement point for battery correction factor for single flow implementation" SWORD Factor 0 0 -32.0 31.9 ECU_ADDRESS 0x40022B0A /end MEASUREMENT
/begin MEASUREMENT EGRVlv_bSRCMax "EGR Valve voltage signal maximum limit value" UBYTE boolean 0 0 0.0 1.0 ECU_ADDRESS 0x40022B14 /end MEASUREMENT
/begin MEASUREMENT EGRVlv_bSRCMin "EGR Valve voltage signal minimum limit value" UBYTE boolean 0 0 0.0 1.0 ECU_ADDRESS 0x40022B15 /end MEASUREMENT
/begin MEASUREMENT EGRVlv_bPhysRngHi "Status Sensor of the EGR Valve high voltage Signal range" UBYTE boolean 0 0 0.0 1.0 ECU_ADDRESS 0x40022B16 /end MEASUREMENT
/begin MEASUREMENT EGRVlv_bPhysRngLo "Status Sensor of the EGR Valve low voltage Signal range" UBYTE boolean 0 0 0.0 1.0 ECU_ADDRESS 0x40022B17 /end MEASUREMENT
/begin MEASUREMENT EGRVlv_drRaw_mp "EGR rate gradient calculated over current position" SLONG EGR_rate_s 0 0 -1000.0 1000.0 ECU_ADDRESS 0x40022B18 /end MEASUREMENT
/begin MEASUREMENT EGRVlv_tEngMon_mp "Engine monitoring temperature" SWORD Temp_deg 0 0 -3000.0 3000.0 ECU_ADDRESS 0x40022B1C /end MEASUREMENT
/begin MEASUREMENT EGRVlv_stEnaMon "Enable condition" UBYTE boolean 0 0 0.0 1.0 ECU_ADDRESS 0x40022B20 /end MEASUREMENT
/begin COMPU_METHOD EngSpeed_rpm "f(x)=(c1*X*X+c2*X+c3)/(c4*X*X+c5*X+c6)" RAT_FUNC "%6.1" "rpm" COEFFS 0 2.000 0.000 0 0 1.000 /end COMPU_METHOD
/begin COMPU_METHOD State_uint8 "f(x)=(c1*X*X+c2*X+c3)/(c4*X*X+c5*X+c6)" RAT_FUNC "%3.0" "" COEFFS 0 1 0 0 0 1 /end COMPU_METHOD
/begin COMPU_METHOD State_uint16 "f(x)=(c1*X*X+c2*X+c3)/(c4*X*X+c5*X+c6)" RAT_FUNC "%5.0" "" COEFFS 0 1 0 0 0 1 /end COMPU_METHOD
/begin COMPU_METHOD State_uint32 "f(x)=(c1*X*X+c2*X+c3)/(c4*X*X+c5*X+c6)" RAT_FUNC "%10.0" "" COEFFS 0 1 0 0 0 1 /end COMPU_METHOD
/begin COMPU_METHOD Trq_Nm "f(x)=(c1*X*X+c2*X+c3)/(c4*X*X+c5*X+c6)" RAT_FUNC "%0.3" "Nm" COEFFS 0 10.000 0.000 0 0 1.000 /end COMPU_METHOD
/begin COMPU_METHOD FuelMass_mg_hub "f(x)=(c1*X*X+c2*X+c3)/(c4*X*X+c5*X+c6)" RAT_FUNC "%0.3" "mg/hub" COEFFS 0 102.400 0.000 0 0 1.000 /end COMPU_METHOD
/begin COMPU_METHOD AirPressure_kPa "f(x)=(c1*X*X+c2*X+c3)/(c4*X*X+c5*X+c6)" RAT_FUNC "%0.3" "kPa" COEFFS 0 10.000 0.000 0 0 1.000 /end COMPU_METHOD
/begin COMPU_METHOD boolean "f(x)=(c1*X*X+c2*X+c3)/(c4*X*X+c5*X+c6)" RAT_FUNC "%1.0" "" COEFFS 0 1 0 0 0 1 /end COMPU_METHOD
/begin COMPU_METHOD uint8 "f(x)=(c1*X*X+c2*X+c3)/(c4*X*X+c5*X+c6)" RAT_FUNC "%3.0" "" COEFFS 0 1 0 0 0 1 /end COMPU_METHOD
/begin COMPU_METHOD EngTime_ms "f(x)=(c1*X*X+c2*X+c3)/(c4*X*X+c5*X+c6)" RAT_FUNC "%0.3" "ms" COEFFS 0 1.000 0.000 0 0 10.000 /end COMPU_METHOD
/begin COMPU_METHOD Prc_100_rate "f(x)=(c1*X*X+c2*X+c3)/(c4*X*X+c5*X+c6)" RAT_FUNC "%0.3" "%" COEFFS 0 81.920 0.000 0 0 1.000 /end COMPU_METHOD
/begin COMPU_METHOD InjTime_us "f(x)=(c1*X*X+c2*X+c3)/(c4*X*X+c5*X+c6)" RAT_FUNC "%0.3" "us" COEFFS 0 2.500 0.000 0 0 1.000 /end COMPU_METHOD
/begin COMPU_METHOD Time_PwmHigh_us "f(x)=(c1*X*X+c2*X+c3)/(c4*X*X+c5*X+c6)" RAT_FUNC "%0.3" "us" COEFFS 0 20.000 0.000 0 0 1.000 /end COMPU_METHOD
/begin COMPU_METHOD DutyCycle_rate "f(x)=(c1*X*X+c2*X+c3)/(c4*X*X+c5*X+c6)" RAT_FUNC "%0.3" "%" COEFFS 0 100.000 0.000 0 0 1.000 /end COMPU_METHOD
/begin COMPU_METHOD Time_Period_HFM6 "f(x)=(c1*X*X+c2*X+c3)/(c4*X*X+c5*X+c6)" RAT_FUNC "%0.3" "ms" COEFFS 0 20000.000 0.000 0 0 1.000 /end COMPU_METHOD
/begin COMPU_METHOD Ad_mv "f(x)=(c1*X*X+c2*X+c3)/(c4*X*X+c5*X+c6)" RAT_FUNC "%5.0" "mv" COEFFS 0 1 0 0 0 1 /end COMPU_METHOD
/begin COMPU_METHOD Debounce_ms "f(x)=(c1*X*X+c2*X+c3)/(c4*X*X+c5*X+c6)" RAT_FUNC "%10.0" "ms" COEFFS 0 1 0 0 0 1 /end COMPU_METHOD
/begin COMPU_METHOD EGR_rate_s "f(x)=(c1*X*X+c2*X+c3)/(c4*X*X+c5*X+c6)" RAT_FUNC "%0.3" "r/s" COEFFS 0 1000.000 0.000 0 0 1.000 /end COMPU_METHOD
/begin COMPU_METHOD Length_Km "f(x)=(c1*X*X+c2*X+c3)/(c4*X*X+c5*X+c6)" RAT_FUNC "%0.3" "Km" COEFFS 0 1000.000 0.000 0 0 1.000 /end COMPU_METHOD
/begin COMPU_METHOD Freq_q1p0 "f(x)=(c1*X*X+c2*X+c3)/(c4*X*X+c5*X+c6)" RAT_FUNC "%5.0" "Hz" COEFFS 0 1 0 0 0 1 /end COMPU_METHOD
/begin COMPU_METHOD AirMass_mg_hub "f(x)=(c1*X*X+c2*X+c3)/(c4*X*X+c5*X+c6)" RAT_FUNC "%6.1" "mg/hub" COEFFS 0 2.000 0.000 0 0 1.000 /end COMPU_METHOD
/begin COMPU_METHOD EngSpeed_rpm_s "f(x)=(c1*X*X+c2*X+c3)/(c4*X*X+c5*X+c6)" RAT_FUNC "%6.1" "rpm/s" COEFFS 0 2.000 0.000 0 0 1.000 /end COMPU_METHOD
/begin COMPU_METHOD VehSpeed_km_h "f(x)=(c1*X*X+c2*X+c3)/(c4*X*X+c5*X+c6)" RAT_FUNC "%0.3" "km/h" COEFFS 0 100.000 0.000 0 0 1.000 /end COMPU_METHOD
/begin COMPU_METHOD TransRatio "f(x)=(c1*X*X+c2*X+c3)/(c4*X*X+c5*X+c6)" RAT_FUNC "%0.3" "" COEFFS 0 100.000 0.000 0 0 1.000 /end COMPU_METHOD
/begin COMPU_METHOD Prc_Fact100 "f(x)=(c1*X*X+c2*X+c3)/(c4*X*X+c5*X+c6)" RAT_FUNC "%0.3" "" COEFFS 0 100.000 0.000 0 0 1.000 /end COMPU_METHOD
/begin COMPU_METHOD Temp_deg "f(x)=(c1*X*X+c2*X+c3)/(c4*X*X+c5*X+c6)" RAT_FUNC "%0.3" "deg" COEFFS 0 10.000 2731.400 0 0 1.000 /end COMPU_METHOD
/begin COMPU_METHOD Temp_deg_s "f(x)=(c1*X*X+c2*X+c3)/(c4*X*X+c5*X+c6)" RAT_FUNC "%0.3" "deg/s" COEFFS 0 10.000 2731.400 0 0 1.000 /end COMPU_METHOD
/begin COMPU_METHOD Fact8192 "f(x)=(c1*X*X+c2*X+c3)/(c4*X*X+c5*X+c6)" RAT_FUNC "%14.6" "" COEFFS 0 8192.000 0.000 0 0 1.000 /end COMPU_METHOD
/begin COMPU_METHOD PT_fac "f(x)=(c1*X*X+c2*X+c3)/(c4*X*X+c5*X+c6)" RAT_FUNC "%0.3" "" COEFFS 0 655.360 0.000 0 0 1.000 /end COMPU_METHOD
/begin COMPU_METHOD AirMassPerTime "f(x)=(c1*X*X+c2*X+c3)/(c4*X*X+c5*X+c6)" RAT_FUNC "%7.2" "kg/h" COEFFS 0 4.000 0.000 0 0 1.000 /end COMPU_METHOD
/begin COMPU_METHOD Accpedal_rate "f(x)=(c1*X*X+c2*X+c3)/(c4*X*X+c5*X+c6)" RAT_FUNC "%0.3" "%" COEFFS 0 81.920 0.000 0 0 1.000 /end COMPU_METHOD
/begin COMPU_METHOD Factor "f(x)=(c1*X*X+c2*X+c3)/(c4*X*X+c5*X+c6)" RAT_FUNC "%12.6" "" COEFFS 0 1024.000 0.000 0 0 1.000 /end COMPU_METHOD
/begin COMPU_METHOD Turbo_rpm "f(x)=(c1*X*X+c2*X+c3)/(c4*X*X+c5*X+c6)" RAT_FUNC "%0.3" "rpm" COEFFS 0 1.000 0.000 0 0 10.000 /end COMPU_METHOD
/begin COMPU_METHOD RailPressure_bar "f(x)=(c1*X*X+c2*X+c3)/(c4*X*X+c5*X+c6)" RAT_FUNC "%0.3" "bar" COEFFS 0 12.800 0.000 0 0 1.000 /end COMPU_METHOD
/begin COMPU_METHOD Angle_CA "f(x)=(c1*X*X+c2*X+c3)/(c4*X*X+c5*X+c6)" RAT_FUNC "%0.3" "CA" COEFFS 0 45.511 0.000 0 0 1.000 /end COMPU_METHOD
/begin COMPU_METHOD Tra_V2N_km_h_rpm "f(x)=(c1*X*X+c2*X+c3)/(c4*X*X+c5*X+c6)" RAT_FUNC "%0.3" "km/h/rpm" COEFFS 0 100000.000 0.000 0 0 1.000 /end COMPU_METHOD
/begin COMPU_METHOD Tra_num "f(x)=(c1*X*X+c2*X+c3)/(c4*X*X+c5*X+c6)" RAT_FUNC "%3.0" "" COEFFS 0 1 0 0 0 1 /end COMPU_METHOD
/begin COMPU_METHOD Switch_conv "Enumerated data type: Switch_conv" TAB_VERB "%0.3" "" COMPU_TAB_REF VTAB_FOR_Switch_conv /end COMPU_METHOD
/begin COMPU_METHOD PT_TraType_State_conv "Enumerated data type: PT_TraType_State_conv" TAB_VERB "%0.3" "" COMPU_TAB_REF VTAB_FOR_PT_TraType_State_conv /end COMPU_METHOD
/begin COMPU_METHOD Trq_Nm_s "f(x)=(c1*X*X+c2*X+c3)/(c4*X*X+c5*X+c6)" RAT_FUNC "%0.3" "Nm/s" COEFFS 0 10.000 0.000 0 0 1.000 /end COMPU_METHOD
/begin COMPU_METHOD DutyCycle_rate_s "f(x)=(c1*X*X+c2*X+c3)/(c4*X*X+c5*X+c6)" RAT_FUNC "%0.3" "%/s" COEFFS 0 100.000 0.000 0 0 1.000 /end COMPU_METHOD
/begin COMPU_METHOD Fact1 "f(x)=(c1*X*X+c2*X+c3)/(c4*X*X+c5*X+c6)" RAT_FUNC "%10.6" "" COEFFS 0 128.000 0.000 0 0 1.000 /end COMPU_METHOD
/begin COMPU_METHOD sfix32_Sp001 "f(x)=(c1*X*X+c2*X+c3)/(c4*X*X+c5*X+c6)" RAT_FUNC "%0.3" "" COEFFS 0 1000.000 0.000 0 0 1.000 /end COMPU_METHOD
/begin COMPU_METHOD FanSpd_rpm "f(x)=(c1*X*X+c2*X+c3)/(c4*X*X+c5*X+c6)" RAT_FUNC "%5.0" "rpm" COEFFS 0 1 0 0 0 1 /end COMPU_METHOD
/begin COMPU_METHOD sfix16_En1 "f(x)=(c1*X*X+c2*X+c3)/(c4*X*X+c5*X+c6)" RAT_FUNC "%6.1" "" COEFFS 0 2.000 0.000 0 0 1.000 /end COMPU_METHOD
/begin COMPU_METHOD Prc_Fact10000 "f(x)=(c1*X*X+c2*X+c3)/(c4*X*X+c5*X+c6)" RAT_FUNC "%0.3" "" COEFFS 0 10000.000 0.000 0 0 1.000 /end COMPU_METHOD
/begin COMPU_METHOD AirPressure_kPa_s "f(x)=(c1*X*X+c2*X+c3)/(c4*X*X+c5*X+c6)" RAT_FUNC "%0.3" "kPa/s" COEFFS 0 10.000 0.000 0 0 1.000 /end COMPU_METHOD
/begin COMPU_METHOD AFS_RmpInjMass_mg_stroke_s "f(x)=(c1*X*X+c2*X+c3)/(c4*X*X+c5*X+c6)" RAT_FUNC "%0.3" "(mg/stroke)/s" COEFFS 0 327.000 0.000 0 0 1.000 /end COMPU_METHOD
/begin COMPU_METHOD Rmp_1_s "f(x)=(c1*X*X+c2*X+c3)/(c4*X*X+c5*X+c6)" RAT_FUNC "%0.3" "1/s" COEFFS 0 1000.000 0.000 0 0 1.000 /end COMPU_METHOD
/begin COMPU_METHOD uint16 "f(x)=(c1*X*X+c2*X+c3)/(c4*X*X+c5*X+c6)" RAT_FUNC "%5.0" "" COEFFS 0 1 0 0 0 1 /end COMPU_METHOD
/begin COMPU_VTAB VTAB_FOR_Switch_conv "Enumerated data type: Switch_conv" TAB_VERB 2 0 "OFF" 1 "ON" /end COMPU_VTAB
/begin COMPU_VTAB VTAB_FOR_PT_TraType_State_conv "Enumerated data type: PT_TraType_State_conv" TAB_VERB 5 0 "TRA_MT" 1 "TRA_AT" 2 "TRA_AST" 3 "TRA_CVT" 4 "TRA_DCT" /end COMPU_VTAB
/begin GROUP Root_CoVeh_CalcTrqPrpLimErr "CoVeh_CalcTrqPrpLimErr/CoVeh_CalcTrqPrpLimErr"
 /begin REF_CHARACTERISTIC CoVeh_bLimTboxFenceOut_C CoVeh_dtrqLimDwn_C CoVeh_dtrqLimUp_C CoVeh_trqLim_CUR /end REF_CHARACTERISTIC
 /begin REF_MEASUREMENT CoVeh_trqLim_mp /end REF_MEASUREMENT
/end GROUP
/begin GROUP CoVeh_PrfmLim "CoVeh_PrfmLim" /begin REF_CHARACTERISTIC CoVeh_trqPrfmLimDes_C /end REF_CHARACTERISTIC /end GROUP
/begin GROUP LsComp_TrqCalc "LsComp_TrqCalc" /begin REF_CHARACTERISTIC CoVeh_trqDesCompNoFl_C CoVeh_trqDesCompVeh_C /end REF_CHARACTERISTIC /end GROUP
/begin GROUP CoESS_Dem "CoESS_Dem" /begin REF_CHARACTERISTIC ESS_nMax_C ESS_nMin_C ESS_trqDesAcs_C ESS_trqResvAcs_C /end REF_CHARACTERISTIC /end GROUP
/begin GROUP GlbDa_LSum "GlbDa_LSum" /begin SUB_GROUP Root_GlbDa_LSum /end SUB_GROUP /end GROUP
/begin GROUP Root_GlbDa_LSum "GlbDa_LSum/GlbDa_LSum" /begin SUB_GROUP S1_VehDisSum /end SUB_GROUP /begin REF_CHARACTERISTIC GlbDa_LSum_VehThreshold_C /end REF_CHARACTERISTIC /begin REF_MEASUREMENT GlbDa_lTotDstVeh_EEP GlbDa_lTotDst_EEP /end REF_MEASUREMENT /end GROUP
/begin GROUP S1_VehDisSum "GlbDa_LSum/GlbDa_LSum/VehDisSum" /begin REF_CHARACTERISTIC GlbDa_LSum_lVehCHGECU_C /end REF_CHARACTERISTIC /end GROUP
/begin GROUP GlbDa_SetData "GlbDa_SetData" /begin REF_CHARACTERISTIC TrbCh_n_C /end REF_CHARACTERISTIC /end GROUP
/begin GROUP GlbDa_TrqDem "GlbDa_TrqDem" /begin REF_CHARACTERISTIC GlbDa_stTrqDem_C /end REF_CHARACTERISTIC /end GROUP
/begin GROUP CoPT_ThermDem "CoPT_ThermDem" /begin REF_CHARACTERISTIC CoPT_tClntDesMax_C CoPT_tClntDesMin_C /end REF_CHARACTERISTIC /end GROUP
/begin GROUP CoPT_TrqDesCoord "CoPT_TrqDesCoord" /begin SUB_GROUP Root_Torque_Coordination /end SUB_GROUP /end GROUP
/begin GROUP Root_Torque_Coordination "CoPT_TrqDesCoord/Torque Coordination" /begin SUB_GROUP S3_TraIntv /end SUB_GROUP /end GROUP
/begin GROUP S3_TraIntv "CoPT_TrqDesCoord/Torque Coordination/TraIntv" /begin SUB_GROUP S12_TraDecIntv S12_TraIncIntv /end SUB_GROUP /end GROUP
/begin GROUP S12_TraDecIntv "CoPT_TrqDesCoord/Torque Coordination/TraIntv/TraDecIntv" /begin REF_MEASUREMENT CoPT_trqDesDecMin_mp /end REF_MEASUREMENT /end GROUP
/begin GROUP S12_TraIncIntv "CoPT_TrqDesCoord/Torque Coordination/TraIntv/TraIncIntv" /begin REF_MEASUREMENT CoPT_trqDesIncMax_mp /end REF_MEASUREMENT /end GROUP
/begin GROUP CoPT_TrqLeadCoord "CoPT_TrqLeadCoord" /begin SUB_GROUP Root_Torque_Coordination1 /end SUB_GROUP /end GROUP
/begin GROUP Root_Torque_Coordination1 "CoPT_TrqLeadCoord/Torque Coordination" /begin SUB_GROUP S2_TraDecIntv /end SUB_GROUP /end GROUP
/begin GROUP S2_TraDecIntv "CoPT_TrqLeadCoord/Torque Coordination/TraDecIntv" /begin SUB_GROUP S4_Torque_Curr_Intervention S4_Torque_Lead_Intervention /end SUB_GROUP /end GROUP
/begin GROUP S4_Torque_Curr_Intervention "CoPT_TrqLeadCoord/Torque Coordination/TraDecIntv/Torque Curr Intervention"
 /begin REF_CHARACTERISTIC CoPT_dtrqCurrCorP_Neg_C CoPT_dtrqCurrCorP_Pos_C CoPT_tiDebCurr_C /end REF_CHARACTERISTIC
/end GROUP
/begin GROUP S4_Torque_Lead_Intervention "CoPT_TrqLeadCoord/Torque Coordination/TraDecIntv/Torque Lead Intervention"
 /begin REF_CHARACTERISTIC CoPT_dtrqCurrCorP_Neg_C CoPT_dtrqCurrCorP_Pos_C CoPT_tiDebLead_C /end REF_CHARACTERISTIC
/end GROUP
/begin GROUP PTLo_LosCalc "PTLo_LosCalc" /begin REF_CHARACTERISTIC PT_bTrqConv_C /end REF_CHARACTERISTIC /end GROUP
/begin GROUP PTODi_TrqComp "PTODi_TrqComp" /begin REF_CHARACTERISTIC CoPT_trqDesCompEng_C /end REF_CHARACTERISTIC /end GROUP
/begin GROUP PTODi_TrqDesCoord "PTODi_TrqDesCoord" /begin SUB_GROUP Root_PTODi_TrqDesCoord /end SUB_GROUP /end GROUP
/begin GROUP Root_PTODi_TrqDesCoord "PTODi_TrqDesCoord/PTODi_TrqDesCoord" /begin REF_CHARACTERISTIC PT_trqCrSDCS_C /end REF_CHARACTERISTIC /end GROUP
/begin GROUP Conv_LdCalc "Conv_LdCalc" /begin REF_CHARACTERISTIC Conv_trqLd_C Conv_trqResv_C /end REF_CHARACTERISTIC /end GROUP
/begin GROUP Gbx_Data "Gbx_Data"
 /begin REF_CHARACTERISTIC Gbx_nIdlDes_C Gbx_rFanClgDem_C Gbx_rTrq_C Gbx_stOvrSpdDem_C Gbx_tClntDes_C /end REF_CHARACTERISTIC
/end GROUP
/begin GROUP PT_Grip "PT_Grip" /begin SUB_GROUP Root_If_Action_Subsystem1 /end SUB_GROUP /end GROUP
/begin GROUP Root_If_Action_Subsystem1 "PT_Grip/If Action Subsystem1" /begin SUB_GROUP S1_drive_off_element_manual_clutch /end SUB_GROUP /end GROUP
/begin GROUP S1_drive_off_element_manual_clutch "PT_Grip/If Action Subsystem1/drive_off_element_manual_clutch"
 /begin SUB_GROUP S2_calculation_intermediate_grip_states S2_calculation_no_grip_state /end SUB_GROUP
 /begin REF_CHARACTERISTIC PT_rClthSlipDeb_C PT_rClthSlip_C PT_rGripDfl_C PT_rGrip_C PT_rNoGrip_C /end REF_CHARACTERISTIC
/end GROUP
/begin GROUP S2_calculation_intermediate_grip_states "PT_Grip/If Action Subsystem1/drive_off_element_manual_clutch/calculation_intermediate_grip_states" /begin REF_CHARACTERISTIC PT_tiDebClthStSlip_C /end REF_CHARACTERISTIC /end GROUP
/begin GROUP S2_calculation_no_grip_state "PT_Grip/If Action Subsystem1/drive_off_element_manual_clutch/calculation_no_grip_state" /begin REF_CHARACTERISTIC PT_GripCfg_CW PT_vMinGrip_C /end REF_CHARACTERISTIC /end GROUP
/begin GROUP PT_TrqRat "PT_TrqRat"
 /begin REF_CHARACTERISTIC PT_rTrqDfl_C PT_rTrqMax_C PT_rTrqMin_C PT_swtDetTypeCAN_C PT_vMinTrqRat_C /end REF_CHARACTERISTIC
 /begin REF_MEASUREMENT PT_rTrqTmp1_mp PT_rTrqTmp2_mp PT_rTrq_mp /end REF_MEASUREMENT
/end GROUP
/begin GROUP Tra_Add "Tra_Add" /begin SUB_GROUP Root_Tra_Add /end SUB_GROUP /end GROUP
/begin GROUP Root_Tra_Add "Tra_Add/Tra_Add"
 /begin REF_CHARACTERISTIC Tra_bCanAirCanPtd_C Tra_bCanClntCanPtd_C Tra_rClgDem_C Tra_tClntDes_C /end REF_CHARACTERISTIC
/end GROUP
/begin GROUP Tra_DblClthDet "Tra_DblClthDet" /begin REF_CHARACTERISTIC Tra_trqDblClthEngMax_C Tra_trqDblClthVehMax_C /end REF_CHARACTERISTIC /end GROUP
/begin GROUP Tra_GearInfo "Tra_GearInfo" /begin SUB_GROUP Root_Tra_GearInfo /end SUB_GROUP /end GROUP
/begin GROUP Root_Tra_GearInfo "Tra_GearInfo/Tra_GearInfo"
 /begin SUB_GROUP S1_Gear_detection_loop S1_Spd_Spd_ratio S1_Veh_Spd_ratio S1_start_stop_Inhibit S1_state_of_reverse /end SUB_GROUP
 /begin REF_CHARACTERISTIC Tra_facNPT1_C /end REF_CHARACTERISTIC
 /begin REF_MEASUREMENT Tra_nEngFlt_mp /end REF_MEASUREMENT
/end GROUP
/begin GROUP S1_Gear_detection_loop "Tra_GearInfo/Tra_GearInfo/Gear_detection_loop" /begin SUB_GROUP S2_Gear_detect S2_Substitute /end SUB_GROUP /end GROUP
/begin GROUP S1_Spd_Spd_ratio "Tra_GearInfo/Tra_GearInfo/Spd_Spd_ratio"
 /begin REF_CHARACTERISTIC Tra_facN2NPT1_C Tra_nCrdShMin_C Tra_rN2NGbxMax_C Tra_rN2NGbxMin_C Tra_rnFacCrdS_C Tra_swtSrcCrdSSpdVal_C /end REF_CHARACTERISTIC
 /begin REF_MEASUREMENT PT_rTraN2N Tra_rN2NUnflt_mp /end REF_MEASUREMENT
/end GROUP
/begin GROUP S1_Veh_Spd_ratio "Tra_GearInfo/Tra_GearInfo/Veh_Spd_ratio"
 /begin REF_CHARACTERISTIC Tra_facV2NPT1_C Tra_nEngMin_C Tra_rV2NDfl_C Tra_rV2NMax_C Tra_rV2NMin_C /end REF_CHARACTERISTIC
 /begin REF_MEASUREMENT Tra_rV2NUnFlt_mp /end REF_MEASUREMENT
/end GROUP
/begin GROUP S1_start_stop_Inhibit "Tra_GearInfo/Tra_GearInfo/start_stop_Inhibit" /begin REF_CHARACTERISTIC Tra_bStrtStopEnaDfl_C /end REF_CHARACTERISTIC /end GROUP
/begin GROUP S1_state_of_reverse "Tra_GearInfo/Tra_GearInfo/state of reverse" /begin REF_CHARACTERISTIC PT_stTraRevGear_C /end REF_CHARACTERISTIC /end GROUP
/begin GROUP S2_Gear_detect "Tra_GearInfo/Tra_GearInfo/Gear_detection_loop/Gear_detect" /begin SUB_GROUP S8_While_Iterator_Subsystem /end SUB_GROUP /end GROUP
/begin GROUP S2_Substitute "Tra_GearInfo/Tra_GearInfo/Gear_detection_loop/Substitute" /begin REF_CHARACTERISTIC Tra_numGearDfl1_C Tra_numGearDfl2_C Tra_rTransTable_CA /end REF_CHARACTERISTIC /end GROUP
/begin GROUP S8_While_Iterator_Subsystem "Tra_GearInfo/Tra_GearInfo/Gear_detection_loop/Gear_detect/While Iterator Subsystem" /begin SUB_GROUP S10_LoopPos S10_Lower_Limit S10_Upper_Limit S10_acceptance /end SUB_GROUP /end GROUP
/begin GROUP S10_LoopPos "Tra_GearInfo/Tra_GearInfo/Gear_detection_loop/Gear_detect/While Iterator Subsystem/LoopPos" /begin REF_CHARACTERISTIC Tra_SumGear_C /end REF_CHARACTERISTIC /end GROUP
/begin GROUP S10_Lower_Limit "Tra_GearInfo/Tra_GearInfo/Gear_detection_loop/Gear_detect/While Iterator Subsystem/Lower_Limit" /begin REF_CHARACTERISTIC Tra_GearWide_C Tra_rTransTable_CA /end REF_CHARACTERISTIC /begin REF_MEASUREMENT Tra_rnnDiffLowLim_mp /end REF_MEASUREMENT /end GROUP
/begin GROUP S10_Upper_Limit "Tra_GearInfo/Tra_GearInfo/Gear_detection_loop/Gear_detect/While Iterator Subsystem/Upper_Limit" /begin REF_CHARACTERISTIC Tra_GearWide_C Tra_rTransTable_CA /end REF_CHARACTERISTIC /begin REF_MEASUREMENT Tra_rnnDiffUpLim_mp /end REF_MEASUREMENT /end GROUP
/begin GROUP S10_acceptance "Tra_GearInfo/Tra_GearInfo/Gear_detection_loop/Gear_detect/While Iterator Subsystem/acceptance" /begin REF_CHARACTERISTIC Tra_numGearTable_CA Tra_rTransTable_CA /end REF_CHARACTERISTIC /end GROUP
/begin GROUP Tra_Los "Tra_Los" /begin SUB_GROUP Root_Tra_Los /end SUB_GROUP /end GROUP
/begin GROUP Root_Tra_Los "Tra_Los/Tra_Los" /begin REF_CHARACTERISTIC Tra_trqLos_C /end REF_CHARACTERISTIC /end GROUP
/begin GROUP Tra_Prt "Tra_Prt" /begin SUB_GROUP Root_Tra_Prt /end SUB_GROUP /end GROUP
/begin GROUP Root_Tra_Prt "Tra_Prt/Tra_Prt"
 /begin SUB_GROUP S1_Gear_Limitation S1_JumpStart_Limitation S1_PTO_WESDem_Limitation /end SUB_GROUP
/end GROUP
/begin GROUP S1_Gear_Limitation "Tra_Prt/Tra_Prt/Gear_Limitation" /begin SUB_GROUP S2_Subsystem S2_Tra_numGearGrp /end SUB_GROUP /end GROUP
/begin GROUP S1_JumpStart_Limitation "Tra_Prt/Tra_Prt/JumpStart_Limitation" /begin REF_CHARACTERISTIC Tra_trqInMax_C /end REF_CHARACTERISTIC /begin REF_MEASUREMENT Tra_trqPrtJmpStrt_mp /end REF_MEASUREMENT /end GROUP
/begin GROUP S1_PTO_WESDem_Limitation "Tra_Prt/Tra_Prt/PTO_WESDem_Limitation" /begin SUB_GROUP S4_Ramp_Function S4_Tra_trqLimRaw_mp /end SUB_GROUP /end GROUP
/begin GROUP S2_Subsystem "Tra_Prt/Tra_Prt/Gear_Limitation/Subsystem"
 /begin REF_CHARACTERISTIC Tra_trqMaxGearGrp1_CUR Tra_trqMaxGearGrp2_CUR Tra_trqMaxGearGrp3_CUR Tra_trqMaxGearGrp4_CUR Tra_trqMaxGearGrp5_CUR Tra_trqMaxGearGrp6_CUR /end REF_CHARACTERISTIC
 /begin REF_MEASUREMENT Tra_trqPrtGear_mp /end REF_MEASUREMENT
/end GROUP
/begin GROUP S2_Tra_numGearGrp "Tra_Prt/Tra_Prt/Gear_Limitation/Tra_numGearGrp"
 /begin REF_CHARACTERISTIC Tra_numGearGrpThres1_C Tra_numGearGrpThres2_C Tra_numGearGrpThres3_C Tra_numGearGrpThres4_C Tra_numGearGrpThres5_C /end REF_CHARACTERISTIC
 /begin REF_MEASUREMENT Tra_numGearGrp /end REF_MEASUREMENT
/end GROUP
/begin GROUP S4_Ramp_Function "Tra_Prt/Tra_Prt/PTO_WESDem_Limitation/Ramp Function" /begin REF_CHARACTERISTIC Tra_dtrqPTORmpP_Neg_C Tra_dtrqPTORmpP_Pos_C /end REF_CHARACTERISTIC /begin REF_MEASUREMENT Tra_trqPTOInMax_mp /end REF_MEASUREMENT /end GROUP
/begin GROUP S4_Tra_trqLimRaw_mp "Tra_Prt/Tra_Prt/PTO_WESDem_Limitation/Tra_trqLimRaw_mp"
 /begin REF_CHARACTERISTIC Tra_swtPTOLim1KD_C Tra_trqInMax_C Tra_trqPTOLim1_CUR Tra_trqPTOLim2_CUR Tra_trqPTOLim3_CUR Tra_trqWESDemLim0_C Tra_trqWESDemLim1_C Tra_trqWESDemLim2_C Tra_trqWESDemLim3_C /end REF_CHARACTERISTIC
 /begin REF_MEASUREMENT Tra_trqLimRaw_mp Tra_trqPTOLimRaw_mp Tra_trqWESDemLimRaw /end REF_MEASUREMENT
/end GROUP
/begin GROUP Tra_RtnIntfc "Tra_RtnIntfc" /begin SUB_GROUP Root_Tra_RtnIntfc /end SUB_GROUP /end GROUP
/begin GROUP Root_Tra_RtnIntfc "Tra_RtnIntfc/Tra_RtnIntfc"
 /begin REF_CHARACTERISTIC Tra_bCANIdlSetP_C Tra_bFltIdlSpdDes_C Tra_nMax_C Tra_nMin_C /end REF_CHARACTERISTIC
/end GROUP
/begin GROUP Tra_TrqRed "Tra_TrqRed"
 /begin REF_CHARACTERISTIC Tra_trqDesMax_C Tra_trqDesMin_C Tra_trqLeadMax_C Tra_trqLeadMin_C /end REF_CHARACTERISTIC
/end GROUP
/begin GROUP Tra_TypeInfo "Tra_TypeInfo" /begin REF_CHARACTERISTIC PT_stTraType_C /end REF_CHARACTERISTIC /end GROUP
/begin GROUP ACCtl_Demand "ACCtl_Demand" /begin REF_CHARACTERISTIC TS_nMinAC_C /end REF_CHARACTERISTIC /end GROUP
/begin GROUP CoTS_MechDem "CoTS_MechDem" /begin SUB_GROUP Root_CoTS_MechDem /end SUB_GROUP /end GROUP
/begin GROUP Root_CoTS_MechDem "CoTS_MechDem/CoTS_MechDem" /begin REF_CHARACTERISTIC TS_nMax_C TS_nMin_C TS_trqDesAcs_C TS_trqResvAcs_C /end REF_CHARACTERISTIC /end GROUP
/begin GROUP FanCtl_Spd "FanCtl_Spd" /begin SUB_GROUP Root_FanCtl_Spd /end SUB_GROUP /end GROUP
/begin GROUP Root_FanCtl_Spd "FanCtl_Spd/FanCtl_Spd"
 /begin SUB_GROUP S1_FanPath1 S1_FanPath2 S1_FanState S1_Fanst_ S1_Fanst_2 S1_GetPermission1 S1_GetPermission2 /end SUB_GROUP
 /begin REF_CHARACTERISTIC FanCtl_rClgDesARMin_C FanCtl_tiAftRunMax_C FanCtl_tiDelStrt_C Fan_numFans_C /end REF_CHARACTERISTIC
/end GROUP
/begin GROUP S1_FanPath1 "FanCtl_Spd/FanCtl_Spd/FanPath1"
 /begin SUB_GROUP S2_ContFan__inl2_ S2_FanCorIntv__inl1_ S2_FanIntv__inl3_ S2_Limit_Convert /end SUB_GROUP
 /begin REF_CHARACTERISTIC FanCtl_facCorSpd_MAP FanCtl_nSpdDes_MAP /end REF_CHARACTERISTIC
 /begin REF_MEASUREMENT FanCtl_nSpdDes_mp /end REF_MEASUREMENT
/end GROUP
/begin GROUP S1_FanPath2 "FanCtl_Spd/FanCtl_Spd/FanPath2"
 /begin SUB_GROUP S3_ContFan__inl2_ S3_FanCorIntv__inl1_ S3_FanIntv__inl3_ S3_Limit_Convert /end SUB_GROUP
 /begin REF_CHARACTERISTIC FanCtl_facCorSpd2_MAP FanCtl_nSpdDes2_MAP /end REF_CHARACTERISTIC
 /begin REF_MEASUREMENT FanCtl_nSpdDes2_mp /end REF_MEASUREMENT
/end GROUP
/begin GROUP S1_FanState "FanCtl_Spd/FanCtl_Spd/FanState" /begin REF_MEASUREMENT FanCtl_stFanCtl_mp /end REF_MEASUREMENT /end GROUP
/begin GROUP S1_Fanst_ "FanCtl_Spd/FanCtl_Spd/Fanst " /begin REF_CHARACTERISTIC Fan_rHysHi_C Fan_rHysLo_C /end REF_CHARACTERISTIC /end GROUP
/begin GROUP S1_Fanst_2 "FanCtl_Spd/FanCtl_Spd/Fanst 2" /begin REF_CHARACTERISTIC Fan_rHys2Hi_C Fan_rHys2Lo_C /end REF_CHARACTERISTIC /end GROUP
/begin GROUP S1_GetPermission1 "FanCtl_Spd/FanCtl_Spd/GetPermission1" /begin REF_CHARACTERISTIC FanCtl_rClgDesErr_C /end REF_CHARACTERISTIC /end GROUP
/begin GROUP S1_GetPermission2 "FanCtl_Spd/FanCtl_Spd/GetPermission2" /begin REF_CHARACTERISTIC FanCtl_rClgDesErr_C /end REF_CHARACTERISTIC /end GROUP
/begin GROUP S2_ContFan__inl2_ "FanCtl_Spd/FanCtl_Spd/FanPath1/ContFan (inl2)"
 /begin REF_CHARACTERISTIC FanCtl_nSpdWin1L_C FanCtl_nSpdWin1R_C FanCtl_nSpdWin2L_C FanCtl_nSpdWin2R_C FanCtl_nSpdWin3L_C FanCtl_nSpdWin3R_C /end REF_CHARACTERISTIC
 /begin REF_MEASUREMENT FanCtl_nSpd_mp /end REF_MEASUREMENT
/end GROUP
/begin GROUP S2_FanCorIntv__inl1_ "FanCtl_Spd/FanCtl_Spd/FanPath1/FanCorIntv (inl1)" /begin REF_CHARACTERISTIC FanCtl_facCorErr_C /end REF_CHARACTERISTIC /end GROUP
/begin GROUP S2_FanIntv__inl3_ "FanCtl_Spd/FanCtl_Spd/FanPath1/FanIntv (inl3)" /begin REF_CHARACTERISTIC FanCtl_tiTrqResv_C /end REF_CHARACTERISTIC /end GROUP
/begin GROUP S2_Limit_Convert "FanCtl_Spd/FanCtl_Spd/FanPath1/Limit_Convert" /begin REF_CHARACTERISTIC FanCtl_nSpdFanMax_C FanCtl_nSpdMinDelta_C FanCtl_nSpdMin_C /end REF_CHARACTERISTIC /begin REF_MEASUREMENT FanCtl_rSpdFan_mp /end REF_MEASUREMENT /end GROUP
/begin GROUP S3_ContFan__inl2_ "FanCtl_Spd/FanCtl_Spd/FanPath2/ContFan (inl2)"
 /begin REF_CHARACTERISTIC FanCtl_nSpd2Win1L_C FanCtl_nSpd2Win1R_C FanCtl_nSpd2Win2L_C FanCtl_nSpd2Win2R_C FanCtl_nSpd2Win3L_C FanCtl_nSpd2Win3R_C /end REF_CHARACTERISTIC
 /begin REF_MEASUREMENT FanCtl_nSpd2_mp /end REF_MEASUREMENT
/end GROUP
/begin GROUP S3_FanCorIntv__inl1_ "FanCtl_Spd/FanCtl_Spd/FanPath2/FanCorIntv (inl1)" /begin REF_CHARACTERISTIC FanCtl_facCorErr_C /end REF_CHARACTERISTIC /end GROUP
/begin GROUP S3_FanIntv__inl3_ "FanCtl_Spd/FanCtl_Spd/FanPath2/FanIntv (inl3)" /begin REF_CHARACTERISTIC FanCtl_tiTrqResv2_C /end REF_CHARACTERISTIC /end GROUP
/begin GROUP S3_Limit_Convert "FanCtl_Spd/FanCtl_Spd/FanPath2/Limit_Convert"
 /begin REF_CHARACTERISTIC FanCtl_nSpdFan2Max_C FanCtl_nSpdMin2_C FanCtl_nSpdMinDelta2_C /end REF_CHARACTERISTIC
 /begin REF_MEASUREMENT FanCtl_rSpdFan2_mp /end REF_MEASUREMENT
/end GROUP
/begin GROUP Fans_ClgDem "Fans_ClgDem" /begin SUB_GROUP Root_Relative_cooling_performance_demand /end SUB_GROUP /end GROUP
/begin GROUP Root_Relative_cooling_performance_demand "Fans_ClgDem/Relative cooling performance demand"
 /begin REF_CHARACTERISTIC Fans_RmpSlpNeg_C Fans_RmpSlpPos_C Fans_facVelCorErr_C Fans_facVelCor_CUR /end REF_CHARACTERISTIC
/end GROUP
/begin GROUP Fans_trq "Fans_trq" /begin SUB_GROUP Root_Fans_trq /end SUB_GROUP /end GROUP
/begin GROUP Root_Fans_trq "Fans_trq/Fans_trq" /begin SUB_GROUP S1_Torque_Demand_Fan_1 S1_Torque_Demand_Fan_2 /end SUB_GROUP /begin REF_CHARACTERISTIC Fan_numFans_C /end REF_CHARACTERISTIC /begin REF_MEASUREMENT Fans_trqCons2_mp Fans_trqDemResv2_mp /end REF_MEASUREMENT /end GROUP
/begin GROUP S1_Torque_Demand_Fan_1 "Fans_trq/Fans_trq/Torque_Demand_Fan_1" /begin REF_CHARACTERISTIC Fan_facTrqDemFltPT1_C Fan_trqDem_CUR Fan_trqSplyDem_C /end REF_CHARACTERISTIC /begin REF_MEASUREMENT Fans_trqCons1_mp Fans_trqDemResv1_mp /end REF_MEASUREMENT /end GROUP
/begin GROUP S1_Torque_Demand_Fan_2 "Fans_trq/Fans_trq/Torque_Demand_Fan_2" /begin REF_CHARACTERISTIC Fan_facTrqDemFlt2PT1_C Fan_trqDem2_CUR Fan_trqSplyDem2_C /end REF_CHARACTERISTIC /end GROUP
/begin GROUP Diff_PlausPrtTrq "Diff_PlausPrtTrq"
 /begin REF_CHARACTERISTIC DiffIO_trqPrtDfftl_C Diff_dtrqRmpPNeg_C Diff_dtrqRmpPPos_C Diff_trqPrtErrLim_C /end REF_CHARACTERISTIC
/end GROUP
/begin GROUP Diff_TrqRat "Diff_TrqRat" /begin REF_CHARACTERISTIC DiffIO_rTrqDfftl_C Diff_rTrqDfftl_C /end REF_CHARACTERISTIC /end GROUP
/begin GROUP Prp_TrqDesCoord "Prp_TrqDesCoord" /begin SUB_GROUP Root_Torque_Coordination2 /end SUB_GROUP /end GROUP
/begin GROUP Root_Torque_Coordination2 "Prp_TrqDesCoord/Torque_Coordination" /begin REF_MEASUREMENT Prp_trqDes_mp /end REF_MEASUREMENT /end GROUP
/begin GROUP Prp_TrqLeadCoord "Prp_TrqLeadCoord" /begin REF_MEASUREMENT VehMot_trqDesLead_mp /end REF_MEASUREMENT /end GROUP
/begin GROUP AccPed_DoCoordOut "AccPed_DoCoordOut"
 /begin SUB_GROUP Root_TrqErrorLimitation Root_nMaxErrorLimitation Root_nMinErrorLimitation /end SUB_GROUP
/end GROUP
/begin GROUP Root_TrqErrorLimitation "AccPed_DoCoordOut/TrqErrorLimitation" /begin REF_CHARACTERISTIC AccPed_trqLimMax_C /end REF_CHARACTERISTIC /end GROUP
/begin GROUP Root_nMaxErrorLimitation "AccPed_DoCoordOut/nMaxErrorLimitation" /begin REF_CHARACTERISTIC AccPed_nMax_C /end REF_CHARACTERISTIC /end GROUP
/begin GROUP Root_nMinErrorLimitation "AccPed_DoCoordOut/nMinErrorLimitation" /begin REF_CHARACTERISTIC AccPed_nMinBrkApp_C AccPed_nMinBrk_C AccPed_nMinNoBrk_C /end REF_CHARACTERISTIC /end GROUP
/begin GROUP AccPed_DrvDemDes "AccPed_DrvDemDes"
 /begin SUB_GROUP Root_Before_Compensation Root_Compensation Root_Negative_Torque_Intervention Root_Overrun_behaviour Root_Pull_Behaviour Root_Status_Calculation /end SUB_GROUP
/end GROUP
/begin GROUP Root_Before_Compensation "AccPed_DrvDemDes/Before_Compensation" /begin REF_MEASUREMENT AccPed_trqDesBefComp_mp /end REF_MEASUREMENT /end GROUP
/begin GROUP Root_Compensation "AccPed_DrvDemDes/Compensation" /begin REF_CHARACTERISTIC AccPed_facCompTot_C /end REF_CHARACTERISTIC /begin REF_MEASUREMENT AccPed_trqDesComp_mp /end REF_MEASUREMENT /end GROUP
/begin GROUP Root_Negative_Torque_Intervention "AccPed_DrvDemDes/Negative_Torque_Intervention"
 /begin SUB_GROUP S3_Engine_Brake_Priorisation_and_last_wins_logic S3_trqEngBrk /end SUB_GROUP
 /begin REF_CHARACTERISTIC SigTst_swtAccPed_C SigTst_trqAccPed_C /end REF_CHARACTERISTIC
/end GROUP
/begin GROUP Root_Overrun_behaviour "AccPed_DrvDemDes/Overrun_behaviour" /begin SUB_GROUP S4_OverRunCurve /end SUB_GROUP /begin REF_MEASUREMENT AccPed_trqDesOvrRun_mp /end REF_MEASUREMENT /end GROUP
/begin GROUP Root_Pull_Behaviour "AccPed_DrvDemDes/Pull_Behaviour" /begin SUB_GROUP S5_PullConventional S5_PullMastershift /end SUB_GROUP /end GROUP
/begin GROUP Root_Status_Calculation "AccPed_DrvDemDes/Status_Calculation" /begin REF_CHARACTERISTIC AccPed_trqDemThres_C /end REF_CHARACTERISTIC /end GROUP
/begin GROUP S3_Engine_Brake_Priorisation_and_last_wins_logic "AccPed_DrvDemDes/Negative_Torque_Intervention/Engine_Brake_Priorisation_and_last_wins_logic" /begin REF_CHARACTERISTIC AccPed_swtBrkPrio_C /end REF_CHARACTERISTIC /end GROUP
/begin GROUP S3_trqEngBrk "AccPed_DrvDemDes/Negative_Torque_Intervention/trqEngBrk" /begin REF_CHARACTERISTIC AccPed_rBrk50_CUR /end REF_CHARACTERISTIC /end GROUP
/begin GROUP S4_OverRunCurve "AccPed_DrvDemDes/Overrun_behaviour/OverRunCurve" /begin REF_CHARACTERISTIC AccPed_rThresPrp_C AccPed_rZero_C /end REF_CHARACTERISTIC /end GROUP
/begin GROUP S5_PullConventional "AccPed_DrvDemDes/Pull_Behaviour/PullConventional" /begin REF_CHARACTERISTIC MoFDrDem_trqEngRev_MAP MoFDrDem_trqEng_MAP /end REF_CHARACTERISTIC /end GROUP
/begin GROUP S5_PullMastershift "AccPed_DrvDemDes/Pull_Behaviour/PullMastershift" /begin REF_CHARACTERISTIC AccPed_trqPrp_MAP /end REF_CHARACTERISTIC /end GROUP
/begin GROUP AccPed_DrvDemLead "AccPed_DrvDemLead"
 /begin SUB_GROUP Root_Lead_Compensation Root_Negative_torque_intervention Root_Overrun_behaviour1 Root_Pull_Behaviour1 /end SUB_GROUP
/end GROUP
/begin GROUP Root_Lead_Compensation "AccPed_DrvDemLead/Lead_Compensation" /begin REF_MEASUREMENT AccPed_trqLeadComp_mp /end REF_MEASUREMENT /end GROUP
/begin GROUP Root_Negative_torque_intervention "AccPed_DrvDemLead/Negative_torque_intervention" /begin REF_CHARACTERISTIC SigTst_swtAccPedLead_C SigTst_trqAccPedLead_C /end REF_CHARACTERISTIC /end GROUP
/begin GROUP Root_Overrun_behaviour1 "AccPed_DrvDemLead/Overrun_behaviour" /begin SUB_GROUP S3_OverRunCurve /end SUB_GROUP /end GROUP
/begin GROUP Root_Pull_Behaviour1 "AccPed_DrvDemLead/Pull_Behaviour" /begin SUB_GROUP S4_PullConventional__Inl_ S4_PullMastershift__Inl_ /end SUB_GROUP /end GROUP
/begin GROUP S3_OverRunCurve "AccPed_DrvDemLead/Overrun_behaviour/OverRunCurve" /begin REF_CHARACTERISTIC AccPed_rThresPrp_C AccPed_rZero_C /end REF_CHARACTERISTIC /end GROUP
/begin GROUP S4_PullConventional__Inl_ "AccPed_DrvDemLead/Pull_Behaviour/PullConventional (Inl)" /begin REF_CHARACTERISTIC AccPed_trqEngRev_MAP MoFDrDem_trqEng_MAP /end REF_CHARACTERISTIC /end GROUP
/begin GROUP S4_PullMastershift__Inl_ "AccPed_DrvDemLead/Pull_Behaviour/PullMastershift (Inl)" /begin REF_CHARACTERISTIC AccPed_trqPrp_MAP /end REF_CHARACTERISTIC /end GROUP
/begin GROUP AccPed_DrvDemStpLim "AccPed_DrvDemStpLim"
 /begin REF_CHARACTERISTIC AccPed_dnMaxRmp_C AccPed_dtrqDwnLim_MAP AccPed_dtrqUpLim_MAP AccPed_nMaxRmp_C AccPed_swtStpLim_C /end REF_CHARACTERISTIC
 /begin REF_MEASUREMENT AccPed_dtrqDwnLim_mp AccPed_dtrqUpLim_mp AccPed_trqSumDwnLimDes_mp AccPed_trqSumUpLimDes_mp /end REF_MEASUREMENT
/end GROUP
/begin GROUP CoVMD_TrqCalc "CoVMD_TrqCalc" /begin REF_CHARACTERISTIC CoVMD_trqLLim_C /end REF_CHARACTERISTIC /end GROUP
/begin GROUP CoVMD_TrqDesCoord "CoVMD_TrqDesCoord" /begin SUB_GROUP Root_CoVMD_TrqDesCoord /end SUB_GROUP /end GROUP
/begin GROUP Root_CoVMD_TrqDesCoord "CoVMD_TrqDesCoord/CoVMD_TrqDesCoord" /begin SUB_GROUP S1_DrvDem_nSetPLo S1_swtTrqSel S1_trqDes /end SUB_GROUP /end GROUP
/begin GROUP S1_DrvDem_nSetPLo "CoVMD_TrqDesCoord/CoVMD_TrqDesCoord/DrvDem_nSetPLo" /begin REF_CHARACTERISTIC DrvDem_nSetPLo_C /end REF_CHARACTERISTIC /end GROUP
/begin GROUP S1_swtTrqSel "CoVMD_TrqDesCoord/CoVMD_TrqDesCoord/swtTrqSel" /begin REF_CHARACTERISTIC CoVMD_facTrq_C /end REF_CHARACTERISTIC
 /begin REF_MEASUREMENT VMD_accpedstbrkdes_mp VMD_appr_mp VMD_nsetplocomp_mp VMD_swtTrqSel_mp VMD_trqDesInThres_mp VMD_trqdescomp_mp /end REF_MEASUREMENT
/end GROUP
/begin GROUP S1_trqDes "CoVMD_TrqDesCoord/CoVMD_TrqDesCoord/trqDes" /begin REF_CHARACTERISTIC VMD_swtVCMActv_C /end REF_CHARACTERISTIC /end GROUP
/begin GROUP InjVlv_BlkSht "InjVlv_BlkSht" /begin SUB_GROUP Root_InjVlv_BlkSht /end SUB_GROUP /end GROUP
/begin GROUP Root_InjVlv_BlkSht "InjVlv_BlkSht/InjVlv_BlkSht"
 /begin SUB_GROUP S1_Blank_shot_requests S1_Enable S1_StartAngle S1_energising_time /end SUB_GROUP
/end GROUP
/begin GROUP S1_Blank_shot_requests "InjVlv_BlkSht/InjVlv_BlkSht/Blank_shot_requests"
 /begin REF_CHARACTERISTIC InjVlv_freqBlkShtMax_CUR SigTst_freqBlkSht_C SigTst_swtFreqBlkSht_C /end REF_CHARACTERISTIC
/end GROUP
/begin GROUP S1_Enable "InjVlv_BlkSht/InjVlv_BlkSht/Enable" /begin REF_CHARACTERISTIC InjVlv_freqBlkShtMin_C /end REF_CHARACTERISTIC /begin REF_MEASUREMENT InjVlv_bBlkShtEnbAftrun InjVlv_bBlkShtEnbOverrun /end REF_MEASUREMENT /end GROUP
/begin GROUP S1_StartAngle "InjVlv_BlkSht/InjVlv_BlkSht/StartAngle"
 /begin REF_CHARACTERISTIC InjVlv_phiBlkShtStrtMax_C InjVlv_phiBlkShtStrtMin_C InjVlv_phiBlkShtStrt_C /end REF_CHARACTERISTIC
/end GROUP
/begin GROUP S1_energising_time "InjVlv_BlkSht/InjVlv_BlkSht/energising_time" /begin SUB_GROUP S5_ZFC_Correction /end SUB_GROUP
 /begin REF_CHARACTERISTIC InjVlv_swtPlausBlkShtET_C InjVlv_tiETBlkShtAft_MAP InjVlv_tiETBlkShtMin_C InjVlv_tiETBlkSht_MAP /end REF_CHARACTERISTIC
/end GROUP
/begin GROUP S5_ZFC_Correction "InjVlv_BlkSht/InjVlv_BlkSht/energising_time/ZFC_Correction" /begin REF_CHARACTERISTIC InjVlv_tiETBlkShtZFC_C /end REF_CHARACTERISTIC /begin REF_MEASUREMENT InjVlv_tiBlkShtETMax_mp /end REF_MEASUREMENT /end GROUP
/begin GROUP InjVlv_CalcET "InjVlv_CalcET"
 /begin SUB_GROUP Root_InjVlv_EstET Root_InjVlv_GetET Root_InjVlv_PresMin Root_InjVlv_QntMin Root_InjVlv_TiRngChk /end SUB_GROUP
 /begin REF_CHARACTERISTIC SigTst_swtMI1ET_C SigTst_swtPOI2ET_C SigTst_swtPiI1ET_C SigTst_swtPiI2ET_C SigTst_tiMI1ET_C SigTst_tiPOI2ET_C SigTst_tiPiI1ET_C SigTst_tiPiI2ET_C /end REF_CHARACTERISTIC
/end GROUP
/begin GROUP Root_InjVlv_EstET "InjVlv_CalcET/InjVlv_EstET" /begin REF_CHARACTERISTIC InjVlv_tiCloseDelay_MAP InjVlv_tiOpenDelay_MAP /end REF_CHARACTERISTIC /begin REF_MEASUREMENT InjVlv_tiEOEDynCor_mp InjVlv_tiSOEDynCor_mp /end REF_MEASUREMENT /end GROUP
/begin GROUP Root_InjVlv_GetET "InjVlv_CalcET/InjVlv_GetET" /begin REF_CHARACTERISTIC InjVlv_tiET_MAP /end REF_CHARACTERISTIC
 /begin REF_MEASUREMENT InjVlv_tiETMI1NoCor_mp InjVlv_tiETPiI1NoCor_mp InjVlv_tiETPiI2NoCor_mp InjVlv_tiETPoI2NoCor_mp /end REF_MEASUREMENT
/end GROUP
/begin GROUP Root_InjVlv_PresMin "InjVlv_CalcET/InjVlv_PresMin" /begin REF_CHARACTERISTIC InjVlv_pMin_C InjVlv_pMin_CUR /end REF_CHARACTERISTIC /begin REF_MEASUREMENT InjVlv_pMin_mp InjVlv_stPresMin /end REF_MEASUREMENT /end GROUP
/begin GROUP Root_InjVlv_QntMin "InjVlv_CalcET/InjVlv_QntMin"
 /begin REF_CHARACTERISTIC InjVlv_qMI1Min_CUR InjVlv_qPiI1Min_CUR InjVlv_qPiI2Min_CUR InjVlv_qPoI2Min_CUR /end REF_CHARACTERISTIC
 /begin REF_MEASUREMENT InjVlv_qMI1Min_mp InjVlv_qPiI1Min_mp InjVlv_qPiI2Min_mp InjVlv_qPoI2Min_mp InjVlv_stMI1QntMin InjVlv_stPiI1QntMin InjVlv_stPiI2QntMin InjVlv_stPoI2QntMin /end REF_MEASUREMENT
/end GROUP
/begin GROUP Root_InjVlv_TiRngChk "InjVlv_CalcET/InjVlv_TiRngChk" /begin REF_CHARACTERISTIC InjVlv_tiDiffMin_MAP InjVlv_tiPseElec /end REF_CHARACTERISTIC /begin REF_MEASUREMENT InjVlv_tiPiIDiffMin_mp InjVlv_tiPoI2DiffMin_mp /end REF_MEASUREMENT /end GROUP
/begin GROUP AFS_DD "AFS_DD" /begin SUB_GROUP Root_SRCCheck Root_filter /end SUB_GROUP /end GROUP
/begin GROUP Root_SRCCheck "AFS_DD/SRCCheck" /begin SUB_GROUP S1_If_Action_Subsystem /end SUB_GROUP /end GROUP
/begin GROUP Root_filter "AFS_DD/filter" /begin REF_CHARACTERISTIC AFS_facLPFiltPT1_C /end REF_CHARACTERISTIC /end GROUP
/begin GROUP S1_If_Action_Subsystem "AFS_DD/SRCCheck/If Action Subsystem"
 /begin REF_CHARACTERISTIC AFS_tiRawSRCHi_C AFS_tiRawSRCLo_C AFS_tiRawSRCMaxDebDef_C AFS_tiRawSRCMaxDebOk_C AFS_tiRawSRCMinDebDef_C AFS_tiRawSRCMinDebOk_C /end REF_CHARACTERISTIC
/end GROUP
/begin GROUP AFS_DD1ms "AFS_DD1ms" /begin SUB_GROUP Root_AFS_DD1ms /end SUB_GROUP /end GROUP
/begin GROUP Root_AFS_DD1ms "AFS_DD1ms/AFS_DD1ms" /begin SUB_GROUP S1_SegSum S1_SensRaw S1_SlidingAverage /end SUB_GROUP /end GROUP
/begin GROUP S1_SegSum "AFS_DD1ms/AFS_DD1ms/SegSum" /begin REF_CHARACTERISTIC AFS_numSmplMax_C /end REF_CHARACTERISTIC /end GROUP
/begin GROUP S1_SensRaw "AFS_DD1ms/AFS_DD1ms/SensRaw" /begin REF_CHARACTERISTIC AFS_dmTransf_CUR /end REF_CHARACTERISTIC /begin REF_MEASUREMENT AFS_dmSensRaw AFS_tiTransfCrvIn_mp /end REF_MEASUREMENT /end GROUP
/begin GROUP S1_SlidingAverage "AFS_DD1ms/AFS_DD1ms/SlidingAverage" /begin SUB_GROUP S5_If_Action_Subsystem /end SUB_GROUP /end GROUP
/begin GROUP S5_If_Action_Subsystem "AFS_DD1ms/AFS_DD1ms/SlidingAverage/If Action Subsystem" /begin REF_MEASUREMENT AFS_dmSensAvr_mp /end REF_MEASUREMENT /end GROUP
/begin GROUP AFS_VD "AFS_VD" /begin SUB_GROUP Root_AFS_VD /end SUB_GROUP /end GROUP
/begin GROUP Root_AFS_VD "AFS_VD/AFS_VD"
 /begin SUB_GROUP S1_AirPerCylCalc S1_Correction S1_DrftMonRls S1_PlausChk S1_PlausChkOvrRunRls S1_SubsValSwt /end SUB_GROUP
 /begin REF_MEASUREMENT AFS_stMon_mp /end REF_MEASUREMENT
/end GROUP
/begin GROUP S1_AirPerCylCalc "AFS_VD/AFS_VD/AirPerCylCalc" /begin REF_CHARACTERISTIC SigTst_mAirPerCyl_C SigTst_swtAirPerCyl_C /end REF_CHARACTERISTIC /end GROUP
/begin GROUP S1_Correction "AFS_VD/AFS_VD/Correction"
 /begin SUB_GROUP S3_DriftComp S3_Fault_Freeze S3_PulseCorrection S3_SwitchOn_Correction /end SUB_GROUP
/end GROUP
/begin GROUP S1_DrftMonRls "AFS_VD/AFS_VD/DrftMonRls"
 /begin REF_CHARACTERISTIC AFS_dtAirThresHi_C AFS_dtAirThresLo_C AFS_numEngTemp_C AFS_pAirThrLo_C AFS_rEGRThresHi_C AFS_rEGRThresLo_C AFS_rTVAThrHi_C AFS_rTVAThrLo_C AFS_tEngThresHi_C AFS_tEngThresLo_C AFS_tiDlyEGRPPlSetyDrft_C /end REF_CHARACTERISTIC
 /begin REF_MEASUREMENT AFS_stPlChkRls_mp AFS_tEngMon_mp /end REF_MEASUREMENT
/end GROUP
/begin GROUP S1_PlausChk "AFS_VD/AFS_VD/PlausChk" /begin SUB_GROUP S5_Detect S5_Monitor_Fault /end SUB_GROUP /end GROUP
/begin GROUP S1_PlausChkOvrRunRls "AFS_VD/AFS_VD/PlausChkOvrRunRls"
 /begin REF_CHARACTERISTIC AFS_nAvrgThresHi_C AFS_nAvrgThresLo_C AFS_numAirTemp_C AFS_pBstThresHi_C AFS_pBstThresLo_C AFS_qRawOvrRunThresHi_C AFS_qRawOvrRunThresLo_C AFS_tAirThresHi_C AFS_tAirThresLo_C /end REF_CHARACTERISTIC
 /begin REF_MEASUREMENT AFS_stOvrRunRls_mp AFS_tAirMon_mp /end REF_MEASUREMENT
/end GROUP
/begin GROUP S1_SubsValSwt "AFS_VD/AFS_VD/SubsValSwt"
 /begin REF_CHARACTERISTIC AFS_dmAirSubsVal_MAP AFS_facAirSubsEnvPCor_CUR AFS_swtSensInstVal_C SigTst_dmAFSVal_C SigTst_swtAFSSubsVal_C SigTst_swtAFSVal_C /end REF_CHARACTERISTIC
 /begin REF_MEASUREMENT AFS_dmAirSubsVal_mp AFS_dmSubsVal_mp /end REF_MEASUREMENT
/end GROUP
/begin GROUP S3_DriftComp "AFS_VD/AFS_VD/Correction/DriftComp" /begin REF_MEASUREMENT AFS_dmComp_mp /end REF_MEASUREMENT /end GROUP
/begin GROUP S3_Fault_Freeze "AFS_VD/AFS_VD/Correction/Fault_Freeze" /begin REF_MEASUREMENT AFS_dmAirFrz_mp /end REF_MEASUREMENT /end GROUP
/begin GROUP S3_PulseCorrection "AFS_VD/AFS_VD/Correction/PulseCorrection"
 /begin REF_CHARACTERISTIC AFS_facPlsCorBasEGRShOff_MAP AFS_facPlsCorBasEOMQnt2_MAP AFS_swtEnaPlsCor_C /end REF_CHARACTERISTIC
 /begin REF_MEASUREMENT AFS_facPlsCorBasEGRShOff_mp /end REF_MEASUREMENT
/end GROUP
/begin GROUP S3_SwitchOn_Correction "AFS_VD/AFS_VD/Correction/SwitchOn_Correction" /begin REF_CHARACTERISTIC AFS_facSwtOnCor_C AFS_tiDlySwtOnCor_C /end REF_CHARACTERISTIC /begin REF_MEASUREMENT AFS_dmSensCorr_mp AFS_facSwtOnCor_mp /end REF_MEASUREMENT /end GROUP
/begin GROUP S5_Detect "AFS_VD/AFS_VD/PlausChk/Detect"
 /begin REF_CHARACTERISTIC AFS_facAirNrmPT1_C AFS_rAirThresIdlHi_C AFS_rAirThresIdlLo_C AFS_rAirThresLdHi_C AFS_rAirThresLdLo_C AFS_rAirThresOvrRunHi_C AFS_rAirThresOvrRunLo_C AFS_swtPlausChkIdl_C AFS_swtPlausChkLd_C /end REF_CHARACTERISTIC
 /begin REF_MEASUREMENT AFS_rAirThresPlausMax_mp AFS_rAirThresPlausMin_mp AFS_rNorm_mp /end REF_MEASUREMENT
/end GROUP
/begin GROUP S5_Monitor_Fault "AFS_VD/AFS_VD/PlausChk/Monitor_Fault" /begin SUB_GROUP S40_If_Action_Subsystem /end SUB_GROUP /begin REF_CHARACTERISTIC AFS_swtPlausChkOvrRun_C /end REF_CHARACTERISTIC /end GROUP
/begin GROUP S40_If_Action_Subsystem "AFS_VD/AFS_VD/PlausChk/Monitor_Fault/If Action Subsystem"
 /begin REF_CHARACTERISTIC AFS_tiSetyDrftMaxDebDef_C AFS_tiSetyDrftMaxDebOk_C AFS_tiSetyDrftMinDebDef_C AFS_tiSetyDrftMinDebOk_C /end REF_CHARACTERISTIC
/end GROUP
/begin GROUP AFS_VDDrftComp "AFS_VDDrftComp" /begin SUB_GROUP Root_AFS_VDDrftComp /end SUB_GROUP /end GROUP
/begin GROUP Root_AFS_VDDrftComp "AFS_VDDrftComp/AFS_VDDrftComp"
 /begin SUB_GROUP S1_CalcCorFac S1_CorValCalc S1_EGRClsDem S1_OvrnAdjRlsCon S1_UpdCorFac S1_WtPenMon S1__AdjRlsEnvCon S1__IdlAdjRlsCon S1__LdAdjRlsCon /end SUB_GROUP
 /begin REF_MEASUREMENT AFS_facIdlAdjVal_EEP AFS_facLdAdjVal_EEP /end REF_MEASUREMENT
/end GROUP
/begin GROUP S1__AdjRlsEnvCon "AFS_VDDrftComp/AFS_VDDrftComp/ AdjRlsEnvCon" /begin SUB_GROUP S2_AFS_tAirDrftComp_mp S2_AFS_tEnvTemp_mp /end SUB_GROUP
 /begin REF_CHARACTERISTIC AFS_numAirDrftComp_C AFS_numEnvTemp_C AFS_tAirAdjRlsThresHi_C AFS_tAirAdjRlsThresLo_C AFS_tEnvAdjRlsThresHi_C AFS_tEnvAdjRlsThresLo_C AFS_tiStrtDelAdjRls_C /end REF_CHARACTERISTIC
 /begin REF_MEASUREMENT AFS_stAdjRlsEnvCon AFS_stEnvCon_mp /end REF_MEASUREMENT
/end GROUP
/begin GROUP S1__IdlAdjRlsCon "AFS_VDDrftComp/AFS_VDDrftComp/ IdlAdjRlsCon"
 /begin REF_CHARACTERISTIC AFS_nAvrgIdlAdjThresHi_C AFS_nAvrgIdlAdjThresLo_C AFS_pBstAtmDiffLim_C AFS_qCurrIdlAdjThresHi_C AFS_qCurrIdlAdjThresLo_C /end REF_CHARACTERISTIC
 /begin REF_MEASUREMENT AFS_stIdlAdjRlsCon_mp AFS_stIdlAdjRlsUnDeb /end REF_MEASUREMENT
/end GROUP
/begin GROUP S1__LdAdjRlsCon "AFS_VDDrftComp/AFS_VDDrftComp/ LdAdjRlsCon" /begin SUB_GROUP S4__LdAdjGradMon /end SUB_GROUP
 /begin REF_CHARACTERISTIC AFS_pBstLdAdjThresHi_C AFS_pBstLdAdjThresLo_C AFS_qWinLdAdjThresHi_CUR AFS_qWinLdAdjThresLo_CUR AFS_vVehLdAdjThresHi_C AFS_vVehLdAdjThresLo_C /end REF_CHARACTERISTIC
 /begin REF_MEASUREMENT AFS_qWinLdAdjThresHi_mp AFS_qWinLdAdjThresLo_mp AFS_stLdAdjRlsCon_mp AFS_stLdAdjRlsUnDeb /end REF_MEASUREMENT
/end GROUP
/begin GROUP S1_CalcCorFac "AFS_VDDrftComp/AFS_VDDrftComp/CalcCorFac" /begin SUB_GROUP S5_If_Action_Subsystem11 S5_If_Action_Subsystem11 /end SUB_GROUP
 /begin REF_CHARACTERISTIC AFS_facAirMsPT1_C AFS_facCorFacPT1_C AFS_tiIdlAdjRlsDeb AFS_tiLdAdjRlsDeb /end REF_CHARACTERISTIC
 /begin REF_MEASUREMENT AFS_dmAirMsFlt_mp AFS_facCalcValFlt_mp AFS_facCalcVal_mp /end REF_MEASUREMENT
/end GROUP
/begin GROUP S1_CorValCalc "AFS_VDDrftComp/AFS_VDDrftComp/CorValCalc"
 /begin REF_CHARACTERISTIC AFS_dmIdlAirMsLim_C AFS_dmLdAirMsLim_C AFS_facCorExtpIdl_CUR AFS_facCorExtpLd_CUR AFS_swtAirMsCorRls_C /end REF_CHARACTERISTIC
 /begin REF_MEASUREMENT AFS_dmAirDrftComp AFS_facAirMsNrmIdl_mp AFS_facAirMsNrmLd_mp AFS_facCorIpo_mp AFS_stIntpRng_mp /end REF_MEASUREMENT
/end GROUP
/begin GROUP S1_EGRClsDem "AFS_VDDrftComp/AFS_VDDrftComp/EGRClsDem" /begin REF_CHARACTERISTIC AFS_tiAdjRlsDel_C /end REF_CHARACTERISTIC /begin REF_MEASUREMENT AFS_stAdjRlsDel_mp AFS_stIdlAdjRls AFS_stLdAdjRls /end REF_MEASUREMENT /end GROUP
/begin GROUP S1_OvrnAdjRlsCon "AFS_VDDrftComp/AFS_VDDrftComp/OvrnAdjRlsCon"
 /begin REF_CHARACTERISTIC AFS_nOvrnAdjMax_C AFS_nOvrnAdjMin_C AFS_numOvrnAdjGearMin_C AFS_swtLdAdjSel_C AFS_vOvrnAdjMin_C /end REF_CHARACTERISTIC
 /begin REF_MEASUREMENT AFS_stADCO_mp AFS_stOvrAdjRlsUnDeb AFS_stOvrnAdjRlsCon_mp /end REF_MEASUREMENT
/end GROUP
/begin GROUP S1_UpdCorFac "AFS_VDDrftComp/AFS_VDDrftComp/UpdCorFac" /begin SUB_GROUP S10_Updata4 S10_update S10_update1 /end SUB_GROUP
 /begin REF_CHARACTERISTIC AFS_dmIdlAirMsLim_C AFS_dmLdAirMsLim_C AFS_facAdjPlausDiff_C AFS_facIdlAdjPlausMax_C AFS_facIdlAdjValMax_C AFS_facIdlAdjValMin_C AFS_facIdlAdjValStepLim_C AFS_facLdAdjPlausMin_C AFS_facLdAdjValMax_C AFS_facLdAdjValMin_C AFS_facLdAdjValStepLim_C AFS_facLoThresIdlAdjVal_C AFS_facLoThresLdAdjVal_C AFS_swtAdjPlausLim_C /end REF_CHARACTERISTIC
 /begin REF_MEASUREMENT AFS_facIdlAdjVal_mp AFS_facLdAdjVal_mp AFS_stRstLoDrftThres_mp /end REF_MEASUREMENT
/end GROUP
/begin GROUP S1_WtPenMon "AFS_VDDrftComp/AFS_VDDrftComp/WtPenMon"
 /begin REF_CHARACTERISTIC AFS_drWtPenDetThresHi_C AFS_facWtPenDetPT1_C AFS_swtLdAdjSel_C AFS_tiWtPenDeb /end REF_CHARACTERISTIC
 /begin REF_MEASUREMENT AFS_drWtPenDetFlt_mp AFS_drWtPenDet_mp AFS_stWtPenDetDeb_mp AFS_stWtPenDet_mp /end REF_MEASUREMENT
/end GROUP
/begin GROUP S2_AFS_tAirDrftComp_mp "AFS_VDDrftComp/AFS_VDDrftComp/ AdjRlsEnvCon/AFS_tAirDrftComp_mp" /begin REF_MEASUREMENT AFS_tAirDrftComp_mp /end REF_MEASUREMENT /end GROUP
/begin GROUP S2_AFS_tEnvTemp_mp "AFS_VDDrftComp/AFS_VDDrftComp/ AdjRlsEnvCon/AFS_tEnvTemp_mp" /begin REF_MEASUREMENT AFS_tEnvTemp_mp /end REF_MEASUREMENT /end GROUP
/begin GROUP S4__LdAdjGradMon "AFS_VDDrftComp/AFS_VDDrftComp/ LdAdjRlsCon/ LdAdjGradMon"
 /begin REF_CHARACTERISTIC AFS_dnEngLdAdjThresHi_C AFS_dpLdAdjThresHi_C AFS_dqLdAdjThresHi_C AFS_facBstPresPT1_C AFS_facQntCurrPT1_C AFS_facnEngPT1_C /end REF_CHARACTERISTIC
 /begin REF_MEASUREMENT AFS_dnEngAbsFlt_mp AFS_dnEngAbs_mp AFS_dpIntValAbsFlt_mp AFS_dpIntValAbs_mp AFS_dqCurrAbsFlt_mp AFS_dqCurrAbs_mp /end REF_MEASUREMENT
/end GROUP
/begin GROUP S5_If_Action_Subsystem11 "AFS_VDDrftComp/AFS_VDDrftComp/CalcCorFac/If Action Subsystem" /begin REF_MEASUREMENT AFS_dmIdlAirMs_mp AFS_facCalcIdlAdjVal_mp AFS_stCurrIdlAdj /end REF_MEASUREMENT /end GROUP
/begin GROUP S5_If_Action_Subsystem11 "AFS_VDDrftComp/AFS_VDDrftComp/CalcCorFac/If Action Subsystem1" /begin REF_MEASUREMENT AFS_dmLdAirMs_mp AFS_facCalcLdAdjVal_mp AFS_stCurrLdAdj /end REF_MEASUREMENT /end GROUP
/begin GROUP S10_Updata4 "AFS_VDDrftComp/AFS_VDDrftComp/UpdCorFac/Updata4" /begin REF_MEASUREMENT AFS_stCurrAdj /end REF_MEASUREMENT /end GROUP
/begin GROUP S10_update "AFS_VDDrftComp/AFS_VDDrftComp/UpdCorFac/update" /begin REF_MEASUREMENT AFS_facIdlAdjValUnLim_mp /end REF_MEASUREMENT /end GROUP
/begin GROUP S10_update1 "AFS_VDDrftComp/AFS_VDDrftComp/UpdCorFac/update1" /begin REF_MEASUREMENT AFS_facLdAdjValUnLim_mp /end REF_MEASUREMENT /end GROUP
/begin GROUP AFST_DD "AFST_DD" /begin SUB_GROUP Root_AFST_Overview /end SUB_GROUP /end GROUP
/begin GROUP Root_AFST_Overview "AFST_DD/AFST_Overview" /begin SUB_GROUP S1_NTC S1_PWM S1_Period /end SUB_GROUP /begin REF_CHARACTERISTIC Air_bDtyOrUType_C /end REF_CHARACTERISTIC /end GROUP
/begin GROUP S1_NTC "AFST_DD/AFST_Overview/NTC" /begin SUB_GROUP S2_Voltage_SRC S2_tTransfer /end SUB_GROUP /end GROUP
/begin GROUP S1_PWM "AFST_DD/AFST_Overview/PWM" /begin SUB_GROUP S3_DutyCycle_SRC_ S3_tTransfer /end SUB_GROUP /end GROUP
/begin GROUP S1_Period "AFST_DD/AFST_Overview/Period" /begin SUB_GROUP S4_Period_Corr S4_Period_SRC /end SUB_GROUP /end GROUP
/begin GROUP S2_Voltage_SRC "AFST_DD/AFST_Overview/NTC/Voltage_SRC" /begin SUB_GROUP S6_SRCHi S6_SRCLo /end SUB_GROUP /end GROUP
/begin GROUP S2_tTransfer "AFST_DD/AFST_Overview/NTC/tTransfer" /begin REF_CHARACTERISTIC Air_utTransfTAFS_CUR /end REF_CHARACTERISTIC /end GROUP
/begin GROUP S3_DutyCycle_SRC_ "AFST_DD/AFST_Overview/PWM/DutyCycle_SRC " /begin SUB_GROUP S18_SRCHi S18_SRCLo /end SUB_GROUP /end GROUP
/begin GROUP S3_tTransfer "AFST_DD/AFST_Overview/PWM/tTransfer" /begin REF_CHARACTERISTIC Air_tTransfTAFS_CUR /end REF_CHARACTERISTIC /end GROUP
/begin GROUP S4_Period_Corr "AFST_DD/AFST_Overview/Period/Period_Corr"
 /begin REF_CHARACTERISTIC Air_bDtyOrUType_C Air_facPerCorTAFS_C Air_swtOscSelTAFS_C Air_tiPerRefTAFS_C /end REF_CHARACTERISTIC
/end GROUP
/begin GROUP S4_Period_SRC "AFST_DD/AFST_Overview/Period/Period_SRC" /begin SUB_GROUP S31_SRCHi S31_SRCLo /end SUB_GROUP /end GROUP
/begin GROUP S6_SRCHi "AFST_DD/AFST_Overview/NTC/Voltage_SRC/SRCHi"
 /begin REF_CHARACTERISTIC Air_tiVoltHiTAFSDefDeb_C Air_tiVoltHiTAFSOKDeb_C Air_uVoltMaxTAFS_C /end REF_CHARACTERISTIC
 /begin REF_MEASUREMENT Air_bVoltHiTAFS /end REF_MEASUREMENT
/end GROUP
/begin GROUP S6_SRCLo "AFST_DD/AFST_Overview/NTC/Voltage_SRC/SRCLo"
 /begin REF_CHARACTERISTIC Air_tiVoltLoTAFSDefDeb_C Air_tiVoltLoTAFSOKDeb_C Air_uVoltMinTAFS_C /end REF_CHARACTERISTIC
 /begin REF_MEASUREMENT Air_bVoltLoTAFS /end REF_MEASUREMENT
/end GROUP
/begin GROUP S18_SRCHi "AFST_DD/AFST_Overview/PWM/DutyCycle_SRC /SRCHi"
 /begin REF_CHARACTERISTIC Air_rDtyCycMaxTAFS_C Air_tiDtyCycHiTAFSDefDeb_C Air_tiDtyCycHiTAFSOKDeb_C /end REF_CHARACTERISTIC
 /begin REF_MEASUREMENT Air_bDtyCycHiTAFS /end REF_MEASUREMENT
/end GROUP
/begin GROUP S18_SRCLo "AFST_DD/AFST_Overview/PWM/DutyCycle_SRC /SRCLo"
 /begin REF_CHARACTERISTIC Air_rDtyCycMinTAFS_C Air_tiDtyCycLoTAFSDefDeb_C Air_tiDtyCycLoTAFSOKDeb_C /end REF_CHARACTERISTIC
 /begin REF_MEASUREMENT Air_bDtyCycLoTAFS /end REF_MEASUREMENT
/end GROUP
/begin GROUP S31_SRCHi "AFST_DD/AFST_Overview/Period/Period_SRC/SRCHi"
 /begin REF_CHARACTERISTIC Air_tiPerHiTAFSDefDeb_C Air_tiPerHiTAFSOKDeb_C Air_tiRefSigPerMaxTAFS_C /end REF_CHARACTERISTIC
 /begin REF_MEASUREMENT Air_bRefSigPerHiTAFS /end REF_MEASUREMENT
/end GROUP
/begin GROUP S31_SRCLo "AFST_DD/AFST_Overview/Period/Period_SRC/SRCLo"
 /begin REF_CHARACTERISTIC Air_tiPerLoTAFSDefDeb_C Air_tiPerLoTAFSOKDeb_C Air_tiRefSigPerMinTAFS_C /end REF_CHARACTERISTIC
 /begin REF_MEASUREMENT Air_bRefSigPerLoTAFS /end REF_MEASUREMENT
/end GROUP
/begin GROUP AFST_VD "AFST_VD" /begin SUB_GROUP Root_AFST_VD /end SUB_GROUP /end GROUP
/begin GROUP Root_AFST_VD "AFST_VD/AFST_VD" /begin SUB_GROUP S1_Filter S1_Substitute /end SUB_GROUP /end GROUP
/begin GROUP S1_Filter "AFST_VD/AFST_VD/Filter" /begin REF_CHARACTERISTIC Air_facPT1TAFS_C SigTst_swtTAFS_C SigTst_tTAFS_C /end REF_CHARACTERISTIC /end GROUP
/begin GROUP S1_Substitute "AFST_VD/AFST_VD/Substitute"
 /begin REF_CHARACTERISTIC Air_RmpSlpTAFSNeg_C Air_RmpSlpTAFSPos_C Air_tTransStgTAFSDfl_C /end REF_CHARACTERISTIC
/end GROUP
/begin GROUP EGRVlv_DD "EGRVlv_DD" /begin SUB_GROUP Root_EGRVlv_DD /end SUB_GROUP /end GROUP
/begin GROUP Root_EGRVlv_DD "EGRVlv_DD/EGRVlv_DD"
 /begin SUB_GROUP S1_EGR_Valve_with_H_bridge_control S1_EGR_Valve_with_simple_PWM_control /end SUB_GROUP
 /begin REF_CHARACTERISTIC EGRVlv_swtHwSel_C EGRVlv_tiPs_C /end REF_CHARACTERISTIC
/end GROUP
/begin GROUP S1_EGR_Valve_with_H_bridge_control "EGRVlv_DD/EGRVlv_DD/EGR Valve with H-bridge control" /begin SUB_GROUP S2_Battery_voltage_correction /end SUB_GROUP
 /begin REF_CHARACTERISTIC EGRVlv_rCnvHb_MAP EGRVlv_rCnvPsNrmHb_CUR EGRVlv_rPwmOutMax_C EGRVlv_rPwmOutMin_C EGRVlv_stPwrStgDiaDis_C EGRVlv_stPwrStgDis_C EGRVlv_swtPwmOutBattCor_C /end REF_CHARACTERISTIC
 /begin REF_MEASUREMENT EGRVlv_rCnvHb_mp EGRVlv_rCnvInHb_mp EGRVlv_rPsHb EGRVlv_rPsNrmHb /end REF_MEASUREMENT
/end GROUP
/begin GROUP S1_EGR_Valve_with_simple_PWM_control "EGRVlv_DD/EGRVlv_DD/EGR Valve with simple PWM control" /begin SUB_GROUP S3_Battery_voltage_correction /end SUB_GROUP
 /begin REF_CHARACTERISTIC EGRVlv_rCnvPWM_MAP EGRVlv_rCnvPsNrmPWM_CUR EGRVlv_rPwmOutMax_C EGRVlv_rPwmOutMin_C EGRVlv_stPwrStgDiaDis_C EGRVlv_stPwrStgDis_C EGRVlv_swtPwmOutBattCor_C /end REF_CHARACTERISTIC
 /begin REF_MEASUREMENT EGRVlv_rCnvInPWM_mp EGRVlv_rCnvPWM_mp EGRVlv_rPsNrmPWM EGRVlv_rPsPWM /end REF_MEASUREMENT
/end GROUP
/begin GROUP S2_Battery_voltage_correction "EGRVlv_DD/EGRVlv_DD/EGR Valve with H-bridge control/Battery voltage correction" /begin REF_CHARACTERISTIC EGRVlv_facBattCorFacFlt_C EGRVlv_facCorStrt_C /end REF_CHARACTERISTIC /begin REF_MEASUREMENT EGRVlv_facCorFltHb_mp /end REF_MEASUREMENT /end GROUP
/begin GROUP S3_Battery_voltage_correction "EGRVlv_DD/EGRVlv_DD/EGR Valve with simple PWM control/Battery voltage correction" /begin REF_CHARACTERISTIC EGRVlv_facBattCorFacFlt_C EGRVlv_facCorStrt_C /end REF_CHARACTERISTIC /begin REF_MEASUREMENT EGRVlv_facCorFltPWM_mp /end REF_MEASUREMENT /end GROUP
/begin GROUP EGRVlv_DDSens "EGRVlv_DDSens" /begin SUB_GROUP Root_EGRVlv_DDSens /end SUB_GROUP /end GROUP
/begin GROUP Root_EGRVlv_DDSens "EGRVlv_DDSens/EGRVlv_DDSens" /begin SUB_GROUP S1_PRC_Debounce S1_SRC_Debounce S1_U2R_Cnv /end SUB_GROUP /begin REF_CHARACTERISTIC EGRVlv_rCmpNewCtlUn_C /end REF_CHARACTERISTIC /end GROUP
/begin GROUP S1_PRC_Debounce "EGRVlv_DDSens/EGRVlv_DDSens/PRC_Debounce"
 /begin REF_CHARACTERISTIC EGRVlv_rAdapDiffPlausLgT_C EGRVlv_tiPhysRngHiDefDeb_C EGRVlv_tiPhysRngHiOKDeb_C EGRVlv_tiPhysRngLoDefDeb_C EGRVlv_tiPhysRngLoOKDeb_C /end REF_CHARACTERISTIC
 /begin REF_MEASUREMENT EGRVlv_bPhysRngHi EGRVlv_bPhysRngLo /end REF_MEASUREMENT
/end GROUP
/begin GROUP S1_SRC_Debounce "EGRVlv_DDSens/EGRVlv_DDSens/SRC_Debounce"
 /begin REF_CHARACTERISTIC EGRVlv_tiMaxDefDeb_C EGRVlv_tiMaxOKDeb_C EGRVlv_tiMinDefDeb_C EGRVlv_tiMinOKDeb_C EGRVlv_uSRCMax_C EGRVlv_uSRCMin_C /end REF_CHARACTERISTIC
 /begin REF_MEASUREMENT EGRVlv_bSRCMax EGRVlv_bSRCMin /end REF_MEASUREMENT
/end GROUP
/begin GROUP S1_U2R_Cnv "EGRVlv_DDSens/EGRVlv_DDSens/U2R_Cnv" /begin REF_CHARACTERISTIC EGRVlv_rTransf_CUR /end REF_CHARACTERISTIC /end GROUP
/begin GROUP EGRVlv_VDMon "EGRVlv_VDMon" /begin SUB_GROUP Root_EGRVlv_VDMon /end SUB_GROUP /end GROUP
/begin GROUP Root_EGRVlv_VDMon "EGRVlv_VDMon/EGRVlv_VDMon"
 /begin SUB_GROUP S1_DSM_RepVheck S1_EGRdrRaw S1_Enable_GDMon S1_LMS_Detection S1_Release_Function /end SUB_GROUP
 /begin REF_CHARACTERISTIC EGRVlv_numMonEngTemp_C EGRVlv_tEngHi_C EGRVlv_tEngLo_C /end REF_CHARACTERISTIC
 /begin REF_MEASUREMENT EGRVlv_tEngMon_mp /end REF_MEASUREMENT
/end GROUP
/begin GROUP S1_DSM_RepVheck "EGRVlv_VDMon/EGRVlv_VDMon/DSM_RepVheck"
 /begin REF_CHARACTERISTIC EGRVlv_drActDvtHi_C EGRVlv_drActDvt_C EGRVlv_rDvtMax_C EGRVlv_rDvtMin_C EGRVlv_tiGovDvtMaxDebDef_C EGRVlv_tiGovDvtMaxDebOk_C EGRVlv_tiGovDvtMinDebDef_C EGRVlv_tiGovDvtMinDebOk_C /end REF_CHARACTERISTIC
/end GROUP
/begin GROUP S1_EGRdrRaw "EGRVlv_VDMon/EGRVlv_VDMon/EGRdrRaw" /begin REF_CHARACTERISTIC EGRVlv_facdrActFlt_C /end REF_CHARACTERISTIC /begin REF_MEASUREMENT EGRVlv_drRaw_mp /end REF_MEASUREMENT /end GROUP
/begin GROUP S1_Enable_GDMon "EGRVlv_VDMon/EGRVlv_VDMon/Enable GDMon" /begin REF_CHARACTERISTIC EGRVlv_swtGovByp_C /end REF_CHARACTERISTIC /begin REF_MEASUREMENT EGRVlv_stEnaMon /end REF_MEASUREMENT /end GROUP
/begin GROUP S1_LMS_Detection "EGRVlv_VDMon/EGRVlv_VDMon/LMS Detection" /begin REF_CHARACTERISTIC EGRVlv_rDvtMax_C EGRVlv_rDvtMin_C /end REF_CHARACTERISTIC /end GROUP
/begin GROUP S3_Switch_Governor_Output "EGRVlv_VDPosGov/EGRVlv_VDPosGov/Function position governor/Switch Governor Output" /begin REF_CHARACTERISTIC EGRVlv_swtGovByp_C /end REF_CHARACTERISTIC /end GROUP
/begin GROUP S2_Offset_Correction_and_Slope_Calculation "EGRVlv_VDSens/EGRVlv_VDSens/Calculation of the actual valve position/Offset Correction and Slope Calculation" /begin REF_CHARACTERISTIC EGRVlv_rCmpNewCtlUn_C /end REF_CHARACTERISTIC /end GROUP
/begin GROUP S2_Offset_Learning "EGRVlv_VDSens/EGRVlv_VDSens/Calculation of the actual valve position/Offset Learning" /begin REF_CHARACTERISTIC EGRVlv_rAdapDiffPlausLgT_C /end REF_CHARACTERISTIC /end GROUP
/begin GROUP S5_State_PLAUSIBLE "EGRVlv_VDSens/EGRVlv_VDSens/Calculation of the actual valve position/Offset Learning/State PLAUSIBLE" /begin REF_CHARACTERISTIC EGRVlv_rCmpNewCtlUn_C /end REF_CHARACTERISTIC /end GROUP
/begin RECORD_LAYOUT Scalar_BOOLEAN FNC_VALUES 1 UBYTE COLUMN_DIR DIRECT /end RECORD_LAYOUT
/begin RECORD_LAYOUT Scalar_UBYTE FNC_VALUES 1 UBYTE COLUMN_DIR DIRECT /end RECORD_LAYOUT
/begin RECORD_LAYOUT Scalar_BYTE FNC_VALUES 1 SBYTE COLUMN_DIR DIRECT /end RECORD_LAYOUT
/begin RECORD_LAYOUT Scalar_UWORD FNC_VALUES 1 UWORD COLUMN_DIR DIRECT /end RECORD_LAYOUT
/begin RECORD_LAYOUT Scalar_SWORD FNC_VALUES 1 SWORD COLUMN_DIR DIRECT /end RECORD_LAYOUT
/begin RECORD_LAYOUT Scalar_ULONG FNC_VALUES 1 ULONG COLUMN_DIR DIRECT /end RECORD_LAYOUT
/begin RECORD_LAYOUT Scalar_LONG FNC_VALUES 1 SLONG COLUMN_DIR DIRECT /end RECORD_LAYOUT
/begin RECORD_LAYOUT Lookup1D_UWORD FNC_VALUES 1 UWORD COLUMN_DIR DIRECT /end RECORD_LAYOUT
/begin RECORD_LAYOUT Lookup1D_WORD FNC_VALUES 1 SWORD COLUMN_DIR DIRECT /end RECORD_LAYOUT
/begin RECORD_LAYOUT Lookup1D_X_WORD AXIS_PTS_X 1 SWORD INDEX_INCR DIRECT /end RECORD_LAYOUT
/begin RECORD_LAYOUT Lookup1D_X_LONG AXIS_PTS_X 1 SLONG INDEX_INCR DIRECT /end RECORD_LAYOUT
/begin RECORD_LAYOUT Lookup1D_FLOAT32_IEEE FNC_VALUES 1 FLOAT32_IEEE COLUMN_DIR DIRECT /end RECORD_LAYOUT
/begin RECORD_LAYOUT Lookup1D_X_FLOAT32_IEEE AXIS_PTS_X 1 FLOAT32_IEEE INDEX_INCR DIRECT /end RECORD_LAYOUT
/begin RECORD_LAYOUT Lookup1D_FLOAT64_IEEE FNC_VALUES 1 FLOAT64_IEEE COLUMN_DIR DIRECT /end RECORD_LAYOUT
/begin RECORD_LAYOUT Lookup2D_X_BYTE AXIS_PTS_X 1 SBYTE INDEX_INCR DIRECT /end RECORD_LAYOUT
/begin RECORD_LAYOUT Lookup2D_WORD FNC_VALUES 1 SWORD COLUMN_DIR DIRECT /end RECORD_LAYOUT
/begin RECORD_LAYOUT Lookup2D_X_WORD AXIS_PTS_X 1 SWORD INDEX_INCR DIRECT /end RECORD_LAYOUT
/end MODULE
/end PROJECT
