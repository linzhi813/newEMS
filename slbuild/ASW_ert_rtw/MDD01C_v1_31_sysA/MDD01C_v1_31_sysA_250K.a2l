ASAP2_VERSION 1 51
/begin PROJECT XCPDemo ""
/begin MODULE XCP ""
/begin MOD_COMMON "" BYTE_ORDER MSB_FIRST ALIGNMENT_BYTE 1 ALIGNMENT_WORD 1 ALIGNMENT_LONG 1 ALIGNMENT_FLOAT32_IEEE 1 ALIGNMENT_FLOAT64_IEEE 1 /end MOD_COMMON
/begin CHARACTERISTIC EGRVlv_tiLMS_C "Time during which pull down is active" VALUE 0x387538 Scalar_LONG 0 Time_s 0.0 10000.0 /end CHARACTERISTIC
/begin CHARACTERISTIC EGRVlv_tiRepRls_C "Time for releasing jammed valve condition" VALUE 0x38756C Scalar_LONG 0 Time_s 0.0 10000.0 /end CHARACTERISTIC
/begin CHARACTERISTIC EGRVlv_tiRls_C "Time during which release function is active" VALUE 0x387570 Scalar_LONG 0 Time_s 0.0 10000.0 /end CHARACTERISTIC
/begin CHARACTERISTIC EGRVlv_rLMSActPosThresInit_C "positive threshold" VALUE 0x387456 Scalar_SWORD 0 Prc_100_rate -100.0 100.0 /end CHARACTERISTIC
/begin CHARACTERISTIC EGRVlv_rLMSActThresDwn_C "Actual position threshold to detect LMS" VALUE 0x387458 Scalar_SWORD 0 Prc_100_rate -100.0 100.0 /end CHARACTERISTIC
/begin CHARACTERISTIC EGRVlv_rLMSThresDwn_C "Set point threshold to detect LMS" VALUE 0x38745A Scalar_SWORD 0 Prc_100_rate -100.0 100.0 /end CHARACTERISTIC
/begin CHARACTERISTIC EGRVlv_rLMSThresUp_C "Threshold to reset LMS detection bit" VALUE 0x38745C Scalar_SWORD 0 Prc_100_rate -100.0 100.0 /end CHARACTERISTIC
/begin CHARACTERISTIC EGRVlv_rLckdDetThres_C "Locked detection threshold ratio" VALUE 0x38745E Scalar_SWORD 0 Prc_100_rate -100.0 100.0 /end CHARACTERISTIC
/begin CHARACTERISTIC EGRVlv_rRlsMax_C "Maximum output for release function" VALUE 0x38747C Scalar_SWORD 0 Prc_100_rate -100.0 100.0 /end CHARACTERISTIC
/begin CHARACTERISTIC EGRVlv_rStpThres_C "Threshold for step detection" VALUE 0x387484 Scalar_SWORD 0 Prc_100_rate -100.0 100.0 /end CHARACTERISTIC
/begin CHARACTERISTIC EGRVlv_RlsIKi_C "Ki for the release integrator" VALUE 0x386D54 Scalar_SWORD 0 EGRCtl_Ki -128.0 127.9 /end CHARACTERISTIC
/begin CHARACTERISTIC EGRVlv_numJamVlv_C "The maxmum number of anti-stuck execution times" VALUE 0x386DF4 Scalar_UBYTE 0 State_uint8 0.0 100.0 /end CHARACTERISTIC
/begin CHARACTERISTIC EGRVlv_numLckdDetThres_C "Locked detection threshold" VALUE 0x386DF5 Scalar_UBYTE 0 State_uint8 0.0 255.0 /end CHARACTERISTIC
/begin CHARACTERISTIC EGRVlv_rDesEGR_CUR "Curve to calculation the desired value for the governor EGRVlv_rGovDesVal based on EGRVlv_r" CURVE 0x387316 Lookup1D_WORD 0 Prc_100_rate -100.0 100.0
 /begin AXIS_DESCR COM_AXIS EGRVlv_r Prc_100_rate 25 -100.0 100.0 AXIS_PTS_REF EGRVlv_rDesEGR_CURX /end AXIS_DESCR
/end CHARACTERISTIC
/begin CHARACTERISTIC EGRVlv_iEff_CUR "Transformation curve to convert the positon value to current value" CURVE 0x386D8C Lookup1D_WORD 0 Current_mA -12800.0 12799.6
 /begin AXIS_DESCR COM_AXIS EGRVlv_rAbsEGR_mp Prc_100_rate 25 -100.0 100.0 AXIS_PTS_REF EGRVlv_iEff_CURX /end AXIS_DESCR
/end CHARACTERISTIC
/begin CHARACTERISTIC EGRVlv_rGovMax_CUR "Transformation curve to convert the current value to position value" CURVE 0x38738A Lookup1D_WORD 0 Prc_100_rate -100.0 100.0
 /begin AXIS_DESCR COM_AXIS EGRVlv_iEffFlt_mp Current_mA 25 -12800.0 12799.6 AXIS_PTS_REF EGRVlv_rGovMax_CURX /end AXIS_DESCR
/end CHARACTERISTIC
/begin CHARACTERISTIC EGRVlv_rGovMin_CUR "Transformation curve to convert the current value to position value" CURVE 0x3873F0 Lookup1D_WORD 0 Prc_100_rate -100.0 100.0
 /begin AXIS_DESCR COM_AXIS EGRVlv_iEffFlt_mp Current_mA 25 -12800.0 12799.6 AXIS_PTS_REF EGRVlv_rGovMin_CURX /end AXIS_DESCR
/end CHARACTERISTIC
/begin CHARACTERISTIC EGRVlv_ctClnUpFin_C "Number of valvle cleaning open-close cycle count" VALUE 0x386D6C Scalar_ULONG 0 Counter_num 0.0 65535.0 /end CHARACTERISTIC
/begin CHARACTERISTIC EGRVlv_tiClnUp_C "Time for which valve is opened or closed during cleanup operation" VALUE 0x38751C Scalar_ULONG 0 Debounce_ms 0.0 65535.0 /end CHARACTERISTIC
/begin CHARACTERISTIC EGRVlv_tiLimDlyOvrLd_C "Delay time for governor limitation because of overcurrent" VALUE 0x38753C Scalar_LONG 0 Time_s 0.0 10000.0 /end CHARACTERISTIC
/begin CHARACTERISTIC EGRVlv_tiOutIMax_C "Timer for holding current limitation" VALUE 0x387550 Scalar_LONG 0 Time_s 0.0 10000.0 /end CHARACTERISTIC
/begin CHARACTERISTIC EGRVlv_rActNgv_C "Threshold value for valve lift for detection of slow closing" VALUE 0x386DFC Scalar_SWORD 0 Prc_100_rate -100.0 100.0 /end CHARACTERISTIC
/begin CHARACTERISTIC EGRVlv_rDesClnUpCls_C "Desired value for cleanup function for closed valve" VALUE 0x387312 Scalar_SWORD 0 Prc_100_rate -100.0 100.0 /end CHARACTERISTIC
/begin CHARACTERISTIC EGRVlv_rDesClnUpOpen_C "Desired value for cleanup function for open valve" VALUE 0x387314 Scalar_SWORD 0 Prc_100_rate -100.0 100.0 /end CHARACTERISTIC
/begin CHARACTERISTIC EGRVlv_rDesLMSMin_C "Minimum limitation for desired LMS value" VALUE 0x38737A Scalar_SWORD 0 Prc_100_rate -100.0 100.0 /end CHARACTERISTIC
/begin CHARACTERISTIC EGRVlv_rDesOffHold_C "Desired LMS hold value" VALUE 0x38737C Scalar_SWORD 0 Prc_100_rate -100.0 100.0 /end CHARACTERISTIC
/begin CHARACTERISTIC EGRVlv_rEGRDflVal_C "Default control value for the EGR valve" VALUE 0x387382 Scalar_SWORD 0 Prc_100_rate -100.0 100.0 /end CHARACTERISTIC
/begin CHARACTERISTIC EGRVlv_rEGRSwtOff_C "Desired switch off value" VALUE 0x387384 Scalar_SWORD 0 Prc_100_rate -100.0 100.0 /end CHARACTERISTIC
/begin CHARACTERISTIC EGRVlv_rGovDvtThres_C "Threshold value for masking the D component of PID controller" VALUE 0x387386 Scalar_SWORD 0 Prc_100_rate -100.0 100.0 /end CHARACTERISTIC
/begin CHARACTERISTIC EGRVlv_rGovMax_C "calibration parameter to set of the upper limiting value of PID controller" VALUE 0x387388 Scalar_SWORD 0 Prc_100_rate -100.0 100.0 /end CHARACTERISTIC
/begin CHARACTERISTIC EGRVlv_rGovMin_C "calibration parameter to set of the lower limiting value of PID controller" VALUE 0x3873EE Scalar_SWORD 0 Prc_100_rate -100.0 100.0 /end CHARACTERISTIC
/begin CHARACTERISTIC EGRVlv_rIniStp_C "Lead value for I component in case of step from lower mechanical stop" VALUE 0x387454 Scalar_SWORD 0 Prc_100_rate -100.0 100.0 /end CHARACTERISTIC
/begin CHARACTERISTIC EGRVlv_rOutDMax_C "Maximum permisssible correcting variable for the D component of PID controller" VALUE 0x38746E Scalar_SWORD 0 Prc_100_rate -100.0 100.0 /end CHARACTERISTIC
/begin CHARACTERISTIC EGRVlv_rOutIMax_C "Upper limiting value of I component of the position governor" VALUE 0x387470 Scalar_SWORD 0 Prc_100_rate -100.0 100.0 /end CHARACTERISTIC
/begin CHARACTERISTIC EGRVlv_rPIDWinNgv_C "Negative window limit" VALUE 0x387472 Scalar_SWORD 0 Prc_100_rate -100.0 100.0 /end CHARACTERISTIC
/begin CHARACTERISTIC EGRVlv_rPIDWinPsv_C "Positive window limit" VALUE 0x387474 Scalar_SWORD 0 Prc_100_rate -100.0 100.0 /end CHARACTERISTIC
/begin CHARACTERISTIC EGRVlv_rSwtOffRmp_C "Slope to ramp to switch off value" VALUE 0x387486 Scalar_SWORD 0 Prc_100_rate -100.0 100.0 /end CHARACTERISTIC
/begin CHARACTERISTIC EGRVlv_IKiLMSSlp_C "Slope for desired value of EGRVlv LMS control" VALUE 0x386D46 Scalar_SWORD 0 VlvCtl_Ki -32.0 31.9 /end CHARACTERISTIC
/begin CHARACTERISTIC EGRVlv_IKiNgv_C "For positive large signals" VALUE 0x386D48 Scalar_SWORD 0 VlvCtl_Ki -32.0 31.9 /end CHARACTERISTIC
/begin CHARACTERISTIC EGRVlv_IKiPsv_C "For negative large signals" VALUE 0x386D4C Scalar_SWORD 0 VlvCtl_Ki -32.0 31.9 /end CHARACTERISTIC
/begin CHARACTERISTIC EGRVlv_SlwClsIKi_C "I-Gain of the PID controller for slow closing" VALUE 0x386D5C Scalar_SWORD 0 VlvCtl_Ki -32.0 31.9 /end CHARACTERISTIC
/begin CHARACTERISTIC EGRVlv_SmlSigNgvIKi_C "For negative small signals" VALUE 0x386D62 Scalar_SWORD 0 VlvCtl_Ki -32.0 31.9 /end CHARACTERISTIC
/begin CHARACTERISTIC EGRVlv_SmlSigPsvIKi_C "For positive small signals" VALUE 0x386D68 Scalar_SWORD 0 VlvCtl_Ki -32.0 31.9 /end CHARACTERISTIC
/begin CHARACTERISTIC EGRVlv_iEffOvrLd_C "Threshold for overcurrent detection" VALUE 0x386D8A Scalar_SWORD 0 Current_mA -12800.0 12799.6 /end CHARACTERISTIC
/begin CHARACTERISTIC EGRVlv_facCrntEffFlt_C "Factor of the PT1 filter" VALUE 0x386D82 Scalar_UWORD 0 PT_fac 0.0 99.9985 /end CHARACTERISTIC
/begin CHARACTERISTIC EGRVlv_PKpNgv_C "For positive large signals" VALUE 0x386D50 Scalar_SWORD 0 EGRCtl_Kp -256.0 255.9 /end CHARACTERISTIC
/begin CHARACTERISTIC EGRVlv_PKpPsv_C "For negative large signals" VALUE 0x386D52 Scalar_SWORD 0 EGRCtl_Kp -256.0 255.9 /end CHARACTERISTIC
/begin CHARACTERISTIC EGRVlv_SlwClsPKp_C "P-Gain of the PID controller for slow closing" VALUE 0x386D5E Scalar_SWORD 0 EGRCtl_Kp -256.0 255.9 /end CHARACTERISTIC
/begin CHARACTERISTIC EGRVlv_SmlSigNgvPKp_C "For negative small signals" VALUE 0x386D64 Scalar_SWORD 0 EGRCtl_Kp -256.0 255.9 /end CHARACTERISTIC
/begin CHARACTERISTIC EGRVlv_SmlSigPsvPKp_C "For positive small signals" VALUE 0x386D6A Scalar_SWORD 0 EGRCtl_Kp -256.0 255.9 /end CHARACTERISTIC
/begin CHARACTERISTIC EGRVlv_DKdNgv_C "For negative large signals" VALUE 0x386D42 Scalar_SWORD 0 EGRCtl_Ki -128.0 127.9 /end CHARACTERISTIC
/begin CHARACTERISTIC EGRVlv_DKdPsv_C "For positive large signals" VALUE 0x386D44 Scalar_SWORD 0 EGRCtl_Ki -128.0 127.9 /end CHARACTERISTIC
/begin CHARACTERISTIC EGRVlv_KdParDT1_C "Factor of the DT1 element for detection of slow closing" VALUE 0x386D4E Scalar_SWORD 0 EGRCtl_Ki -128.0 127.9 /end CHARACTERISTIC
/begin CHARACTERISTIC EGRVlv_SlwClsDKd_C "D-Gain of the PID controller for slow closing" VALUE 0x386D5A Scalar_SWORD 0 EGRCtl_Ki -128.0 127.9 /end CHARACTERISTIC
/begin CHARACTERISTIC EGRVlv_SmlSigNgvDKd_C "For negative small signals" VALUE 0x386D60 Scalar_SWORD 0 EGRCtl_Ki -128.0 127.9 /end CHARACTERISTIC
/begin CHARACTERISTIC EGRVlv_SmlSigPsvDKd_C "For positive small signals" VALUE 0x386D66 Scalar_SWORD 0 EGRCtl_Ki -128.0 127.9 /end CHARACTERISTIC
/begin CHARACTERISTIC EGRVlv_tiGovDT1_C "Time constant of the DT1 element in the PID controller" VALUE 0x387524 Scalar_SWORD 0 DT1_s 0.0 5.0 /end CHARACTERISTIC
/begin CHARACTERISTIC EGRVlv_tiParDT1_C "Time constant of the DT1 element for detection of slow closing" VALUE 0x387554 Scalar_SWORD 0 DT1_s 0.0 5.0 /end CHARACTERISTIC
/begin CHARACTERISTIC EGRVlv_drActNgv_C "Threshold value for valve velocity for detection of slow closing" VALUE 0x386D78 Scalar_SWORD 0 DutyCycle_rate_s -327.68 327.67 /end CHARACTERISTIC
/begin CHARACTERISTIC EGRVlv_swtEGRTyp_C "Type of EGR actuator used" VALUE 0x3874FE Scalar_UBYTE 0 State_uint8 0.0 255.0 /end CHARACTERISTIC
/begin CHARACTERISTIC EGRVlv_stClnUpInh_C "Paramter to inhibit valve cleaning permanently" VALUE 0x3874F2 Scalar_BOOLEAN 0 boolean 0.0 1.0 /end CHARACTERISTIC
/begin CHARACTERISTIC EGRVlv_swtDesValNrmInv_C "Switch to select the normalized desired value" VALUE 0x3874FD Scalar_BOOLEAN 0 boolean 0.0 1.0 /end CHARACTERISTIC
/begin CHARACTERISTIC EGRVlv_swtSelDT1In_C "Switch to select the DT1 governor input" VALUE 0x387503 Scalar_BOOLEAN 0 boolean 0.0 1.0 /end CHARACTERISTIC
/begin AXIS_PTS EGRVlv_rDesEGR_CURX "Curve axis to calculation the desired value for the governor EGRVlv_rGovDesVal based on EGRVlv_r" 0x387348 EGRVlv_r Lookup1D_X_WORD 0 Prc_100_rate 25 -100.0 100.0 /end AXIS_PTS
/begin AXIS_PTS EGRVlv_iEff_CURX "Transformation aixs to  convert the positon value to current value" 0x386DBE EGRVlv_rAbsEGR_mp Lookup1D_X_WORD 0 Prc_100_rate 25 -100.0 100.0 /end AXIS_PTS
/begin AXIS_PTS EGRVlv_rGovMax_CURX "Transformation aixs to  convert the current value to position value" 0x3873BC EGRVlv_iEffFlt_mp Lookup1D_X_WORD 0 Current_mA 25 -12800.0 12799.6 /end AXIS_PTS
/begin AXIS_PTS EGRVlv_rGovMin_CURX "Transformation aixs to  convert the current value to position value" 0x387422 EGRVlv_iEffFlt_mp Lookup1D_X_WORD 0 Current_mA 25 -12800.0 12799.6 /end AXIS_PTS
/begin CHARACTERISTIC EGRVlv_tiAdapJamVlv_C "Debounce time to detect a stuck valve in Open state" VALUE 0x387514 Scalar_ULONG 0 Debounce_ms 0.0 65535.0 /end CHARACTERISTIC
/begin CHARACTERISTIC EGRVlv_tiAdapWaitSensAcq_C "Waiting time before checking the learnt value in Pierburg strategy-2" VALUE 0x387518 Scalar_ULONG 0 Debounce_ms 0.0 65535.0 /end CHARACTERISTIC
/begin CHARACTERISTIC EGRVlv_tiClsJamVlv_C "Debounce time to detect a stuck valve in closed state" VALUE 0x387520 Scalar_ULONG 0 Debounce_ms 0.0 65535.0 /end CHARACTERISTIC
/begin CHARACTERISTIC EGRVlv_tiStable_C "Duration time that keeps the EGR valve steady" VALUE 0x387574 Scalar_ULONG 0 Debounce_ms 0.0 65535.0 /end CHARACTERISTIC
/begin CHARACTERISTIC EGRVlv_numAdapClsMax_C "Maximum number of opening and closing cycles" VALUE 0x386DF0 Scalar_UWORD 0 uint16 0.0 65535.0 /end CHARACTERISTIC
/begin CHARACTERISTIC EGRVlv_uBattMax_C "Maximum value of battery voltage to release zero point adaption" VALUE 0x387578 Scalar_UWORD 0 Battery_mv 0.0 50000.0 /end CHARACTERISTIC
/begin CHARACTERISTIC EGRVlv_uBattMin_C "Minimum value of battery voltage to release zero point adaption" VALUE 0x38757A Scalar_UWORD 0 Battery_mv 0.0 50000.0 /end CHARACTERISTIC
/begin CHARACTERISTIC EGRVlv_rActMax_C "Maximum threshold for actual sensed valve position" VALUE 0x386DF8 Scalar_SWORD 0 Prc_100_rate -100.0 100.0 /end CHARACTERISTIC
/begin CHARACTERISTIC EGRVlv_rActMin_C "Minimum threshold for actual sensed valve position" VALUE 0x386DFA Scalar_SWORD 0 Prc_100_rate -100.0 100.0 /end CHARACTERISTIC
/begin CHARACTERISTIC EGRVlv_rActOfs_C "Offset correction value." VALUE 0x386DFE Scalar_SWORD 0 Prc_100_rate -100.0 100.0 /end CHARACTERISTIC
/begin CHARACTERISTIC EGRVlv_rAdapAgOpnMax_C "Maximum opening angle" VALUE 0x386E00 Scalar_SWORD 0 Prc_100_rate -100.0 100.0 /end CHARACTERISTIC
/begin CHARACTERISTIC EGRVlv_rAdapAgOpnMin_C "Minimum opening angle" VALUE 0x386E02 Scalar_SWORD 0 Prc_100_rate -100.0 100.0 /end CHARACTERISTIC
/begin CHARACTERISTIC EGRVlv_rAdapDiffPlausShT_C "Short time drift threshold" VALUE 0x386E06 Scalar_SWORD 0 Prc_100_rate -100.0 100.0 /end CHARACTERISTIC
/begin CHARACTERISTIC EGRVlv_rAdapDiffPlaus_C "Permissible difference b/n max and min adaption values" VALUE 0x386E08 Scalar_SWORD 0 Prc_100_rate -100.0 100.0 /end CHARACTERISTIC
/begin CHARACTERISTIC EGRVlv_rAdapIniOpn0_C "Initialisation value for the integrator for the opening valve(first time)" VALUE 0x386E0A Scalar_SWORD 0 Prc_100_rate -100.0 100.0 /end CHARACTERISTIC
/begin CHARACTERISTIC EGRVlv_rAdapIniOpn_C "Initialisation value for the integrator for the opening valve" VALUE 0x386E0C Scalar_SWORD 0 Prc_100_rate -100.0 100.0 /end CHARACTERISTIC
/begin CHARACTERISTIC EGRVlv_rAdapOpnBnd_C "Initialisation value for integrator in case max permissible angle is reached" VALUE 0x386E0E Scalar_SWORD 0 Prc_100_rate -100.0 100.0 /end CHARACTERISTIC
/begin CHARACTERISTIC EGRVlv_rOfsLrnDwn_C "Position constant for the integrator during valve closure" VALUE 0x387460 Scalar_SWORD 0 Prc_100_rate -100.0 100.0 /end CHARACTERISTIC
/begin CHARACTERISTIC EGRVlv_rOfsLrnRmpDwnCls_C "Position constant for the integrator in ramp down to close state" VALUE 0x387462 Scalar_SWORD 0 Prc_100_rate -100.0 100.0 /end CHARACTERISTIC
/begin CHARACTERISTIC EGRVlv_rOfsLrnRmpUpFst_C "Position constant for the integrator in ramp up fast state" VALUE 0x387464 Scalar_SWORD 0 Prc_100_rate -100.0 100.0 /end CHARACTERISTIC
/begin CHARACTERISTIC EGRVlv_rOfsLrnVlvMax_C "Upper limit of control value for offset learning" VALUE 0x387466 Scalar_SWORD 0 Prc_100_rate -100.0 100.0 /end CHARACTERISTIC
/begin CHARACTERISTIC EGRVlv_rOfsLrnVlvMin_C "Lower limit of control value for offset learning" VALUE 0x387468 Scalar_SWORD 0 Prc_100_rate -100.0 100.0 /end CHARACTERISTIC
/begin CHARACTERISTIC EGRVlv_rOfsMax_C "Maximum offset parameter" VALUE 0x38746A Scalar_SWORD 0 Prc_100_rate -100.0 100.0 /end CHARACTERISTIC
/begin CHARACTERISTIC EGRVlv_rOfsMin_C "Minimum offset parameter" VALUE 0x38746C Scalar_SWORD 0 Prc_100_rate -100.0 100.0 /end CHARACTERISTIC
/begin CHARACTERISTIC EGRVlv_rPullDwnThres_C "Pull down threshold ratio" VALUE 0x387476 Scalar_SWORD 0 Prc_100_rate -100.0 100.0 /end CHARACTERISTIC
/begin CHARACTERISTIC EGRVlv_rRmpDwnCls_C "Threshold for integrator in ramp down to close state" VALUE 0x38747E Scalar_SWORD 0 Prc_100_rate -100.0 100.0 /end CHARACTERISTIC
/begin CHARACTERISTIC EGRVlv_rRmpUpFst_C "Threshold for integrator in ramp up faststate" VALUE 0x387480 Scalar_SWORD 0 Prc_100_rate -100.0 100.0 /end CHARACTERISTIC
/begin CHARACTERISTIC EGRVlv_rSensVlvThres_C "Threshold for detection of lower stop" VALUE 0x387482 Scalar_SWORD 0 Prc_100_rate -100.0 100.0 /end CHARACTERISTIC
/begin CHARACTERISTIC EGRVlv_rTmpOfsLrnMax_C "Maximum offset ratio" VALUE 0x387488 Scalar_SWORD 0 Prc_100_rate -100.0 100.0 /end CHARACTERISTIC
/begin CHARACTERISTIC EGRVlv_rTmpOfsLrnMin_C "Minimum offset ratio" VALUE 0x38748A Scalar_SWORD 0 Prc_100_rate -100.0 100.0 /end CHARACTERISTIC
/begin CHARACTERISTIC EGRVlv_rTransStgDfl_C "Structure for Transtage / Fixed replacement value" VALUE 0x38748C Scalar_SWORD 0 Prc_100_rate -100.0 100.0 /end CHARACTERISTIC
/begin CHARACTERISTIC SigTst_rEGRVlv_C "Set EGR valve position by hand" VALUE 0x398054 Scalar_SWORD 0 Prc_100_rate -100.0 100.0 /end CHARACTERISTIC
/begin CHARACTERISTIC EGRVlv_tEngFldThresOfsLrnRls1_C "Threshold temperature for release of offset learning strategy-1" VALUE 0x387506 Scalar_SWORD 0 Temp_deg -3000.0 3000.0 /end CHARACTERISTIC
/begin CHARACTERISTIC EGRVlv_tEngFldThresOfsLrnRls2_C "Threshold temperature for release of offset learning strategy-2" VALUE 0x387508 Scalar_SWORD 0 Temp_deg -3000.0 3000.0 /end CHARACTERISTIC
/begin CHARACTERISTIC EGRVlv_tEngMax_C "Maximum value of engine temparature to release the zero point adaption" VALUE 0x38750E Scalar_SWORD 0 Temp_deg -3000.0 3000.0 /end CHARACTERISTIC
/begin CHARACTERISTIC EGRVlv_tEngMin_C "Minimum value of engine temparature to release the zero point adaption" VALUE 0x387510 Scalar_SWORD 0 Temp_deg -3000.0 3000.0 /end CHARACTERISTIC
/begin CHARACTERISTIC EGRVlv_facAdapClsStrt_C "Integrator initialisation factor" VALUE 0x386D7A Scalar_SWORD 0 Factor -32.0 31.9 /end CHARACTERISTIC
/begin CHARACTERISTIC EGRVlv_facAdapPosCls_C "Factor to calculate the EGR valve close position" VALUE 0x386D7C Scalar_SWORD 0 Factor -32.0 31.9 /end CHARACTERISTIC
/begin CHARACTERISTIC EGRVlv_IKiOfsLrnUp_C "Position constant for the integrator during valve opening" VALUE 0x386D4A Scalar_SWORD 0 EGRCtl_Ki -128.0 127.9 /end CHARACTERISTIC
/begin CHARACTERISTIC EGRVlv_RmpSlpNeg_C "Parameter for Ramp 1 / negative ramp slope" VALUE 0x386D56 Scalar_SWORD 0 DutyCycle_rate_s -327.68 327.67 /end CHARACTERISTIC
/begin CHARACTERISTIC EGRVlv_RmpSlpPos_C "Parameter for Ramp 1 / Slope if the ramp has to be increased" VALUE 0x386D58 Scalar_SWORD 0 DutyCycle_rate_s -327.68 327.67 /end CHARACTERISTIC
/begin CHARACTERISTIC EGRVlv_facPT1ModVal_C "PT1 filter factor for EGRVlv sensor model value" VALUE 0x386D84 Scalar_UWORD 0 PT_fac 0.0 99.9985 /end CHARACTERISTIC
/begin CHARACTERISTIC EGRVlv_facPT1_C "PT1 filter factor for EGRVlv sensor" VALUE 0x386D86 Scalar_UWORD 0 PT_fac 0.0 99.9985 /end CHARACTERISTIC
/begin CHARACTERISTIC EGRVlv_numEngTempOfsLrnRls1_C "Index for EngDa_tFld" VALUE 0x386DF2 Scalar_UBYTE 0 uint8 0.0 255.0 /end CHARACTERISTIC
/begin CHARACTERISTIC EGRVlv_numEngTempOfsLrnRls2_C "Index for EngDa_tFld" VALUE 0x386DF3 Scalar_UBYTE 0 uint8 0.0 255.0 /end CHARACTERISTIC
/begin CHARACTERISTIC EGRVlv_numTempSel_C "Temperature selector from the engine temperature field" VALUE 0x386DF7 Scalar_UBYTE 0 uint8 0.0 255.0 /end CHARACTERISTIC
/begin CHARACTERISTIC EGRVlv_stNewVlvTrg_C "Trigger for new valve" VALUE 0x3874F3 Scalar_BOOLEAN 0 boolean 0.0 1.0 /end CHARACTERISTIC
/begin CHARACTERISTIC EGRVlv_stOfsEngCond_C "Decides whether offset learning has to be startedonly after engine has entered to running state" VALUE 0x3874F4 Scalar_BOOLEAN 0 boolean 0.0 1.0 /end CHARACTERISTIC
/begin CHARACTERISTIC EGRVlv_stOfsLrnEnb_C "Switch to ENABLE/DISABLE offset learning" VALUE 0x3874F5 Scalar_BOOLEAN 0 boolean 0.0 1.0 /end CHARACTERISTIC
/begin CHARACTERISTIC EGRVlv_stOfsLrnTrg_C "Trigger for offset learning" VALUE 0x3874F6 Scalar_BOOLEAN 0 boolean 0.0 1.0 /end CHARACTERISTIC
/begin CHARACTERISTIC EGRVlv_swtActOfs_C "Switch to activate offset correction replacement value" VALUE 0x3874FC Scalar_BOOLEAN 0 boolean 0.0 1.0 /end CHARACTERISTIC
/begin CHARACTERISTIC EGRVlv_swtOfsLrnActv_C "Switch to ENABLE/DISABLE offset learning" VALUE 0x387501 Scalar_BOOLEAN 0 boolean 0.0 1.0 /end CHARACTERISTIC
/begin CHARACTERISTIC EGRVlv_swtSensPrs_C "Switch for position sensor present or not" VALUE 0x387504 Scalar_BOOLEAN 0 boolean 0.0 1.0 /end CHARACTERISTIC
/begin CHARACTERISTIC SigTst_swtEGRVlv_C "Switch for EGR valve position by hand" VALUE 0x398075 Scalar_UBYTE 0 Switch_conv 0 1 /end CHARACTERISTIC
/begin CHARACTERISTIC IAirHt_stPsDiaDisbl_C "Application parameter to check if all conditions are met for enabling air heating" VALUE 0x38A8E0 Scalar_UWORD 0 State_uint16 0.0 65535.0 /end CHARACTERISTIC
/begin CHARACTERISTIC IAirHt_stPsDisbl_C "Application parameter to check if all conditions are met for enabling air heating" VALUE 0x38A8E2 Scalar_UWORD 0 State_uint16 0.0 65535.0 /end CHARACTERISTIC
/begin CHARACTERISTIC SigTst_stIAirHt_C "manual air heater state" VALUE 0x398062 Scalar_BOOLEAN 0 boolean 0.0 1.0 /end CHARACTERISTIC
/begin CHARACTERISTIC SigTst_swtIAirHt_C "switch of manual air heater state" VALUE 0x39807D Scalar_UBYTE 0 Switch_conv 0 1 /end CHARACTERISTIC
/begin CHARACTERISTIC Air_pTransfPIntkVUs_CUR "Transformation curve to convert the voltage value to pressure value-y axis" CURVE 0x386346 Lookup1D_WORD 0 AirPressure_kPa 0.0 1200.0
 /begin AXIS_DESCR COM_AXIS Air_uRawPIntkVUs Ad_mv 2 0.0 5000.0 AXIS_PTS_REF Air_pTransfPIntkVUs_CURX /end AXIS_DESCR
/end CHARACTERISTIC
/begin CHARACTERISTIC Air_tiPIntkVUsMaxDefDeb_C "debounce time which the maximum defect of raw air pressure upstream of the intake valve is detected" VALUE 0x386430 Scalar_ULONG 0 Debounce_ms 0.0 65535.0 /end CHARACTERISTIC
/begin CHARACTERISTIC Air_tiPIntkVUsMaxOKDeb_C "debounce time which the maximum defect of raw air pressure upstream of the intake valve is removed" VALUE 0x386434 Scalar_ULONG 0 Debounce_ms 0.0 65535.0 /end CHARACTERISTIC
/begin CHARACTERISTIC Air_tiPIntkVUsMinDefDeb_C "debounce time which the minimum defect of raw air pressure upstream of the intake valve is detected" VALUE 0x386438 Scalar_ULONG 0 Debounce_ms 0.0 65535.0 /end CHARACTERISTIC
/begin CHARACTERISTIC Air_tiPIntkVUsMinOKDeb_C "debounce time which the minimum defect of raw air pressure upstream of the intake valve is removed" VALUE 0x38643C Scalar_ULONG 0 Debounce_ms 0.0 65535.0 /end CHARACTERISTIC
/begin CHARACTERISTIC Air_tiPhysRngHiIntkVUsDefDeb_C "debounce time which the maximum defect of physical air pressure upstream of the intake valve is detected" VALUE 0x386454 Scalar_ULONG 0 Debounce_ms 0.0 65535.0 /end CHARACTERISTIC
/begin CHARACTERISTIC Air_tiPhysRngHiIntkVUsOKDeb_C "debounce time which the maximum defect of physical air pressure upstream of the intake valve is removed" VALUE 0x386458 Scalar_ULONG 0 Debounce_ms 0.0 65535.0 /end CHARACTERISTIC
/begin CHARACTERISTIC Air_tiPhysRngLoIntkVUsDefDeb_C "debounce time which the minimum defect of physical air pressure upstream of the intake valve is detected" VALUE 0x38645C Scalar_ULONG 0 Debounce_ms 0.0 65535.0 /end CHARACTERISTIC
/begin CHARACTERISTIC Air_tiPhysRngLoIntkVUsOKDeb_C "debounce time which the minimum defect of physical air pressure upstream of the intake valve is removed" VALUE 0x386460 Scalar_ULONG 0 Debounce_ms 0.0 65535.0 /end CHARACTERISTIC
/begin CHARACTERISTIC Air_tiPlsMaxIntkVUsDefDeb_C "debounce time which the maximum difference defect of plausible air pressure upstream of the intake valve is detected" VALUE 0x386464 Scalar_ULONG 0 Debounce_ms 0.0 65535.0 /end CHARACTERISTIC
/begin CHARACTERISTIC Air_tiPlsMaxIntkVUsOKDeb_C "debounce time which the maximum difference defect of plausible air pressure upstream of the intake valve is removed" VALUE 0x386468 Scalar_ULONG 0 Debounce_ms 0.0 65535.0 /end CHARACTERISTIC
/begin CHARACTERISTIC Air_tiPlsMinIntkVUsDefDeb_C "debounce time which the minimum difference defect of plausible air pressure upstream of the intake valve is detected" VALUE 0x38646C Scalar_ULONG 0 Debounce_ms 0.0 65535.0 /end CHARACTERISTIC
/begin CHARACTERISTIC Air_tiPlsMinIntkVUsOKDeb_C "debounce time which the minimum difference defect of plausible air pressure upstream of the intake valve is removed" VALUE 0x386470 Scalar_ULONG 0 Debounce_ms 0.0 65535.0 /end CHARACTERISTIC
/begin CHARACTERISTIC Air_uSRCPIntkVUsMax_C "Structure to hold SRC thresholds for voltage signal of air pressure upstream of the intake valve / Threshold for SRC -Max detection" VALUE 0x38649C Scalar_SWORD 0 Ad_mv 0.0 5000.0 /end CHARACTERISTIC
/begin CHARACTERISTIC Air_uSRCPIntkVUsMin_C "Structure to hold SRC thresholds for voltage signal of air pressure upstream of the intake valve / Threshold for SRC -Min detection" VALUE 0x38649E Scalar_SWORD 0 Ad_mv 0.0 5000.0 /end CHARACTERISTIC
/begin CHARACTERISTIC Air_pMaxDiffLimPlsPIntkVUs_C "Maximum threshold of difference pressure above which intake-valve upstream pressure is \"not plausible\"" VALUE 0x38633C Scalar_SWORD 0 AirPressure_kPa -1200.0 1200.0 /end CHARACTERISTIC
/begin CHARACTERISTIC Air_pMinDiffLimPlsPIntkVUs_C "Minimum threshold of difference pressure below which intake-valve upstream pressure is \"not plausible\"" VALUE 0x38633E Scalar_SWORD 0 AirPressure_kPa -1200.0 1200.0 /end CHARACTERISTIC
/begin CHARACTERISTIC Air_pPhysRngPIntkVUsMax_C "Structure for physical range thresholds for pressure sensor upstream of intake valve. / Maximum threshold for the Sensed value." VALUE 0x386340 Scalar_SWORD 0 AirPressure_kPa 0.0 1200.0 /end CHARACTERISTIC
/begin CHARACTERISTIC Air_pPhysRngPIntkVUsMin_C "Structure for physical range thresholds for pressure sensor upstream of intake valve. / Minimum threshold for the Sensed value." VALUE 0x386342 Scalar_SWORD 0 AirPressure_kPa 0.0 1200.0 /end CHARACTERISTIC
/begin CHARACTERISTIC Air_facPT1T1PIntkVUs_C "PT1 filter time constant for filtering ADC voltage of air pressure upstream of the intake valve" VALUE 0x386332 Scalar_UWORD 0 PT_fac 0.0 99.9985 /end CHARACTERISTIC
/begin AXIS_PTS Air_pTransfPIntkVUs_CURX "Transformation curve to convert the voltage value to pressure value-x axis" 0x38634A Air_uRawPIntkVUs Lookup1D_X_WORD 0 Ad_mv 2 0.0 5000.0 /end AXIS_PTS
/begin CHARACTERISTIC Air_RmpSlpPIntkVUsNeg_C "Structure for setting Ramp Slope / negative ramp slope" VALUE 0x386322 Scalar_SWORD 0 AirPressure_kPa -1200.0 1200.0 /end CHARACTERISTIC
/begin CHARACTERISTIC Air_RmpSlpPIntkVUsPos_C "Structure for setting Ramp Slope / Slope if the ramp has to be increased" VALUE 0x386324 Scalar_SWORD 0 AirPressure_kPa -1200.0 1200.0 /end CHARACTERISTIC
/begin CHARACTERISTIC Air_dpGradLimPIntkVUs_C "The limit for the rate of rise and fall of linearized intake-valve-upstream-pressure" VALUE 0x386330 Scalar_SWORD 0 AirPressure_kPa_s -1200.0 1200.0 /end CHARACTERISTIC
/begin CHARACTERISTIC Air_pTransStgPIntkVUsDfl_C "Structure containing fixed replacement value and status word for intake valve upstream air pressure sensor / Fixed replacement value" VALUE 0x386344 Scalar_SWORD 0 AirPressure_kPa 0.0 1200.0 /end CHARACTERISTIC
/begin CHARACTERISTIC SigTst_pPIntkVUs_C "Set intake-valve upstream pressure by hand" VALUE 0x398042 Scalar_SWORD 0 AirPressure_kPa 0.0 1200.0 /end CHARACTERISTIC
/begin CHARACTERISTIC Air_facPT1T1SigPIntkVUs_C "PT1 filter time constant for sensed air temperature upstream of the intake valve" VALUE 0x386334 Scalar_UWORD 0 PT_fac 0.0 99.9985 /end CHARACTERISTIC
/begin CHARACTERISTIC SigTst_swtPIntkVUs_C "Switch for intake-valve upstream pressure by hand" VALUE 0x398085 Scalar_UBYTE 0 Switch_conv 0 1 /end CHARACTERISTIC
/begin CHARACTERISTIC Air_tTransfTIntkVUs_CUR "Transformation curve to convert the voltage value to temperature value" CURVE 0x3863BC Lookup1D_WORD 0 Temp_deg -200.0 200.0
 /begin AXIS_DESCR COM_AXIS Air_uRawTIntkVUs Ad_mv 25 0.0 5000.0 AXIS_PTS_REF Air_tTransfTIntkVUs_CURX /end AXIS_DESCR
/end CHARACTERISTIC
/begin CHARACTERISTIC Air_tiSRCMaxTIntkVUsDefDeb_C "debounce time which the maximum defect of raw air temperature upstream of the intake valve is detected" VALUE 0x38647C Scalar_ULONG 0 Debounce_ms 0.0 65535.0 /end CHARACTERISTIC
/begin CHARACTERISTIC Air_tiSRCMaxTIntkVUsOKDeb_C "debounce time which the maximum defect of raw air temperature upstream of the intake valve is removed" VALUE 0x386480 Scalar_ULONG 0 Debounce_ms 0.0 65535.0 /end CHARACTERISTIC
/begin CHARACTERISTIC Air_tiSRCMinTIntkVUsDefDeb_C "debounce time which the minimum defect of raw air temperature upstream of the intake valve is detected" VALUE 0x386484 Scalar_ULONG 0 Debounce_ms 0.0 65535.0 /end CHARACTERISTIC
/begin CHARACTERISTIC Air_tiSRCMinTIntkVUsOKDeb_C "debounce time which the minimum defect of raw air temperature upstream of the intake valve is removed" VALUE 0x386488 Scalar_ULONG 0 Debounce_ms 0.0 65535.0 /end CHARACTERISTIC
/begin CHARACTERISTIC Air_uSRCTIntkVUsMax_C "structure for signal range check / Threshold for SRC -Max detection" VALUE 0x3864A0 Scalar_SWORD 0 Ad_mv 0.0 5000.0 /end CHARACTERISTIC
/begin CHARACTERISTIC Air_uSRCTIntkVUsMin_C "structure for signal range check / Threshold for SRC -Min detection" VALUE 0x3864A2 Scalar_SWORD 0 Ad_mv 0.0 5000.0 /end CHARACTERISTIC
/begin AXIS_PTS Air_tTransfTIntkVUs_CURX "Air_uRawTIntkVUs" 0x3863EE Air_uRawTIntkVUs Lookup1D_X_WORD 0 Ad_mv 25 0.0 5000.0 /end AXIS_PTS
/begin CHARACTERISTIC Air_RmpSlpTIntkVUsNeg_C "Structure containing ramp rate for transition in case of SRC errors in intake valve upstream air temperature sensor / negative ramp slope" VALUE 0x38632A Scalar_SWORD 0 Temp_deg_s -200.0 200.0 /end CHARACTERISTIC
/begin CHARACTERISTIC Air_RmpSlpTIntkVUsPos_C "Structure containing ramp rate for transition in case of SRC errors in intake valve upstream air temperature sensor / Slope if the ramp has to be increased" VALUE 0x38632C Scalar_SWORD 0 Temp_deg_s -200.0 200.0 /end CHARACTERISTIC
/begin CHARACTERISTIC Air_tTransStgTIntkVUsDfl_C "Structure containing fixed replacement value and status word for intake valve upstream air temperature sensor / Fixed replacement value" VALUE 0x386356 Scalar_SWORD 0 Temp_deg -200.0 200.0 /end CHARACTERISTIC
/begin CHARACTERISTIC SigTst_tIntkVUs_C "Set induction air temperature by hand" VALUE 0x3980A0 Scalar_SWORD 0 Temp_deg -200.0 200.0 /end CHARACTERISTIC
/begin CHARACTERISTIC Air_facPT1TIntkVUs_C "PT1 filter time constant for sensed air temperature upstream of the intake valve" VALUE 0x386338 Scalar_UWORD 0 PT_fac 0.0 99.9985 /end CHARACTERISTIC
/begin CHARACTERISTIC SigTst_swtTIntkVUs_C "Switch for induction air temperature by hand" VALUE 0x398098 Scalar_UBYTE 0 Switch_conv 0 1 /end CHARACTERISTIC
/begin CHARACTERISTIC DevLib_tiActrPrt_C "Actutar protection time" VALUE 0x386848 Scalar_ULONG 0 EngTime_ms 0.0 1000.0 /end CHARACTERISTIC
/begin CHARACTERISTIC DebLib_nActrRls_C "The minimum engine speed for the actuator release" VALUE 0x386834 Scalar_SWORD 0 EngSpeed_rpm 20.0 10000.0 /end CHARACTERISTIC
/begin CHARACTERISTIC DebLib_uBattThdBattHiHysHi_C "Structure containing hysterisis check for SCR battery voltage LOWHIGH / Higher limit for battery voltage LOW hysterisis check" VALUE 0x386836 Scalar_UWORD 0 Battery_mv 0.0 65535.0 /end CHARACTERISTIC
/begin CHARACTERISTIC DebLib_uBattThdBattHiHysLo_C "Structure containing hysterisis check for SCR battery voltage LOWHIGH / Lower limit for battery voltage LOW hysterisis check." VALUE 0x386838 Scalar_UWORD 0 Battery_mv 0.0 65535.0 /end CHARACTERISTIC
/begin CHARACTERISTIC DebLib_uBattThdBattLoHysHi_C "Structure containing hysterisis check for SCR battery voltage LOWHIGH / Upper limit for battery voltage HIGH hysterisis check" VALUE 0x38683A Scalar_UWORD 0 Battery_mv 0.0 65535.0 /end CHARACTERISTIC
/begin CHARACTERISTIC DebLib_uBattThdBattLoHysLo_C "Structure containing hysterisis check for SCR battery voltage LOWHIGH / Lower limit for battery voltage HIGH hysterisis check" VALUE 0x38683C Scalar_UWORD 0 Battery_mv 0.0 65535.0 /end CHARACTERISTIC
/begin CHARACTERISTIC DebLib_uPwrStgBattHiHysHi_C "Structure containing hysterisis check for battery voltage LOW/HIGH / Upper limit for battery voltage HIGH hysterisis check" VALUE 0x38683E Scalar_UWORD 0 Battery_mv 0.0 65535.0 /end CHARACTERISTIC
/begin CHARACTERISTIC DebLib_uPwrStgBattHiHysLo_C "Structure containing hysterisis check for battery voltage LOW/HIGH / Lower limit for battery voltage HIGH hysterisis check" VALUE 0x386840 Scalar_UWORD 0 Battery_mv 0.0 65535.0 /end CHARACTERISTIC
/begin CHARACTERISTIC DebLib_uPwrStgBattLoHysHi_C "Structure containing hysterisis check for battery voltage LOW/HIGH / Higher limit for battery voltage LOW hysterisis check" VALUE 0x386842 Scalar_UWORD 0 Battery_mv 0.0 65535.0 /end CHARACTERISTIC
/begin CHARACTERISTIC DebLib_uPwrStgBattLoHysLo_C "Structure containing hysterisis check for battery voltage LOW/HIGH / Lower limit for battery voltage HIGH hysterisis check" VALUE 0x386844 Scalar_UWORD 0 Battery_mv 0.0 65535.0 /end CHARACTERISTIC
/begin CHARACTERISTIC DebLib_facPwrStgHighHysHi_C "Structure containing hysterisis limits for battery voltage correction factor / Higher hysterisis limit for battery correction factor HIGH." VALUE 0x38682C Scalar_SWORD 0 Factor -4.0 4.0 /end CHARACTERISTIC
/begin CHARACTERISTIC DebLib_facPwrStgHighHysLo_C "Structure containing hysterisis limits for battery voltage correction factor / Lower hysterisis limit for battery correction factor HIGH." VALUE 0x38682E Scalar_SWORD 0 Factor -4.0 4.0 /end CHARACTERISTIC
/begin CHARACTERISTIC DebLib_facPwrStgLowHysHi_C "Structure containing hysterisis limits for battery voltage correction factor / Higher hysterisis limit for battery correction factor LOW." VALUE 0x386830 Scalar_SWORD 0 Factor -4.0 4.0 /end CHARACTERISTIC
/begin CHARACTERISTIC DebLib_facPwrStgLowHysLo_C "Structure containing hysterisis limits for battery voltage correction factor / Lower hysterisis limit for battery correction factor LOW." VALUE 0x386832 Scalar_SWORD 0 Factor -4.0 4.0 /end CHARACTERISTIC
/begin CHARACTERISTIC BattU_uTransf_CUR "Transformation curve for battery voltage" CURVE 0x386544 Lookup1D_UWORD 0 Battery_mv 0.0 50000.0
 /begin AXIS_DESCR COM_AXIS BattU_uRaw Ad_mv 16 0.0 5000.0 AXIS_PTS_REF BattU_uTransf_CURX /end AXIS_DESCR
/end CHARACTERISTIC
/begin CHARACTERISTIC BattU_tiMaxDefDeb_C "debounce time" VALUE 0x386518 Scalar_ULONG 0 Debounce_ms 0.0 65535.0 /end CHARACTERISTIC
/begin CHARACTERISTIC BattU_tiMaxOKDeb_C "debounce time" VALUE 0x38651C Scalar_ULONG 0 Debounce_ms 0.0 65535.0 /end CHARACTERISTIC
/begin CHARACTERISTIC BattU_tiMinDefDeb_C "debounce time" VALUE 0x386520 Scalar_ULONG 0 Debounce_ms 0.0 65535.0 /end CHARACTERISTIC
/begin CHARACTERISTIC BattU_tiMinOKDeb_C "debounce time" VALUE 0x386524 Scalar_ULONG 0 Debounce_ms 0.0 65535.0 /end CHARACTERISTIC
/begin CHARACTERISTIC BattU_tiPhysRngHiDefDeb_C "debounce time" VALUE 0x386528 Scalar_ULONG 0 Debounce_ms 0.0 65535.0 /end CHARACTERISTIC
/begin CHARACTERISTIC BattU_tiPhysRngHiOKDeb_C "debounce time" VALUE 0x38652C Scalar_ULONG 0 Debounce_ms 0.0 65535.0 /end CHARACTERISTIC
/begin CHARACTERISTIC BattU_tiPhysRngLoDefDeb_C "debounce time" VALUE 0x386530 Scalar_ULONG 0 Debounce_ms 0.0 65535.0 /end CHARACTERISTIC
/begin CHARACTERISTIC BattU_tiPhysRngLoOKDeb_C "debounce time" VALUE 0x386534 Scalar_ULONG 0 Debounce_ms 0.0 65535.0 /end CHARACTERISTIC
/begin CHARACTERISTIC BattU_uSRCMax_C "Max. voltage for SRC high check" VALUE 0x38653E Scalar_SWORD 0 Ad_mv 0.0 5000.0 /end CHARACTERISTIC
/begin CHARACTERISTIC BattU_uSRCMin_C "Min. voltage for SRC low check" VALUE 0x386540 Scalar_SWORD 0 Ad_mv 0.0 5000.0 /end CHARACTERISTIC
/begin CHARACTERISTIC BattU_uPhysRngMax_C "threshold for battery voltage (High value)" VALUE 0x38653A Scalar_UWORD 0 Battery_mv 0.0 50000.0 /end CHARACTERISTIC
/begin CHARACTERISTIC BattU_uPhysRngMin_C "threshold for battery voltage (Low value)" VALUE 0x38653C Scalar_UWORD 0 Battery_mv 0.0 50000.0 /end CHARACTERISTIC
/begin AXIS_PTS BattU_uTransf_CURX "BattU_uRaw: Battery voltage before defect detection and handling" 0x386564 BattU_uRaw Lookup1D_X_WORD 0 Ad_mv 16 0.0 5000.0 /end AXIS_PTS
/begin CHARACTERISTIC BattU_RmpSlpNeg_C "Structure for ramp parameters / negative ramp slope" VALUE 0x38650C Scalar_LONG 0 Battery_mv_s 0.0 50000.0 /end CHARACTERISTIC
/begin CHARACTERISTIC BattU_RmpSlpPos_C "Structure for ramp parameters / Slope if the ramp has to be increased" VALUE 0x386510 Scalar_LONG 0 Battery_mv_s 0.0 50000.0 /end CHARACTERISTIC
/begin CHARACTERISTIC BattU_uNrm_C "Normal battery voltage to calculate the correction factor" VALUE 0x386538 Scalar_UWORD 0 Battery_mv 0.0 50000.0 /end CHARACTERISTIC
/begin CHARACTERISTIC BattU_uTransStgDfl_C "Default value" VALUE 0x386542 Scalar_UWORD 0 Battery_mv 0.0 50000.0 /end CHARACTERISTIC
/begin CHARACTERISTIC BattU_facPT1_C "PT1 factor" VALUE 0x386514 Scalar_UWORD 0 PT_fac 0.0 99.9985 /end CHARACTERISTIC
/begin CHARACTERISTIC BattU_swtRated_C "Switch for rated voltage selection" VALUE 0x386516 Scalar_UBYTE 0 Switch_conv 0 1 /end CHARACTERISTIC
/begin CHARACTERISTIC MRly_ctErlyOpng_C "Threshold to detect the early opening" VALUE 0x394E58 Scalar_ULONG 0 Counter_num 0.0 255.0 /end CHARACTERISTIC
/begin CHARACTERISTIC MRly_tiCloseStk_C "Time to perform the MRly diagnosis" VALUE 0x394E60 Scalar_ULONG 0 Debounce_ms 0.0 65535.0 /end CHARACTERISTIC
/begin CHARACTERISTIC MRly_tiStkRlyDiaDel_C "Time to perform the MRly diagnosis" VALUE 0x394E64 Scalar_ULONG 0 Debounce_ms 0.0 65535.0 /end CHARACTERISTIC
/begin CHARACTERISTIC MRly_uStkRlyBattThr_C "Threshold voltage to prevent the jammed" VALUE 0x394E68 Scalar_UWORD 0 Battery_mv 0.0 50000.0 /end CHARACTERISTIC
/begin CHARACTERISTIC MRly_facBattVltgFlt_C "Factor of  filtered voltage" VALUE 0x394E5C Scalar_UWORD 0 PT_fac 0.0 99.9985 /end CHARACTERISTIC
/begin CHARACTERISTIC SSpMon_tiSRCMaxSply1DefDeb_C "Time for SSpMon1 maximum signal range power suply" VALUE 0x398008 Scalar_ULONG 0 Debounce_ms 0.0 65535.0 /end CHARACTERISTIC
/begin CHARACTERISTIC SSpMon_tiSRCMaxSply1OKDeb_C "Time for SSpMon1 maximum signal range OK power suply" VALUE 0x39800C Scalar_ULONG 0 Debounce_ms 0.0 65535.0 /end CHARACTERISTIC
/begin CHARACTERISTIC SSpMon_tiSRCMaxSplyDefDeb_C "Time for SSpMon maximum signal range power suply" VALUE 0x398010 Scalar_ULONG 0 Debounce_ms 0.0 65535.0 /end CHARACTERISTIC
/begin CHARACTERISTIC SSpMon_tiSRCMaxSplyOKDeb_C "Time for SSpMon maximum signal range OK power suply" VALUE 0x398014 Scalar_ULONG 0 Debounce_ms 0.0 65535.0 /end CHARACTERISTIC
/begin CHARACTERISTIC SSpMon_tiSRCMinSply1DefDeb_C "Time for SSpMon1 minimum signal range power suply" VALUE 0x398018 Scalar_ULONG 0 Debounce_ms 0.0 65535.0 /end CHARACTERISTIC
/begin CHARACTERISTIC SSpMon_tiSRCMinSply1OKDeb_C "Time for SSpMon1 minimum signal range OK power suply" VALUE 0x39801C Scalar_ULONG 0 Debounce_ms 0.0 65535.0 /end CHARACTERISTIC
/begin CHARACTERISTIC SSpMon_tiSRCMinSplyDefDeb_C "Time for SSpMon minimum signal range power suply" VALUE 0x398020 Scalar_ULONG 0 Debounce_ms 0.0 65535.0 /end CHARACTERISTIC
/begin CHARACTERISTIC SSpMon_tiSRCMinSplyOKDeb_C "Time for SSpMon minimum signal range OK power suply" VALUE 0x398024 Scalar_ULONG 0 Debounce_ms 0.0 65535.0 /end CHARACTERISTIC
/begin CHARACTERISTIC SSpMon_uSply1OutMax_C "Higher threshold for 12V sensor supply 1 voltage when the battery voltage is above SSpMon_uBattRef_C" VALUE 0x398028 Scalar_SWORD 0 Ad_mv 0.0 5000.0 /end CHARACTERISTIC
/begin CHARACTERISTIC SSpMon_uSply1OutMin_C "Lower threshold for 12V sensor supply 1 voltage when the battery voltage is above SSpMon_uBattRef_C" VALUE 0x39802A Scalar_SWORD 0 Ad_mv 0.0 5000.0 /end CHARACTERISTIC
/begin CHARACTERISTIC SSpMon_uSplyOutMax_C "Higher threshold for 12V sensor supply when the battery voltage is above SSpMon_uSply1BattRef_C" VALUE 0x39802C Scalar_SWORD 0 Ad_mv 0.0 5000.0 /end CHARACTERISTIC
/begin CHARACTERISTIC SSpMon_uSplyOutMin_C "Lower threshold for 12V sensor supply when the battery voltage is above SSpMon_uSply1BattRef_C" VALUE 0x39802E Scalar_SWORD 0 Ad_mv 0.0 5000.0 /end CHARACTERISTIC
/begin CHARACTERISTIC SyC_tiPostDrive_C "After run end time" VALUE 0x39AAC8 Scalar_ULONG 0 Debounce_ms 0.0 65535.0 /end CHARACTERISTIC
/begin CHARACTERISTIC T15_tiDebHiLo_C "Debounce time terminal15-signal from low to high" VALUE 0x39AACC Scalar_ULONG 0 Debounce_ms 0.0 65535.0 /end CHARACTERISTIC
/begin CHARACTERISTIC T15_tiDebLoHi_C "Debounce time terminal15-signal from high to low" VALUE 0x39AAD0 Scalar_ULONG 0 Debounce_ms 0.0 65535.0 /end CHARACTERISTIC
/begin CHARACTERISTIC T15_uThreshold_C "T15 voltage threshold" VALUE 0x39AAD4 Scalar_SWORD 0 Ad_mv 0.0 5000.0 /end CHARACTERISTIC
/begin CHARACTERISTIC T50_tiDebHiLo_C "Debounce time terminal50-signal from low to high" VALUE 0x39AAD8 Scalar_ULONG 0 Debounce_ms 0.0 65535.0 /end CHARACTERISTIC
/begin CHARACTERISTIC T50_tiDebLoHi_C "Debounce time terminal50-signal from high to low" VALUE 0x39AADC Scalar_ULONG 0 Debounce_ms 0.0 65535.0 /end CHARACTERISTIC
/begin CHARACTERISTIC T50_uThreshold_C "T50 voltage threshold" VALUE 0x39AAE4 Scalar_SWORD 0 Ad_mv 0.0 5000.0 /end CHARACTERISTIC
/begin CHARACTERISTIC DDRC_DurDebT50_tiErrDebDef_C "Time from debounced signal is high for DFC_T50Err set" VALUE 0x386824 Scalar_ULONG 0 Debounce_ms 0.0 4.294967295E+9 /end CHARACTERISTIC
/begin CHARACTERISTIC DDRC_DurDebT50_tiErrDebOk_C "Time from debounced signal is high for DFC_T50Err reset" VALUE 0x386828 Scalar_ULONG 0 Debounce_ms 0.0 4.294967295E+9 /end CHARACTERISTIC
/begin CHARACTERISTIC T50_tiEmgcyReq_C "Applicable time for emergency request" VALUE 0x39AAE0 Scalar_ULONG 0 Debounce_ms 0.0 4.294967295E+9 /end CHARACTERISTIC
/begin CHARACTERISTIC Oil_pMaxP_CUR "Transformation curve to search the max oil pressure corresponding to current engine speed" CURVE 0x3955A6 Lookup1D_WORD 0 AirPressure_kPa 0.0 1200.0
 /begin AXIS_DESCR COM_AXIS Epm_nEng EngSpeed_rpm 16 0.0 6000.0 AXIS_PTS_REF Oil_pMaxP_CURX /end AXIS_DESCR
/end CHARACTERISTIC
/begin CHARACTERISTIC Oil_pMinP_CUR "Transformation curve to search the min oil pressure corresponding to current engine speed" CURVE 0x3955E6 Lookup1D_WORD 0 AirPressure_kPa 0.0 1200.0
 /begin AXIS_DESCR COM_AXIS Epm_nEng EngSpeed_rpm 16 0.0 6000.0 AXIS_PTS_REF Oil_pMinP_CURX /end AXIS_DESCR
/end CHARACTERISTIC
/begin CHARACTERISTIC Oil_pTransfPSwmp_CUR "Transformation curve to convert the voltage value to pressure value" CURVE 0x395628 Lookup1D_WORD 0 AirPressure_kPa 0.0 1200.0
 /begin AXIS_DESCR COM_AXIS Oil_uRawPSwmp Ad_mv 25 0.0 5000.0 AXIS_PTS_REF Oil_pTransfPSwmp_CURX /end AXIS_DESCR
/end CHARACTERISTIC
/begin CHARACTERISTIC OilP_tiPlusDebHiLo_C "Parameter structure for debounce times of main brake switch / Time for a Low to High transition" VALUE 0x395590 Scalar_ULONG 0 Debounce_ms 0.0 65535.0 /end CHARACTERISTIC
/begin CHARACTERISTIC OilP_tiPlusDebLoHi_C "Parameter structure for debounce times of main brake switch / Time for a Low to High transition" VALUE 0x395594 Scalar_ULONG 0 Debounce_ms 0.0 65535.0 /end CHARACTERISTIC
/begin CHARACTERISTIC Oil_tiPhysRngHiPSwmpDefDeb_C "Debounc time for checking defect of DFC_OilPSwmpPhysRngHi" VALUE 0x3956E4 Scalar_ULONG 0 Debounce_ms 0.0 65535.0 /end CHARACTERISTIC
/begin CHARACTERISTIC Oil_tiPhysRngHiPSwmpOKDeb_C "Debounc time for checking defect of DFC_OilPSwmpPhysRngHi" VALUE 0x3956E8 Scalar_ULONG 0 Debounce_ms 0.0 65535.0 /end CHARACTERISTIC
/begin CHARACTERISTIC Oil_tiPhysRngLoPSwmpDefDeb_C "Debounc time for checking defect of DFC_OilPSwmpPhysRngLo" VALUE 0x3956EC Scalar_ULONG 0 Debounce_ms 0.0 65535.0 /end CHARACTERISTIC
/begin CHARACTERISTIC Oil_tiPhysRngLoPSwmpOKDeb_C "Debounc time for checking defect of DFC_OilPSwmpPhysRngLo" VALUE 0x3956F0 Scalar_ULONG 0 Debounce_ms 0.0 65535.0 /end CHARACTERISTIC
/begin CHARACTERISTIC Oil_tiSRCMaxPSwmpDefDeb_C "Debounc time for checking defect of DFC_OilPSwmpSRCMax" VALUE 0x3956FC Scalar_ULONG 0 Debounce_ms 0.0 65535.0 /end CHARACTERISTIC
/begin CHARACTERISTIC Oil_tiSRCMaxPSwmpOKDeb_C "Debounc time for checking defect of DFC_OilPSwmpSRCMax" VALUE 0x395700 Scalar_ULONG 0 Debounce_ms 0.0 65535.0 /end CHARACTERISTIC
/begin CHARACTERISTIC Oil_tiSRCMinPSwmpDefDeb_C "Debounc time for checking defect of DFC_OilPSwmpSRCMin" VALUE 0x395704 Scalar_ULONG 0 Debounce_ms 0.0 65535.0 /end CHARACTERISTIC
/begin CHARACTERISTIC Oil_tiSRCMinPSwmpOKDeb_C "Debounc time for checking defect of DFC_OilPSwmpSRCMin" VALUE 0x395708 Scalar_ULONG 0 Debounce_ms 0.0 65535.0 /end CHARACTERISTIC
/begin CHARACTERISTIC Oil_uSRCPSwmpMax_C "Signal Range Check / Threshold for SRC -Max detection" VALUE 0x39570C Scalar_SWORD 0 Ad_mv 0.0 5000.0 /end CHARACTERISTIC
/begin CHARACTERISTIC Oil_uSRCPSwmpMin_C "Signal Range Check / Threshold for SRC -Min detection" VALUE 0x39570E Scalar_SWORD 0 Ad_mv 0.0 5000.0 /end CHARACTERISTIC
/begin CHARACTERISTIC Oil_tLimP_C "Threshold for Oil temperature" VALUE 0x395690 Scalar_SWORD 0 Temp_deg -50.0 150.0 /end CHARACTERISTIC
/begin CHARACTERISTIC Oil_pAnaHi_C "Oil pressure value when sensor type is analog" VALUE 0x3955A4 Scalar_SWORD 0 AirPressure_kPa 0.0 3276.0 /end CHARACTERISTIC
/begin AXIS_PTS Oil_pMaxP_CURX "Epm_nEng" 0x3955C6 Epm_nEng Lookup1D_X_WORD 0 EngSpeed_rpm 16 0.0 6000.0 /end AXIS_PTS
/begin AXIS_PTS Oil_pMinP_CURX "Epm_nEng" 0x395606 Epm_nEng Lookup1D_X_WORD 0 EngSpeed_rpm 16 0.0 6000.0 /end AXIS_PTS
/begin AXIS_PTS Oil_pTransfPSwmp_CURX "Oil_uRawPSwmp" 0x39565A Oil_uRawPSwmp Lookup1D_X_WORD 0 Ad_mv 25 0.0 5000.0 /end AXIS_PTS
/begin CHARACTERISTIC Oil_RmpSlpPNeg_C "Parameter for Ramp 1 / negative ramp slope" VALUE 0x395598 Scalar_SWORD 0 AirPressure_kPa_s -1200.0 1200.0 /end CHARACTERISTIC
/begin CHARACTERISTIC Oil_RmpSlpPPos_C "Parameter for Ramp 1 / Slope if the ramp has to be increased" VALUE 0x39559A Scalar_SWORD 0 AirPressure_kPa_s -1200.0 1200.0 /end CHARACTERISTIC
/begin CHARACTERISTIC Oil_pTransStgDfl_C "Default oil pressure value " VALUE 0x395626 Scalar_SWORD 0 AirPressure_kPa 0.0 1200.0 /end CHARACTERISTIC
/begin CHARACTERISTIC SigTst_pOilPSwmp_C "Set oil pressure by hand" VALUE 0x398040 Scalar_SWORD 0 AirPressure_kPa 0.0 1200.0 /end CHARACTERISTIC
/begin CHARACTERISTIC Oil_facPT1FltP_C "Time constant of PT1 filter for oil pressure" VALUE 0x3955A0 Scalar_UWORD 0 PT_fac 0.0 99.9985 /end CHARACTERISTIC
/begin CHARACTERISTIC Oil_swtPresSensTyp_C "digital sensor Oil_swtPresSensTyp_C == 0 otherwise  analog sensor" VALUE 0x39568C Scalar_UBYTE 0 Switch_conv 0 1 /end CHARACTERISTIC
/begin CHARACTERISTIC SigTst_swtOilPSwmp_C "Switch for oil pressure by hand" VALUE 0x398083 Scalar_UBYTE 0 Switch_conv 0 1 /end CHARACTERISTIC
/begin CHARACTERISTIC Oil_tTransfT_CUR "Transformation aixs to convert the voltage value to temperature value" CURVE 0x395694 Lookup1D_WORD 0 Temp_deg -50.0 200.0
 /begin AXIS_DESCR COM_AXIS Oil_uRawTSwmp Ad_mv 16 0.0 5000.0 AXIS_PTS_REF Oil_tTransfT_CURX /end AXIS_DESCR
/end CHARACTERISTIC
/begin CHARACTERISTIC Oil_tiMaxTDefDeb_C "Debounc time for checking heal of DFC_OilTSRCMax" VALUE 0x3956D4 Scalar_ULONG 0 Debounce_ms 0.0 65535.0 /end CHARACTERISTIC
/begin CHARACTERISTIC Oil_tiMaxTOKDeb_C "Debounc time for checking heal of DFC_OilTSRCMax" VALUE 0x3956D8 Scalar_ULONG 0 Debounce_ms 0.0 65535.0 /end CHARACTERISTIC
/begin CHARACTERISTIC Oil_tiMinTDefDeb_C "Debounc time for checking heal of DFC_OilTSRCMin" VALUE 0x3956DC Scalar_ULONG 0 Debounce_ms 0.0 65535.0 /end CHARACTERISTIC
/begin CHARACTERISTIC Oil_tiMinTOKDeb_C "Debounc time for checking heal of DFC_OilTSRCMin" VALUE 0x3956E0 Scalar_ULONG 0 Debounce_ms 0.0 65535.0 /end CHARACTERISTIC
/begin CHARACTERISTIC Oil_uSRCTMax_C "Signal Range Check / Threshold for SRC -Max detection" VALUE 0x395710 Scalar_SWORD 0 Ad_mv 0.0 5000.0 /end CHARACTERISTIC
/begin CHARACTERISTIC Oil_uSRCTMin_C "Signal Range Check / Threshold for SRC -Min detection" VALUE 0x395712 Scalar_SWORD 0 Ad_mv 0.0 5000.0 /end CHARACTERISTIC
/begin AXIS_PTS Oil_tTransfT_CURX "Oil_uRawTSwmp" 0x3956B4 Oil_uRawTSwmp Lookup1D_X_WORD 0 Ad_mv 16 0.0 5000.0 /end AXIS_PTS
/begin CHARACTERISTIC Oil_tiPlausTDefDeb_C "Debounc time for checking PlausError" VALUE 0x3956F4 Scalar_ULONG 0 Debounce_ms 0.0 65535.0 /end CHARACTERISTIC
/begin CHARACTERISTIC Oil_tiPlausTOKDeb_C "Debounc time for checking PlausError" VALUE 0x3956F8 Scalar_ULONG 0 Debounce_ms 0.0 65535.0 /end CHARACTERISTIC
/begin CHARACTERISTIC Oil_RmpSlpTNeg_C "Negative ramp slope" VALUE 0x39559C Scalar_SWORD 0 Temp_deg_s -200.0 200.0 /end CHARACTERISTIC
/begin CHARACTERISTIC Oil_RmpSlpTPos_C "Positive ramp slope" VALUE 0x39559E Scalar_SWORD 0 Temp_deg_s -200.0 200.0 /end CHARACTERISTIC
/begin CHARACTERISTIC Oil_tDiffMaxHiT_C "absolute difference between the oil temperture and the CEngDst" VALUE 0x39568E Scalar_SWORD 0 Temp_deg -200.0 200.0 /end CHARACTERISTIC
/begin CHARACTERISTIC Oil_tTransStgTDfl_C "Default oil temperature value " VALUE 0x395692 Scalar_SWORD 0 Temp_deg -50.0 150.0 /end CHARACTERISTIC
/begin CHARACTERISTIC SigTst_tOilTSwmp_C "Set oil temperature by hand" VALUE 0x3980A2 Scalar_SWORD 0 Temp_deg -50.0 200.0 /end CHARACTERISTIC
/begin CHARACTERISTIC Oil_facSerPT1T_C "Filter factor" VALUE 0x3955A2 Scalar_UWORD 0 PT_fac 0.0 99.9985 /end CHARACTERISTIC
/begin CHARACTERISTIC SigTst_swtOilTSwmp_C "Switch for oil temperature by hand" VALUE 0x398084 Scalar_UBYTE 0 Switch_conv 0 1 /end CHARACTERISTIC
/begin CHARACTERISTIC Strt_stPsDisbl_C "Status of powerstage disable/enable" VALUE 0x39AAC4 Scalar_UWORD 0 State_uint16 0.0 65535.0 /end CHARACTERISTIC
/begin CHARACTERISTIC FlFWLvl_tiSensSigRawDebHiLo_C "Structure for the time debounce parameter for the digital input / Time for a High to Low transition" VALUE 0x389CD0 Scalar_ULONG 0 Debounce_ms 0.0 65535.0 /end CHARACTERISTIC
/begin CHARACTERISTIC FlFWLvl_tiSensSigRawDebLoHi_C "Structure for the time debounce parameter for the digital input / Time for a Low to High transition" VALUE 0x389CD4 Scalar_ULONG 0 Debounce_ms 0.0 65535.0 /end CHARACTERISTIC
/begin CHARACTERISTIC SigTst_stFlFWLv_C "water level in the fuel filter " VALUE 0x398060 Scalar_BOOLEAN 0 boolean 0.0 1.0 /end CHARACTERISTIC
/begin CHARACTERISTIC SigTst_swtFlFWLv_C "Switch for water level in the fuel filter by hand" VALUE 0x398078 Scalar_UBYTE 0 Switch_conv 0 1 /end CHARACTERISTIC
/begin CHARACTERISTIC FlFltCtl_tHysHi_C "Maximum fuel temperature threshold for fuel filterheating control" VALUE 0x389CDC Scalar_SWORD 0 Temp_deg -50.0 150.0 /end CHARACTERISTIC
/begin CHARACTERISTIC FlFltCtl_tHysLo_C "Minimum fuel temperature threshold for fuel filterheating control" VALUE 0x389CDE Scalar_SWORD 0 Temp_deg -50.0 150.0 /end CHARACTERISTIC
/begin CHARACTERISTIC FlFltCtl_nHtThres_C "Engine speed threshold for deactivating the FuelFilter heating during start" VALUE 0x389CDA Scalar_SWORD 0 EngSpeed_rpm 0.0 6000.0 /end CHARACTERISTIC
/begin CHARACTERISTIC FlFltCtl_SwtSigSel_C "Switch for selection of fuel system temperature(0:EDC internal calculation;1:Acquisition via CAN)" VALUE 0x389CD8 Scalar_BOOLEAN 0 boolean 0.0 1.0 /end CHARACTERISTIC
/begin CHARACTERISTIC FlWLmp_stPsDiaDisbl_C "Application parameter to disable diagnosis of power stage under certain battery and engine conditions" VALUE 0x389D0A Scalar_UWORD 0 State_uint16 0.0 65535.0 /end CHARACTERISTIC
/begin CHARACTERISTIC FlWLmp_stPsDisbl_C "Mask to enable / disable power stage" VALUE 0x389D0C Scalar_UWORD 0 State_uint16 0.0 65535.0 /end CHARACTERISTIC
/begin CHARACTERISTIC FlWLmp_O_D_ATS "Signal test of water in fuel lamp" VALUE 0x389D08 Scalar_BOOLEAN 0 boolean 0.0 1.0 /end CHARACTERISTIC
/begin CHARACTERISTIC SigTst_swtFlWLmp_C "Switch for water level in the fuel lamp by hand" VALUE 0x398079 Scalar_UBYTE 0 Switch_conv 0 1 /end CHARACTERISTIC
/begin CHARACTERISTIC FuelT_tTransf_CUR "Transformation curve to convert the voltage value to temperature value" CURVE 0x389D90 Lookup1D_WORD 0 Temp_deg -200.0 200.0
 /begin AXIS_DESCR COM_AXIS FuelT_uRaw Ad_mv 25 0.0 5000.0 AXIS_PTS_REF FuelT_tTransf_CURX /end AXIS_DESCR
/end CHARACTERISTIC
/begin CHARACTERISTIC FuelT_tiMaxDefDeb_C "Debounc time for checking defect of DFC_FuelTSRCMax or heal of DFC_FuelTSRCMax" VALUE 0x389DF4 Scalar_ULONG 0 Debounce_ms 0.0 65535.0 /end CHARACTERISTIC
/begin CHARACTERISTIC FuelT_tiMaxOKDeb_C "Debounc time for checking defect of DFC_FuelTSRCMax or heal of DFC_FuelTSRCMax" VALUE 0x389DF8 Scalar_ULONG 0 Debounce_ms 0.0 65535.0 /end CHARACTERISTIC
/begin CHARACTERISTIC FuelT_tiMinDefDeb_C "Debounc time for checking defect of DFC_FuelTSRCMin or heal of DFC_FuelTSRCMin" VALUE 0x389DFC Scalar_ULONG 0 Debounce_ms 0.0 65535.0 /end CHARACTERISTIC
/begin CHARACTERISTIC FuelT_tiMinOKDeb_C "Debounc time for checking defect of DFC_FuelTSRCMin or heal of DFC_FuelTSRCMin" VALUE 0x389E00 Scalar_ULONG 0 Debounce_ms 0.0 65535.0 /end CHARACTERISTIC
/begin CHARACTERISTIC FuelT_tiPlausHiDefDeb_C "Debounc time for checking defect of DFC_FuelTPlausHi or  heal of DFC_FuelTPlausHi" VALUE 0x389E04 Scalar_ULONG 0 Debounce_ms 0.0 65535.0 /end CHARACTERISTIC
/begin CHARACTERISTIC FuelT_tiPlausHiOKDeb_C "Debounc time for checking defect of DFC_FuelTPlausHi or  heal of DFC_FuelTPlausHi" VALUE 0x389E08 Scalar_ULONG 0 Debounce_ms 0.0 65535.0 /end CHARACTERISTIC
/begin CHARACTERISTIC FuelT_tiPlausLoDefDeb_C "Debounc time for checking defect of DFC_FuelTPlausLo or  heal of DFC_FuelTPlausLo" VALUE 0x389E0C Scalar_ULONG 0 Debounce_ms 0.0 65535.0 /end CHARACTERISTIC
/begin CHARACTERISTIC FuelT_tiPlausLoOKDeb_C "Debounc time for checking defect of DFC_FuelTPlausLo or  heal of DFC_FuelTPlausLo" VALUE 0x389E10 Scalar_ULONG 0 Debounce_ms 0.0 65535.0 /end CHARACTERISTIC
/begin CHARACTERISTIC FuelT_uSRCMax_C "Signal Range Check / Threshold for SRC -Max detection" VALUE 0x389E14 Scalar_SWORD 0 Ad_mv 0.0 5000.0 /end CHARACTERISTIC
/begin CHARACTERISTIC FuelT_uSRCMin_C "Signal Range Check / Threshold for SRC -Min detection" VALUE 0x389E16 Scalar_SWORD 0 Ad_mv 0.0 5000.0 /end CHARACTERISTIC
/begin CHARACTERISTIC FuelT_tDiffMaxHi_C " Maximum difference threshold for the  fuel temperature sensor value" VALUE 0x389D8A Scalar_SWORD 0 Temp_deg -200.0 200.0 /end CHARACTERISTIC
/begin CHARACTERISTIC FuelT_tDiffMaxLo_C " Maximum difference threshold for the  fuel temperature sensor value" VALUE 0x389D8C Scalar_SWORD 0 Temp_deg -200.0 200.0 /end CHARACTERISTIC
/begin CHARACTERISTIC FuelT_swtTempPlaSel_C "Switch for the second temperature for Plaubisility Range Check" VALUE 0x389D86 Scalar_UBYTE 0 Switch_conv 0 1 /end CHARACTERISTIC
/begin AXIS_PTS FuelT_tTransf_CURX "FuelT_uRaw" 0x389DC2 FuelT_uRaw Lookup1D_X_WORD 0 Ad_mv 25 0.0 5000.0 /end AXIS_PTS
/begin CHARACTERISTIC FuelT_RmpSlpNeg_C "Parameter for Ramp 1 / negative ramp slope" VALUE 0x389D80 Scalar_SWORD 0 Temp_deg_s -200.0 200.0 /end CHARACTERISTIC
/begin CHARACTERISTIC FuelT_RmpSlpPos_C "Parameter for Ramp 1 / Slope if the ramp has to be increased" VALUE 0x389D82 Scalar_SWORD 0 Temp_deg_s -200.0 200.0 /end CHARACTERISTIC
/begin CHARACTERISTIC FuelT_tDflFlSys_C "Fuel System temperature default value" VALUE 0x389D88 Scalar_SWORD 0 Temp_deg -200.0 200.0 /end CHARACTERISTIC
/begin CHARACTERISTIC FuelT_tTransStgDfl_C "Default fuel temperature value for cold engine conditions" VALUE 0x389D8E Scalar_SWORD 0 Temp_deg -200.0 200.0 /end CHARACTERISTIC
/begin CHARACTERISTIC SigTst_tFuelT_C "Set Fuel temperature by hand" VALUE 0x39809E Scalar_SWORD 0 Temp_deg -200.0 200.0 /end CHARACTERISTIC
/begin CHARACTERISTIC FuelT_facSerPT1T_C "Time constant of PT1 filter for Fuel temperature" VALUE 0x389D84 Scalar_UWORD 0 PT_fac 0.0 99.9985 /end CHARACTERISTIC
/begin CHARACTERISTIC FuelT_swtTempSel_C "Switch to select the temperature for fuel system evaluation" VALUE 0x389D87 Scalar_UBYTE 0 State_uint8 0.0 2.0 /end CHARACTERISTIC
/begin CHARACTERISTIC SigTst_swtFuelT_C "Switch for Fuel temperature by hand" VALUE 0x39807B Scalar_UBYTE 0 Switch_conv 0 1 /end CHARACTERISTIC
/begin CHARACTERISTIC MeUn_tiPer_CUR "Curve for period duration of the PWM power stage" CURVE 0x39500A Lookup1D_UWORD 0 Period_us 0.0 6553.0
 /begin AXIS_DESCR COM_AXIS MeUn_nDiffRef_mp EngSpeed_rpm 30 0.0 6000.0 AXIS_PTS_REF MeUn_tiPer_CURX /end AXIS_DESCR
/end CHARACTERISTIC
/begin CHARACTERISTIC MeUn_rSetLin_CUR "Linearised setpoint of the metering unit duty cycle" CURVE 0x394FE6 Lookup1D_WORD 0 DutyCycle_rate 0.0 100.0
 /begin AXIS_DESCR COM_AXIS MeUn_rSet_mp DutyCycle_rate 4 0.0 100.0 AXIS_PTS_REF MeUn_rSetLin_CURX /end AXIS_DESCR
/end CHARACTERISTIC
/begin CHARACTERISTIC MeUn_rPwmOutMax_CUR "Class for output duty cycle parameter / Maximum threshold for the duty cycle" CURVE 0x394FD4 Lookup1D_WORD 0 DutyCycle_rate 0.0 100.0
 /begin AXIS_DESCR COM_AXIS BattU_u Battery_mv 3 0.0 50000.0 AXIS_PTS_REF MeUn_rPwmOutMax_CURX /end AXIS_DESCR
/end CHARACTERISTIC
/begin CHARACTERISTIC MeUn_resCoil_C "Resistance value of the coil for the metering unit" VALUE 0x394FF6 Scalar_UWORD 0 MeUn_Resistance_mOhm 0.0 65535.0 /end CHARACTERISTIC
/begin CHARACTERISTIC MeUn_uBattHi_C "Upper voltage level after which the frequency of the metering unit is switched to the normal value" VALUE 0x39509C Scalar_UWORD 0 Battery_mv 0.0 50000.0 /end CHARACTERISTIC
/begin CHARACTERISTIC MeUn_uBattLo_C "Lower voltage level after which the frequency of the metering unit is switched to the normal value" VALUE 0x39509E Scalar_UWORD 0 Battery_mv 0.0 50000.0 /end CHARACTERISTIC
/begin CHARACTERISTIC MeUn_CrntCtlDT1T1_C "Class for DT1 current governor parameter / Reciprocal of time delay T1 ( 2^32 / T1; T1 in same quantisation as Dt)" VALUE 0x394E6C Scalar_SWORD 0 Factor 0.01 0.99 /end CHARACTERISTIC
/begin CHARACTERISTIC MeUn_nDiffMax_C "Maximum difference between filtered engine speed for a curve and current engine speed for applying new speed value" VALUE 0x394F92 Scalar_SWORD 0 EngSpeed_rpm 0.0 6000.0 /end CHARACTERISTIC
/begin CHARACTERISTIC MeUn_CrntCtlDT1Kd_C "Class for DT1 current governor parameter / Differential factor Kd = Td/T1" VALUE 0x394E6A Scalar_UWORD 0 Pid_Kp_Kd 0.0 15.0 /end CHARACTERISTIC
/begin CHARACTERISTIC MeUn_rPwmOutMin_C "Class for output duty cycle parameter / Minimum threshold for the duty cycle" VALUE 0x394FE0 Scalar_SWORD 0 DutyCycle_rate 0.0 100.0 /end CHARACTERISTIC
/begin CHARACTERISTIC SigTst_rMeUnDuty_C "Set duty cycle by hand" VALUE 0x398056 Scalar_SWORD 0 DutyCycle_rate 0.0 100.0 /end CHARACTERISTIC
/begin CHARACTERISTIC MeUn_tiPerUBattHi_C "Period duration of the metering unit PWM power stage in the case of increased battery voltage" VALUE 0x395008 Scalar_UWORD 0 Period_us 0.0 6553.0 /end CHARACTERISTIC
/begin CHARACTERISTIC MeUn_stHSAct_C "state of high side of metering unit" VALUE 0x394FF9 Scalar_UBYTE 0 State_uint8 0.0 255.0 /end CHARACTERISTIC
/begin CHARACTERISTIC MeUn_stPwrStgActv_C "Metering unit high side power stage active or not" VALUE 0x394FFA Scalar_UBYTE 0 State_uint8 0.0 255.0 /end CHARACTERISTIC
/begin CHARACTERISTIC MeUn_stPwrStgDia_C "Status word for specifying the shut-off behaviour of the metering unit high side power stage error diagnosis" VALUE 0x394FFB Scalar_UBYTE 0 State_uint8 0.0 255.0 /end CHARACTERISTIC
/begin CHARACTERISTIC MeUn_swtBattCor_C "Class for output duty cycle parameter / Switch to enable battery voltage correction" VALUE 0x394FFD Scalar_UBYTE 0 Switch_conv 0 1 /end CHARACTERISTIC
/begin CHARACTERISTIC SigTst_swtMeUnDuty_C "Switch for  duty cycle by hand" VALUE 0x398082 Scalar_UBYTE 0 Switch_conv 0 1 /end CHARACTERISTIC
/begin AXIS_PTS MeUn_tiPer_CURX "MeUn_nDiffRef_mp" 0x395046 MeUn_nDiffRef_mp Lookup1D_X_WORD 0 EngSpeed_rpm 30 0.0 6000.0 /end AXIS_PTS
/begin AXIS_PTS MeUn_rSetLin_CURX "MeUn_rSet_mp" 0x394FEE MeUn_rSet_mp Lookup1D_X_WORD 0 DutyCycle_rate 4 0.0 100.0 /end AXIS_PTS
/begin AXIS_PTS MeUn_rPwmOutMax_CURX "BattU_u" 0x394FDA BattU_u Lookup1D_X_UWORD 0 Battery_mv 3 0.0 50000.0 /end AXIS_PTS
/begin CHARACTERISTIC MeUn_rLin_CUR "the curve of duty cycle of metering unit" CURVE 0x394F94 Lookup1D_WORD 0 DutyCycle_rate 0.0 100.0
 /begin AXIS_DESCR COM_AXIS FuelT_t Temp_deg 16 -50.0 150.0 AXIS_PTS_REF MeUn_rLin_CURX /end AXIS_DESCR
/end CHARACTERISTIC
/begin CHARACTERISTIC MeUn_ctRot_C "counter of state of anchor rotation function of metering unit" VALUE 0x394EBC Scalar_ULONG 0 Counter_num 0.0 65535.0 /end CHARACTERISTIC
/begin CHARACTERISTIC MeUn_tiRotDel_C "debounce time" VALUE 0x395084 Scalar_ULONG 0 Debounce_ms 0.0 65535.0 /end CHARACTERISTIC
/begin CHARACTERISTIC MeUn_tiRotWait_C "debounce time" VALUE 0x395088 Scalar_ULONG 0 Debounce_ms 0.0 65535.0 /end CHARACTERISTIC
/begin CHARACTERISTIC MeUn_rRotEnd_C "duty cycle of metering unit of ending" VALUE 0x394FE2 Scalar_SWORD 0 DutyCycle_rate 0.0 100.0 /end CHARACTERISTIC
/begin CHARACTERISTIC MeUn_rRotStrt_C "duty cycle of metering unit of starting" VALUE 0x394FE4 Scalar_SWORD 0 DutyCycle_rate 0.0 100.0 /end CHARACTERISTIC
/begin CHARACTERISTIC MeUn_stRotActv_C "state of active anchor rotation function of metering unit" VALUE 0x394FFC Scalar_BOOLEAN 0 boolean 0.0 1.0 /end CHARACTERISTIC
/begin AXIS_PTS MeUn_rLin_CURX "FuelT_t" 0x394FB4 FuelT_t Lookup1D_X_WORD 0 Temp_deg 16 -50.0 150.0 /end AXIS_PTS
/begin CHARACTERISTIC MeUn_VoltLin_CUR "MeUn voltage sampling linearization" CURVE 0x394E78 Lookup1D_WORD 0 Ad_mv 0.0 5000.0
 /begin AXIS_DESCR COM_AXIS MeUn_uRaw Ad_mv 16 0.0 5000.0 AXIS_PTS_REF MeUn_VoltLin_CURX /end AXIS_DESCR
/end CHARACTERISTIC
/begin CHARACTERISTIC MeUn_facCrntCtlInit_CUR "Initail factor for Meun governor" CURVE 0x394EC0 Lookup1D_UWORD 0 Pid_Kp_Kd 0.0 15.0
 /begin AXIS_DESCR COM_AXIS NO_INPUT_QUANTITY Temp_deg 16 -200.0 200.0 AXIS_PTS_REF MeUn_facCrntCtlInit_CURX /end AXIS_DESCR
/end CHARACTERISTIC
/begin CHARACTERISTIC MeUn_facCrntOpenCtl_CUR "MeUn Current Open Control Factor" CURVE 0x394F04 Lookup1D_UWORD 0 Pid_Kp_Kd 0.0 15.0
 /begin AXIS_DESCR COM_AXIS NO_INPUT_QUANTITY Temp_deg 16 -200.0 200.0 AXIS_PTS_REF MeUn_facCrntOpenCtl_CURX /end AXIS_DESCR
/end CHARACTERISTIC
/begin CHARACTERISTIC MeUn_iCnvFlowRate_CUR "Curve for converting volume flow to current" CURVE 0x394F48 Lookup1D_WORD 0 Current_mA -12000.0 12000.0
 /begin AXIS_DESCR COM_AXIS MeUn_dvolSet FuelVol_mm3_s 16 -327680.0 327670.0 AXIS_PTS_REF MeUn_iCnvFlowRate_CURX /end AXIS_DESCR
/end CHARACTERISTIC
/begin CHARACTERISTIC MeUn_iLin_CUR "Analog input, linearisation curve" CURVE 0x394F88 Lookup1D_WORD 0 Current_mA -12000.0 12000.0
 /begin AXIS_DESCR COM_AXIS NO_INPUT_QUANTITY Ad_mv 2 0.0 5000.0 AXIS_PTS_REF MeUn_iLin_CURX /end AXIS_DESCR
/end CHARACTERISTIC
/begin CHARACTERISTIC MeUn_tiCrntCtlInit_C "time for Initial value use when started" VALUE 0x395004 Scalar_ULONG 0 Debounce_ms 0.0 655350.0 /end CHARACTERISTIC
/begin CHARACTERISTIC MeUn_tiSRCMaxDefDeb_C "debounce time of SRCMaxDef" VALUE 0x39508C Scalar_ULONG 0 Debounce_ms 0.0 65535.0 /end CHARACTERISTIC
/begin CHARACTERISTIC MeUn_tiSRCMaxOKDeb_C "debounce time of SRCMaxOK" VALUE 0x395090 Scalar_ULONG 0 Debounce_ms 0.0 65535.0 /end CHARACTERISTIC
/begin CHARACTERISTIC MeUn_tiSRCMinDefDeb_C "debounce time of SRCMinDef" VALUE 0x395094 Scalar_ULONG 0 Debounce_ms 0.0 65535.0 /end CHARACTERISTIC
/begin CHARACTERISTIC MeUn_tiSRCMinOKDeb_C "debounce time of SRCMinOK" VALUE 0x395098 Scalar_ULONG 0 Debounce_ms 0.0 65535.0 /end CHARACTERISTIC
/begin CHARACTERISTIC MeUn_uSRCMax_C "Class for default values for signal range check analog input / Threshold for SRC -Max detection" VALUE 0x3950A0 Scalar_SWORD 0 Ad_mv 0.0 5000.0 /end CHARACTERISTIC
/begin CHARACTERISTIC MeUn_uSRCMin_C "Class for default values for signal range check analog input / Threshold for SRC -Min detection" VALUE 0x3950A2 Scalar_SWORD 0 Ad_mv -5000.0 5000.0 /end CHARACTERISTIC
/begin CHARACTERISTIC MeUn_tDefltTemp_C "Default Temperature of system normal state" VALUE 0x395000 Scalar_SWORD 0 Temp_deg -200.0 200.0 /end CHARACTERISTIC
/begin CHARACTERISTIC MeUn_tTempInitThrsd_C "Threshold temperature of deviation for Initial Value use" VALUE 0x395002 Scalar_SWORD 0 Temp_deg -200.0 200.0 /end CHARACTERISTIC
/begin CHARACTERISTIC MeUn_CrntCtlIKiNeg_C "Class for I element parameter / Ki_C factor below the window" VALUE 0x394E6E Scalar_UWORD 0 Pid_Ki 0.0 65.0 /end CHARACTERISTIC
/begin CHARACTERISTIC MeUn_CrntCtlIKiPos_C "Class for I element parameter / Ki_C factor above the window" VALUE 0x394E70 Scalar_UWORD 0 Pid_Ki 0.0 65.0 /end CHARACTERISTIC
/begin CHARACTERISTIC MeUn_CrntCtlIKi_C "Class for I element parameter / Ki_C factor within the window" VALUE 0x394E72 Scalar_UWORD 0 Pid_Ki 0.0 65.0 /end CHARACTERISTIC
/begin CHARACTERISTIC MeUn_facCrntCtlMax_C "Maximum I component" VALUE 0x394F00 Scalar_UWORD 0 Pid_Kp_Kd 0.0 15.0 /end CHARACTERISTIC
/begin CHARACTERISTIC MeUn_facCrntCtlMin_C "Minimum I component" VALUE 0x394F02 Scalar_UWORD 0 Pid_Kp_Kd 0.0 15.0 /end CHARACTERISTIC
/begin CHARACTERISTIC MeUn_CrntCtlIWinNeg_C "Class for I element parameter / Lower border of the window" VALUE 0x394E74 Scalar_SWORD 0 Current_mA -12000.0 12000.0 /end CHARACTERISTIC
/begin CHARACTERISTIC MeUn_CrntCtlIWinPos_C "Class for I element parameter / Upper border of the window" VALUE 0x394E76 Scalar_SWORD 0 Current_mA -12000.0 12000.0 /end CHARACTERISTIC
/begin CHARACTERISTIC MeUn_iSetMin_C "Setpoint current for electrical shut-off of the metering unit" VALUE 0x394F90 Scalar_SWORD 0 Current_mA -12000.0 12000.0 /end CHARACTERISTIC
/begin CHARACTERISTIC SigTst_iMeUnCurrent_C "Set duty current by hand" VALUE 0x398034 Scalar_SWORD 0 Current_mA -12000.0 12000.0 /end CHARACTERISTIC
/begin CHARACTERISTIC MeUn_facFlt1PT1_C "PT1 filter time constant for actual current value" VALUE 0x394F44 Scalar_UWORD 0 PT_fac 0.0 99.9985 /end CHARACTERISTIC
/begin CHARACTERISTIC MeUn_facFlt2PT1_C "PT2 filter time constant for actual current value" VALUE 0x394F46 Scalar_UWORD 0 PT_fac 0.0 99.9985 /end CHARACTERISTIC
/begin CHARACTERISTIC MeUn_stActrCtl_C "State of actuator value control for metering unit" VALUE 0x394FF8 Scalar_UBYTE 0 State_uint8 0.0 255.0 /end CHARACTERISTIC
/begin CHARACTERISTIC MeUn_bCrntClsdCtl_C "switch for open or close loop control" VALUE 0x394EB8 Scalar_BOOLEAN 0 boolean 0.0 1.0 /end CHARACTERISTIC
/begin CHARACTERISTIC MeUn_bFiterAct_C "IIR Fiter Active or not" VALUE 0x394EB9 Scalar_BOOLEAN 0 boolean 0.0 1.0 /end CHARACTERISTIC
/begin CHARACTERISTIC MeUn_bFuelTFit_C "select FuelT sensor exist or not" VALUE 0x394EBA Scalar_BOOLEAN 0 boolean 0.0 1.0 /end CHARACTERISTIC
/begin CHARACTERISTIC MeUn_swtFrzICtl_C "switch to freeze I_MeUn part function" VALUE 0x394FFE Scalar_BOOLEAN 0 boolean 0.0 1.0 /end CHARACTERISTIC
/begin CHARACTERISTIC MeUn_swtVolt_C "switch of MeUn voltage sampling" VALUE 0x394FFF Scalar_BOOLEAN 0 boolean 0.0 1.0 /end CHARACTERISTIC
/begin CHARACTERISTIC SigTst_swtMeUnCurrent_C "Switch for  current by hand" VALUE 0x398081 Scalar_UBYTE 0 Switch_conv 0 1 /end CHARACTERISTIC
/begin AXIS_PTS MeUn_VoltLin_CURX "MeUn voltage sampling linearization" 0x394E98 MeUn_uRaw Lookup1D_X_WORD 0 Ad_mv 16 0.0 5000.0 /end AXIS_PTS
/begin AXIS_PTS MeUn_facCrntCtlInit_CURX "XAxis of curve, fuel or coolant temperature" 0x394EE0 NO_INPUT_QUANTITY Lookup1D_X_WORD 0 Temp_deg 16 -200.0 200.0 /end AXIS_PTS
/begin AXIS_PTS MeUn_facCrntOpenCtl_CURX "XAxis of curve, fuel or coolant temperature" 0x394F24 NO_INPUT_QUANTITY Lookup1D_X_WORD 0 Temp_deg 16 -200.0 200.0 /end AXIS_PTS
/begin AXIS_PTS MeUn_iCnvFlowRate_CURX "MeUn_dvolSetAdapt" 0x394F68 MeUn_dvolSet Lookup1D_X_WORD 0 FuelVol_mm3_s 16 -327680.0 327670.0 /end AXIS_PTS
/begin AXIS_PTS MeUn_iLin_CURX "MeUn_uRaw" 0x394F8C NO_INPUT_QUANTITY Lookup1D_X_WORD 0 Ad_mv 2 0.0 5000.0 /end AXIS_PTS
/begin CHARACTERISTIC RailP_pLin_CUR "Linearisation curve for fuel pressure sensor" CURVE 0x395AA8 Lookup1D_WORD 0 RailPressure_bar 0.0 2500.0
 /begin AXIS_DESCR COM_AXIS RailP_uRaw Ad_mv 4 0.0 5000.0 AXIS_PTS_REF RailP_pLin_CURX /end AXIS_DESCR
/end CHARACTERISTIC
/begin CHARACTERISTIC RailP_tiSRCMaxDefDeb_C "Debounce time for checking defect of RailP_bSRCMaxDeb" VALUE 0x395AE0 Scalar_ULONG 0 Debounce_ms 0.0 65535.0 /end CHARACTERISTIC
/begin CHARACTERISTIC RailP_tiSRCMaxOKDeb_C "Debounce time for checking heal of RailP_bSRCMaxDeb" VALUE 0x395AE4 Scalar_ULONG 0 Debounce_ms 0.0 65535.0 /end CHARACTERISTIC
/begin CHARACTERISTIC RailP_tiSRCMinDefDeb_C "Debounce time for checking defect of RailP_bSRCMinDeb" VALUE 0x395AE8 Scalar_ULONG 0 Debounce_ms 0.0 65535.0 /end CHARACTERISTIC
/begin CHARACTERISTIC RailP_tiSRCMinOKDeb_C "Debounce time for checking heal of RailP_bSRCMinDeb" VALUE 0x395AEC Scalar_ULONG 0 Debounce_ms 0.0 65535.0 /end CHARACTERISTIC
/begin CHARACTERISTIC RailP_uSRCMax_C "Threshold for SRC -Max detection" VALUE 0x395AF4 Scalar_SWORD 0 Ad_mv 0.0 5000.0 /end CHARACTERISTIC
/begin CHARACTERISTIC RailP_uSRCMin_C "Threshold for SRC -Min detection" VALUE 0x395AF6 Scalar_SWORD 0 Ad_mv 0.0 5000.0 /end CHARACTERISTIC
/begin AXIS_PTS RailP_pLin_CURX "RailP_uRaw" 0x395AB0 RailP_uRaw Lookup1D_X_WORD 0 Ad_mv 4 0.0 5000.0 /end AXIS_PTS
/begin CHARACTERISTIC PRV_tiCalcAvrgRP_C "calculation time of the averaged rail pressure" VALUE 0x39572C Scalar_ULONG 0 EngTime_ms 0.0 5000.0 /end CHARACTERISTIC
/begin CHARACTERISTIC PRV_tiOpnMax_C "Maximum open time till wear out of PRV" VALUE 0x395730 Scalar_ULONG 0 EngTime_ms 0.0 2.0E+7 /end CHARACTERISTIC
/begin CHARACTERISTIC PRV_tiWaitAvrgRP_C "stabilisation time before the verification of the averaged rail pressure" VALUE 0x395734 Scalar_ULONG 0 EngTime_ms 0.0 5000.0 /end CHARACTERISTIC
/begin CHARACTERISTIC PRV_tiWaitNVld_C "Waiting time to enshure save detection of engine speed at ECU start" VALUE 0x395738 Scalar_ULONG 0 EngTime_ms 0.0 1000.0 /end CHARACTERISTIC
/begin CHARACTERISTIC PRV_tiWaitPresInc_C "time period for the rail pressure build up before performing a rail pressure shock" VALUE 0x39573C Scalar_ULONG 0 EngTime_ms 0.0 1000.0 /end CHARACTERISTIC
/begin CHARACTERISTIC PRV_ClosePressureMin_C "PRV closed when the pressure below threshold value" VALUE 0x39571C Scalar_SWORD 0 RailPressure_bar 0.0 2000.0 /end CHARACTERISTIC
/begin CHARACTERISTIC PRV_pAvrgRPTol_C "rail pressure tolerance for detection of the openingof the pressure relief valve by the rail pressure evaluation" VALUE 0x39572A Scalar_SWORD 0 RailPressure_bar -500.0 500.0 /end CHARACTERISTIC
/begin CHARACTERISTIC PRV_nClsdMax_C "below this engine speed the PRV will close again even if it was open" VALUE 0x395724 Scalar_SWORD 0 EngSpeed_rpm 0.0 1000.0 /end CHARACTERISTIC
/begin CHARACTERISTIC PRV_nMinPresInc_C "The minimum engine speed to perform a pressure shock is determined" VALUE 0x395726 Scalar_SWORD 0 EngSpeed_rpm 0.0 1000.0 /end CHARACTERISTIC
/begin CHARACTERISTIC PRV_nOpnMin_C "engine speed threshold for detection of an opened pressure relief valve at startup of the ECU" VALUE 0x395728 Scalar_SWORD 0 EngSpeed_rpm 0.0 3000.0 /end CHARACTERISTIC
/begin CHARACTERISTIC PRV_dpRPGradOpn_CA0 "pattern of rail pressure gradients for recognition of the opening of the pressure relief valve" VALUE 0x395720 Scalar_SWORD 0 RailPressure_bar_ms -100.0 300.0 /end CHARACTERISTIC
/begin CHARACTERISTIC PRV_dpRPGradOpn_CA1 "pattern of rail pressure gradients for recognition of the opening of the pressure relief valve" VALUE 0x395722 Scalar_SWORD 0 RailPressure_bar_ms -100.0 300.0 /end CHARACTERISTIC
/begin CHARACTERISTIC PRV_ctOpnMax_C "Maximum number of opening cycles till wear out of PRV" VALUE 0x39571E Scalar_UBYTE 0 State_uint8 0.0 200.0 /end CHARACTERISTIC
/begin CHARACTERISTIC RailP_numMax_CUR "Curve that delivers the number of rail pressure max values" CURVE 0x395A58 Lookup1D_UBYTE 0 uint8 1.0 20.0
 /begin AXIS_DESCR COM_AXIS RailP_nRef_mp EngSpeed_rpm 10 0.0 6000.0 AXIS_PTS_REF RailP_numMax_CURX /end AXIS_DESCR
/end CHARACTERISTIC
/begin CHARACTERISTIC RailP_pSubsCtlDlvMeUn_CUR "Rail pressure for opened PRV and controlled delivery of MeUn" CURVE 0x395AB8 Lookup1D_WORD 0 RailPressure_bar 0.0 2500.0
 /begin AXIS_DESCR COM_AXIS RailP_dvolSubsCtlDlvMeUn_mp FuelVol_mm3_s 9 -327680.0 327670.0 AXIS_PTS_REF RailP_pSubsCtlDlvMeUn_CURX /end AXIS_DESCR
/end CHARACTERISTIC
/begin CHARACTERISTIC RailP_pFltWinNeg_CUR "Rail pressure decrease from which the system switches to the large signal parameter" CURVE 0x395A80 Lookup1D_WORD 0 RailPressure_bar 0.0 2500.0
 /begin AXIS_DESCR COM_AXIS InjCtl_qSetUnBal FuelMass_mg_hub 10 -300.0 300.0 AXIS_PTS_REF RailP_pFltWinNeg_CURX /end AXIS_DESCR
/end CHARACTERISTIC
/begin CHARACTERISTIC RailP_nDiffMax_C "Speed difference from that a new speed to the determination of the number of rail pressure max values is applied" VALUE 0x395A52 Scalar_SWORD 0 EngSpeed_rpm 0.0 50.0 /end CHARACTERISTIC
/begin CHARACTERISTIC RailP_facFlt1PT1_C "PT1 filter parameter for increasing rail pressure" VALUE 0x395A4C Scalar_UWORD 0 PT_fac 0.0 99.9985 /end CHARACTERISTIC
/begin CHARACTERISTIC RailP_facFlt2PT1_C "PT1 filter parameter for decreasing rail pressure (small signal behaviour)" VALUE 0x395A4E Scalar_UWORD 0 PT_fac 0.0 99.9985 /end CHARACTERISTIC
/begin CHARACTERISTIC RailP_facFlt3PT1_C "PT1 filter parameter for severely decreasing rail pressure (large signal behaviour)" VALUE 0x395A50 Scalar_UWORD 0 PT_fac 0.0 99.9985 /end CHARACTERISTIC
/begin CHARACTERISTIC RailP_swtFlt_C "Functioning of the peak rail pressure value determination" VALUE 0x395ADC Scalar_BOOLEAN 0 boolean 0.0 1.0 /end CHARACTERISTIC
/begin AXIS_PTS RailP_numMax_CURX "Curve that delivers the number of rail pressure max values" 0x395A62 RailP_nRef_mp Lookup1D_X_WORD 0 EngSpeed_rpm 10 0.0 6000.0 /end AXIS_PTS
/begin AXIS_PTS RailP_pSubsCtlDlvMeUn_CURX "RailP_dvolSubsCtlDlvMeUn_mp" 0x395ACA RailP_dvolSubsCtlDlvMeUn_mp Lookup1D_X_WORD 0 FuelVol_mm3_s 9 -327680.0 327670.0 /end AXIS_PTS
/begin AXIS_PTS RailP_pFltWinNeg_CURX "InjCtl_qSetUnBal" 0x395A94 InjCtl_qSetUnBal Lookup1D_X_WORD 0 FuelMass_mg_hub 10 -300.0 300.0 /end AXIS_PTS
/begin CHARACTERISTIC RailP_numGradExcdMax_C "Number of pressure jumps detected that trigger a diagnotic fault check." VALUE 0x395A54 Scalar_ULONG 0 Counter_num 0.0 65535.0 /end CHARACTERISTIC
/begin CHARACTERISTIC RailP_numdPDefDeb_C "Debounce time for default confirmed" VALUE 0x395A78 Scalar_ULONG 0 Debounce_ms 0.0 65535.0 /end CHARACTERISTIC
/begin CHARACTERISTIC RailP_numdPOKDeb_C "Debounce time for default healed" VALUE 0x395A7C Scalar_ULONG 0 Debounce_ms 0.0 65535.0 /end CHARACTERISTIC
/begin CHARACTERISTIC RailP_tidPresRst_C "Recovery time that resets the pressure jump counter." VALUE 0x395AF0 Scalar_ULONG 0 Debounce_ms 0.0 65535.0 /end CHARACTERISTIC
/begin CHARACTERISTIC RailP_dpMaxHyd_C "Largest allowed hydraulic pressure gradient before an error is detected." VALUE 0x395A4A Scalar_SWORD 0 RailPressure_bar 0.0 2500.0 /end CHARACTERISTIC
/begin CHARACTERISTIC AirC_stCmprPsDiaDisbl_C "Status for deactivation of the power stage diagnostics" VALUE 0x382490 Scalar_UWORD 0 State_uint16 0.0 65535.0 /end CHARACTERISTIC
/begin CHARACTERISTIC AirC_stCmprPsDisbl_C "Status for activation of the power stage" VALUE 0x382492 Scalar_UWORD 0 State_uint16 0.0 65535.0 /end CHARACTERISTIC
/begin CHARACTERISTIC SigTst_stACCmpr_C "set AC relay state by hand" VALUE 0x39805A Scalar_BOOLEAN 0 boolean 0.0 1.0 /end CHARACTERISTIC
/begin CHARACTERISTIC SigTst_swtACCmpr_C "Swtich to select AC relay signal" VALUE 0x398067 Scalar_UBYTE 0 Switch_conv 0 1 /end CHARACTERISTIC
/begin CHARACTERISTIC AC_trqMaxAC_C "Application parameter for allowed compressor torque load" VALUE 0x380060 Scalar_SWORD 0 Trq_Nm -3000.0 3000.0 /end CHARACTERISTIC
/begin CHARACTERISTIC AirC_trqCmprMax_C "Maximum value of compressor torque allowed" VALUE 0x3824A0 Scalar_SWORD 0 Trq_Nm -1000.0 1000.0 /end CHARACTERISTIC
/begin CHARACTERISTIC AirC_trqCmprMin_C "Minimum value of the compressor torque" VALUE 0x3824A2 Scalar_SWORD 0 Trq_Nm -1000.0 1000.0 /end CHARACTERISTIC
/begin CHARACTERISTIC AirC_tiSwtDebHiLo_C "Structure to hold Parameters for debouncing of AC switch signal read from the sensor / Time for a High to Low transition" VALUE 0x382498 Scalar_ULONG 0 EngTime_ms 0.0 4.294967295E+10 /end CHARACTERISTIC
/begin CHARACTERISTIC AirC_tiSwtDebLoHi_C "Structure to hold Parameters for debouncing of AC switch signal read from the sensor / Time for a Low to High transition" VALUE 0x38249C Scalar_ULONG 0 EngTime_ms 0.0 4.294967295E+10 /end CHARACTERISTIC
/begin CHARACTERISTIC AirC_stSwtDfl_C "Default value for AC switch in case of errors" VALUE 0x382494 Scalar_BOOLEAN 0 boolean 0.0 1.0 /end CHARACTERISTIC
/begin CHARACTERISTIC SigTst_stAirCSwtPrs_C "the state of  AC switch by hand" VALUE 0x39805C Scalar_BOOLEAN 0 boolean 0.0 1.0 /end CHARACTERISTIC
/begin CHARACTERISTIC AirC_swtMnSwtSig_C "Switch to select the Signal source for AC" VALUE 0x382495 Scalar_UBYTE 0 Switch_conv 0 1 /end CHARACTERISTIC
/begin CHARACTERISTIC SigTst_swtAirCSwtPrs_C "switch of AC swtich" VALUE 0x39806E Scalar_UBYTE 0 Switch_conv 0 1 /end CHARACTERISTIC
/begin CHARACTERISTIC CEngDsT_tTransf_CUR "Transformation curve to convert the voltage value to temperature value" CURVE 0x3865AE Lookup1D_WORD 0 Temp_deg -50.0 150.0
 /begin AXIS_DESCR COM_AXIS CEngDsT_uRaw Ad_mv 25 0.0 5000.0 AXIS_PTS_REF CEngDsT_tTransf_CURX /end AXIS_DESCR
/end CHARACTERISTIC
/begin CHARACTERISTIC CEngDsT_tiMaxDefDeb_C "Debounc time for checking heal of DFC_CEngDsTSRCMax" VALUE 0x386614 Scalar_ULONG 0 Debounce_ms 0.0 65535.0 /end CHARACTERISTIC
/begin CHARACTERISTIC CEngDsT_tiMaxOKDeb_C "Debounc time for checking heal of DFC_CEngDsTSRCMax" VALUE 0x386618 Scalar_ULONG 0 Debounce_ms 0.0 65535.0 /end CHARACTERISTIC
/begin CHARACTERISTIC CEngDsT_tiMinDefDeb_C "Debounc time for checking heal of DFC_CEngDsTSRCMin" VALUE 0x38661C Scalar_ULONG 0 Debounce_ms 0.0 65535.0 /end CHARACTERISTIC
/begin CHARACTERISTIC CEngDsT_tiMinOKDeb_C "Debounc time for checking heal of DFC_CEngDsTSRCMin" VALUE 0x386620 Scalar_ULONG 0 Debounce_ms 0.0 65535.0 /end CHARACTERISTIC
/begin CHARACTERISTIC CEngDsT_tiPhysRngHiDefDeb_C "Debounc time for checking heal of DFC_CEngDsTPhysRngHi" VALUE 0x386624 Scalar_ULONG 0 Debounce_ms 0.0 65535.0 /end CHARACTERISTIC
/begin CHARACTERISTIC CEngDsT_tiPhysRngHiOKDeb_C "Debounc time for checking heal of DFC_CEngDsTPhysRngHi" VALUE 0x386628 Scalar_ULONG 0 Debounce_ms 0.0 65535.0 /end CHARACTERISTIC
/begin CHARACTERISTIC CEngDsT_tiPhysRngLoDefDeb_C "Debounc time for checking heal of DFC_CEngDsTPhysRngLo" VALUE 0x38662C Scalar_ULONG 0 Debounce_ms 0.0 65535.0 /end CHARACTERISTIC
/begin CHARACTERISTIC CEngDsT_tiPhysRngLoOKDeb_C "Debounc time for checking heal of DFC_CEngDsTPhysRngLo" VALUE 0x386630 Scalar_ULONG 0 Debounce_ms 0.0 65535.0 /end CHARACTERISTIC
/begin CHARACTERISTIC CEngDsT_uSRCMax_C "Signal Range Check / Threshold for SRC -Max detection" VALUE 0x386634 Scalar_SWORD 0 Ad_mv 0.0 5000.0 /end CHARACTERISTIC
/begin CHARACTERISTIC CEngDsT_uSRCMin_C "Signal Range Check / Threshold for SRC -Min detection" VALUE 0x386636 Scalar_SWORD 0 Ad_mv 0.0 5000.0 /end CHARACTERISTIC
/begin CHARACTERISTIC CEngDsT_tPhysRngMax_C "physical range thresholds for Coolant downstream temperature sensor / Maximum threshold for the Sensed value" VALUE 0x3865AA Scalar_SWORD 0 Temp_deg -50.0 150.0 /end CHARACTERISTIC
/begin CHARACTERISTIC CEngDsT_tPhysRngMin_C "physical range thresholds for Coolant downstream temperature sensor / Minimum threshold for the Sensed value" VALUE 0x3865AC Scalar_SWORD 0 Temp_deg -50.0 150.0 /end CHARACTERISTIC
/begin AXIS_PTS CEngDsT_tTransf_CURX "Transformation aixs to convert the voltage value to temperature value" 0x3865E0 CEngDsT_uRaw Lookup1D_X_WORD 0 Ad_mv 25 0.0 5000.0 /end AXIS_PTS
/begin CHARACTERISTIC CEngDsT_RmpSlpNeg_C "Parameter for Ramp 1 / negative ramp slope" VALUE 0x3865A0 Scalar_SWORD 0 Temp_deg_s -200.0 200.0 /end CHARACTERISTIC
/begin CHARACTERISTIC CEngDsT_RmpSlpPos_C "Parameter for Ramp 1 / Slope if the ramp has to be increased" VALUE 0x3865A2 Scalar_SWORD 0 Temp_deg_s -200.0 200.0 /end CHARACTERISTIC
/begin CHARACTERISTIC CEngDsT_tDflCold_C "Default downstream engine coolant temperature value for cold engine conditions" VALUE 0x3865A6 Scalar_SWORD 0 Temp_deg -200.0 200.0 /end CHARACTERISTIC
/begin CHARACTERISTIC CEngDsT_tDflWarm_C "Default downstream engine coolant temperature value for warm engine conditions" VALUE 0x3865A8 Scalar_SWORD 0 Temp_deg -200.0 200.0 /end CHARACTERISTIC
/begin CHARACTERISTIC SigTst_tCEngDsT_C "Set coolent temperature by hand" VALUE 0x39809A Scalar_SWORD 0 Temp_deg -200.0 200.0 /end CHARACTERISTIC
/begin CHARACTERISTIC CEngDsT_facSerPT1_C "Time constant of PT1 filter for coolent Down streem temperature" VALUE 0x3865A4 Scalar_UWORD 0 PT_fac 0.0 99.9985 /end CHARACTERISTIC
/begin CHARACTERISTIC SigTst_swtCEngDsT_C "Switch for coolent temperature by hand" VALUE 0x398072 Scalar_UBYTE 0 Switch_conv 0 1 /end CHARACTERISTIC
/begin CHARACTERISTIC Fan_rCnv_CUR "The set-point value Fan_r%output duty cycle value use Fan_rCnv%_CUR" CURVE 0x389C32 Lookup1D_WORD 0 DutyCycle_rate 0.0 100.0
 /begin AXIS_DESCR COM_AXIS Fan_r DutyCycle_rate 11 0.0 100.0 AXIS_PTS_REF Fan_rCnv_CURX /end AXIS_DESCR
/end CHARACTERISTIC
/begin CHARACTERISTIC Fan_rCnv2_CUR "The set-point value Fan_r%output duty cycle value use Fan_rCnv%_CUR" CURVE 0x389C06 Lookup1D_WORD 0 DutyCycle_rate 0.0 100.0
 /begin AXIS_DESCR COM_AXIS Fan_r2 DutyCycle_rate 11 0.0 100.0 AXIS_PTS_REF Fan_rCnv2_CURX /end AXIS_DESCR
/end CHARACTERISTIC
/begin CHARACTERISTIC Fan_tiFanCyc_C "Diagnostic interface switch" VALUE 0x389C78 Scalar_ULONG 0 Debounce_ms 0.0 65535.0 /end CHARACTERISTIC
/begin CHARACTERISTIC Fan_stPsDiaDisblPWM2_C "Application parameter array to Disable diagnosisof PWM" VALUE 0x389C6A Scalar_UWORD 0 State_uint16 0.0 65535.0 /end CHARACTERISTIC
/begin CHARACTERISTIC Fan_stPsDiaDisblPWM_C "Application parameter array to Disable diagnosisof PWM" VALUE 0x389C6C Scalar_UWORD 0 State_uint16 0.0 65535.0 /end CHARACTERISTIC
/begin CHARACTERISTIC Fan_stPsDisDIO2_C "Application parameter array to disable powerstageof DIO" VALUE 0x389C6E Scalar_UWORD 0 State_uint16 0.0 65535.0 /end CHARACTERISTIC
/begin CHARACTERISTIC Fan_stPsDisDIO_C "Application parameter array to disable powerstageof DIO" VALUE 0x389C70 Scalar_UWORD 0 State_uint16 0.0 65535.0 /end CHARACTERISTIC
/begin CHARACTERISTIC Fan_stPsDisblPWM2_C "Application parameter array to disable PWM powerstage" VALUE 0x389C72 Scalar_UWORD 0 State_uint16 0.0 65535.0 /end CHARACTERISTIC
/begin CHARACTERISTIC Fan_stPsDisblPWM_C "Application parameter array to disable PWM powerstage" VALUE 0x389C74 Scalar_UWORD 0 State_uint16 0.0 65535.0 /end CHARACTERISTIC
/begin CHARACTERISTIC Fan_PwmOut2_rMax_C "The corrected duty cycle value is limited  a maximum value" VALUE 0x389BF4 Scalar_SWORD 0 DutyCycle_rate 0.0 100.0 /end CHARACTERISTIC
/begin CHARACTERISTIC Fan_PwmOut2_rMin_C "The corrected duty cycle value is limited  a minimum value" VALUE 0x389BF6 Scalar_SWORD 0 DutyCycle_rate 0.0 100.0 /end CHARACTERISTIC
/begin CHARACTERISTIC Fan_PwmOut_rMax_C "The corrected duty cycle value is limited  a maximum value" VALUE 0x389BFA Scalar_SWORD 0 DutyCycle_rate 0.0 100.0 /end CHARACTERISTIC
/begin CHARACTERISTIC Fan_PwmOut_rMin_C "The corrected duty cycle value is limited  a minimum value" VALUE 0x389BFC Scalar_SWORD 0 DutyCycle_rate 0.0 100.0 /end CHARACTERISTIC
/begin CHARACTERISTIC Fan_rPsDisbl2_C "substitute output duty cycle while locking condition for PWM fan stage is active" VALUE 0x389C66 Scalar_SWORD 0 DutyCycle_rate 0.0 100.0 /end CHARACTERISTIC
/begin CHARACTERISTIC Fan_rPsDisbl_C "substitute output duty cycle while locking condition for PWM fan stage is active" VALUE 0x389C68 Scalar_SWORD 0 DutyCycle_rate 0.0 100.0 /end CHARACTERISTIC
/begin CHARACTERISTIC Fan_PwmOut2_swtBattCor_C "Class Instance for PWM Output / Switch to enable battery correction" VALUE 0x389BF8 Scalar_BOOLEAN 0 boolean 0.0 1.0 /end CHARACTERISTIC
/begin CHARACTERISTIC Fan_PwmOut_swtBattCor_C "Class Instance for PWM Output / Switch to enable battery correction" VALUE 0x389BFE Scalar_BOOLEAN 0 boolean 0.0 1.0 /end CHARACTERISTIC
/begin CHARACTERISTIC Fan_swtSYDia2_C "Diagnostic interface switch" VALUE 0x389C76 Scalar_BOOLEAN 0 boolean 0.0 1.0 /end CHARACTERISTIC
/begin CHARACTERISTIC Fan_swtSYDia_C "Diagnostic interface switch" VALUE 0x389C77 Scalar_BOOLEAN 0 boolean 0.0 1.0 /end CHARACTERISTIC
/begin AXIS_PTS Fan_rCnv_CURX "Fan speed set point" 0x389C48 Fan_r Lookup1D_X_WORD 0 DutyCycle_rate 11 0.0 100.0 /end AXIS_PTS
/begin AXIS_PTS Fan_rCnv2_CURX "Fan speed set point" 0x389C1C Fan_r2 Lookup1D_X_WORD 0 DutyCycle_rate 11 0.0 100.0 /end AXIS_PTS
/begin CHARACTERISTIC APP_tiAliveDebHiLo_C "Debounce times for alive detection of APP / Time for a High to Low transition" VALUE 0x380A38 Scalar_ULONG 0 Debounce_ms 0.0 1000.0 /end CHARACTERISTIC
/begin CHARACTERISTIC APP_tiAliveDebLoHi_C "Debounce times for alive detection of APP / Time for a Low to High transition" VALUE 0x380A3C Scalar_ULONG 0 Debounce_ms 0.0 1000.0 /end CHARACTERISTIC
/begin CHARACTERISTIC APP_tiRmtAppEN_C "Remote accelerator pedal initial check delay time" VALUE 0x380A50 Scalar_ULONG 0 Debounce_ms 0.0 50000.0 /end CHARACTERISTIC
/begin CHARACTERISTIC APP_drLimNeg_C "Ramp slope for substitutevalue in case of APP/Brake plausibilityerror / negative ramp slope" VALUE 0x3809F8 Scalar_LONG 0 Accpedal_rate_s -200.0 200.0 /end CHARACTERISTIC
/begin CHARACTERISTIC APP_drLimPos_C "Ramp slope for substitutevalue in case of APP/Brake plausibilityerror / Slope if the ramp has to be increased" VALUE 0x3809FC Scalar_LONG 0 Accpedal_rate_s -200.0 200.0 /end CHARACTERISTIC
/begin CHARACTERISTIC APP_drLimpMax_C "Limit for APP gradient in limphome mode" VALUE 0x380A00 Scalar_LONG 0 Accpedal_rate_s -200.0 200.0 /end CHARACTERISTIC
/begin CHARACTERISTIC APP_rLimpMax_C "Limit for APP value in limphome mode" VALUE 0x380A1C Scalar_SWORD 0 Accpedal_rate 0.0 100.0 /end CHARACTERISTIC
/begin CHARACTERISTIC APP_rPlaMaxVal_C "Maximum APP value when plausibility with brake failed" VALUE 0x380A1E Scalar_SWORD 0 Accpedal_rate 0.0 100.0 /end CHARACTERISTIC
/begin CHARACTERISTIC APP_rRmtAPPThresTrqDemH_C "High Threshold for Remote accelerator pedal hysteresis comparato" VALUE 0x380A20 Scalar_SWORD 0 Accpedal_rate 0.0 100.0 /end CHARACTERISTIC
/begin CHARACTERISTIC APP_rRmtAPPThresTrqDemL_C "Low Threshold for Remote accelerator pedal hysteresis comparator" VALUE 0x380A22 Scalar_SWORD 0 Accpedal_rate 0.0 100.0 /end CHARACTERISTIC
/begin CHARACTERISTIC APP_rRmtAPPThresTrqDem_C "Threshold for Remote accelerator pedal sensor value for resetting the HLSDem \"Torque demand\"" VALUE 0x380A24 Scalar_SWORD 0 Accpedal_rate -200.0 200.0 /end CHARACTERISTIC
/begin CHARACTERISTIC APP_rThresAliveDet_C "APP threshold for alive detection" VALUE 0x380A2E Scalar_SWORD 0 Accpedal_rate 0.0 100.0 /end CHARACTERISTIC
/begin CHARACTERISTIC APP_stRmtAppTrqEN_C "Remote accelerator pedal Torque Request enable" VALUE 0x380A30 Scalar_BOOLEAN 0 boolean 0.0 1.0 /end CHARACTERISTIC
/begin CHARACTERISTIC APP_swtAliveDetEna_C "Switch to enable alive detection" VALUE 0x380A31 Scalar_UBYTE 0 Switch_conv 0 1 /end CHARACTERISTIC
/begin CHARACTERISTIC APP_swtPlaChkEna_C "Switch to enable plausibility check with brake" VALUE 0x380A36 Scalar_UBYTE 0 Switch_conv 0 1 /end CHARACTERISTIC
/begin CHARACTERISTIC APP_tiSRCHighDefDeb_C "debounce time" VALUE 0x380A54 Scalar_ULONG 0 Debounce_ms 0.0 1000.0 /end CHARACTERISTIC
/begin CHARACTERISTIC APP_tiSRCHighOKDeb_C "debounce time" VALUE 0x380A58 Scalar_ULONG 0 Debounce_ms 0.0 1000.0 /end CHARACTERISTIC
/begin CHARACTERISTIC APP_tiSRCLowDefDeb_C "debounce time" VALUE 0x380A5C Scalar_ULONG 0 Debounce_ms 0.0 1000.0 /end CHARACTERISTIC
/begin CHARACTERISTIC APP_tiSRCLowOKDeb_C "debounce time" VALUE 0x380A60 Scalar_ULONG 0 Debounce_ms 0.0 1000.0 /end CHARACTERISTIC
/begin CHARACTERISTIC APP_uRaw1Def_C "Substitute value for sensor 1 defect" VALUE 0x380A6C Scalar_SWORD 0 Ad_mv 0.0 5000.0 /end CHARACTERISTIC
/begin CHARACTERISTIC APP_uRaw1SRCHigh_C "voltage upper threshold of channel 1" VALUE 0x380A6E Scalar_SWORD 0 Ad_mv 0.0 5000.0 /end CHARACTERISTIC
/begin CHARACTERISTIC APP_uRaw1SRCLow_C "voltage lower threshold of channel 1" VALUE 0x380A70 Scalar_SWORD 0 Ad_mv 0.0 5000.0 /end CHARACTERISTIC
/begin CHARACTERISTIC APP_uRaw2Def_C "Substitute value for sensor 2 defect" VALUE 0x380A72 Scalar_SWORD 0 Ad_mv 0.0 5000.0 /end CHARACTERISTIC
/begin CHARACTERISTIC APP_uRaw2SRCHigh_C "voltage upper threshold of channel 2" VALUE 0x380A76 Scalar_SWORD 0 Ad_mv 0.0 5000.0 /end CHARACTERISTIC
/begin CHARACTERISTIC APP_uRaw2SRCLow_C "voltage lower threshold of channel 2" VALUE 0x380A78 Scalar_SWORD 0 Ad_mv 0.0 5000.0 /end CHARACTERISTIC
/begin CHARACTERISTIC APP_uKDHighAPP_C "Upper threshold for kickdown hysteresis" VALUE 0x380A68 Scalar_SWORD 0 Ad_mv 0.0 5000.0 /end CHARACTERISTIC
/begin CHARACTERISTIC APP_uKDLowAPP_C "Lower threshold for kickdown hysteresis" VALUE 0x380A6A Scalar_SWORD 0 Ad_mv 0.0 5000.0 /end CHARACTERISTIC
/begin CHARACTERISTIC MoFAPP_dRawSigFac_C "Factor between the voltage of APP1 and APP2" VALUE 0x3950A4 Scalar_SWORD 0 Factor 0.0 8.0 /end CHARACTERISTIC
/begin CHARACTERISTIC SigTst_stAPPKickDown_C "Status of APP kickdown test signal" VALUE 0x39805B Scalar_BOOLEAN 0 boolean 0.0 1.0 /end CHARACTERISTIC
/begin CHARACTERISTIC SigTst_swtAPPKickDown_C "Switch to test the Kickdown status" VALUE 0x39806A Scalar_UBYTE 0 Switch_conv 0 1 /end CHARACTERISTIC
/begin CHARACTERISTIC MoFAPP_uSync_CUR "Curve to calculate permitted maximum for difference of signalvoltages of sensor 1 and sensor 2" CURVE 0x3950AE Lookup1D_WORD 0 Ad_mv 0.0 5000.0
 /begin AXIS_DESCR COM_AXIS APP_uMin12half_mp Ad_mv 2 0.0 5000.0 AXIS_PTS_REF MoFAPP_uSync_CURX /end AXIS_DESCR
/end CHARACTERISTIC
/begin CHARACTERISTIC APP_PlaAPPDefDeb_C "debounce time fot the defect detection of sync check" VALUE 0x3809F0 Scalar_ULONG 0 Debounce_ms 0.0 1000.0 /end CHARACTERISTIC
/begin CHARACTERISTIC APP_PlaAPPDefOK_C "debounce time for the healing of sync check" VALUE 0x3809F4 Scalar_ULONG 0 Debounce_ms 0.0 1000.0 /end CHARACTERISTIC
/begin CHARACTERISTIC APP_uSyncMin_C "Minimum voltage to enable sync check" VALUE 0x380A7A Scalar_SWORD 0 Ad_mv 0.0 5000.0 /end CHARACTERISTIC
/begin AXIS_PTS MoFAPP_uSync_CURX "Curve axis for calculate permitted maximum for difference of signalvoltages of sensor 1 and sensor 2" 0x3950B2 APP_uMin12half_mp Lookup1D_X_WORD 0 Ad_mv 2 0.0 5000.0 /end AXIS_PTS
/begin CHARACTERISTIC APP_tiGradCondDebHiLo_C "Debounce times for Gradient condition for APP/Brake plausibility / Time for a High to Low transition" VALUE 0x380A40 Scalar_ULONG 0 Debounce_ms 0.0 1000.0 /end CHARACTERISTIC
/begin CHARACTERISTIC APP_tiGradCondDebLoHi_C "Debounce times for Gradient condition for APP/Brake plausibility / Time for a Low to High transition" VALUE 0x380A44 Scalar_ULONG 0 Debounce_ms 0.0 1000.0 /end CHARACTERISTIC
/begin CHARACTERISTIC APP_tiPlaBrkDetDeb_C "Debounce time for detection of APP/Brake plausibility" VALUE 0x380A48 Scalar_ULONG 0 Debounce_ms 0.0 1000.0 /end CHARACTERISTIC
/begin CHARACTERISTIC APP_tiPlaBrkRstDeb_C "Debounce Time for reset of plausibility error with brake" VALUE 0x380A4C Scalar_ULONG 0 Debounce_ms 0.0 1000.0 /end CHARACTERISTIC
/begin CHARACTERISTIC APP_drUnFltLim_C "Threshold for APP gradient to reset plausibility with brake" VALUE 0x380A08 Scalar_LONG 0 Accpedal_rate_s -200.0 200.0 /end CHARACTERISTIC
/begin CHARACTERISTIC APP_nLim_C "threshold for engine speed to skip security check" VALUE 0x380A1A Scalar_SWORD 0 EngSpeed_rpm 0.0 6000.0 /end CHARACTERISTIC
/begin CHARACTERISTIC APP_vLim_C "threshold for vehicle speed to skip security check" VALUE 0x380A7C Scalar_SWORD 0 VehSpeed_km_h 0.0 200.0 /end CHARACTERISTIC
/begin CHARACTERISTIC APP_swtAppGradEna_C "Switch to enable reset plausibility with brake by APP gradient" VALUE 0x380A32 Scalar_UBYTE 0 Switch_conv 0 1 /end CHARACTERISTIC
/begin CHARACTERISTIC APP_swtBrkDet_C "Switch to choose brake signal detection by value or edge" VALUE 0x380A33 Scalar_UBYTE 0 Switch_conv 0 1 /end CHARACTERISTIC
/begin CHARACTERISTIC APP_swtRstCon_C "Switch to choose reset condition for plausibility" VALUE 0x380A37 Scalar_UBYTE 0 Switch_conv 0 1 /end CHARACTERISTIC
/begin CHARACTERISTIC APP_duLimErrPos_C "error ramp within the selction of mastersignal /positive ramp slope" VALUE 0x380A0C Scalar_SWORD 0 Ad_mv_s 0.0 5000.0 /end CHARACTERISTIC
/begin CHARACTERISTIC APP_uAPPDef_C "Substitute value if both sensors are defect" VALUE 0x380A64 Scalar_SWORD 0 Ad_mv 0.0 5000.0 /end CHARACTERISTIC
/begin CHARACTERISTIC APP_uRaw2Offset_C "Offset for sensor signal 2" VALUE 0x380A74 Scalar_SWORD 0 Ad_mv 0.0 5000.0 /end CHARACTERISTIC
/begin CHARACTERISTIC MoFAPP_rLinAPPCURCalMsgA_CUR "the physical value of accpedal" CURVE 0x3950A6 Lookup1D_WORD 0 Accpedal_rate 0.0 100.0
 /begin AXIS_DESCR COM_AXIS APP_uUnJit_mp Ad_mv 2 0.0 5000.0 AXIS_PTS_REF MoFAPP_rLinAPPCURCalMsgA_CURX /end AXIS_DESCR
/end CHARACTERISTIC
/begin CHARACTERISTIC APP_drLinRmp_C "Permissible amount of accpedal value when vehicle quits limp mode" VALUE 0x380A04 Scalar_LONG 0 Accpedal_rate_s -200.0 200.0 /end CHARACTERISTIC
/begin CHARACTERISTIC APP_uJitter_C "Threshold for unjittering" VALUE 0x380A66 Scalar_SWORD 0 Ad_mv 0.0 5000.0 /end CHARACTERISTIC
/begin CHARACTERISTIC APP_rThrFltLowNeg_C "Threshold for low/mid-range Filter parameter falling signal" VALUE 0x380A26 Scalar_SWORD 0 Accpedal_rate 0.0 100.0 /end CHARACTERISTIC
/begin CHARACTERISTIC APP_rThrFltLowPos_C "Threshold for low/mid-range Filter parameter rising signal" VALUE 0x380A28 Scalar_SWORD 0 Accpedal_rate 0.0 100.0 /end CHARACTERISTIC
/begin CHARACTERISTIC APP_rThrFltMidNeg_C "Threshold for mid/high-range Filter parameter falling signal" VALUE 0x380A2A Scalar_SWORD 0 Accpedal_rate 0.0 100.0 /end CHARACTERISTIC
/begin CHARACTERISTIC APP_rThrFltMidPos_C "Threshold for mid/high-range Filter parameter rising signal" VALUE 0x380A2C Scalar_SWORD 0 Accpedal_rate 0.0 100.0 /end CHARACTERISTIC
/begin CHARACTERISTIC SigTst_rAPP_C "set the accpedal value" VALUE 0x398052 Scalar_SWORD 0 Accpedal_rate 0.0 100.0 /end CHARACTERISTIC
/begin CHARACTERISTIC APP_facLowNegPT1_C "Filter parameter falling signal low range" VALUE 0x380A0E Scalar_UWORD 0 PT_fac 0.0 99.9985 /end CHARACTERISTIC
/begin CHARACTERISTIC APP_facLowPosPT1_C "Filter parameter rising signal low range" VALUE 0x380A10 Scalar_UWORD 0 PT_fac 0.0 99.9985 /end CHARACTERISTIC
/begin CHARACTERISTIC APP_facMidNegPT1_C "Filter parameter falling signal mid range" VALUE 0x380A12 Scalar_UWORD 0 PT_fac 0.0 99.9985 /end CHARACTERISTIC
/begin CHARACTERISTIC APP_facMidPosPT1_C "Filter parameter rising signal mid range" VALUE 0x380A14 Scalar_UWORD 0 PT_fac 0.0 99.9985 /end CHARACTERISTIC
/begin CHARACTERISTIC APP_facUppNegPT1_C "Filter parameter falling signal high range" VALUE 0x380A16 Scalar_UWORD 0 PT_fac 0.0 99.9985 /end CHARACTERISTIC
/begin CHARACTERISTIC APP_facUppPosPT1_C "Filter parameter rising signal high range" VALUE 0x380A18 Scalar_UWORD 0 PT_fac 0.0 99.9985 /end CHARACTERISTIC
/begin CHARACTERISTIC APP_swtEnaFlt_C "Switch to enable PT1" VALUE 0x380A34 Scalar_UBYTE 0 Switch_conv 0 1 /end CHARACTERISTIC
/begin CHARACTERISTIC APP_swtEnaUnJit_C "Switch to enable unjittering" VALUE 0x380A35 Scalar_UBYTE 0 Switch_conv 0 1 /end CHARACTERISTIC
/begin CHARACTERISTIC SigTst_swtAPP_C "Switch to set accpedal value" VALUE 0x39806B Scalar_UBYTE 0 Switch_conv 0 1 /end CHARACTERISTIC
/begin AXIS_PTS MoFAPP_rLinAPPCURCalMsgA_CURX "accpedal axis" 0x3950AA APP_uUnJit_mp Lookup1D_X_WORD 0 Ad_mv 2 0.0 5000.0 /end AXIS_PTS
/begin CHARACTERISTIC Brk_tiMnDebHiLo_C "Parameter structure for debounce times of main brake switch / Time for a High to Low transition" VALUE 0x386588 Scalar_ULONG 0 Debounce_ms 0.0 65535.0 /end CHARACTERISTIC
/begin CHARACTERISTIC Brk_tiMnDebLoHi_C "Parameter structure for debounce times of main brake switch / Time for a Low to High transition" VALUE 0x38658C Scalar_ULONG 0 Debounce_ms 0.0 65535.0 /end CHARACTERISTIC
/begin CHARACTERISTIC Brk_tiRedDebHiLo_C "Parameter structure for debounce times of redundant brake switch / Time for a High to Low transition" VALUE 0x386598 Scalar_ULONG 0 Debounce_ms 0.0 65535.0 /end CHARACTERISTIC
/begin CHARACTERISTIC Brk_tiRedDebLoHi_C "Parameter structure for debounce times of redundant brake switch / Time for a Low to High transition" VALUE 0x38659C Scalar_ULONG 0 Debounce_ms 0.0 65535.0 /end CHARACTERISTIC
/begin CHARACTERISTIC BrkDD_bBrkSigInv_C "invert the redundant brake switch signal" VALUE 0x386584 Scalar_BOOLEAN 0 boolean 0.0 1.0 /end CHARACTERISTIC
/begin CHARACTERISTIC SigTst_stBrkMn_C "the state of main brake switch by hand" VALUE 0x39805D Scalar_BOOLEAN 0 boolean 0.0 1.0 /end CHARACTERISTIC
/begin CHARACTERISTIC SigTst_stBrkRed_C "the state of redundant brake switch by hand" VALUE 0x39805E Scalar_BOOLEAN 0 boolean 0.0 1.0 /end CHARACTERISTIC
/begin CHARACTERISTIC SigTst_swtBrkMn_C "set main brake switch by hand" VALUE 0x398070 Scalar_UBYTE 0 Switch_conv 0 1 /end CHARACTERISTIC
/begin CHARACTERISTIC SigTst_swtBrkRed_C "set redundant brake switch by hand" VALUE 0x398071 Scalar_UBYTE 0 Switch_conv 0 1 /end CHARACTERISTIC
/begin CHARACTERISTIC Brk_tiPlaDebDef_C "DDRC / Duration of defect debouncing for check DFC_BrkNpl" VALUE 0x386590 Scalar_ULONG 0 Debounce_ms 0.0 65535.0 /end CHARACTERISTIC
/begin CHARACTERISTIC Brk_tiPlaDebOk_C "DDRC / Duration of healing debouncing for check DFC_BrkNpl" VALUE 0x386594 Scalar_ULONG 0 Debounce_ms 0.0 65535.0 /end CHARACTERISTIC
/begin CHARACTERISTIC Clth_tiDebHiLo_C "Debounce structure for clutch signal / Time for a High to Low transition" VALUE 0x38663C Scalar_ULONG 0 Debounce_ms 0.0 65535.0 /end CHARACTERISTIC
/begin CHARACTERISTIC Clth_tiDebLoHi_C "Debounce structure for clutch signal / Time for a Low to High transition" VALUE 0x386640 Scalar_ULONG 0 Debounce_ms 0.0 65535.0 /end CHARACTERISTIC
/begin CHARACTERISTIC Clth_stDflVal_C "Default value of clutch state" VALUE 0x38663A Scalar_UBYTE 0 State_uint8 0.0 255.0 /end CHARACTERISTIC
/begin CHARACTERISTIC Clth_swtSig_C "Switch for signal source of clutch state" VALUE 0x38663B Scalar_UBYTE 0 State_uint8 0.0 255.0 /end CHARACTERISTIC
/begin CHARACTERISTIC SigTst_stClth_C "Set clutch state by hand" VALUE 0x39805F Scalar_UBYTE 0 State_uint8 0.0 255.0 /end CHARACTERISTIC
/begin CHARACTERISTIC SigTst_swtClth_C "Switch for clutch state by hand" VALUE 0x398073 Scalar_UBYTE 0 Switch_conv 0 1 /end CHARACTERISTIC
/begin CHARACTERISTIC Clth_tiGearShft_C "Debounce time for gear shift detection" VALUE 0x386644 Scalar_ULONG 0 Debounce_ms 0.0 65535.0 /end CHARACTERISTIC
/begin CHARACTERISTIC Clth_tiPlaDebDef_C "DDRC / Duration of defect debouncing for check DFC_ClthNpl" VALUE 0x386648 Scalar_ULONG 0 Debounce_ms 0.0 65535.0 /end CHARACTERISTIC
/begin CHARACTERISTIC Clth_tiPlaDebOk_C "DDRC / Duration of healing debouncing for check DFC_ClthNpl" VALUE 0x38664C Scalar_ULONG 0 Debounce_ms 0.0 65535.0 /end CHARACTERISTIC
/begin CHARACTERISTIC Clth_vNoGearShftDet_C "Minimal vehicle speed for gear shift detection" VALUE 0x386650 Scalar_SWORD 0 VehSpeed_km_h 0.0 255.0 /end CHARACTERISTIC
/begin CHARACTERISTIC Clth_nNoGearShftDet_C "Minimal engine speed for gear shift detection" VALUE 0x386638 Scalar_SWORD 0 EngSpeed_rpm 0.0 6000.0 /end CHARACTERISTIC
/begin CHARACTERISTIC EngSpd_rPs_C "Engine speed PWM output dutycycle" VALUE 0x389396 Scalar_SWORD 0 DutyCycle_rate 0.0 100.0 /end CHARACTERISTIC
/begin CHARACTERISTIC EpmSpd_numPlsPerRot_C "the number of PWM output per engine revolution used for engine speed display" VALUE 0x389478 Scalar_UBYTE 0 uint8 0.0 255.0 /end CHARACTERISTIC
/begin MEASUREMENT EGRVlv_numLckdDet "Number of tasks since constant governor deviation at LMS" UBYTE State_uint8 0 0 0.0 255.0 ECU_ADDRESS 0x40022B1E /end MEASUREMENT
/begin MEASUREMENT EGRVlv_numJamVlv_mp "The number of jammed valve releasing" UBYTE State_uint8 0 0 0.0 255.0 ECU_ADDRESS 0x40022B1F /end MEASUREMENT
/begin MEASUREMENT EGRVlv_stStepDet "Status of step detection" UBYTE boolean 0 0 0.0 1.0 ECU_ADDRESS 0x40022B21 /end MEASUREMENT
/begin MEASUREMENT EGRVlv_stLMSDet "Status of LMS detection" UBYTE boolean 0 0 0.0 1.0 ECU_ADDRESS 0x40022B22 /end MEASUREMENT
/begin MEASUREMENT EGRVlv_stJamVlv_mp "Status indicates that the valve is jammed" UBYTE boolean 0 0 0.0 1.0 ECU_ADDRESS 0x40022B23 /end MEASUREMENT
/begin MEASUREMENT EGRVlv_bJamVlvRlsCheck_mp "Set bit 10 of EGRVlv_stMon" UBYTE boolean 0 0 0.0 1.0 ECU_ADDRESS 0x40022B24 /end MEASUREMENT
/begin MEASUREMENT EGRVlv_ctClnUp "Counter for EGR valve open-close cleanup cycles" ULONG Counter_num 0 0 0.0 65535.0 ECU_ADDRESS 0x40022B28 /end MEASUREMENT
/begin MEASUREMENT EGRVlv_tiClnUp "Time of post drive extension when valve cleaningis active" ULONG Debounce_ms 0 0 0.0 65535.0 ECU_ADDRESS 0x40022B2C /end MEASUREMENT
/begin MEASUREMENT EGRVlv_rAbsEGR_mp "Absolute value of duty cycle for calculating modelled current" SWORD Prc_100_rate 0 0 -100.0 100.0 ECU_ADDRESS 0x40022B30 /end MEASUREMENT
/begin MEASUREMENT EGRVlv_rGovMax_mp "Maximum governor output limit" SWORD Prc_100_rate 0 0 -100.0 100.0 ECU_ADDRESS 0x40022B32 /end MEASUREMENT
/begin MEASUREMENT EGRVlv_rGovMin_mp "Minimum governor output limit" SWORD Prc_100_rate 0 0 -100.0 100.0 ECU_ADDRESS 0x40022B34 /end MEASUREMENT
/begin MEASUREMENT EGRVlv_rOutPID_mp "Output of PID controller" SWORD Prc_100_rate 0 0 -100.0 100.0 ECU_ADDRESS 0x40022B36 /end MEASUREMENT
/begin MEASUREMENT EGRVlv_rIniVal "Initial value of correcting variable for position controller for single flow implementation" SWORD Prc_100_rate 0 0 -100.0 100.0 ECU_ADDRESS 0x40022B38 /end MEASUREMENT
/begin MEASUREMENT EGRVlv_rDesClnUp "Desired EGR valve position during valve cleaningoperation" SWORD Prc_100_rate 0 0 -100.0 100.0 ECU_ADDRESS 0x40022B3A /end MEASUREMENT
/begin MEASUREMENT EGRVlv_KiPar "I-Gain of the PID controller" SWORD VlvCtl_Ki 0 0 -32.0 31.9 ECU_ADDRESS 0x40022B3C /end MEASUREMENT
/begin MEASUREMENT EGRVlv_iEff_mp "Modelled current" SWORD Current_mA 0 0 -12800.0 12799.6 ECU_ADDRESS 0x40022B3E /end MEASUREMENT
/begin MEASUREMENT EGRVlv_iEffFlt_mp "Filtered value of modelled current" SWORD Current_mA 0 0 -12800.0 12799.6 ECU_ADDRESS 0x40022B40 /end MEASUREMENT
/begin MEASUREMENT EGRVlv_KpPar "P-Gain of the PID controller" SWORD EGRCtl_Kp 0 0 -256.0 255.9 ECU_ADDRESS 0x40022B42 /end MEASUREMENT
/begin MEASUREMENT EGRVlv_KdPar "D-Gain of the PID controller" SWORD EGRCtl_Ki 0 0 -128.0 127.9 ECU_ADDRESS 0x40022B44 /end MEASUREMENT
/begin MEASUREMENT EGRVlv_drAct_mp "Valve velocity" SWORD DutyCycle_rate_s 0 0 -327.68 327.67 ECU_ADDRESS 0x40022B46 /end MEASUREMENT
/begin MEASUREMENT EGRVlv_stClnUpBlkd "Status of valvle cleanup inhibited / interrupted" UBYTE boolean 0 0 0.0 1.0 ECU_ADDRESS 0x40022B48 /end MEASUREMENT
/begin MEASUREMENT EGRVlv_stSlwCls "Status of slow close detection" UBYTE boolean 0 0 0.0 1.0 ECU_ADDRESS 0x40022B49 /end MEASUREMENT
/begin MEASUREMENT StpIni "Status of stepping from lower mechanical stop" UBYTE boolean 0 0 0.0 1.0 ECU_ADDRESS 0x40022B4A /end MEASUREMENT
/begin MEASUREMENT EGRVlv_stLMSActv "LMS and no CleanUp active,then activate LMS control" UBYTE boolean 0 0 0.0 1.0 ECU_ADDRESS 0x40022B4B /end MEASUREMENT
/begin MEASUREMENT GovIni "Status of PID initialization" UBYTE boolean 0 0 0.0 1.0 ECU_ADDRESS 0x40022B4C /end MEASUREMENT
/begin MEASUREMENT EGRVlv_stIni "Status of limiting the current" UBYTE boolean 0 0 0.0 1.0 ECU_ADDRESS 0x40022B4D /end MEASUREMENT
/begin MEASUREMENT local_static_TrgClnUp "Local static status of valve cleaning trigger" UBYTE boolean 0 0 0.0 1.0 ECU_ADDRESS 0x40022B4E /end MEASUREMENT
/begin MEASUREMENT swt_off "Switch to value EGRVlv_rEGRSwtOff_C over a ramp with slope EGRVlv_rSwtOffRmp_C" UBYTE boolean 0 0 0.0 1.0 ECU_ADDRESS 0x40022B4F /end MEASUREMENT
/begin MEASUREMENT EGRVlv_stClnUpRls "Status of valvle cleanup release function" UBYTE boolean 0 0 0.0 1.0 ECU_ADDRESS 0x40022B50 /end MEASUREMENT
/begin MEASUREMENT EGRVlv_stClnUpOpn "Status indicates that the valve is moving in open position direction" UBYTE boolean 0 0 0.0 1.0 ECU_ADDRESS 0x40022B51 /end MEASUREMENT
/begin MEASUREMENT EGRVlv_stClnUpCls "Status indicates that the valve is moving in closed position direction" UBYTE boolean 0 0 0.0 1.0 ECU_ADDRESS 0x40022B52 /end MEASUREMENT
/begin MEASUREMENT EGRVlv_stClnUpFin "Status indicates that CleanUp function is finished without any interrupt" UBYTE boolean 0 0 0.0 1.0 ECU_ADDRESS 0x40022B53 /end MEASUREMENT
/begin MEASUREMENT EGRVlv_ctAdapCls_mp "Close/open cycle counter" ULONG Counter_num 0 0 0.0 65535.0 ECU_ADDRESS 0x40022B54 /end MEASUREMENT
/begin MEASUREMENT EGRVlv_tiStable_mp "Duration time that keeps the EGR valve steady" ULONG Debounce_ms 0 0 0.0 65535.0 ECU_ADDRESS 0x40022B58 /end MEASUREMENT
/begin MEASUREMENT EGRVlv_tiAdapWaitSensAcq_mp "Duration time waiting for sensor acquisition" ULONG Debounce_ms 0 0 0.0 65535.0 ECU_ADDRESS 0x40022B5C /end MEASUREMENT
/begin MEASUREMENT EGRVlv_rUnFlt "Unfiltered EGR valve position" SWORD Prc_100_rate 0 0 -100.0 100.0 ECU_ADDRESS 0x40022B60 /end MEASUREMENT
/begin MEASUREMENT EGRVlv_rFlt "Filtered EGR valve position" SWORD Prc_100_rate 0 0 -100.0 100.0 ECU_ADDRESS 0x40022B62 /end MEASUREMENT
/begin MEASUREMENT EGRVlv_rOfs_mp "Offset correction" SWORD Prc_100_rate 0 0 -100.0 100.0 ECU_ADDRESS 0x40022B64 /end MEASUREMENT
/begin MEASUREMENT EGRVlv_rTmpOfs "Temperory offset calculated" SWORD Prc_100_rate 0 0 -100.0 100.0 ECU_ADDRESS 0x40022B66 /end MEASUREMENT
/begin MEASUREMENT EGRVlv_rLinOfs_mp "Valve position before limiting" SWORD Prc_100_rate 0 0 -100.0 100.0 ECU_ADDRESS 0x40022B68 /end MEASUREMENT
/begin MEASUREMENT EGRVlv_rModVal "The model value used in the evaluation of the EGR valve actuator position EGRVlv_rAct" SWORD Prc_100_rate 0 0 -100.0 100.0 ECU_ADDRESS 0x40022B6A /end MEASUREMENT
/begin MEASUREMENT EGRVlv_rPosLrnMax_mp "Maximum offset obtained during offset learning close/open cycles" SWORD Prc_100_rate 0 0 -100.0 100.0 ECU_ADDRESS 0x40022B6C /end MEASUREMENT
/begin MEASUREMENT EGRVlv_rPosLrnMin_mp "Minimum offset obtained during offset learning close/open cycles" SWORD Prc_100_rate 0 0 -100.0 100.0 ECU_ADDRESS 0x40022B6E /end MEASUREMENT
/begin MEASUREMENT EGRVlv_rAdapPosAvg_mp "Average valve position at zero point" SWORD Prc_100_rate 0 0 -100.0 100.0 ECU_ADDRESS 0x40022B70 /end MEASUREMENT
/begin MEASUREMENT EGRVlv_rOfsLrnVlvUnLim "Unlimited control value for offset learning" SWORD Prc_100_rate 0 0 -100.0 100.0 ECU_ADDRESS 0x40022B72 /end MEASUREMENT
/begin MEASUREMENT EGRVlv_rAdapPos_mp "Valve position at zero point" SWORD Prc_100_rate 0 0 -100.0 100.0 ECU_ADDRESS 0x40022B74 /end MEASUREMENT
/begin MEASUREMENT EGRVlv_swtEGRTyp2T "Temperature-related state when EGRVlv_swtEGRTyp.2 is set" UBYTE boolean 0 0 0.0 1.0 ECU_ADDRESS 0x40022B76 /end MEASUREMENT
/begin MEASUREMENT EGRVlv_stBrkAftRun "Status of broken afterrun" UBYTE boolean 0 0 0.0 1.0 ECU_ADDRESS 0x40022B77 /end MEASUREMENT
/begin MEASUREMENT EGRVlv_stOfsEngCond_mp "Status of engine condition for offset learning release" UBYTE boolean 0 0 0.0 1.0 ECU_ADDRESS 0x40022B78 /end MEASUREMENT
/begin MEASUREMENT EGRVlv_stOfsLrnRls_mp "Status of offset learning release" UBYTE boolean 0 0 0.0 1.0 ECU_ADDRESS 0x40022B79 /end MEASUREMENT
/begin MEASUREMENT EGRVlv_stTrg_mp "Trigger status" UBYTE boolean 0 0 0.0 1.0 ECU_ADDRESS 0x40022B7A /end MEASUREMENT
/begin MEASUREMENT EGRVlv_stOfsLrnLst "Status of last learnt offset value" UBYTE boolean 0 0 0.0 1.0 ECU_ADDRESS 0x40022B7B /end MEASUREMENT
/begin MEASUREMENT EGRVlv_stOpnLdDiag "Trigger for open Load diagnostics" UBYTE boolean 0 0 0.0 1.0 ECU_ADDRESS 0x40022B7C /end MEASUREMENT
/begin MEASUREMENT EGRVlv_stAdapVlv_mp "State of valve close" UBYTE boolean 0 0 0.0 1.0 ECU_ADDRESS 0x40022B7D /end MEASUREMENT
/begin MEASUREMENT EGRVlv_stLgTDrft "State to indicate a long time drift error is detected" UBYTE boolean 0 0 0.0 1.0 ECU_ADDRESS 0x40022B7E /end MEASUREMENT
/begin MEASUREMENT EGRVlv_stShTDrft "State to indicate a short time drift error is detected" UBYTE boolean 0 0 0.0 1.0 ECU_ADDRESS 0x40022B7F /end MEASUREMENT
/begin MEASUREMENT EGRVlv_stStr_mp "Store state status" UBYTE boolean 0 0 0.0 1.0 ECU_ADDRESS 0x40022B80 /end MEASUREMENT
/begin MEASUREMENT EGRVlv_stPlaus "State to indicate a plausibility error is detected" UBYTE boolean 0 0 0.0 1.0 ECU_ADDRESS 0x40022B81 /end MEASUREMENT
/begin MEASUREMENT EGRVlv_stOfsLrnFrst "Status of first learnt offset value" UBYTE boolean 0 0 0.0 1.0 ECU_ADDRESS 0x40022B82 /end MEASUREMENT
/begin MEASUREMENT EGRVlv_stAdpSccs "State to indicate the offset learning is adapting successfully" UBYTE boolean 0 0 0.0 1.0 ECU_ADDRESS 0x40022B83 /end MEASUREMENT
/begin MEASUREMENT EGRVlv_stVlvClsd_mp "Status of valve closure" UBYTE boolean 0 0 0.0 1.0 ECU_ADDRESS 0x40022B84 /end MEASUREMENT
/begin MEASUREMENT EGRVlv_stMovFin_mp "Status of adaption finished" UBYTE boolean 0 0 0.0 1.0 ECU_ADDRESS 0x40022B85 /end MEASUREMENT
/begin MEASUREMENT EGRVlv_stVlvStkCls_mp "Status of valve stuck during closing" UBYTE boolean 0 0 0.0 1.0 ECU_ADDRESS 0x40022B86 /end MEASUREMENT
/begin MEASUREMENT EGRVlv_stEdgOpn_mp "Status of opening of EGR valve not for the first time" UBYTE boolean 0 0 0.0 1.0 ECU_ADDRESS 0x40022B87 /end MEASUREMENT
/begin MEASUREMENT EGRVlv_stFrstOpn_mp "Status of first opening of EGR valve" UBYTE boolean 0 0 0.0 1.0 ECU_ADDRESS 0x40022B88 /end MEASUREMENT
/begin MEASUREMENT EGRVlv_stVlvStk_mp "Status of valve stuck during opening" UBYTE boolean 0 0 0.0 1.0 ECU_ADDRESS 0x40022B89 /end MEASUREMENT
/begin MEASUREMENT EGRVlv_swtEGRTyp2 "Bit 2 of EGRVlv_swtEGRTyp" UBYTE boolean 0 0 0.0 1.0 ECU_ADDRESS 0x40022B8A /end MEASUREMENT
/begin MEASUREMENT EGRVlv_rPlausVal_mp "Plausible value(Difference between the max and min adaption values)" SWORD Prc_100_rate 0 0 -100.0 100.0 ECU_ADDRESS 0x40022B8C /end MEASUREMENT
/begin MEASUREMENT EGRVlv_stVlvClsBuf_mp "Status of valve closure" UBYTE boolean 0 0 0.0 1.0 ECU_ADDRESS 0x40022B8E /end MEASUREMENT
/begin MEASUREMENT EGRVlv_stVlvJamBufCls_mp "Status of valve jammed during closing" UBYTE boolean 0 0 0.0 1.0 ECU_ADDRESS 0x40022B8F /end MEASUREMENT
/begin MEASUREMENT EGRVlv_stVlvOpnBuf_mp "Status of valve opening" UBYTE boolean 0 0 0.0 1.0 ECU_ADDRESS 0x40022B90 /end MEASUREMENT
/begin MEASUREMENT EGRVlv_stVlvJamBuf_mp "Status of valve jammed during opening" UBYTE boolean 0 0 0.0 1.0 ECU_ADDRESS 0x40022B91 /end MEASUREMENT
/begin MEASUREMENT EGRVlv_rOfsLrnFrstEEP "" SWORD sfix16_Sp01220703125 0 0 -400.0 399.98779296875 ECU_ADDRESS 0x4002FBE0 /end MEASUREMENT
/begin MEASUREMENT EGRVlv_rOfsLrnLstEEP "" SWORD sfix16_Sp01220703125 0 0 -400.0 399.98779296875 ECU_ADDRESS 0x4002FBE2 /end MEASUREMENT
/begin MEASUREMENT IAirHt_stShutOffPs "Logical Output of Intake Air Heating" UBYTE boolean 0 0 0.0 1.0 ECU_ADDRESS 0x40022E58 /end MEASUREMENT
/begin MEASUREMENT Air_pDiffLimPlsPIntkVUs_mp "Sensed manifold absolute pressure" SWORD AirPressure_kPa 0 0 0.0 1200.0 ECU_ADDRESS 0x40023108 /end MEASUREMENT
/begin MEASUREMENT Air_bSRCPIntkVUsMax "Provisional defect which the raw air pressure upstream of the intake valve is exceeding the maximum in SRC" UBYTE boolean 0 0 0.0 1.0 ECU_ADDRESS 0x4002310A /end MEASUREMENT
/begin MEASUREMENT Air_bSRCPIntkVUsMin "Provisional defect which the raw air pressure upstream of the intake valve is exceeding the minimum in SRC" UBYTE boolean 0 0 0.0 1.0 ECU_ADDRESS 0x4002310B /end MEASUREMENT
/begin MEASUREMENT Air_bPhysRngPIntkVUsHi "Provisional defect which the physical air pressure upstream of the intake valve is exceeding the maximum in SRC" UBYTE boolean 0 0 0.0 1.0 ECU_ADDRESS 0x4002310C /end MEASUREMENT
/begin MEASUREMENT Air_bPhysRngPIntkVUsLo "Provisional defect which the physical air pressure upstream of the intake valve is exceeding the minimum in SRC" UBYTE boolean 0 0 0.0 1.0 ECU_ADDRESS 0x4002310D /end MEASUREMENT
/begin MEASUREMENT Air_bPlsPIntkVUsMax "Provisional defect which the air pressure upstream of the intake valve is exceeding the maximum in plausibility check" UBYTE boolean 0 0 0.0 1.0 ECU_ADDRESS 0x4002310E /end MEASUREMENT
/begin MEASUREMENT Air_bPlsPIntkVUsMin "Provisional defect which the air pressure upstream of the intake valve is exceeding the minimum in plausibility check" UBYTE boolean 0 0 0.0 1.0 ECU_ADDRESS 0x4002310F /end MEASUREMENT
/begin MEASUREMENT Air_pSensDpLimPIntkVUs_mp "Measuring point for slope limited sensed value of Intake valve Upstream Air Pressure" SWORD AirPressure_kPa 0 0 0.0 1200.0 ECU_ADDRESS 0x40023110 /end MEASUREMENT
/begin MEASUREMENT Air_pUnFltPIntkVUs_mp "Unfiltered pressure value upstream of the intake valve" SWORD AirPressure_kPa 0 0 0.0 1200.0 ECU_ADDRESS 0x40023112 /end MEASUREMENT
/begin MEASUREMENT Air_bSRCTIntkVUsMax "Provisional defect which the raw air temperature upstream of the intake valve is exceeding the maximum in SRC" UBYTE boolean 0 0 0.0 1.0 ECU_ADDRESS 0x4002340B /end MEASUREMENT
/begin MEASUREMENT Air_bSRCTIntkVUsMin "Provisional defect which the raw air temperature upstream of the intake valve is exceeding the minimum in SRC" UBYTE boolean 0 0 0.0 1.0 ECU_ADDRESS 0x4002340C /end MEASUREMENT
/begin MEASUREMENT Air_tUnFltIntkVUs_mp "Measuring point for unfiltered Intake air temperature upstream of the inlet valve" SWORD Temp_deg 0 0 -200.0 200.0 ECU_ADDRESS 0x4002340E /end MEASUREMENT
/begin MEASUREMENT BattU_bSRCMax "Status of BattU maximum signal range " UBYTE boolean 0 0 0.0 1.0 ECU_ADDRESS 0x4002215F /end MEASUREMENT
/begin MEASUREMENT BattU_bSRCMin "Status of BattU minimum signal range " UBYTE boolean 0 0 0.0 1.0 ECU_ADDRESS 0x40022160 /end MEASUREMENT
/begin MEASUREMENT BattU_bPhysRngHi "Status of BattU maximum physical range " UBYTE boolean 0 0 0.0 1.0 ECU_ADDRESS 0x40022161 /end MEASUREMENT
/begin MEASUREMENT BattU_bPhysRngLo "Status of BattU minimum physical range " UBYTE boolean 0 0 0.0 1.0 ECU_ADDRESS 0x40022162 /end MEASUREMENT
/begin MEASUREMENT BattU_uUnFlt_mp "Battery voltage" UWORD Battery_mv 0 0 0.0 50000.0 ECU_ADDRESS 0x40022164 /end MEASUREMENT
/begin MEASUREMENT MRly_stAct "Status of main relay" UBYTE boolean 0 0 0.0 1.0 ECU_ADDRESS 0x400230E8 /end MEASUREMENT
/begin MEASUREMENT MRly_bStkRly "Status of prevent the jammed" UBYTE boolean 0 0 0.0 1.0 ECU_ADDRESS 0x400230E9 /end MEASUREMENT
/begin MEASUREMENT MRly_bErlyOpng "Status of Prevent premature opening" UBYTE boolean 0 0 0.0 1.0 ECU_ADDRESS 0x400230EA /end MEASUREMENT
/begin MEASUREMENT T15_stRaw "Raw value of Terminal 15 status" UBYTE Switch_conv 0 0 0 1 ECU_ADDRESS 0x400232B4 /end MEASUREMENT
/begin MEASUREMENT Oil_pMaxP_mp "maximum pressure limit" SWORD AirPressure_kPa 0 0 0.0 1200.0 ECU_ADDRESS 0x400230EC /end MEASUREMENT
/begin MEASUREMENT Oil_pMinP_mp "minimum pressure limit" SWORD AirPressure_kPa 0 0 0.0 1200.0 ECU_ADDRESS 0x400230EE /end MEASUREMENT
/begin MEASUREMENT OilP_bSRCMax "SRC high of voltage signal range of oil pressure sensor" UBYTE boolean 0 0 0.0 1.0 ECU_ADDRESS 0x400230F0 /end MEASUREMENT
/begin MEASUREMENT OilP_bSRCMin "SRC low of voltage signal range of oil pressure sensor" UBYTE boolean 0 0 0.0 1.0 ECU_ADDRESS 0x400230F1 /end MEASUREMENT
/begin MEASUREMENT OilP_bPhysRngHi "Status sensor of the oil pressure high physical signal range" UBYTE boolean 0 0 0.0 1.0 ECU_ADDRESS 0x400230F2 /end MEASUREMENT
/begin MEASUREMENT OilP_bPhysRngLo "Status sensor of the oil pressure low physical signal range" UBYTE boolean 0 0 0.0 1.0 ECU_ADDRESS 0x400230F3 /end MEASUREMENT
/begin MEASUREMENT OilT_bSRCMax "SRC high of voltage signal range of oil temperature sensor" UBYTE boolean 0 0 0.0 1.0 ECU_ADDRESS 0x40023104 /end MEASUREMENT
/begin MEASUREMENT OilT_bSRCMin "SRC low of voltage signal range of oil temperature sensor" UBYTE boolean 0 0 0.0 1.0 ECU_ADDRESS 0x40023105 /end MEASUREMENT
/begin MEASUREMENT FuelT_bSRCMax "SRC high of fuel temperature sensor voltage" UBYTE boolean 0 0 0.0 1.0 ECU_ADDRESS 0x40022D36 /end MEASUREMENT
/begin MEASUREMENT FuelT_bSRCMin "SRC low of fuel temperature sensor voltage" UBYTE boolean 0 0 0.0 1.0 ECU_ADDRESS 0x40022D37 /end MEASUREMENT
/begin MEASUREMENT FuelT_bPlsMax "Status sensor of the fuel temperature high physical signal range" UBYTE boolean 0 0 0.0 1.0 ECU_ADDRESS 0x40022D38 /end MEASUREMENT
/begin MEASUREMENT FuelT_bPlsMin "Status sensor of the fuel temperature low physical signal range" UBYTE boolean 0 0 0.0 1.0 ECU_ADDRESS 0x40022D39 /end MEASUREMENT
/begin MEASUREMENT MeUn_nDiffRef_mp "Filtered engine speed for a curve" SWORD EngSpeed_rpm 0 0 0.0 6000.0 ECU_ADDRESS 0x400230BE /end MEASUREMENT
/begin MEASUREMENT MeUn_rSet_mp "setpoint of the metering unit duty cycle" SWORD DutyCycle_rate 0 0 0.0 100.0 ECU_ADDRESS 0x400230C0 /end MEASUREMENT
/begin MEASUREMENT MeUn_rSetLin_mp "Linearised setpoint of the metering unit duty cycle" SWORD DutyCycle_rate 0 0 0.0 100.0 ECU_ADDRESS 0x400230C2 /end MEASUREMENT
/begin MEASUREMENT MeUn_rSetDT1_mp "Setpoint duty cycle with DT1 component" SWORD DutyCycle_rate 0 0 0.0 100.0 ECU_ADDRESS 0x400230C4 /end MEASUREMENT
/begin MEASUREMENT MeUn_rSetBattCor_mp "Duty cycle setpoint with battery correction" SWORD DutyCycle_rate 0 0 0.0 100.0 ECU_ADDRESS 0x400230C6 /end MEASUREMENT
/begin MEASUREMENT MeUn_rPwmOutMax_mp "Battery voltage dependent maximum duty cycle" SWORD DutyCycle_rate 0 0 0.0 100.0 ECU_ADDRESS 0x400230C8 /end MEASUREMENT
/begin MEASUREMENT MeUn_ctRot_mp "counter of state of anchor rotation function of metering unit" ULONG Counter_num 0 0 0.0 65535.0 ECU_ADDRESS 0x400230CC /end MEASUREMENT
/begin MEASUREMENT MeUn_rRot_mp "dutycycle for rotation function" SWORD DutyCycle_rate 0 0 0.0 100.0 ECU_ADDRESS 0x400230D0 /end MEASUREMENT
/begin MEASUREMENT MeUn_stRotEnd_mp "state of active anchor rotation function of metering unit" UBYTE boolean 0 0 0.0 1.0 ECU_ADDRESS 0x400230D2 /end MEASUREMENT
/begin MEASUREMENT MeUn_uRawCal_mp "Raw value of meun after calibrated" SWORD Ad_mv 0 0 0.0 5000.0 ECU_ADDRESS 0x400230D4 /end MEASUREMENT
/begin MEASUREMENT MeUn_uRaw_filter "Raw value of meun" SWORD Ad_mv 0 0 0.0 5000.0 ECU_ADDRESS 0x400230D6 /end MEASUREMENT
/begin MEASUREMENT MeUn_facCrntBefCtlLim_mp "Metering unit current control, I component" UWORD Pid_Kp_Kd 0 0 0.0 15.0 ECU_ADDRESS 0x400230D8 /end MEASUREMENT
/begin MEASUREMENT MeUn_iCnvFlowRate_mp "Setpoint current from lookup curve" SWORD Current_mA 0 0 -12000.0 12000.0 ECU_ADDRESS 0x400230DA /end MEASUREMENT
/begin MEASUREMENT MeUn_iSetFlt_mp "Setpoint current for the metering unit after filter" SWORD Current_mA 0 0 -12000.0 12000.0 ECU_ADDRESS 0x400230DC /end MEASUREMENT
/begin MEASUREMENT MeUn_iActFlt_mp "Current actual value after filter" SWORD Current_mA 0 0 -12000.0 12000.0 ECU_ADDRESS 0x400230DE /end MEASUREMENT
/begin MEASUREMENT MeUn_iDvt_mp "Metering unit current control governor deviation" SWORD Current_mA 0 0 -12000.0 12000.0 ECU_ADDRESS 0x400230E0 /end MEASUREMENT
/begin MEASUREMENT MeUn_stActrCtl_mp "State of actuator value control for metering unit" UBYTE State_uint8 0 0 0.0 255.0 ECU_ADDRESS 0x400230E2 /end MEASUREMENT
/begin MEASUREMENT MeUn_bSRCMax_mp "state of SRCMax" UBYTE boolean 0 0 0.0 1.0 ECU_ADDRESS 0x400230E3 /end MEASUREMENT
/begin MEASUREMENT MeUn_bSRCMin_mp "state of SRCMin" UBYTE boolean 0 0 0.0 1.0 ECU_ADDRESS 0x400230E4 /end MEASUREMENT
/begin MEASUREMENT RailP_pLin_base "Fuel pressure from curve" SWORD RailPressure_bar 0 0 0.0 2500.0 ECU_ADDRESS 0x40023206 /end MEASUREMENT
/begin MEASUREMENT RailP_bSRCMax "The result of the signal range check " UBYTE boolean 0 0 0.0 1.0 ECU_ADDRESS 0x40023208 /end MEASUREMENT
/begin MEASUREMENT RailP_bSRCMin "The result of the signal range check " UBYTE boolean 0 0 0.0 1.0 ECU_ADDRESS 0x40023209 /end MEASUREMENT
/begin MEASUREMENT PRV_tiOpn_mp_MW "open time till wear out of PRV" ULONG EngTime_ms 0 0 0.0 2.0E+7 ECU_ADDRESS 0x40023210 /end MEASUREMENT
/begin MEASUREMENT PRV_pDiff_mp "rail pressure deviation between  two sample cycle" SWORD RailPressure_bar 0 0 -2000.0 2000.0 ECU_ADDRESS 0x40023214 /end MEASUREMENT
/begin MEASUREMENT PRV_dpRPGradCurr_mp "current calculated rail pressure gradient" SWORD RailPressure_bar_ms 0 0 -100.0 50.0 ECU_ADDRESS 0x40023216 /end MEASUREMENT
/begin MEASUREMENT PRV_ctOpn_mp_MW "count number of the opening of PRV" UBYTE uint8 0 0 0.0 100.0 ECU_ADDRESS 0x40023218 /end MEASUREMENT
/begin MEASUREMENT PRV_tiOpn_EEP "" ULONG ufix32_S10 0 0 0 4.294967295E+10 ECU_ADDRESS 0x4002FBF0 /end MEASUREMENT
/begin MEASUREMENT PRV_ctOpn_EEP "" UBYTE State_uint8 0 0 0 255 ECU_ADDRESS 0x4002FBEC /end MEASUREMENT
/begin MEASUREMENT RailP_pFltNoCor_mp "Not corrected rail pressure" SWORD RailPressure_bar 0 0 0.0 2500.0 ECU_ADDRESS 0x4002321A /end MEASUREMENT
/begin MEASUREMENT RailP_dvolSubsCtlDlvMeUn_mp "Open loop controlled volume flow in limp home mode" SWORD FuelVol_mm3_s 0 0 -327680.0 327670.0 ECU_ADDRESS 0x4002321C /end MEASUREMENT
/begin MEASUREMENT RailP_nRef_mp "Engine speed" SWORD EngSpeed_rpm 0 0 0.0 6000.0 ECU_ADDRESS 0x4002321E /end MEASUREMENT
/begin MEASUREMENT RailP_facFltPT1_mp "Current filter time for PT1 filter" UWORD PT_fac 0 0 0.0 99.9985 ECU_ADDRESS 0x40023220 /end MEASUREMENT
/begin MEASUREMENT RailP_numMax_mp "Number of rail pressure max values" UBYTE uint8 0 0 1.0 20.0 ECU_ADDRESS 0x40023222 /end MEASUREMENT
/begin MEASUREMENT RailP_bGradMon "Flag for gradient monitoring" UBYTE boolean 0 0 0.0 1.0 ECU_ADDRESS 0x40023223 /end MEASUREMENT
/begin MEASUREMENT AirC_stShutOffPsCmpr "Digital output shutoff state" UBYTE boolean 0 0 0.0 1.0 ECU_ADDRESS 0x40021E95 /end MEASUREMENT
/begin MEASUREMENT CEngDsT_bSRCMax "coolant temperature voltage signal maximum limit value" UBYTE boolean 0 0 0.0 1.0 ECU_ADDRESS 0x4002219C /end MEASUREMENT
/begin MEASUREMENT CEngDsT_bSRCMin "coolant temperature voltage signal minimum limit value" UBYTE boolean 0 0 0.0 1.0 ECU_ADDRESS 0x4002219D /end MEASUREMENT
/begin MEASUREMENT CEngDsT_bPhysRngHi "Status Sensor of the coolant temperature high voltage Signal range" UBYTE boolean 0 0 0.0 1.0 ECU_ADDRESS 0x4002219E /end MEASUREMENT
/begin MEASUREMENT CEngDsT_bPhysRngLo "Status Sensor of the coolant temperature low voltage Signal range" UBYTE boolean 0 0 0.0 1.0 ECU_ADDRESS 0x4002219F /end MEASUREMENT
/begin MEASUREMENT Fan_Calculated_dutycycle_mp "out duty cycle value is limited between  maximum and minimum" SWORD DutyCycle_rate 0 0 0.0 100.0 ECU_ADDRESS 0x40022CA8 /end MEASUREMENT
/begin MEASUREMENT APP_rPla_mp "APP value after plausibility check with brake" SWORD Accpedal_rate 0 0 0.0 100.0 ECU_ADDRESS 0x400220A4 /end MEASUREMENT
/begin MEASUREMENT APP_rUnLim_mp "APP value not limited by alive detection" SWORD Accpedal_rate 0 0 0.0 100.0 ECU_ADDRESS 0x400220A6 /end MEASUREMENT
/begin MEASUREMENT APP_stAlive_mp "State of APP alive detection of APP" UBYTE boolean 0 0 0.0 1.0 ECU_ADDRESS 0x400220A8 /end MEASUREMENT
/begin MEASUREMENT APP_bSRCHigh1 "Status temporary SRC-High error Sensor 1" UBYTE boolean 0 0 0.0 1.0 ECU_ADDRESS 0x400220B4 /end MEASUREMENT
/begin MEASUREMENT APP_bSRCLow1 "Status temporary SRC-Low error Sensor 1" UBYTE boolean 0 0 0.0 1.0 ECU_ADDRESS 0x400220B5 /end MEASUREMENT
/begin MEASUREMENT APP_bSRCHigh2 "Status temporary SRC-High error Sensor 2" UBYTE boolean 0 0 0.0 1.0 ECU_ADDRESS 0x400220B6 /end MEASUREMENT
/begin MEASUREMENT APP_bSRCLow2 "Status temporary SRC-Low error Sensor 2" UBYTE boolean 0 0 0.0 1.0 ECU_ADDRESS 0x400220B7 /end MEASUREMENT
/begin MEASUREMENT APP_uDiff_mp "Difference between signal voltages of sensor 1 and sensor 2" SWORD Ad_mv 0 0 0.0 5000.0 ECU_ADDRESS 0x400220BA /end MEASUREMENT
/begin MEASUREMENT APP_uMin12half_mp "Minimum of signal 1 and signal 2 in range of signal 2" SWORD Ad_mv 0 0 0.0 5000.0 ECU_ADDRESS 0x400220BC /end MEASUREMENT
/begin MEASUREMENT APP_uDiffMax_mp "Permitted maximum for difference of signalvoltages of sensor 1 and sensor 2" SWORD Ad_mv 0 0 0.0 5000.0 ECU_ADDRESS 0x400220BE /end MEASUREMENT
/begin MEASUREMENT APP_stAPP_mp "State of detection accelerate" UBYTE boolean 0 0 0.0 1.0 ECU_ADDRESS 0x400220C0 /end MEASUREMENT
/begin MEASUREMENT APP_stBrk_mp "State of detection brake" UBYTE boolean 0 0 0.0 1.0 ECU_ADDRESS 0x400220C1 /end MEASUREMENT
/begin MEASUREMENT APP_stTempErr_mp "Status for temporary errors" UBYTE boolean 0 0 0.0 1.0 ECU_ADDRESS 0x400220C2 /end MEASUREMENT
/begin MEASUREMENT APP_rUnFlt_mp "Unfiltered APP value" SWORD Accpedal_rate 0 0 0.0 100.0 ECU_ADDRESS 0x400220C8 /end MEASUREMENT
/begin MEASUREMENT APP_facPT1 "Filter time" UWORD PT_fac 0 0 0.0 99.9985 ECU_ADDRESS 0x400220CA /end MEASUREMENT
/begin MEASUREMENT Clth_stIntDebVal "Internal debounced Clutch sensor value" UBYTE State_uint8 0 0 0.0 255.0 ECU_ADDRESS 0x400221A4 /end MEASUREMENT
/begin MEASUREMENT Clth_stLastGear "Gear information from last calculation cycle" SBYTE Tra_num 0 0 -128.0 127.0 ECU_ADDRESS 0x400221B3 /end MEASUREMENT
/begin MEASUREMENT Clth_stOldGear "Last valid gear information" SBYTE Tra_num 0 0 -128.0 127.0 ECU_ADDRESS 0x400221B4 /end MEASUREMENT
/begin MEASUREMENT Clth_stOpnMark "marker of clutch state: clutch is open" UBYTE State_uint8 0 0 0.0 255.0 ECU_ADDRESS 0x400221B5 /end MEASUREMENT
/begin COMPU_METHOD EngSpeed_rpm "f(x)=(c1*X*X+c2*X+c3)/(c4*X*X+c5*X+c6)" RAT_FUNC "%6.1" "rpm" COEFFS 0 2.000 0.000 0 0 1.000 /end COMPU_METHOD
/begin COMPU_METHOD State_uint8 "f(x)=(c1*X*X+c2*X+c3)/(c4*X*X+c5*X+c6)" RAT_FUNC "%3.0" "" COEFFS 0 1 0 0 0 1 /end COMPU_METHOD
/begin COMPU_METHOD State_uint16 "f(x)=(c1*X*X+c2*X+c3)/(c4*X*X+c5*X+c6)" RAT_FUNC "%5.0" "" COEFFS 0 1 0 0 0 1 /end COMPU_METHOD
/begin COMPU_METHOD Trq_Nm "f(x)=(c1*X*X+c2*X+c3)/(c4*X*X+c5*X+c6)" RAT_FUNC "%0.3" "Nm" COEFFS 0 10.000 0.000 0 0 1.000 /end COMPU_METHOD
/begin COMPU_METHOD FuelMass_mg_hub "f(x)=(c1*X*X+c2*X+c3)/(c4*X*X+c5*X+c6)" RAT_FUNC "%0.3" "mg/hub" COEFFS 0 102.400 0.000 0 0 1.000 /end COMPU_METHOD
/begin COMPU_METHOD AirPressure_kPa "f(x)=(c1*X*X+c2*X+c3)/(c4*X*X+c5*X+c6)" RAT_FUNC "%0.3" "kPa" COEFFS 0 10.000 0.000 0 0 1.000 /end COMPU_METHOD
/begin COMPU_METHOD boolean "f(x)=(c1*X*X+c2*X+c3)/(c4*X*X+c5*X+c6)" RAT_FUNC "%1.0" "" COEFFS 0 1 0 0 0 1 /end COMPU_METHOD
/begin COMPU_METHOD Counter_num "f(x)=(c1*X*X+c2*X+c3)/(c4*X*X+c5*X+c6)" RAT_FUNC "%10.0" "" COEFFS 0 1 0 0 0 1 /end COMPU_METHOD
/begin COMPU_METHOD uint8 "f(x)=(c1*X*X+c2*X+c3)/(c4*X*X+c5*X+c6)" RAT_FUNC "%3.0" "" COEFFS 0 1 0 0 0 1 /end COMPU_METHOD
/begin COMPU_METHOD EngTime_ms "f(x)=(c1*X*X+c2*X+c3)/(c4*X*X+c5*X+c6)" RAT_FUNC "%0.3" "ms" COEFFS 0 1.000 0.000 0 0 10.000 /end COMPU_METHOD
/begin COMPU_METHOD Prc_100_rate "f(x)=(c1*X*X+c2*X+c3)/(c4*X*X+c5*X+c6)" RAT_FUNC "%0.3" "%" COEFFS 0 81.920 0.000 0 0 1.000 /end COMPU_METHOD
/begin COMPU_METHOD DutyCycle_rate "f(x)=(c1*X*X+c2*X+c3)/(c4*X*X+c5*X+c6)" RAT_FUNC "%0.3" "%" COEFFS 0 100.000 0.000 0 0 1.000 /end COMPU_METHOD
/begin COMPU_METHOD Ad_mv "f(x)=(c1*X*X+c2*X+c3)/(c4*X*X+c5*X+c6)" RAT_FUNC "%5.0" "mv" COEFFS 0 1 0 0 0 1 /end COMPU_METHOD
/begin COMPU_METHOD Period_us "f(x)=(c1*X*X+c2*X+c3)/(c4*X*X+c5*X+c6)" RAT_FUNC "%0.3" "us" COEFFS 0 10.000 0.000 0 0 1.000 /end COMPU_METHOD
/begin COMPU_METHOD Debounce_ms "f(x)=(c1*X*X+c2*X+c3)/(c4*X*X+c5*X+c6)" RAT_FUNC "%10.0" "ms" COEFFS 0 1 0 0 0 1 /end COMPU_METHOD
/begin COMPU_METHOD Accpedal_rate_s "f(x)=(c1*X*X+c2*X+c3)/(c4*X*X+c5*X+c6)" RAT_FUNC "%0.3" "%/s" COEFFS 0 81.920 0.000 0 0 1.000 /end COMPU_METHOD
/begin COMPU_METHOD Time_s "f(x)=(c1*X*X+c2*X+c3)/(c4*X*X+c5*X+c6)" RAT_FUNC "%0.3" "s" COEFFS 0 100.000 0.000 0 0 1.000 /end COMPU_METHOD
/begin COMPU_METHOD Battery_mv "f(x)=(c1*X*X+c2*X+c3)/(c4*X*X+c5*X+c6)" RAT_FUNC "%5.0" "mv" COEFFS 0 1 0 0 0 1 /end COMPU_METHOD
/begin COMPU_METHOD VehSpeed_km_h "f(x)=(c1*X*X+c2*X+c3)/(c4*X*X+c5*X+c6)" RAT_FUNC "%0.3" "km/h" COEFFS 0 100.000 0.000 0 0 1.000 /end COMPU_METHOD
/begin COMPU_METHOD Temp_deg "f(x)=(c1*X*X+c2*X+c3)/(c4*X*X+c5*X+c6)" RAT_FUNC "%0.3" "deg" COEFFS 0 10.000 2731.400 0 0 1.000 /end COMPU_METHOD
/begin COMPU_METHOD Temp_deg_s "f(x)=(c1*X*X+c2*X+c3)/(c4*X*X+c5*X+c6)" RAT_FUNC "%0.3" "deg/s" COEFFS 0 10.000 2731.400 0 0 1.000 /end COMPU_METHOD
/begin COMPU_METHOD PT_fac "f(x)=(c1*X*X+c2*X+c3)/(c4*X*X+c5*X+c6)" RAT_FUNC "%0.3" "" COEFFS 0 655.360 0.000 0 0 1.000 /end COMPU_METHOD
/begin COMPU_METHOD Accpedal_rate "f(x)=(c1*X*X+c2*X+c3)/(c4*X*X+c5*X+c6)" RAT_FUNC "%0.3" "%" COEFFS 0 81.920 0.000 0 0 1.000 /end COMPU_METHOD
/begin COMPU_METHOD Factor "f(x)=(c1*X*X+c2*X+c3)/(c4*X*X+c5*X+c6)" RAT_FUNC "%12.6" "" COEFFS 0 1024.000 0.000 0 0 1.000 /end COMPU_METHOD
/begin COMPU_METHOD Pid_Kp_Kd "f(x)=(c1*X*X+c2*X+c3)/(c4*X*X+c5*X+c6)" RAT_FUNC "%0.3" "" COEFFS 0 1000.000 0.000 0 0 1.000 /end COMPU_METHOD
/begin COMPU_METHOD Pid_Ki "f(x)=(c1*X*X+c2*X+c3)/(c4*X*X+c5*X+c6)" RAT_FUNC "%0.3" "" COEFFS 0 1000.000 0.000 0 0 1.000 /end COMPU_METHOD
/begin COMPU_METHOD Current_mA "f(x)=(c1*X*X+c2*X+c3)/(c4*X*X+c5*X+c6)" RAT_FUNC "%0.3" "mA" COEFFS 0 2.560 0.000 0 0 1.000 /end COMPU_METHOD
/begin COMPU_METHOD FuelVol_mm3_s "f(x)=(c1*X*X+c2*X+c3)/(c4*X*X+c5*X+c6)" RAT_FUNC "%0.3" "mm^3/s" COEFFS 0 1.000 0.000 0 0 10.000 /end COMPU_METHOD
/begin COMPU_METHOD RailPressure_bar "f(x)=(c1*X*X+c2*X+c3)/(c4*X*X+c5*X+c6)" RAT_FUNC "%0.3" "bar" COEFFS 0 12.800 0.000 0 0 1.000 /end COMPU_METHOD
/begin COMPU_METHOD Tra_num "f(x)=(c1*X*X+c2*X+c3)/(c4*X*X+c5*X+c6)" RAT_FUNC "%3.0" "" COEFFS 0 1 0 0 0 1 /end COMPU_METHOD
/begin COMPU_METHOD Switch_conv "Enumerated data type: Switch_conv" TAB_VERB "%0.3" "" COMPU_TAB_REF VTAB_FOR_Switch_conv /end COMPU_METHOD
/begin COMPU_METHOD DutyCycle_rate_s "f(x)=(c1*X*X+c2*X+c3)/(c4*X*X+c5*X+c6)" RAT_FUNC "%0.3" "%/s" COEFFS 0 100.000 0.000 0 0 1.000 /end COMPU_METHOD
/begin COMPU_METHOD VlvCtl_Ki "f(x)=(c1*X*X+c2*X+c3)/(c4*X*X+c5*X+c6)" RAT_FUNC "%12.6" "%/(mg/hub)/s" COEFFS 0 1024.000 0.000 0 0 1.000 /end COMPU_METHOD
/begin COMPU_METHOD AirPressure_kPa_s "f(x)=(c1*X*X+c2*X+c3)/(c4*X*X+c5*X+c6)" RAT_FUNC "%0.3" "kPa/s" COEFFS 0 10.000 0.000 0 0 1.000 /end COMPU_METHOD
/begin COMPU_METHOD uint16 "f(x)=(c1*X*X+c2*X+c3)/(c4*X*X+c5*X+c6)" RAT_FUNC "%5.0" "" COEFFS 0 1 0 0 0 1 /end COMPU_METHOD
/begin COMPU_METHOD EGRCtl_Ki "f(x)=(c1*X*X+c2*X+c3)/(c4*X*X+c5*X+c6)" RAT_FUNC "%11.6" "%/(mg/hub)/s" COEFFS 0 256.000 0.000 0 0 1.000 /end COMPU_METHOD
/begin COMPU_METHOD EGRCtl_Kp "f(x)=(c1*X*X+c2*X+c3)/(c4*X*X+c5*X+c6)" RAT_FUNC "%10.6" "%/(mg/hub)" COEFFS 0 128.000 0.000 0 0 1.000 /end COMPU_METHOD
/begin COMPU_METHOD DT1_s "f(x)=(c1*X*X+c2*X+c3)/(c4*X*X+c5*X+c6)" RAT_FUNC "%0.3" "s" COEFFS 0 6553.400 0.000 0 0 1.000 /end COMPU_METHOD
/begin COMPU_METHOD sfix16_Sp01220703125 "f(x)=(c1*X*X+c2*X+c3)/(c4*X*X+c5*X+c6)" RAT_FUNC "%0.3" "" COEFFS 0 81.920 0.000 0 0 1.000 /end COMPU_METHOD
/begin COMPU_METHOD Battery_mv_s "f(x)=(c1*X*X+c2*X+c3)/(c4*X*X+c5*X+c6)" RAT_FUNC "%10.0" "mv/s" COEFFS 0 1 0 0 0 1 /end COMPU_METHOD
/begin COMPU_METHOD MeUn_Resistance_mOhm "f(x)=(c1*X*X+c2*X+c3)/(c4*X*X+c5*X+c6)" RAT_FUNC "%5.0" "mOhm" COEFFS 0 1 0 0 0 1 /end COMPU_METHOD
/begin COMPU_METHOD RailPressure_bar_ms "f(x)=(c1*X*X+c2*X+c3)/(c4*X*X+c5*X+c6)" RAT_FUNC "%0.3" "bar/ms" COEFFS 0 10.000 0.000 0 0 1.000 /end COMPU_METHOD
/begin COMPU_METHOD ufix32_S10 "f(x)=(c1*X*X+c2*X+c3)/(c4*X*X+c5*X+c6)" RAT_FUNC "%0.3" "" COEFFS 0 1.000 0.000 0 0 10.000 /end COMPU_METHOD
/begin COMPU_METHOD Ad_mv_s "f(x)=(c1*X*X+c2*X+c3)/(c4*X*X+c5*X+c6)" RAT_FUNC "%5.0" "mv/s" COEFFS 0 1 0 0 0 1 /end COMPU_METHOD
/begin COMPU_VTAB VTAB_FOR_Switch_conv "Enumerated data type: Switch_conv" TAB_VERB 2 0 "OFF" 1 "ON" /end COMPU_VTAB
/begin GROUP S1_LMS_Detection "EGRVlv_VDMon/EGRVlv_VDMon/LMS Detection"
 /begin REF_CHARACTERISTIC EGRVlv_numLckdDetThres_C EGRVlv_rLMSActPosThresInit_C EGRVlv_rLMSActThresDwn_C EGRVlv_rLMSThresDwn_C EGRVlv_rLMSThresUp_C EGRVlv_rLckdDetThres_C EGRVlv_rStpThres_C EGRVlv_tiLMS_C /end REF_CHARACTERISTIC
 /begin REF_MEASUREMENT EGRVlv_numLckdDet EGRVlv_stLMSDet EGRVlv_stStepDet /end REF_MEASUREMENT
/end GROUP
/begin GROUP S1_Release_Function "EGRVlv_VDMon/EGRVlv_VDMon/Release Function" /begin SUB_GROUP S7_Jammed_valve_detection S7_Repeated_release /end SUB_GROUP /end GROUP
/begin GROUP S7_Jammed_valve_detection "EGRVlv_VDMon/EGRVlv_VDMon/Release Function/Jammed valve detection" /begin REF_CHARACTERISTIC EGRVlv_numJamVlv_C EGRVlv_tiRepRls_C EGRVlv_tiRls_C /end REF_CHARACTERISTIC
 /begin REF_MEASUREMENT EGRVlv_bJamVlvRlsCheck_mp EGRVlv_numJamVlv_mp EGRVlv_stJamVlv_mp /end REF_MEASUREMENT
/end GROUP
/begin GROUP S7_Repeated_release "EGRVlv_VDMon/EGRVlv_VDMon/Release Function/Repeated release" /begin REF_CHARACTERISTIC EGRVlv_RlsIKi_C EGRVlv_rRlsMax_C /end REF_CHARACTERISTIC /end GROUP
/begin GROUP EGRVlv_VDPosGov "EGRVlv_VDPosGov" /begin SUB_GROUP Root_EGRVlv_VDPosGov /end SUB_GROUP /end GROUP
/begin GROUP Root_EGRVlv_VDPosGov "EGRVlv_VDPosGov/EGRVlv_VDPosGov" /begin SUB_GROUP S1_Function_position_governor /end SUB_GROUP /end GROUP
/begin GROUP S1_Function_position_governor "EGRVlv_VDPosGov/EGRVlv_VDPosGov/Function position governor"
 /begin SUB_GROUP S3_CalcLim S3_CalcParam S3_EGR_valve_CleanUp_Function S3_Switch_Governor_Output /end SUB_GROUP
 /begin REF_CHARACTERISTIC EGRVlv_IKiNgv_C EGRVlv_IKiPsv_C EGRVlv_PKpNgv_C EGRVlv_PKpPsv_C EGRVlv_rDesEGR_CUR EGRVlv_rIniStp_C EGRVlv_rOutDMax_C EGRVlv_rPIDWinNgv_C EGRVlv_rPIDWinPsv_C EGRVlv_swtDesValNrmInv_C EGRVlv_swtSelDT1In_C EGRVlv_tiGovDT1_C /end REF_CHARACTERISTIC
 /begin REF_MEASUREMENT EGRVlv_rOutPID_mp /end REF_MEASUREMENT
/end GROUP
/begin GROUP S3_CalcLim "EGRVlv_VDPosGov/EGRVlv_VDPosGov/Function position governor/CalcLim" /begin SUB_GROUP S5_Limit_IPart /end SUB_GROUP
 /begin REF_CHARACTERISTIC EGRVlv_facCrntEffFlt_C EGRVlv_iEffOvrLd_C EGRVlv_iEff_CUR EGRVlv_rGovMax_C EGRVlv_rGovMax_CUR EGRVlv_rGovMin_C EGRVlv_rGovMin_CUR EGRVlv_tiLimDlyOvrLd_C /end REF_CHARACTERISTIC
 /begin REF_MEASUREMENT EGRVlv_iEffFlt_mp EGRVlv_iEff_mp EGRVlv_rAbsEGR_mp EGRVlv_rGovMax_mp EGRVlv_rGovMin_mp /end REF_MEASUREMENT
/end GROUP
/begin GROUP S3_CalcParam "EGRVlv_VDPosGov/EGRVlv_VDPosGov/Function position governor/CalcParam" /begin SUB_GROUP S6_SlwClsDet /end SUB_GROUP
 /begin REF_CHARACTERISTIC EGRVlv_DKdNgv_C EGRVlv_DKdPsv_C EGRVlv_SlwClsDKd_C EGRVlv_SlwClsIKi_C EGRVlv_SlwClsPKp_C EGRVlv_SmlSigNgvDKd_C EGRVlv_SmlSigNgvIKi_C EGRVlv_SmlSigNgvPKp_C EGRVlv_SmlSigPsvDKd_C EGRVlv_SmlSigPsvIKi_C EGRVlv_SmlSigPsvPKp_C EGRVlv_rGovDvtThres_C EGRVlv_rPIDWinNgv_C EGRVlv_rPIDWinPsv_C /end REF_CHARACTERISTIC
 /begin REF_MEASUREMENT EGRVlv_KdPar EGRVlv_KiPar EGRVlv_KpPar /end REF_MEASUREMENT
/end GROUP
/begin GROUP S3_EGR_valve_CleanUp_Function "EGRVlv_VDPosGov/EGRVlv_VDPosGov/Function position governor/EGR valve CleanUp Function" /begin SUB_GROUP S8_EGR_valve_CleanUp_release_conditions /end SUB_GROUP /begin REF_CHARACTERISTIC EGRVlv_stClnUpInh_C /end REF_CHARACTERISTIC /begin REF_MEASUREMENT EGRVlv_stClnUpBlkd local_static_TrgClnUp /end REF_MEASUREMENT /end GROUP
/begin GROUP S3_Switch_Governor_Output "EGRVlv_VDPosGov/EGRVlv_VDPosGov/Function position governor/Switch Governor Output" /begin SUB_GROUP S13_Initialisation_of_EGRVlv_swtEGRTyp S13_LMS_Control /end SUB_GROUP
 /begin REF_CHARACTERISTIC EGRVlv_rEGRDflVal_C EGRVlv_rEGRSwtOff_C EGRVlv_rSwtOffRmp_C /end REF_CHARACTERISTIC
 /begin REF_MEASUREMENT EGRVlv_stLMSActv GovIni StpIni swt_off /end REF_MEASUREMENT
/end GROUP
/begin GROUP S5_Limit_IPart "EGRVlv_VDPosGov/EGRVlv_VDPosGov/Function position governor/CalcLim/Limit_IPart" /begin REF_CHARACTERISTIC EGRVlv_rOutIMax_C EGRVlv_tiOutIMax_C /end REF_CHARACTERISTIC /begin REF_MEASUREMENT EGRVlv_rIniVal EGRVlv_stIni /end REF_MEASUREMENT /end GROUP
/begin GROUP S6_SlwClsDet "EGRVlv_VDPosGov/EGRVlv_VDPosGov/Function position governor/CalcParam/SlwClsDet"
 /begin REF_CHARACTERISTIC EGRVlv_KdParDT1_C EGRVlv_drActNgv_C EGRVlv_rActNgv_C EGRVlv_tiParDT1_C /end REF_CHARACTERISTIC
 /begin REF_MEASUREMENT EGRVlv_drAct_mp EGRVlv_stSlwCls /end REF_MEASUREMENT
/end GROUP
/begin GROUP S8_EGR_valve_CleanUp_release_conditions "EGRVlv_VDPosGov/EGRVlv_VDPosGov/Function position governor/EGR valve CleanUp Function/EGR valve CleanUp release conditions"
 /begin REF_CHARACTERISTIC EGRVlv_ctClnUpFin_C EGRVlv_rDesClnUpCls_C EGRVlv_rDesClnUpOpen_C EGRVlv_tiClnUp_C /end REF_CHARACTERISTIC
 /begin REF_MEASUREMENT EGRVlv_ctClnUp EGRVlv_rDesClnUp EGRVlv_stClnUpCls EGRVlv_stClnUpFin EGRVlv_stClnUpOpn EGRVlv_stClnUpRls EGRVlv_tiClnUp /end REF_MEASUREMENT
/end GROUP
/begin GROUP S13_Initialisation_of_EGRVlv_swtEGRTyp "EGRVlv_VDPosGov/EGRVlv_VDPosGov/Function position governor/Switch Governor Output/Initialisation of EGRVlv_swtEGRTyp" /begin REF_CHARACTERISTIC EGRVlv_swtEGRTyp_C /end REF_CHARACTERISTIC /end GROUP
/begin GROUP S13_LMS_Control "EGRVlv_VDPosGov/EGRVlv_VDPosGov/Function position governor/Switch Governor Output/LMS Control"
 /begin REF_CHARACTERISTIC EGRVlv_IKiLMSSlp_C EGRVlv_rDesLMSMin_C EGRVlv_rDesOffHold_C /end REF_CHARACTERISTIC
/end GROUP
/begin GROUP EGRVlv_VDSens "EGRVlv_VDSens" /begin SUB_GROUP Root_EGRVlv_VDSens /end SUB_GROUP /end GROUP
/begin GROUP Root_EGRVlv_VDSens "EGRVlv_VDSens/EGRVlv_VDSens"
 /begin SUB_GROUP S1_Calculation_of_the_actual_valve_position S1_Transtage_Evaluation /end SUB_GROUP
/end GROUP
/begin GROUP S1_Calculation_of_the_actual_valve_position "EGRVlv_VDSens/EGRVlv_VDSens/Calculation of the actual valve position"
 /begin SUB_GROUP S2_Offset_Correction_and_Slope_Calculation S2_Offset_Learning /end SUB_GROUP
 /begin REF_CHARACTERISTIC EGRVlv_rActMax_C EGRVlv_rActMin_C EGRVlv_rPullDwnThres_C EGRVlv_rTmpOfsLrnMax_C EGRVlv_rTmpOfsLrnMin_C EGRVlv_stOfsLrnEnb_C EGRVlv_swtOfsLrnActv_C EGRVlv_swtSensPrs_C /end REF_CHARACTERISTIC
 /begin REF_MEASUREMENT EGRVlv_rOfsLrnFrstEEP EGRVlv_rOfsLrnLstEEP EGRVlv_rTmpOfs /end REF_MEASUREMENT
/end GROUP
/begin GROUP S1_Transtage_Evaluation "EGRVlv_VDSens/EGRVlv_VDSens/Transtage Evaluation"
 /begin REF_CHARACTERISTIC EGRVlv_RmpSlpNeg_C EGRVlv_RmpSlpPos_C EGRVlv_facPT1ModVal_C EGRVlv_facPT1_C EGRVlv_rTransStgDfl_C SigTst_rEGRVlv_C SigTst_swtEGRVlv_C /end REF_CHARACTERISTIC
 /begin REF_MEASUREMENT EGRVlv_rFlt EGRVlv_rModVal EGRVlv_rUnFlt /end REF_MEASUREMENT
/end GROUP
/begin GROUP S2_Offset_Correction_and_Slope_Calculation "EGRVlv_VDSens/EGRVlv_VDSens/Calculation of the actual valve position/Offset Correction and Slope Calculation" /begin REF_CHARACTERISTIC EGRVlv_rActOfs_C EGRVlv_swtActOfs_C /end REF_CHARACTERISTIC /begin REF_MEASUREMENT EGRVlv_rLinOfs_mp EGRVlv_rOfs_mp /end REF_MEASUREMENT /end GROUP
/begin GROUP S2_Offset_Learning "EGRVlv_VDSens/EGRVlv_VDSens/Calculation of the actual valve position/Offset Learning"
 /begin SUB_GROUP S5_GetBit S5_Release_of_offset_learning_for_EGR_valve S5_State_PLAUSIBLE S5_State_machine_for_the_offset_learning_for_EGR_valve S5_Transition_conditions_from_state_CLOSE S5_Transition_conditions_from_state_OPEN /end SUB_GROUP
 /begin REF_CHARACTERISTIC EGRVlv_facAdapClsStrt_C EGRVlv_numEngTempOfsLrnRls1_C EGRVlv_numEngTempOfsLrnRls2_C EGRVlv_rAdapDiffPlausShT_C EGRVlv_rAdapIniOpn0_C EGRVlv_rAdapIniOpn_C EGRVlv_rOfsLrnDwn_C EGRVlv_rOfsLrnRmpDwnCls_C EGRVlv_rOfsLrnRmpUpFst_C EGRVlv_rOfsLrnVlvMax_C EGRVlv_rOfsLrnVlvMin_C EGRVlv_rRmpDwnCls_C EGRVlv_rRmpUpFst_C EGRVlv_tEngFldThresOfsLrnRls1_C EGRVlv_tEngFldThresOfsLrnRls2_C EGRVlv_tiAdapWaitSensAcq_C EGRVlv_tiStable_C /end REF_CHARACTERISTIC
 /begin REF_MEASUREMENT EGRVlv_ctAdapCls_mp EGRVlv_rAdapPosAvg_mp EGRVlv_rAdapPos_mp EGRVlv_rOfsLrnVlvUnLim EGRVlv_rPosLrnMax_mp EGRVlv_rPosLrnMin_mp EGRVlv_stAdapVlv_mp EGRVlv_stLgTDrft EGRVlv_stOfsLrnLst EGRVlv_stOpnLdDiag EGRVlv_stShTDrft EGRVlv_stStr_mp EGRVlv_swtEGRTyp2T EGRVlv_tiAdapWaitSensAcq_mp EGRVlv_tiStable_mp /end REF_MEASUREMENT
/end GROUP
/begin GROUP S5_GetBit "EGRVlv_VDSens/EGRVlv_VDSens/Calculation of the actual valve position/Offset Learning/GetBit" /begin REF_MEASUREMENT EGRVlv_swtEGRTyp2 /end REF_MEASUREMENT /end GROUP
/begin GROUP S5_Release_of_offset_learning_for_EGR_valve "EGRVlv_VDSens/EGRVlv_VDSens/Calculation of the actual valve position/Offset Learning/Release of offset learning for EGR valve"
 /begin REF_CHARACTERISTIC EGRVlv_numTempSel_C EGRVlv_stNewVlvTrg_C EGRVlv_stOfsEngCond_C EGRVlv_stOfsLrnTrg_C EGRVlv_tEngMax_C EGRVlv_tEngMin_C EGRVlv_uBattMax_C EGRVlv_uBattMin_C /end REF_CHARACTERISTIC
 /begin REF_MEASUREMENT EGRVlv_stBrkAftRun EGRVlv_stOfsEngCond_mp EGRVlv_stOfsLrnRls_mp EGRVlv_stTrg_mp /end REF_MEASUREMENT
/end GROUP
/begin GROUP S5_State_PLAUSIBLE "EGRVlv_VDSens/EGRVlv_VDSens/Calculation of the actual valve position/Offset Learning/State PLAUSIBLE" /begin REF_CHARACTERISTIC EGRVlv_rAdapDiffPlaus_C EGRVlv_rOfsMax_C EGRVlv_rOfsMin_C /end REF_CHARACTERISTIC
 /begin REF_MEASUREMENT EGRVlv_rPlausVal_mp EGRVlv_stAdpSccs EGRVlv_stOfsLrnFrst EGRVlv_stPlaus /end REF_MEASUREMENT
/end GROUP
/begin GROUP S5_Transition_conditions_from_state_CLOSE "EGRVlv_VDSens/EGRVlv_VDSens/Calculation of the actual valve position/Offset Learning/Transition conditions from state CLOSE" /begin SUB_GROUP S16_TurnOnDelay /end SUB_GROUP
 /begin REF_CHARACTERISTIC EGRVlv_facAdapPosCls_C EGRVlv_numAdapClsMax_C EGRVlv_rSensVlvThres_C EGRVlv_tiClsJamVlv_C /end REF_CHARACTERISTIC
 /begin REF_MEASUREMENT EGRVlv_stMovFin_mp EGRVlv_stVlvClsBuf_mp EGRVlv_stVlvClsd_mp EGRVlv_stVlvJamBufCls_mp /end REF_MEASUREMENT
/end GROUP
/begin GROUP S5_Transition_conditions_from_state_OPEN "EGRVlv_VDSens/EGRVlv_VDSens/Calculation of the actual valve position/Offset Learning/Transition conditions from state OPEN" /begin SUB_GROUP S17_TurnOnDelay /end SUB_GROUP /begin REF_CHARACTERISTIC EGRVlv_rAdapAgOpnMin_C EGRVlv_tiAdapJamVlv_C /end REF_CHARACTERISTIC
 /begin REF_MEASUREMENT EGRVlv_stEdgOpn_mp EGRVlv_stFrstOpn_mp EGRVlv_stVlvJamBuf_mp EGRVlv_stVlvOpnBuf_mp /end REF_MEASUREMENT
/end GROUP
/begin GROUP S5_State_machine_for_the_offset_learning_for_EGR_valve "EGRVlv_VDSens/EGRVlv_VDSens/Calculation of the actual valve position/Offset Learning/State machine for the offset learning for EGR valve" /begin SUB_GROUP S15_simfcn /end SUB_GROUP /end GROUP
/begin GROUP S16_TurnOnDelay "EGRVlv_VDSens/EGRVlv_VDSens/Calculation of the actual valve position/Offset Learning/Transition conditions from state CLOSE/TurnOnDelay" /begin REF_MEASUREMENT EGRVlv_stVlvStkCls_mp /end REF_MEASUREMENT /end GROUP
/begin GROUP S17_TurnOnDelay "EGRVlv_VDSens/EGRVlv_VDSens/Calculation of the actual valve position/Offset Learning/Transition conditions from state OPEN/TurnOnDelay" /begin REF_MEASUREMENT EGRVlv_stVlvStk_mp /end REF_MEASUREMENT /end GROUP
/begin GROUP S15_simfcn "EGRVlv_VDSens/EGRVlv_VDSens/Calculation of the actual valve position/Offset Learning/State machine for the offset learning for EGR valve/simfcn"
 /begin REF_CHARACTERISTIC EGRVlv_IKiOfsLrnUp_C EGRVlv_rAdapAgOpnMax_C EGRVlv_rAdapOpnBnd_C /end REF_CHARACTERISTIC
/end GROUP
/begin GROUP IAirHt_DD "IAirHt_DD" /begin SUB_GROUP Root_IAirHt_DD /end SUB_GROUP /end GROUP
/begin GROUP Root_IAirHt_DD "IAirHt_DD/IAirHt_DD"
 /begin REF_CHARACTERISTIC IAirHt_stPsDiaDisbl_C IAirHt_stPsDisbl_C SigTst_stIAirHt_C SigTst_swtIAirHt_C /end REF_CHARACTERISTIC
 /begin REF_MEASUREMENT IAirHt_stShutOffPs /end REF_MEASUREMENT
/end GROUP
/begin GROUP PIntkVUs_DD "PIntkVUs_DD"
 /begin SUB_GROUP Root_Reading_of_the_voltage_value_from_the_ADC Root_Transformation_to_physical_value /end SUB_GROUP
/end GROUP
/begin GROUP Root_Reading_of_the_voltage_value_from_the_ADC "PIntkVUs_DD/Reading of the voltage value from the ADC" /begin REF_CHARACTERISTIC Air_facPT1T1PIntkVUs_C /end REF_CHARACTERISTIC /end GROUP
/begin GROUP Root_Transformation_to_physical_value "PIntkVUs_DD/Transformation to physical value" /begin SUB_GROUP S2_Debounce S2_Debounce1 S2_Debounce2 /end SUB_GROUP
 /begin REF_CHARACTERISTIC Air_pMaxDiffLimPlsPIntkVUs_C Air_pMinDiffLimPlsPIntkVUs_C Air_pPhysRngPIntkVUsMax_C Air_pPhysRngPIntkVUsMin_C Air_pTransfPIntkVUs_CUR Air_uSRCPIntkVUsMax_C Air_uSRCPIntkVUsMin_C /end REF_CHARACTERISTIC
 /begin REF_MEASUREMENT Air_bPhysRngPIntkVUsHi Air_bPhysRngPIntkVUsLo Air_bPlsPIntkVUsMax Air_bPlsPIntkVUsMin Air_bSRCPIntkVUsMax Air_bSRCPIntkVUsMin Air_pDiffLimPlsPIntkVUs_mp /end REF_MEASUREMENT
/end GROUP
/begin GROUP S2_Debounce "PIntkVUs_DD/Transformation to physical value/Debounce"
 /begin REF_CHARACTERISTIC Air_tiPIntkVUsMaxDefDeb_C Air_tiPIntkVUsMaxOKDeb_C Air_tiPIntkVUsMinDefDeb_C Air_tiPIntkVUsMinOKDeb_C /end REF_CHARACTERISTIC
/end GROUP
/begin GROUP S2_Debounce1 "PIntkVUs_DD/Transformation to physical value/Debounce1"
 /begin REF_CHARACTERISTIC Air_tiPhysRngHiIntkVUsDefDeb_C Air_tiPhysRngHiIntkVUsOKDeb_C Air_tiPhysRngLoIntkVUsDefDeb_C Air_tiPhysRngLoIntkVUsOKDeb_C /end REF_CHARACTERISTIC
/end GROUP
/begin GROUP S2_Debounce2 "PIntkVUs_DD/Transformation to physical value/Debounce2"
 /begin REF_CHARACTERISTIC Air_tiPlsMaxIntkVUsDefDeb_C Air_tiPlsMaxIntkVUsOKDeb_C Air_tiPlsMinIntkVUsDefDeb_C Air_tiPlsMinIntkVUsOKDeb_C /end REF_CHARACTERISTIC
/end GROUP
/begin GROUP PIntkVUs_VD "PIntkVUs_VD" /begin SUB_GROUP Root_Slope_Limitation /end SUB_GROUP
 /begin REF_CHARACTERISTIC Air_RmpSlpPIntkVUsNeg_C Air_RmpSlpPIntkVUsPos_C Air_facPT1T1SigPIntkVUs_C Air_pTransStgPIntkVUsDfl_C SigTst_pPIntkVUs_C SigTst_swtPIntkVUs_C /end REF_CHARACTERISTIC
 /begin REF_MEASUREMENT Air_pUnFltPIntkVUs_mp /end REF_MEASUREMENT
/end GROUP
/begin GROUP Root_Slope_Limitation "PIntkVUs_VD/Slope Limitation" /begin REF_CHARACTERISTIC Air_dpGradLimPIntkVUs_C /end REF_CHARACTERISTIC /begin REF_MEASUREMENT Air_pSensDpLimPIntkVUs_mp /end REF_MEASUREMENT /end GROUP
/begin GROUP TIntkVUs_DD "TIntkVUs_DD" /begin SUB_GROUP Root_Debounce1 /end SUB_GROUP
 /begin REF_CHARACTERISTIC Air_tTransfTIntkVUs_CUR Air_uSRCTIntkVUsMax_C Air_uSRCTIntkVUsMin_C /end REF_CHARACTERISTIC
 /begin REF_MEASUREMENT Air_bSRCTIntkVUsMax Air_bSRCTIntkVUsMin /end REF_MEASUREMENT
/end GROUP
/begin GROUP Root_Debounce1 "TIntkVUs_DD/Debounce"
 /begin REF_CHARACTERISTIC Air_tiSRCMaxTIntkVUsDefDeb_C Air_tiSRCMaxTIntkVUsOKDeb_C Air_tiSRCMinTIntkVUsDefDeb_C Air_tiSRCMinTIntkVUsOKDeb_C /end REF_CHARACTERISTIC
/end GROUP
/begin GROUP TIntkVUs_VD "TIntkVUs_VD"
 /begin REF_CHARACTERISTIC Air_RmpSlpTIntkVUsNeg_C Air_RmpSlpTIntkVUsPos_C Air_facPT1TIntkVUs_C Air_tTransStgTIntkVUsDfl_C SigTst_swtTIntkVUs_C SigTst_tIntkVUs_C /end REF_CHARACTERISTIC
 /begin REF_MEASUREMENT Air_tUnFltIntkVUs_mp /end REF_MEASUREMENT
/end GROUP
/begin GROUP DevLib_ActrPrt "DevLib_ActrPrt" /begin REF_CHARACTERISTIC DebLib_nActrRls_C DevLib_tiActrPrt_C /end REF_CHARACTERISTIC /end GROUP
/begin GROUP DevLib_PwrStgState "DevLib_PwrStgState"
 /begin REF_CHARACTERISTIC DebLib_facPwrStgHighHysHi_C DebLib_facPwrStgHighHysLo_C DebLib_facPwrStgLowHysHi_C DebLib_facPwrStgLowHysLo_C DebLib_uBattThdBattHiHysHi_C DebLib_uBattThdBattHiHysLo_C DebLib_uBattThdBattLoHysHi_C DebLib_uBattThdBattLoHysLo_C DebLib_uPwrStgBattHiHysHi_C DebLib_uPwrStgBattHiHysLo_C DebLib_uPwrStgBattLoHysHi_C DebLib_uPwrStgBattLoHysLo_C /end REF_CHARACTERISTIC
/end GROUP
/begin GROUP BattU_DD "BattU_DD" /begin SUB_GROUP Root_Debounce2 Root_Debounce11 /end SUB_GROUP
 /begin REF_CHARACTERISTIC BattU_uPhysRngMax_C BattU_uPhysRngMin_C BattU_uSRCMax_C BattU_uSRCMin_C BattU_uTransf_CUR /end REF_CHARACTERISTIC
 /begin REF_MEASUREMENT BattU_bPhysRngHi BattU_bPhysRngLo BattU_bSRCMax BattU_bSRCMin /end REF_MEASUREMENT
/end GROUP
/begin GROUP Root_Debounce2 "BattU_DD/Debounce"
 /begin REF_CHARACTERISTIC BattU_tiMaxDefDeb_C BattU_tiMaxOKDeb_C BattU_tiMinDefDeb_C BattU_tiMinOKDeb_C /end REF_CHARACTERISTIC
/end GROUP
/begin GROUP Root_Debounce11 "BattU_DD/Debounce1"
 /begin REF_CHARACTERISTIC BattU_tiPhysRngHiDefDeb_C BattU_tiPhysRngHiOKDeb_C BattU_tiPhysRngLoDefDeb_C BattU_tiPhysRngLoOKDeb_C /end REF_CHARACTERISTIC
/end GROUP
/begin GROUP BattU_VD "BattU_VD"
 /begin REF_CHARACTERISTIC BattU_RmpSlpNeg_C BattU_RmpSlpPos_C BattU_facPT1_C BattU_swtRated_C BattU_uNrm_C BattU_uTransStgDfl_C /end REF_CHARACTERISTIC
 /begin REF_MEASUREMENT BattU_uUnFlt_mp /end REF_MEASUREMENT
/end GROUP
/begin GROUP MRly_ShOff "MRly_ShOff" /begin REF_CHARACTERISTIC MRly_ctErlyOpng_C /end REF_CHARACTERISTIC /end GROUP
/begin GROUP MRly_VD "MRly_VD" /begin SUB_GROUP Root_Debounce21 Root_Debounce3 /end SUB_GROUP
 /begin REF_CHARACTERISTIC MRly_ctErlyOpng_C MRly_facBattVltgFlt_C MRly_tiCloseStk_C MRly_uStkRlyBattThr_C /end REF_CHARACTERISTIC
 /begin REF_MEASUREMENT MRly_bErlyOpng MRly_bStkRly MRly_stAct /end REF_MEASUREMENT
/end GROUP
/begin GROUP Root_Debounce21 "MRly_VD/Debounce2" /begin REF_CHARACTERISTIC MRly_tiStkRlyDiaDel_C /end REF_CHARACTERISTIC /end GROUP
/begin GROUP Root_Debounce3 "MRly_VD/Debounce3" /begin REF_CHARACTERISTIC MRly_tiStkRlyDiaDel_C /end REF_CHARACTERISTIC /end GROUP
/begin GROUP SSpMon_Co "SSpMon_Co" /begin SUB_GROUP Root_Debounce4 Root_Debounce12 /end SUB_GROUP
 /begin REF_CHARACTERISTIC SSpMon_uSply1OutMax_C SSpMon_uSply1OutMin_C SSpMon_uSplyOutMax_C SSpMon_uSplyOutMin_C /end REF_CHARACTERISTIC
/end GROUP
/begin GROUP Root_Debounce4 "SSpMon_Co/Debounce"
 /begin REF_CHARACTERISTIC SSpMon_tiSRCMaxSplyDefDeb_C SSpMon_tiSRCMaxSplyOKDeb_C SSpMon_tiSRCMinSplyDefDeb_C SSpMon_tiSRCMinSplyOKDeb_C /end REF_CHARACTERISTIC
/end GROUP
/begin GROUP Root_Debounce12 "SSpMon_Co/Debounce1"
 /begin REF_CHARACTERISTIC SSpMon_tiSRCMaxSply1DefDeb_C SSpMon_tiSRCMaxSply1OKDeb_C SSpMon_tiSRCMinSply1DefDeb_C SSpMon_tiSRCMinSply1OKDeb_C /end REF_CHARACTERISTIC
/end GROUP
/begin GROUP SyC_Main "SyC_Main" /begin SUB_GROUP Root_SyC_Main /end SUB_GROUP /end GROUP
/begin GROUP Root_SyC_Main "SyC_Main/SyC_Main" /begin REF_CHARACTERISTIC SyC_tiPostDrive_C /end REF_CHARACTERISTIC /end GROUP
/begin GROUP T15_DD "T15_DD" /begin REF_CHARACTERISTIC T15_tiDebHiLo_C T15_tiDebLoHi_C T15_uThreshold_C /end REF_CHARACTERISTIC /begin REF_MEASUREMENT T15_stRaw /end REF_MEASUREMENT /end GROUP
/begin GROUP T50_DD "T50_DD" /begin SUB_GROUP Root_T50_DD /end SUB_GROUP /end GROUP
/begin GROUP Root_T50_DD "T50_DD/T50_DD" /begin REF_CHARACTERISTIC T50_tiDebHiLo_C T50_tiDebLoHi_C T50_uThreshold_C /end REF_CHARACTERISTIC /end GROUP
/begin GROUP T50_VD "T50_VD" /begin SUB_GROUP Root_T50_VD /end SUB_GROUP /end GROUP
/begin GROUP Root_T50_VD "T50_VD/T50_VD"
 /begin REF_CHARACTERISTIC DDRC_DurDebT50_tiErrDebDef_C DDRC_DurDebT50_tiErrDebOk_C T50_tiEmgcyReq_C /end REF_CHARACTERISTIC
/end GROUP
/begin GROUP OilP_DD "OilP_DD"
 /begin SUB_GROUP Root__voltage_value_range_detection Root_physical_value_range_detection /end SUB_GROUP
/end GROUP
/begin GROUP Root__voltage_value_range_detection "OilP_DD/ voltage value range detection" /begin SUB_GROUP S1_Debounce /end SUB_GROUP /begin REF_CHARACTERISTIC Oil_uSRCPSwmpMax_C Oil_uSRCPSwmpMin_C /end REF_CHARACTERISTIC /begin REF_MEASUREMENT OilP_bSRCMax OilP_bSRCMin /end REF_MEASUREMENT /end GROUP
/begin GROUP Root_physical_value_range_detection "OilP_DD/physical value range detection" /begin SUB_GROUP S2_Debounce11 /end SUB_GROUP
 /begin REF_CHARACTERISTIC OilP_tiPlusDebHiLo_C OilP_tiPlusDebLoHi_C Oil_pAnaHi_C Oil_pMaxP_CUR Oil_pMinP_CUR Oil_pTransfPSwmp_CUR Oil_tLimP_C /end REF_CHARACTERISTIC
 /begin REF_MEASUREMENT OilP_bPhysRngHi OilP_bPhysRngLo Oil_pMaxP_mp Oil_pMinP_mp /end REF_MEASUREMENT
/end GROUP
/begin GROUP S1_Debounce "OilP_DD/ voltage value range detection/Debounce"
 /begin REF_CHARACTERISTIC Oil_tiSRCMaxPSwmpDefDeb_C Oil_tiSRCMaxPSwmpOKDeb_C Oil_tiSRCMinPSwmpDefDeb_C Oil_tiSRCMinPSwmpOKDeb_C /end REF_CHARACTERISTIC
/end GROUP
/begin GROUP S2_Debounce11 "OilP_DD/physical value range detection/Debounce1"
 /begin REF_CHARACTERISTIC Oil_tiPhysRngHiPSwmpDefDeb_C Oil_tiPhysRngHiPSwmpOKDeb_C Oil_tiPhysRngLoPSwmpDefDeb_C Oil_tiPhysRngLoPSwmpOKDeb_C /end REF_CHARACTERISTIC
/end GROUP
/begin GROUP OilP_VD "OilP_VD"
 /begin SUB_GROUP Root_analog_sensor_the_oil_pressure Root_digital_sensor_the_oil_pressure /end SUB_GROUP
/end GROUP
/begin GROUP Root_analog_sensor_the_oil_pressure "OilP_VD/analog sensor the oil pressure"
 /begin REF_CHARACTERISTIC Oil_RmpSlpPNeg_C Oil_RmpSlpPPos_C Oil_facPT1FltP_C Oil_pTransStgDfl_C SigTst_pOilPSwmp_C SigTst_swtOilPSwmp_C /end REF_CHARACTERISTIC
/end GROUP
/begin GROUP Root_digital_sensor_the_oil_pressure "OilP_VD/digital sensor the oil pressure" /begin REF_CHARACTERISTIC Oil_swtPresSensTyp_C /end REF_CHARACTERISTIC /end GROUP
/begin GROUP OilT_DD "OilT_DD" /begin SUB_GROUP Root_Debounce5 /end SUB_GROUP /begin REF_CHARACTERISTIC Oil_tTransfT_CUR Oil_uSRCTMax_C Oil_uSRCTMin_C /end REF_CHARACTERISTIC /begin REF_MEASUREMENT OilT_bSRCMax OilT_bSRCMin /end REF_MEASUREMENT /end GROUP
/begin GROUP Root_Debounce5 "OilT_DD/Debounce"
 /begin REF_CHARACTERISTIC Oil_tiMaxTDefDeb_C Oil_tiMaxTOKDeb_C Oil_tiMinTDefDeb_C Oil_tiMinTOKDeb_C /end REF_CHARACTERISTIC
/end GROUP
/begin GROUP OilT_VD "OilT_VD"
 /begin SUB_GROUP Root_oil_temperature_limitation Root_oil_temperature_physical_range_detection /end SUB_GROUP
/end GROUP
/begin GROUP Root_oil_temperature_limitation "OilT_VD/oil temperature limitation"
 /begin REF_CHARACTERISTIC Oil_RmpSlpTNeg_C Oil_RmpSlpTPos_C Oil_facSerPT1T_C Oil_tTransStgTDfl_C SigTst_swtOilTSwmp_C SigTst_tOilTSwmp_C /end REF_CHARACTERISTIC
/end GROUP
/begin GROUP Root_oil_temperature_physical_range_detection "OilT_VD/oil temperature physical range detection" /begin SUB_GROUP S2_Debounce3 /end SUB_GROUP /begin REF_CHARACTERISTIC Oil_tDiffMaxHiT_C /end REF_CHARACTERISTIC /end GROUP
/begin GROUP S2_Debounce3 "OilT_VD/oil temperature physical range detection/Debounce" /begin REF_CHARACTERISTIC Oil_tiPlausTDefDeb_C Oil_tiPlausTOKDeb_C /end REF_CHARACTERISTIC /end GROUP
/begin GROUP Strt_DD "Strt_DD" /begin SUB_GROUP Root_Strt_DD /end SUB_GROUP /end GROUP
/begin GROUP Root_Strt_DD "Strt_DD/Strt_DD" /begin REF_CHARACTERISTIC Strt_stPsDisbl_C /end REF_CHARACTERISTIC /end GROUP
/begin GROUP FlFWLvl_DD "FlFWLvl_DD"
 /begin REF_CHARACTERISTIC FlFWLvl_tiSensSigRawDebHiLo_C FlFWLvl_tiSensSigRawDebLoHi_C /end REF_CHARACTERISTIC
/end GROUP
/begin GROUP FlFWLvl_VD "FlFWLvl_VD" /begin REF_CHARACTERISTIC SigTst_stFlFWLv_C SigTst_swtFlFWLv_C /end REF_CHARACTERISTIC /end GROUP
/begin GROUP FlFltCtl_Ht "FlFltCtl_Ht" /begin SUB_GROUP Root_Subsystem2 /end SUB_GROUP /end GROUP
/begin GROUP Root_Subsystem2 "FlFltCtl_Ht/Subsystem"
 /begin REF_CHARACTERISTIC FlFltCtl_SwtSigSel_C FlFltCtl_nHtThres_C FlFltCtl_tHysHi_C FlFltCtl_tHysLo_C /end REF_CHARACTERISTIC
/end GROUP
/begin GROUP FlWtDet_DD "FlWtDet_DD"
 /begin REF_CHARACTERISTIC FlWLmp_O_D_ATS FlWLmp_stPsDiaDisbl_C FlWLmp_stPsDisbl_C SigTst_swtFlWLmp_C /end REF_CHARACTERISTIC
/end GROUP
/begin GROUP FuelT_DD "FuelT_DD" /begin SUB_GROUP Root_physical_detection Root_voltage_detection /end SUB_GROUP /end GROUP
/begin GROUP Root_physical_detection "FuelT_DD/physical detection" /begin SUB_GROUP S1_Debounce1 /end SUB_GROUP
 /begin REF_CHARACTERISTIC FuelT_swtTempPlaSel_C FuelT_tDiffMaxHi_C FuelT_tDiffMaxLo_C /end REF_CHARACTERISTIC
 /begin REF_MEASUREMENT FuelT_bPlsMax FuelT_bPlsMin /end REF_MEASUREMENT
/end GROUP
/begin GROUP Root_voltage_detection "FuelT_DD/voltage detection" /begin SUB_GROUP S2_Debounce4 /end SUB_GROUP /begin REF_CHARACTERISTIC FuelT_tTransf_CUR FuelT_uSRCMax_C FuelT_uSRCMin_C /end REF_CHARACTERISTIC /begin REF_MEASUREMENT FuelT_bSRCMax FuelT_bSRCMin /end REF_MEASUREMENT /end GROUP
/begin GROUP S1_Debounce1 "FuelT_DD/physical detection/Debounce1"
 /begin REF_CHARACTERISTIC FuelT_tiPlausHiDefDeb_C FuelT_tiPlausHiOKDeb_C FuelT_tiPlausLoDefDeb_C FuelT_tiPlausLoOKDeb_C /end REF_CHARACTERISTIC
/end GROUP
/begin GROUP S2_Debounce4 "FuelT_DD/voltage detection/Debounce"
 /begin REF_CHARACTERISTIC FuelT_tiMaxDefDeb_C FuelT_tiMaxOKDeb_C FuelT_tiMinDefDeb_C FuelT_tiMinOKDeb_C /end REF_CHARACTERISTIC
/end GROUP
/begin GROUP FuelT_VD "FuelT_VD" /begin SUB_GROUP Root_overview /end SUB_GROUP /end GROUP
/begin GROUP Root_overview "FuelT_VD/overview" /begin SUB_GROUP S1_FuelT_Sys /end SUB_GROUP
 /begin REF_CHARACTERISTIC FuelT_RmpSlpNeg_C FuelT_RmpSlpPos_C FuelT_facSerPT1T_C FuelT_tTransStgDfl_C SigTst_swtFuelT_C SigTst_tFuelT_C /end REF_CHARACTERISTIC
/end GROUP
/begin GROUP S1_FuelT_Sys "FuelT_VD/overview/FuelT_Sys" /begin REF_CHARACTERISTIC FuelT_swtTempSel_C FuelT_tDflFlSys_C /end REF_CHARACTERISTIC /end GROUP
/begin GROUP MeUn_DD "MeUn_DD" /begin SUB_GROUP Root_MeUn_rPsPreRot Root_MeUn_stHSAct Root_MeUn_tiPer /end SUB_GROUP /end GROUP
/begin GROUP Root_MeUn_rPsPreRot "MeUn_DD/MeUn_rPsPreRot" /begin SUB_GROUP S1_Error_Handle S1_MeUn_rSetLin S1_duty_correction /end SUB_GROUP /end GROUP
/begin GROUP Root_MeUn_stHSAct "MeUn_DD/MeUn_stHSAct" /begin REF_CHARACTERISTIC MeUn_stHSAct_C /end REF_CHARACTERISTIC /end GROUP
/begin GROUP Root_MeUn_tiPer "MeUn_DD/MeUn_tiPer"
 /begin REF_CHARACTERISTIC MeUn_nDiffMax_C MeUn_tiPerUBattHi_C MeUn_tiPer_CUR MeUn_uBattHi_C MeUn_uBattLo_C /end REF_CHARACTERISTIC
 /begin REF_MEASUREMENT MeUn_nDiffRef_mp /end REF_MEASUREMENT
/end GROUP
/begin GROUP S1_Error_Handle "MeUn_DD/MeUn_rPsPreRot/Error Handle" /begin REF_CHARACTERISTIC MeUn_stPwrStgActv_C MeUn_stPwrStgDia_C /end REF_CHARACTERISTIC /end GROUP
/begin GROUP S1_MeUn_rSetLin "MeUn_DD/MeUn_rPsPreRot/MeUn_rSetLin" /begin REF_CHARACTERISTIC MeUn_rSetLin_CUR MeUn_resCoil_C /end REF_CHARACTERISTIC /begin REF_MEASUREMENT MeUn_rSetLin_mp MeUn_rSet_mp /end REF_MEASUREMENT /end GROUP
/begin GROUP S1_duty_correction "MeUn_DD/MeUn_rPsPreRot/duty_correction"
 /begin REF_CHARACTERISTIC MeUn_CrntCtlDT1Kd_C MeUn_CrntCtlDT1T1_C MeUn_rPwmOutMax_CUR MeUn_rPwmOutMin_C MeUn_swtBattCor_C SigTst_rMeUnDuty_C SigTst_swtMeUnDuty_C /end REF_CHARACTERISTIC
 /begin REF_MEASUREMENT MeUn_rPwmOutMax_mp MeUn_rSetBattCor_mp MeUn_rSetDT1_mp /end REF_MEASUREMENT
/end GROUP
/begin GROUP MeUn_Rot "MeUn_Rot" /begin SUB_GROUP Root_OutPutDutyCycle Root_StateOfAnchorRotation /end SUB_GROUP /end GROUP
/begin GROUP Root_OutPutDutyCycle "MeUn_Rot/OutPutDutyCycle" /begin REF_CHARACTERISTIC MeUn_rLin_CUR MeUn_rRotEnd_C MeUn_rRotStrt_C /end REF_CHARACTERISTIC /begin REF_MEASUREMENT MeUn_rRot_mp /end REF_MEASUREMENT /end GROUP
/begin GROUP Root_StateOfAnchorRotation "MeUn_Rot/StateOfAnchorRotation"
 /begin REF_CHARACTERISTIC MeUn_ctRot_C MeUn_stRotActv_C MeUn_tiRotDel_C MeUn_tiRotWait_C /end REF_CHARACTERISTIC
 /begin REF_MEASUREMENT MeUn_ctRot_mp MeUn_stRotEnd_mp /end REF_MEASUREMENT
/end GROUP
/begin GROUP MeUn_VD "MeUn_VD"
 /begin SUB_GROUP Root_MeUn_facCrntCtlLim Root_MeUn_iAct Root_MeUn_stActrCtl Root_iDvt_Calculate Root_iSet_Calculate /end SUB_GROUP
 /begin REF_CHARACTERISTIC MeUn_VoltLin_CUR MeUn_swtVolt_C /end REF_CHARACTERISTIC
 /begin REF_MEASUREMENT MeUn_uRawCal_mp /end REF_MEASUREMENT
/end GROUP
/begin GROUP Root_MeUn_facCrntCtlLim "MeUn_VD/MeUn_facCrntCtlLim"
 /begin REF_CHARACTERISTIC MeUn_CrntCtlIKiNeg_C MeUn_CrntCtlIKiPos_C MeUn_CrntCtlIKi_C MeUn_CrntCtlIWinNeg_C MeUn_CrntCtlIWinPos_C MeUn_bCrntClsdCtl_C MeUn_bFuelTFit_C MeUn_facCrntCtlInit_CUR MeUn_facCrntCtlMax_C MeUn_facCrntCtlMin_C MeUn_facCrntOpenCtl_CUR MeUn_swtFrzICtl_C MeUn_tDefltTemp_C MeUn_tTempInitThrsd_C MeUn_tiCrntCtlInit_C /end REF_CHARACTERISTIC
 /begin REF_MEASUREMENT MeUn_facCrntBefCtlLim_mp /end REF_MEASUREMENT
/end GROUP
/begin GROUP Root_MeUn_iAct "MeUn_VD/MeUn_iAct" /begin SUB_GROUP S2_Debounce5 S2_IIR_fiter S2_Sensing_of_the_actual_current /end SUB_GROUP /end GROUP
/begin GROUP Root_MeUn_stActrCtl "MeUn_VD/MeUn_stActrCtl" /begin REF_CHARACTERISTIC MeUn_stActrCtl_C /end REF_CHARACTERISTIC /begin REF_MEASUREMENT MeUn_stActrCtl_mp /end REF_MEASUREMENT /end GROUP
/begin GROUP Root_iDvt_Calculate "MeUn_VD/iDvt_Calculate" /begin REF_CHARACTERISTIC MeUn_facFlt1PT1_C MeUn_facFlt2PT1_C /end REF_CHARACTERISTIC /begin REF_MEASUREMENT MeUn_iActFlt_mp MeUn_iDvt_mp MeUn_iSetFlt_mp /end REF_MEASUREMENT /end GROUP
/begin GROUP Root_iSet_Calculate "MeUn_VD/iSet_Calculate"
 /begin REF_CHARACTERISTIC MeUn_iCnvFlowRate_CUR MeUn_iSetMin_C SigTst_iMeUnCurrent_C SigTst_swtMeUnCurrent_C /end REF_CHARACTERISTIC
 /begin REF_MEASUREMENT MeUn_iCnvFlowRate_mp /end REF_MEASUREMENT
/end GROUP
/begin GROUP S2_Debounce5 "MeUn_VD/MeUn_iAct/Debounce"
 /begin REF_CHARACTERISTIC MeUn_tiSRCMaxDefDeb_C MeUn_tiSRCMaxOKDeb_C MeUn_tiSRCMinDefDeb_C MeUn_tiSRCMinOKDeb_C MeUn_uSRCMax_C MeUn_uSRCMin_C /end REF_CHARACTERISTIC
 /begin REF_MEASUREMENT MeUn_bSRCMax_mp MeUn_bSRCMin_mp /end REF_MEASUREMENT
/end GROUP
/begin GROUP S2_IIR_fiter "MeUn_VD/MeUn_iAct/IIR_fiter" /begin REF_MEASUREMENT MeUn_uRaw_filter /end REF_MEASUREMENT /end GROUP
/begin GROUP S2_Sensing_of_the_actual_current "MeUn_VD/MeUn_iAct/Sensing of the actual current"
 /begin REF_CHARACTERISTIC MeUn_bFiterAct_C MeUn_iLin_CUR MeUn_uSRCMax_C MeUn_uSRCMin_C /end REF_CHARACTERISTIC
/end GROUP
/begin GROUP RailP_DD "RailP_DD" /begin SUB_GROUP Root_RailP_pLinCal /end SUB_GROUP /end GROUP
/begin GROUP Root_RailP_pLinCal "RailP_DD/RailP_pLinCal" /begin SUB_GROUP S1_Debounce2 /end SUB_GROUP /begin REF_CHARACTERISTIC RailP_pLin_CUR RailP_uSRCMax_C RailP_uSRCMin_C /end REF_CHARACTERISTIC /begin REF_MEASUREMENT RailP_bSRCMax RailP_bSRCMin RailP_pLin_base /end REF_MEASUREMENT /end GROUP
/begin GROUP S1_Debounce2 "RailP_DD/RailP_pLinCal/Debounce"
 /begin REF_CHARACTERISTIC RailP_tiSRCMaxDefDeb_C RailP_tiSRCMaxOKDeb_C RailP_tiSRCMinDefDeb_C RailP_tiSRCMinOKDeb_C /end REF_CHARACTERISTIC
/end GROUP
/begin GROUP RailP_DDsync "RailP_DDsync" /begin REF_CHARACTERISTIC RailP_pLin_CUR RailP_uSRCMax_C RailP_uSRCMin_C /end REF_CHARACTERISTIC /end GROUP
/begin GROUP RailP_PRV "RailP_PRV" /begin SUB_GROUP Root_RailP_PRV /end SUB_GROUP /end GROUP
/begin GROUP Root_RailP_PRV "RailP_PRV/RailP_PRV"
 /begin REF_CHARACTERISTIC PRV_ClosePressureMin_C PRV_ctOpnMax_C PRV_dpRPGradOpn_CA0 PRV_dpRPGradOpn_CA1 PRV_nClsdMax_C PRV_nMinPresInc_C PRV_nOpnMin_C PRV_pAvrgRPTol_C PRV_tiCalcAvrgRP_C PRV_tiOpnMax_C PRV_tiWaitAvrgRP_C PRV_tiWaitNVld_C PRV_tiWaitPresInc_C /end REF_CHARACTERISTIC
 /begin REF_MEASUREMENT PRV_ctOpn_EEP PRV_ctOpn_mp_MW PRV_dpRPGradCurr_mp PRV_pDiff_mp PRV_tiOpn_EEP PRV_tiOpn_mp_MW /end REF_MEASUREMENT
/end GROUP
/begin GROUP RailP_VD "RailP_VD" /begin SUB_GROUP Root_RailP_VDCo_Inl1 /end SUB_GROUP /end GROUP
/begin GROUP Root_RailP_VDCo_Inl1 "RailP_VD/RailP_VDCo_Inl1" /begin SUB_GROUP S1_PT1_Parameter_Selection /end SUB_GROUP
 /begin REF_CHARACTERISTIC RailP_nDiffMax_C RailP_numMax_CUR RailP_pSubsCtlDlvMeUn_CUR RailP_swtFlt_C /end REF_CHARACTERISTIC
 /begin REF_MEASUREMENT RailP_dvolSubsCtlDlvMeUn_mp RailP_nRef_mp RailP_numMax_mp RailP_pFltNoCor_mp /end REF_MEASUREMENT
/end GROUP
/begin GROUP S1_PT1_Parameter_Selection "RailP_VD/RailP_VDCo_Inl1/PT1 Parameter Selection"
 /begin REF_CHARACTERISTIC RailP_facFlt1PT1_C RailP_facFlt2PT1_C RailP_facFlt3PT1_C RailP_pFltWinNeg_CUR /end REF_CHARACTERISTIC
 /begin REF_MEASUREMENT RailP_facFltPT1_mp /end REF_MEASUREMENT
/end GROUP
/begin GROUP RailP_VDGradMon "RailP_VDGradMon" /begin SUB_GROUP Root_RailP_bGradMonDef Root_RailP_stGradCal /end SUB_GROUP /end GROUP
/begin GROUP Root_RailP_bGradMonDef "RailP_VDGradMon/RailP_bGradMonDef" /begin REF_CHARACTERISTIC RailP_numdPDefDeb_C RailP_numdPOKDeb_C /end REF_CHARACTERISTIC /begin REF_MEASUREMENT RailP_bGradMon /end REF_MEASUREMENT /end GROUP
/begin GROUP Root_RailP_stGradCal "RailP_VDGradMon/RailP_stGradCal" /begin REF_CHARACTERISTIC RailP_dpMaxHyd_C RailP_numGradExcdMax_C RailP_tidPresRst_C /end REF_CHARACTERISTIC /end GROUP
/begin GROUP ACCmpr_DD "ACCmpr_DD"
 /begin REF_CHARACTERISTIC AirC_stCmprPsDiaDisbl_C AirC_stCmprPsDisbl_C SigTst_stACCmpr_C SigTst_swtACCmpr_C /end REF_CHARACTERISTIC
 /begin REF_MEASUREMENT AirC_stShutOffPsCmpr /end REF_MEASUREMENT
/end GROUP
/begin GROUP ACCmpr_VD "ACCmpr_VD" /begin SUB_GROUP Root_Subsystem3 /end SUB_GROUP /begin REF_CHARACTERISTIC AC_trqMaxAC_C /end REF_CHARACTERISTIC /end GROUP
/begin GROUP Root_Subsystem3 "ACCmpr_VD/Subsystem" /begin REF_CHARACTERISTIC AirC_trqCmprMax_C AirC_trqCmprMin_C /end REF_CHARACTERISTIC /end GROUP
/begin GROUP ACSwt_DD "ACSwt_DD" /begin SUB_GROUP Root_ACSwt_DD /end SUB_GROUP /end GROUP
/begin GROUP Root_ACSwt_DD "ACSwt_DD/ACSwt_DD" /begin REF_CHARACTERISTIC AirC_tiSwtDebHiLo_C AirC_tiSwtDebLoHi_C /end REF_CHARACTERISTIC /end GROUP
/begin GROUP ACSwt_VD "ACSwt_VD" /begin SUB_GROUP Root_ACSwt_VD /end SUB_GROUP /end GROUP
/begin GROUP Root_ACSwt_VD "ACSwt_VD/ACSwt_VD"
 /begin REF_CHARACTERISTIC AirC_stSwtDfl_C AirC_swtMnSwtSig_C SigTst_stAirCSwtPrs_C SigTst_swtAirCSwtPrs_C /end REF_CHARACTERISTIC
/end GROUP
/begin GROUP CEngDsT_DD "CEngDsT_DD" /begin SUB_GROUP Root_PRC_Debounce Root_SRC_Debounce Root_U2T_Cnv /end SUB_GROUP /end GROUP
/begin GROUP Root_PRC_Debounce "CEngDsT_DD/PRC_Debounce"
 /begin REF_CHARACTERISTIC CEngDsT_tPhysRngMax_C CEngDsT_tPhysRngMin_C CEngDsT_tiPhysRngHiDefDeb_C CEngDsT_tiPhysRngHiOKDeb_C CEngDsT_tiPhysRngLoDefDeb_C CEngDsT_tiPhysRngLoOKDeb_C /end REF_CHARACTERISTIC
 /begin REF_MEASUREMENT CEngDsT_bPhysRngHi CEngDsT_bPhysRngLo /end REF_MEASUREMENT
/end GROUP
/begin GROUP Root_SRC_Debounce "CEngDsT_DD/SRC_Debounce"
 /begin REF_CHARACTERISTIC CEngDsT_tiMaxDefDeb_C CEngDsT_tiMaxOKDeb_C CEngDsT_tiMinDefDeb_C CEngDsT_tiMinOKDeb_C CEngDsT_uSRCMax_C CEngDsT_uSRCMin_C /end REF_CHARACTERISTIC
 /begin REF_MEASUREMENT CEngDsT_bSRCMax CEngDsT_bSRCMin /end REF_MEASUREMENT
/end GROUP
/begin GROUP Root_U2T_Cnv "CEngDsT_DD/U2T_Cnv" /begin REF_CHARACTERISTIC CEngDsT_tTransf_CUR /end REF_CHARACTERISTIC /end GROUP
/begin GROUP CEngDsT_VD "CEngDsT_VD"
 /begin REF_CHARACTERISTIC CEngDsT_RmpSlpNeg_C CEngDsT_RmpSlpPos_C CEngDsT_facSerPT1_C CEngDsT_tDflCold_C CEngDsT_tDflWarm_C SigTst_swtCEngDsT_C SigTst_tCEngDsT_C /end REF_CHARACTERISTIC
/end GROUP
/begin GROUP Fan_DD "Fan_DD" /begin SUB_GROUP Root_Fan_DD /end SUB_GROUP /end GROUP
/begin GROUP Root_Fan_DD "Fan_DD/Fan_DD"
 /begin SUB_GROUP S1_Fan_rPs2_control_logic2 S1_Fan_rPs_control_logic S1_Fan_stPs2_control_logic2 S1_Fan_stPs_control_logic /end SUB_GROUP
 /begin REF_CHARACTERISTIC Fan_tiFanCyc_C /end REF_CHARACTERISTIC
/end GROUP
/begin GROUP S1_Fan_rPs_control_logic "Fan_DD/Fan_DD/Fan_rPs control logic"
 /begin REF_CHARACTERISTIC Fan_PwmOut_rMax_C Fan_PwmOut_rMin_C Fan_PwmOut_swtBattCor_C Fan_rCnv_CUR Fan_rPsDisbl_C Fan_stPsDiaDisblPWM_C Fan_stPsDisblPWM_C Fan_swtSYDia_C /end REF_CHARACTERISTIC
 /begin REF_MEASUREMENT Fan_Calculated_dutycycle_mp /end REF_MEASUREMENT
/end GROUP
/begin GROUP S1_Fan_rPs2_control_logic2 "Fan_DD/Fan_DD/Fan_rPs2 control logic2"
 /begin REF_CHARACTERISTIC Fan_PwmOut2_rMax_C Fan_PwmOut2_rMin_C Fan_PwmOut2_swtBattCor_C Fan_rCnv2_CUR Fan_rPsDisbl2_C Fan_stPsDiaDisblPWM2_C Fan_stPsDisblPWM2_C Fan_swtSYDia2_C /end REF_CHARACTERISTIC
/end GROUP
/begin GROUP S1_Fan_stPs_control_logic "Fan_DD/Fan_DD/Fan_stPs control logic" /begin REF_CHARACTERISTIC Fan_stPsDisDIO_C /end REF_CHARACTERISTIC /end GROUP
/begin GROUP S1_Fan_stPs2_control_logic2 "Fan_DD/Fan_DD/Fan_stPs2 control logic2" /begin REF_CHARACTERISTIC Fan_stPsDisDIO2_C /end REF_CHARACTERISTIC /end GROUP
/begin GROUP APP_ChkSig "APP_ChkSig"
 /begin SUB_GROUP Root_Limp_Mode Root_Live_Detection Root_PlaBrk_Ramp Root_RmtAPP_Gov /end SUB_GROUP
/end GROUP
/begin GROUP Root_Limp_Mode "APP_ChkSig/Limp_Mode" /begin REF_CHARACTERISTIC APP_drLimpMax_C APP_rLimpMax_C /end REF_CHARACTERISTIC /begin REF_MEASUREMENT APP_rUnLim_mp /end REF_MEASUREMENT /end GROUP
/begin GROUP Root_Live_Detection "APP_ChkSig/Live_Detection"
 /begin REF_CHARACTERISTIC APP_rThresAliveDet_C APP_swtAliveDetEna_C APP_tiAliveDebHiLo_C APP_tiAliveDebLoHi_C /end REF_CHARACTERISTIC
 /begin REF_MEASUREMENT APP_stAlive_mp /end REF_MEASUREMENT
/end GROUP
/begin GROUP Root_PlaBrk_Ramp "APP_ChkSig/PlaBrk_Ramp"
 /begin REF_CHARACTERISTIC APP_drLimNeg_C APP_drLimPos_C APP_rPlaMaxVal_C APP_swtPlaChkEna_C /end REF_CHARACTERISTIC
 /begin REF_MEASUREMENT APP_rPla_mp /end REF_MEASUREMENT
/end GROUP
/begin GROUP Root_RmtAPP_Gov "APP_ChkSig/RmtAPP_Gov"
 /begin REF_CHARACTERISTIC APP_rRmtAPPThresTrqDemH_C APP_rRmtAPPThresTrqDemL_C APP_rRmtAPPThresTrqDem_C APP_stRmtAppTrqEN_C APP_tiRmtAppEN_C /end REF_CHARACTERISTIC
/end GROUP
/begin GROUP APP_DD1 "APP_DD1" /begin SUB_GROUP Root_DSM_Check Root_Error_Reaction_ /end SUB_GROUP /end GROUP
/begin GROUP Root_DSM_Check "APP_DD1/DSM_Check"
 /begin REF_CHARACTERISTIC APP_tiSRCHighDefDeb_C APP_tiSRCHighOKDeb_C APP_tiSRCLowDefDeb_C APP_tiSRCLowOKDeb_C APP_uRaw1SRCHigh_C APP_uRaw1SRCLow_C /end REF_CHARACTERISTIC
 /begin REF_MEASUREMENT APP_bSRCHigh1 APP_bSRCLow1 /end REF_MEASUREMENT
/end GROUP
/begin GROUP Root_Error_Reaction_ "APP_DD1/Error_Reaction " /begin REF_CHARACTERISTIC APP_uRaw1Def_C /end REF_CHARACTERISTIC /end GROUP
/begin GROUP APP_DD2 "APP_DD2" /begin SUB_GROUP Root_DSM_Check1 Root_Error_Reaction /end SUB_GROUP /end GROUP
/begin GROUP Root_DSM_Check1 "APP_DD2/DSM_Check"
 /begin REF_CHARACTERISTIC APP_tiSRCHighDefDeb_C APP_tiSRCHighOKDeb_C APP_tiSRCLowDefDeb_C APP_tiSRCLowOKDeb_C APP_uRaw2SRCHigh_C APP_uRaw2SRCLow_C /end REF_CHARACTERISTIC
 /begin REF_MEASUREMENT APP_bSRCHigh2 APP_bSRCLow2 /end REF_MEASUREMENT
/end GROUP
/begin GROUP Root_Error_Reaction "APP_DD2/Error_Reaction" /begin REF_CHARACTERISTIC APP_uRaw2Def_C /end REF_CHARACTERISTIC /end GROUP
/begin GROUP APP_Kickdown "APP_Kickdown"
 /begin REF_CHARACTERISTIC APP_uKDHighAPP_C APP_uKDLowAPP_C MoFAPP_dRawSigFac_C SigTst_stAPPKickDown_C SigTst_swtAPPKickDown_C /end REF_CHARACTERISTIC
/end GROUP
/begin GROUP APP_Plaus12 "APP_Plaus12" /begin SUB_GROUP Root_Sync_Calculation Root_Sync_Fault_Process /end SUB_GROUP /end GROUP
/begin GROUP Root_Sync_Calculation "APP_Plaus12/Sync_Calculation" /begin REF_CHARACTERISTIC APP_uSyncMin_C MoFAPP_dRawSigFac_C MoFAPP_uSync_CUR /end REF_CHARACTERISTIC /begin REF_MEASUREMENT APP_uDiffMax_mp APP_uDiff_mp APP_uMin12half_mp /end REF_MEASUREMENT /end GROUP
/begin GROUP Root_Sync_Fault_Process "APP_Plaus12/Sync_Fault_Process" /begin REF_CHARACTERISTIC APP_PlaAPPDefDeb_C APP_PlaAPPDefOK_C /end REF_CHARACTERISTIC /end GROUP
/begin GROUP APP_PlausBrk "APP_PlausBrk" /begin SUB_GROUP Root_Plausibility_Detection Root_Release_Condition /end SUB_GROUP /end GROUP
/begin GROUP Root_Plausibility_Detection "APP_PlausBrk/Plausibility_Detection"
 /begin REF_CHARACTERISTIC APP_drUnFltLim_C APP_swtAppGradEna_C APP_swtBrkDet_C APP_swtRstCon_C APP_tiGradCondDebHiLo_C APP_tiGradCondDebLoHi_C /end REF_CHARACTERISTIC
 /begin REF_MEASUREMENT APP_stAPP_mp APP_stBrk_mp /end REF_MEASUREMENT
/end GROUP
/begin GROUP Root_Release_Condition "APP_PlausBrk/Release_Condition"
 /begin REF_CHARACTERISTIC APP_nLim_C APP_tiPlaBrkDetDeb_C APP_tiPlaBrkRstDeb_C APP_vLim_C /end REF_CHARACTERISTIC
/end GROUP
/begin GROUP APP_SelSig "APP_SelSig" /begin SUB_GROUP Root_Signal_Selection /end SUB_GROUP /end GROUP
/begin GROUP Root_Signal_Selection "APP_SelSig/Signal_Selection"
 /begin REF_CHARACTERISTIC APP_duLimErrPos_C APP_uAPPDef_C APP_uRaw2Offset_C MoFAPP_dRawSigFac_C /end REF_CHARACTERISTIC
 /begin REF_MEASUREMENT APP_stTempErr_mp /end REF_MEASUREMENT
/end GROUP
/begin GROUP APP_VD "APP_VD" /begin SUB_GROUP Root_APP_UnJit Root_Linearisation Root_Signal_Filter /end SUB_GROUP /end GROUP
/begin GROUP Root_APP_UnJit "APP_VD/APP_UnJit" /begin REF_CHARACTERISTIC APP_swtEnaUnJit_C APP_uJitter_C /end REF_CHARACTERISTIC /end GROUP
/begin GROUP Root_Linearisation "APP_VD/Linearisation" /begin SUB_GROUP S2_APP_rUnFlt_inl /end SUB_GROUP /begin REF_CHARACTERISTIC MoFAPP_rLinAPPCURCalMsgA_CUR SigTst_rAPP_C SigTst_swtAPP_C /end REF_CHARACTERISTIC /end GROUP
/begin GROUP Root_Signal_Filter "APP_VD/Signal_Filter" /begin SUB_GROUP S3_Filter_parameter_selection /end SUB_GROUP /begin REF_CHARACTERISTIC APP_swtEnaFlt_C /end REF_CHARACTERISTIC /end GROUP
/begin GROUP S2_APP_rUnFlt_inl "APP_VD/Linearisation/APP_rUnFlt_inl" /begin REF_CHARACTERISTIC APP_drLinRmp_C /end REF_CHARACTERISTIC /begin REF_MEASUREMENT APP_rUnFlt_mp /end REF_MEASUREMENT /end GROUP
/begin GROUP S3_Filter_parameter_selection "APP_VD/Signal_Filter/Filter_parameter_selection"
 /begin REF_CHARACTERISTIC APP_facLowNegPT1_C APP_facLowPosPT1_C APP_facMidNegPT1_C APP_facMidPosPT1_C APP_facUppNegPT1_C APP_facUppPosPT1_C APP_rThrFltLowNeg_C APP_rThrFltLowPos_C APP_rThrFltMidNeg_C APP_rThrFltMidPos_C /end REF_CHARACTERISTIC
 /begin REF_MEASUREMENT APP_facPT1 /end REF_MEASUREMENT
/end GROUP
/begin GROUP Brk_DD "Brk_DD"
 /begin REF_CHARACTERISTIC BrkDD_bBrkSigInv_C Brk_tiMnDebHiLo_C Brk_tiMnDebLoHi_C Brk_tiRedDebHiLo_C Brk_tiRedDebLoHi_C SigTst_stBrkMn_C SigTst_stBrkRed_C SigTst_swtBrkMn_C SigTst_swtBrkRed_C /end REF_CHARACTERISTIC
/end GROUP
/begin GROUP Brk_VD "Brk_VD" /begin REF_CHARACTERISTIC Brk_tiPlaDebDef_C Brk_tiPlaDebOk_C /end REF_CHARACTERISTIC /end GROUP
/begin GROUP Clth_DD "Clth_DD"
 /begin REF_CHARACTERISTIC Clth_stDflVal_C Clth_swtSig_C Clth_tiDebHiLo_C Clth_tiDebLoHi_C SigTst_stClth_C SigTst_swtClth_C /end REF_CHARACTERISTIC
 /begin REF_MEASUREMENT Clth_stIntDebVal /end REF_MEASUREMENT
/end GROUP
/begin GROUP Clth_VD "Clth_VD"
 /begin REF_CHARACTERISTIC Clth_nNoGearShftDet_C Clth_tiGearShft_C Clth_tiPlaDebDef_C Clth_tiPlaDebOk_C Clth_vNoGearShftDet_C /end REF_CHARACTERISTIC
 /begin REF_MEASUREMENT Clth_stLastGear Clth_stOldGear Clth_stOpnMark /end REF_MEASUREMENT
/end GROUP
/begin GROUP EngSpd_DD "EngSpd_DD" /begin REF_CHARACTERISTIC EngSpd_rPs_C EpmSpd_numPlsPerRot_C /end REF_CHARACTERISTIC /end GROUP
/begin GROUP EnvP_DD "EnvP_DD" /begin SUB_GROUP Root_PRC_Debounce1 Root_SRC_Debounce1 /end SUB_GROUP /end GROUP
/begin RECORD_LAYOUT Scalar_BOOLEAN FNC_VALUES 1 UBYTE COLUMN_DIR DIRECT /end RECORD_LAYOUT
/begin RECORD_LAYOUT Scalar_UBYTE FNC_VALUES 1 UBYTE COLUMN_DIR DIRECT /end RECORD_LAYOUT
/begin RECORD_LAYOUT Scalar_UWORD FNC_VALUES 1 UWORD COLUMN_DIR DIRECT /end RECORD_LAYOUT
/begin RECORD_LAYOUT Scalar_SWORD FNC_VALUES 1 SWORD COLUMN_DIR DIRECT /end RECORD_LAYOUT
/begin RECORD_LAYOUT Scalar_ULONG FNC_VALUES 1 ULONG COLUMN_DIR DIRECT /end RECORD_LAYOUT
/begin RECORD_LAYOUT Scalar_LONG FNC_VALUES 1 SLONG COLUMN_DIR DIRECT /end RECORD_LAYOUT
/begin RECORD_LAYOUT Lookup1D_UBYTE FNC_VALUES 1 UBYTE COLUMN_DIR DIRECT /end RECORD_LAYOUT
/begin RECORD_LAYOUT Lookup1D_UWORD FNC_VALUES 1 UWORD COLUMN_DIR DIRECT /end RECORD_LAYOUT
/begin RECORD_LAYOUT Lookup1D_X_UWORD AXIS_PTS_X 1 UWORD INDEX_INCR DIRECT /end RECORD_LAYOUT
/begin RECORD_LAYOUT Lookup1D_WORD FNC_VALUES 1 SWORD COLUMN_DIR DIRECT /end RECORD_LAYOUT
/begin RECORD_LAYOUT Lookup1D_X_WORD AXIS_PTS_X 1 SWORD INDEX_INCR DIRECT /end RECORD_LAYOUT
/begin RECORD_LAYOUT Lookup1D_X_FLOAT64_IEEE AXIS_PTS_X 1 FLOAT64_IEEE INDEX_INCR DIRECT /end RECORD_LAYOUT
/begin RECORD_LAYOUT Lookup2D_BOOLEAN FNC_VALUES 1 UBYTE COLUMN_DIR DIRECT /end RECORD_LAYOUT
/end MODULE
/end PROJECT
