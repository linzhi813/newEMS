/******************************************************************************
* ASAP2 file: CEngDsT_DD.a2l
* Code generation for model "CEngDsT_DD".
* Model version : 1.108
* Simulink Coder version : 9.4 (R2020b) 29-Jul-2020
* C source code generated on : Thu Feb 4 10:09:05 2021
* Target selection: ert.tlc
* Embedded hardware selection: ARM Compatible->ARM Cortex
* Code generation objectives: Unspecified
* Validation result: Not run
* (add additional file header information here)
******************************************************************************/ ASAP2_VERSION 1 31
/* Version 1.31 */
/begin PROJECT ProjectName "Project Comment Goes Here"
/begin HEADER "Header Comments go here" /end HEADER
/begin MODULE ModuleName "Module Comment Goes Here"
/begin MOD_PAR "MOD PAR Comment Goes Here" /end MOD_PAR
/begin MOD_COMMON "Mod Common Comment Here" BYTE_ORDER MSB_LAST /end MOD_COMMON
/begin RECORD_LAYOUT Scalar_BOOLEAN FNC_VALUES 1 UBYTE COLUMN_DIR DIRECT /end RECORD_LAYOUT
/begin RECORD_LAYOUT Scalar_UBYTE FNC_VALUES 1 UBYTE COLUMN_DIR DIRECT /end RECORD_LAYOUT
/begin RECORD_LAYOUT Scalar_BYTE FNC_VALUES 1 SBYTE COLUMN_DIR DIRECT /end RECORD_LAYOUT
/begin RECORD_LAYOUT Scalar_UWORD FNC_VALUES 1 UWORD COLUMN_DIR DIRECT /end RECORD_LAYOUT
/begin RECORD_LAYOUT Scalar_SWORD FNC_VALUES 1 SWORD COLUMN_DIR DIRECT /end RECORD_LAYOUT
/begin RECORD_LAYOUT Scalar_ULONG FNC_VALUES 1 ULONG COLUMN_DIR DIRECT /end RECORD_LAYOUT
/begin RECORD_LAYOUT Scalar_LONG FNC_VALUES 1 SLONG COLUMN_DIR DIRECT /end RECORD_LAYOUT
/begin RECORD_LAYOUT Scalar_FLOAT32_IEEE FNC_VALUES 1 FLOAT32_IEEE COLUMN_DIR DIRECT /end RECORD_LAYOUT
/begin RECORD_LAYOUT Scalar_FLOAT64_IEEE FNC_VALUES 1 FLOAT64_IEEE COLUMN_DIR DIRECT /end RECORD_LAYOUT
/begin RECORD_LAYOUT Lookup1D_BOOLEAN FNC_VALUES 1 UBYTE COLUMN_DIR DIRECT /end RECORD_LAYOUT
/begin RECORD_LAYOUT Lookup1D_X_BOOLEAN AXIS_PTS_X 1 UBYTE INDEX_INCR DIRECT /end RECORD_LAYOUT
/begin RECORD_LAYOUT Lookup1D_BYTE FNC_VALUES 1 SBYTE COLUMN_DIR DIRECT /end RECORD_LAYOUT
/begin RECORD_LAYOUT Lookup1D_X_BYTE AXIS_PTS_X 1 SBYTE INDEX_INCR DIRECT /end RECORD_LAYOUT
/begin RECORD_LAYOUT Lookup1D_UBYTE FNC_VALUES 1 UBYTE COLUMN_DIR DIRECT /end RECORD_LAYOUT
/begin RECORD_LAYOUT Lookup1D_X_UBYTE AXIS_PTS_X 1 UBYTE INDEX_INCR DIRECT /end RECORD_LAYOUT
/begin RECORD_LAYOUT Lookup1D_UWORD FNC_VALUES 1 UWORD COLUMN_DIR DIRECT /end RECORD_LAYOUT
/begin RECORD_LAYOUT Lookup1D_X_UWORD AXIS_PTS_X 1 UWORD INDEX_INCR DIRECT /end RECORD_LAYOUT
/begin RECORD_LAYOUT Lookup1D_WORD FNC_VALUES 1 SWORD COLUMN_DIR DIRECT /end RECORD_LAYOUT
/begin RECORD_LAYOUT Lookup1D_X_WORD AXIS_PTS_X 1 SWORD INDEX_INCR DIRECT /end RECORD_LAYOUT
/begin RECORD_LAYOUT Lookup1D_ULONG FNC_VALUES 1 ULONG COLUMN_DIR DIRECT /end RECORD_LAYOUT
/begin RECORD_LAYOUT Lookup1D_X_ULONG AXIS_PTS_X 1 ULONG INDEX_INCR DIRECT /end RECORD_LAYOUT
/begin RECORD_LAYOUT Lookup1D_SLONG FNC_VALUES 1 SLONG COLUMN_DIR DIRECT /end RECORD_LAYOUT
/begin RECORD_LAYOUT Lookup1D_X_LONG AXIS_PTS_X 1 SLONG INDEX_INCR DIRECT /end RECORD_LAYOUT
/begin RECORD_LAYOUT Lookup1D_FLOAT32_IEEE FNC_VALUES 1 FLOAT32_IEEE COLUMN_DIR DIRECT /end RECORD_LAYOUT
/begin RECORD_LAYOUT Lookup1D_X_FLOAT32_IEEE AXIS_PTS_X 1 FLOAT32_IEEE INDEX_INCR DIRECT /end RECORD_LAYOUT
/begin RECORD_LAYOUT Lookup1D_FLOAT64_IEEE FNC_VALUES 1 FLOAT64_IEEE COLUMN_DIR DIRECT /end RECORD_LAYOUT
/begin RECORD_LAYOUT Lookup1D_X_FLOAT64_IEEE AXIS_PTS_X 1 FLOAT64_IEEE INDEX_INCR DIRECT /end RECORD_LAYOUT
/begin RECORD_LAYOUT Lookup2D_BOOLEAN FNC_VALUES 1 UBYTE COLUMN_DIR DIRECT /end RECORD_LAYOUT
/begin RECORD_LAYOUT Lookup2D_X_BOOLEAN AXIS_PTS_X 1 UBYTE INDEX_INCR DIRECT /end RECORD_LAYOUT
/begin RECORD_LAYOUT Lookup2D_UBYTE FNC_VALUES 1 UBYTE COLUMN_DIR DIRECT /end RECORD_LAYOUT
/begin RECORD_LAYOUT Lookup2D_X_UBYTE AXIS_PTS_X 1 UBYTE INDEX_INCR DIRECT /end RECORD_LAYOUT
/begin RECORD_LAYOUT Lookup2D_BYTE FNC_VALUES 1 SBYTE COLUMN_DIR DIRECT /end RECORD_LAYOUT
/begin RECORD_LAYOUT Lookup2D_X_BYTE AXIS_PTS_X 1 SBYTE INDEX_INCR DIRECT /end RECORD_LAYOUT
/begin RECORD_LAYOUT Lookup2D_UWORD FNC_VALUES 1 UWORD COLUMN_DIR DIRECT /end RECORD_LAYOUT
/begin RECORD_LAYOUT Lookup2D_X_UWORD AXIS_PTS_X 1 UWORD INDEX_INCR DIRECT /end RECORD_LAYOUT
/begin RECORD_LAYOUT Lookup2D_WORD FNC_VALUES 1 SWORD COLUMN_DIR DIRECT /end RECORD_LAYOUT
/begin RECORD_LAYOUT Lookup2D_X_WORD AXIS_PTS_X 1 SWORD INDEX_INCR DIRECT /end RECORD_LAYOUT
/begin RECORD_LAYOUT Lookup2D_ULONG FNC_VALUES 1 ULONG COLUMN_DIR DIRECT /end RECORD_LAYOUT
/begin RECORD_LAYOUT Lookup2D_X_ULONG AXIS_PTS_X 1 ULONG INDEX_INCR DIRECT /end RECORD_LAYOUT
/begin RECORD_LAYOUT Lookup2D_LONG FNC_VALUES 1 SLONG COLUMN_DIR DIRECT /end RECORD_LAYOUT
/begin RECORD_LAYOUT Lookup2D_X_LONG AXIS_PTS_X 1 SLONG INDEX_INCR DIRECT /end RECORD_LAYOUT
/begin RECORD_LAYOUT Lookup2D_FLOAT32_IEEE FNC_VALUES 1 FLOAT32_IEEE COLUMN_DIR DIRECT /end RECORD_LAYOUT
/begin RECORD_LAYOUT Lookup2D_X_FLOAT32_IEEE AXIS_PTS_X 1 FLOAT32_IEEE INDEX_INCR DIRECT /end RECORD_LAYOUT
/begin RECORD_LAYOUT Lookup2D_FLOAT64_IEEE FNC_VALUES 1 FLOAT64_IEEE COLUMN_DIR DIRECT /end RECORD_LAYOUT
/begin RECORD_LAYOUT Lookup2D_X_FLOAT64_IEEE AXIS_PTS_X 1 FLOAT64_IEEE INDEX_INCR DIRECT /end RECORD_LAYOUT
/begin CHARACTERISTIC CEngDsT_tTransf_CUR "Transformation curve to convert the voltage value to temperature value" /* Characteristic Type */ CURVE 0x0000 /* @ECU_Address@CEngDsT_tTransf_CUR@ */ Lookup1D_WORD /* Maxdiff */ 0 CEngDsT_DD_CM_Temp_C_deg -50.0 150.0
 /begin AXIS_DESCR /* Description of X-Axis Points */ /* Axis Type */ COM_AXIS /* Reference to Input */ CEngDsT_uRaw CEngDsT_DD_CM_Volt_mV_mv /* Number of Axis Pts */ 26 0.0 5000.0 AXIS_PTS_REF CEngDsT_tTransf_CURX /end AXIS_DESCR
/end CHARACTERISTIC
/begin AXIS_PTS CEngDsT_tTransf_CURX "Transformation aixs to convert the voltage value to temperature value" 0x0000 /* @ECU_Address@CEngDsT_tTransf_CURX@ */ /* Input Quantity */ CEngDsT_uRaw Lookup1D_X_WORD 0 CEngDsT_DD_CM_Volt_mV_mv /* Number of Axis Pts */ 26 0.0 5000.0 /end AXIS_PTS
/begin CHARACTERISTIC CEngDsT_tiMaxDefDeb_C "Debounc time for checking heal of DFC_CEngDsTSRCMax" VALUE 0x0000 /* @ECU_Address@CEngDsT_tiMaxDefDeb_C@ */ Scalar_UWORD 0 CEngDsT_DD_CM_Debncd_ms_ms 0.0 655.0 /end CHARACTERISTIC
/begin CHARACTERISTIC CEngDsT_tiMaxOKDeb_C "Debounc time for checking heal of DFC_CEngDsTSRCMax" VALUE 0x0000 /* @ECU_Address@CEngDsT_tiMaxOKDeb_C@ */ Scalar_UWORD 0 CEngDsT_DD_CM_Debncd_ms_ms 0.0 655.0 /end CHARACTERISTIC
/begin CHARACTERISTIC CEngDsT_tiMinDefDeb_C "Debounc time for checking heal of DFC_CEngDsTSRCMin" VALUE 0x0000 /* @ECU_Address@CEngDsT_tiMinDefDeb_C@ */ Scalar_UWORD 0 CEngDsT_DD_CM_Debncd_ms_ms 0.0 655.0 /end CHARACTERISTIC
/begin CHARACTERISTIC CEngDsT_tiMinOKDeb_C "Debounc time for checking heal of DFC_CEngDsTSRCMin" VALUE 0x0000 /* @ECU_Address@CEngDsT_tiMinOKDeb_C@ */ Scalar_UWORD 0 CEngDsT_DD_CM_Debncd_ms_ms 0.0 655.0 /end CHARACTERISTIC
/begin CHARACTERISTIC CEngDsT_tiPhysRngHiDefDeb_C "Debounc time for checking heal of DFC_CEngDsTPhysRngHi" VALUE 0x0000 /* @ECU_Address@CEngDsT_tiPhysRngHiDefDeb_C@ */ Scalar_UWORD 0 CEngDsT_DD_CM_Debncd_ms_ms 0.0 655.0 /end CHARACTERISTIC
/begin CHARACTERISTIC CEngDsT_tiPhysRngHiOKDeb_C "Debounc time for checking heal of DFC_CEngDsTPhysRngHi" VALUE 0x0000 /* @ECU_Address@CEngDsT_tiPhysRngHiOKDeb_C@ */ Scalar_UWORD 0 CEngDsT_DD_CM_Debncd_ms_ms 0.0 655.0 /end CHARACTERISTIC
/begin CHARACTERISTIC CEngDsT_tiPhysRngLoDefDeb_C "Debounc time for checking heal of DFC_CEngDsTPhysRngLo" VALUE 0x0000 /* @ECU_Address@CEngDsT_tiPhysRngLoDefDeb_C@ */ Scalar_UWORD 0 CEngDsT_DD_CM_Debncd_ms_ms 0.0 655.0 /end CHARACTERISTIC
/begin CHARACTERISTIC CEngDsT_tiPhysRngLoOKDeb_C "Debounc time for checking heal of DFC_CEngDsTPhysRngLo" VALUE 0x0000 /* @ECU_Address@CEngDsT_tiPhysRngLoOKDeb_C@ */ Scalar_UWORD 0 CEngDsT_DD_CM_Debncd_ms_ms 0.0 655.0 /end CHARACTERISTIC
/begin CHARACTERISTIC CEngDsT_uSRCMax_C "Signal Range Check / Threshold for SRC -Max detection" VALUE 0x0000 /* @ECU_Address@CEngDsT_uSRCMax_C@ */ Scalar_SWORD 0 CEngDsT_DD_CM_Volt_mV_mv 0.0 5000.0 /end CHARACTERISTIC
/begin CHARACTERISTIC CEngDsT_uSRCMin_C "Signal Range Check / Threshold for SRC -Min detection" VALUE 0x0000 /* @ECU_Address@CEngDsT_uSRCMin_C@ */ Scalar_SWORD 0 CEngDsT_DD_CM_Volt_mV_mv 0.0 5000.0 /end CHARACTERISTIC
/begin MEASUREMENT CEngDsT_uRaw "" SWORD CEngDsT_DD_CM_Volt_mV 0 0 0.0 5000.0 ECU_ADDRESS 0x0000 /* @ECU_Address@CEngDsT_uRaw@ */ /end MEASUREMENT
/begin MEASUREMENT DSM_bCEngDsTSS "" UBYTE CEngDsT_DD_CM_boolean 0 0 0.0 1.0 ECU_ADDRESS 0x0000 /* @ECU_Address@DSM_bCEngDsTSS@ */ /end MEASUREMENT
/begin MEASUREMENT CEngDsT_tSens "Sensed engine coolant temperature" SWORD CEngDsT_DD_CM_Temp_C_deg 0 0 -200.0 200.0 ECU_ADDRESS 0x0000 /* @ECU_Address@CEngDsT_tSens@ */ /end MEASUREMENT
/begin MEASUREMENT CEngDsT_bSRCMax "coolant temperature voltage signal maximum limit value" UBYTE CEngDsT_DD_CM_boolean_NaN 0 0 0.0 1.0 ECU_ADDRESS 0x0000 /* @ECU_Address@CEngDsT_bSRCMax@ */ /end MEASUREMENT
/begin MEASUREMENT CEngDsT_bSRCMaxDeb_DSM "status of CEngDsT_bSRCMaxDeb" UBYTE CEngDsT_DD_CM_boolean_NaN 0 0 0.0 1.0 ECU_ADDRESS 0x0000 /* @ECU_Address@CEngDsT_bSRCMaxDeb_DSM@ */ /end MEASUREMENT
/begin MEASUREMENT CEngDsT_bSRCMin "coolant temperature voltage signal minimum limit value" UBYTE CEngDsT_DD_CM_boolean_NaN 0 0 0.0 1.0 ECU_ADDRESS 0x0000 /* @ECU_Address@CEngDsT_bSRCMin@ */ /end MEASUREMENT
/begin MEASUREMENT CEngDsT_bSRCMinDeb_DSM "status of CEngDsT_bSRCMinDeb" UBYTE CEngDsT_DD_CM_boolean_NaN 0 0 0.0 1.0 ECU_ADDRESS 0x0000 /* @ECU_Address@CEngDsT_bSRCMinDeb_DSM@ */ /end MEASUREMENT
/begin MEASUREMENT CEngDsT_bFinalDef "Status Sensor of the coolant temperature finally defect" UBYTE CEngDsT_DD_CM_boolean_NaN 0 0 0.0 1.0 ECU_ADDRESS 0x0000 /* @ECU_Address@CEngDsT_bFinalDef@ */ /end MEASUREMENT
/begin MEASUREMENT CEngDsT_bProvDef "Status Sensor of the coolant temperature temporary defect" UBYTE CEngDsT_DD_CM_boolean_NaN 0 0 0.0 1.0 ECU_ADDRESS 0x0000 /* @ECU_Address@CEngDsT_bProvDef@ */ /end MEASUREMENT
/begin MEASUREMENT CEngDsT_bPhysRngHi "Status Sensor of the coolant temperature high voltage Signal range" UBYTE CEngDsT_DD_CM_boolean_NaN 0 0 0.0 1.0 ECU_ADDRESS 0x0000 /* @ECU_Address@CEngDsT_bPhysRngHi@ */ /end MEASUREMENT
/begin MEASUREMENT CEngDsT_bPhysRngHiDeb_DSM "status of CEngDsT_bPhysRngHiDeb" UBYTE CEngDsT_DD_CM_boolean_NaN 0 0 0.0 1.0 ECU_ADDRESS 0x0000 /* @ECU_Address@CEngDsT_bPhysRngHiDeb_DSM@ */ /end MEASUREMENT
/begin MEASUREMENT CEngDsT_bPhysRngLo "Status Sensor of the coolant temperature low voltage Signal range" UBYTE CEngDsT_DD_CM_boolean_NaN 0 0 0.0 1.0 ECU_ADDRESS 0x0000 /* @ECU_Address@CEngDsT_bPhysRngLo@ */ /end MEASUREMENT
/begin MEASUREMENT CEngDsT_bPhysRngLoDeb_DSM "status of CEngDsT_bPhysRngLoDeb" UBYTE CEngDsT_DD_CM_boolean_NaN 0 0 0.0 1.0 ECU_ADDRESS 0x0000 /* @ECU_Address@CEngDsT_bPhysRngLoDeb_DSM@ */ /end MEASUREMENT
/begin MEASUREMENT CEngDsT_bPhysRngFinalDef "Status Sensor of the CEngDsT physical Signal range check finally defect" UBYTE CEngDsT_DD_CM_boolean_NaN 0 0 0.0 1.0 ECU_ADDRESS 0x0000 /* @ECU_Address@CEngDsT_bPhysRngFinalDef@ */ /end MEASUREMENT
/begin MEASUREMENT CEngDsT_bPhysRngProvDef "Status Sensor of the CEngDsT physical Signal range check temporary defect" UBYTE CEngDsT_DD_CM_boolean_NaN 0 0 0.0 1.0 ECU_ADDRESS 0x0000 /* @ECU_Address@CEngDsT_bPhysRngProvDef@ */ /end MEASUREMENT
/begin COMPU_METHOD CEngDsT_DD_CM_Temp_C_deg "Q = V*10.000000" RAT_FUNC "%5.1" "deg" COEFFS 0 10.000000 0.000000 0 0 1.000000 /end COMPU_METHOD
/begin COMPU_METHOD CEngDsT_DD_CM_Volt_mV_mv "Q = V" RAT_FUNC "%5.0" "mv" COEFFS 0 1 0 0 0 1 /end COMPU_METHOD
/begin COMPU_METHOD CEngDsT_DD_CM_Debncd_ms_ms "Q = V*10.000000" RAT_FUNC "%5.1" "ms" COEFFS 0 10.000000 0.000000 0 0 1.000000 /end COMPU_METHOD
/begin COMPU_METHOD CEngDsT_DD_CM_Volt_mV "Q = V" RAT_FUNC "%5.0" "" COEFFS 0 1 0 0 0 1 /end COMPU_METHOD
/begin COMPU_METHOD CEngDsT_DD_CM_boolean "Q = V" RAT_FUNC "%1.0" "" COEFFS 0 1 0 0 0 1 /end COMPU_METHOD
/begin COMPU_METHOD CEngDsT_DD_CM_boolean_NaN "Q = V" RAT_FUNC "%1.0" "NaN" COEFFS 0 1 0 0 0 1 /end COMPU_METHOD
/begin GROUP CEngDsT_DD "CEngDsT_DD" /* Root */ ROOT /begin SUB_GROUP Root_Overview /end SUB_GROUP /begin REF_MEASUREMENT CEngDsT_uRaw DSM_bCEngDsTSS /end REF_MEASUREMENT /end GROUP
/begin GROUP Root_Overview "CEngDsT_DD/Overview" /begin SUB_GROUP S1_CEngDsT_DD /end SUB_GROUP /end GROUP
/begin GROUP S1_CEngDsT_DD "CEngDsT_DD/Overview/CEngDsT_DD" /begin SUB_GROUP S2_PRC_Debounce S2_SRC_Debounce S2_U2T_Cnv /end SUB_GROUP /end GROUP
/begin GROUP S2_PRC_Debounce "CEngDsT_DD/Overview/CEngDsT_DD/PRC_Debounce"
 /begin REF_CHARACTERISTIC CEngDsT_tiPhysRngHiDefDeb_C CEngDsT_tiPhysRngHiOKDeb_C CEngDsT_tiPhysRngLoDefDeb_C CEngDsT_tiPhysRngLoOKDeb_C /end REF_CHARACTERISTIC
 /begin REF_MEASUREMENT CEngDsT_bPhysRngFinalDef CEngDsT_bPhysRngHi CEngDsT_bPhysRngHiDeb_DSM CEngDsT_bPhysRngLo CEngDsT_bPhysRngLoDeb_DSM CEngDsT_bPhysRngProvDef /end REF_MEASUREMENT
/end GROUP
/begin GROUP S2_SRC_Debounce "CEngDsT_DD/Overview/CEngDsT_DD/SRC_Debounce"
 /begin REF_CHARACTERISTIC CEngDsT_tiMaxDefDeb_C CEngDsT_tiMaxOKDeb_C CEngDsT_tiMinDefDeb_C CEngDsT_tiMinOKDeb_C CEngDsT_uSRCMax_C CEngDsT_uSRCMin_C /end REF_CHARACTERISTIC
 /begin REF_MEASUREMENT CEngDsT_bFinalDef CEngDsT_bProvDef CEngDsT_bSRCMax CEngDsT_bSRCMaxDeb_DSM CEngDsT_bSRCMin CEngDsT_bSRCMinDeb_DSM /end REF_MEASUREMENT
/end GROUP
/begin GROUP S2_U2T_Cnv "CEngDsT_DD/Overview/CEngDsT_DD/U2T_Cnv" /begin REF_CHARACTERISTIC CEngDsT_tTransf_CUR /end REF_CHARACTERISTIC /begin REF_MEASUREMENT CEngDsT_tSens /end REF_MEASUREMENT /end GROUP
/end MODULE
/end PROJECT
/* (add any file trailer comments here) */
/* EOF CEngDsT_DD.a2l */
