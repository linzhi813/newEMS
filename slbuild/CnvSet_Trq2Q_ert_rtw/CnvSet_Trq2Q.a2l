/******************************************************************************
* ASAP2 file: CnvSet_Trq2Q.a2l
* Code generation for model "CnvSet_Trq2Q".
* Model version : 1.66
* Simulink Coder version : 9.4 (R2020b) 29-Jul-2020
* C source code generated on : Thu Feb 4 09:40:32 2021
* Target selection: ert.tlc
* Embedded hardware selection: ARM Compatible->ARM Cortex
* Code generation objectives: Unspecified
* Validation result: Not run
* (add additional file header information here)
******************************************************************************/ ASAP2_VERSION 1 31
/* Version 1.31 */
/begin PROJECT ProjectName "Project Comment Goes Here"
/begin HEADER "Header Comments go here" /end HEADER
/begin MODULE ModuleName "Module Comment Goes Here"
/begin MOD_PAR "MOD PAR Comment Goes Here" /end MOD_PAR
/begin MOD_COMMON "Mod Common Comment Here" BYTE_ORDER MSB_LAST /end MOD_COMMON
/begin RECORD_LAYOUT Scalar_BOOLEAN FNC_VALUES 1 UBYTE COLUMN_DIR DIRECT /end RECORD_LAYOUT
/begin RECORD_LAYOUT Scalar_UBYTE FNC_VALUES 1 UBYTE COLUMN_DIR DIRECT /end RECORD_LAYOUT
/begin RECORD_LAYOUT Scalar_BYTE FNC_VALUES 1 SBYTE COLUMN_DIR DIRECT /end RECORD_LAYOUT
/begin RECORD_LAYOUT Scalar_UWORD FNC_VALUES 1 UWORD COLUMN_DIR DIRECT /end RECORD_LAYOUT
/begin RECORD_LAYOUT Scalar_SWORD FNC_VALUES 1 SWORD COLUMN_DIR DIRECT /end RECORD_LAYOUT
/begin RECORD_LAYOUT Scalar_ULONG FNC_VALUES 1 ULONG COLUMN_DIR DIRECT /end RECORD_LAYOUT
/begin RECORD_LAYOUT Scalar_LONG FNC_VALUES 1 SLONG COLUMN_DIR DIRECT /end RECORD_LAYOUT
/begin RECORD_LAYOUT Scalar_FLOAT32_IEEE FNC_VALUES 1 FLOAT32_IEEE COLUMN_DIR DIRECT /end RECORD_LAYOUT
/begin RECORD_LAYOUT Scalar_FLOAT64_IEEE FNC_VALUES 1 FLOAT64_IEEE COLUMN_DIR DIRECT /end RECORD_LAYOUT
/begin RECORD_LAYOUT Lookup1D_BOOLEAN FNC_VALUES 1 UBYTE COLUMN_DIR DIRECT /end RECORD_LAYOUT
/begin RECORD_LAYOUT Lookup1D_X_BOOLEAN AXIS_PTS_X 1 UBYTE INDEX_INCR DIRECT /end RECORD_LAYOUT
/begin RECORD_LAYOUT Lookup1D_BYTE FNC_VALUES 1 SBYTE COLUMN_DIR DIRECT /end RECORD_LAYOUT
/begin RECORD_LAYOUT Lookup1D_X_BYTE AXIS_PTS_X 1 SBYTE INDEX_INCR DIRECT /end RECORD_LAYOUT
/begin RECORD_LAYOUT Lookup1D_UBYTE FNC_VALUES 1 UBYTE COLUMN_DIR DIRECT /end RECORD_LAYOUT
/begin RECORD_LAYOUT Lookup1D_X_UBYTE AXIS_PTS_X 1 UBYTE INDEX_INCR DIRECT /end RECORD_LAYOUT
/begin RECORD_LAYOUT Lookup1D_UWORD FNC_VALUES 1 UWORD COLUMN_DIR DIRECT /end RECORD_LAYOUT
/begin RECORD_LAYOUT Lookup1D_X_UWORD AXIS_PTS_X 1 UWORD INDEX_INCR DIRECT /end RECORD_LAYOUT
/begin RECORD_LAYOUT Lookup1D_WORD FNC_VALUES 1 SWORD COLUMN_DIR DIRECT /end RECORD_LAYOUT
/begin RECORD_LAYOUT Lookup1D_X_WORD AXIS_PTS_X 1 SWORD INDEX_INCR DIRECT /end RECORD_LAYOUT
/begin RECORD_LAYOUT Lookup1D_ULONG FNC_VALUES 1 ULONG COLUMN_DIR DIRECT /end RECORD_LAYOUT
/begin RECORD_LAYOUT Lookup1D_X_ULONG AXIS_PTS_X 1 ULONG INDEX_INCR DIRECT /end RECORD_LAYOUT
/begin RECORD_LAYOUT Lookup1D_SLONG FNC_VALUES 1 SLONG COLUMN_DIR DIRECT /end RECORD_LAYOUT
/begin RECORD_LAYOUT Lookup1D_X_LONG AXIS_PTS_X 1 SLONG INDEX_INCR DIRECT /end RECORD_LAYOUT
/begin RECORD_LAYOUT Lookup1D_FLOAT32_IEEE FNC_VALUES 1 FLOAT32_IEEE COLUMN_DIR DIRECT /end RECORD_LAYOUT
/begin RECORD_LAYOUT Lookup1D_X_FLOAT32_IEEE AXIS_PTS_X 1 FLOAT32_IEEE INDEX_INCR DIRECT /end RECORD_LAYOUT
/begin RECORD_LAYOUT Lookup1D_FLOAT64_IEEE FNC_VALUES 1 FLOAT64_IEEE COLUMN_DIR DIRECT /end RECORD_LAYOUT
/begin RECORD_LAYOUT Lookup1D_X_FLOAT64_IEEE AXIS_PTS_X 1 FLOAT64_IEEE INDEX_INCR DIRECT /end RECORD_LAYOUT
/begin RECORD_LAYOUT Lookup2D_BOOLEAN FNC_VALUES 1 UBYTE COLUMN_DIR DIRECT /end RECORD_LAYOUT
/begin RECORD_LAYOUT Lookup2D_X_BOOLEAN AXIS_PTS_X 1 UBYTE INDEX_INCR DIRECT /end RECORD_LAYOUT
/begin RECORD_LAYOUT Lookup2D_UBYTE FNC_VALUES 1 UBYTE COLUMN_DIR DIRECT /end RECORD_LAYOUT
/begin RECORD_LAYOUT Lookup2D_X_UBYTE AXIS_PTS_X 1 UBYTE INDEX_INCR DIRECT /end RECORD_LAYOUT
/begin RECORD_LAYOUT Lookup2D_BYTE FNC_VALUES 1 SBYTE COLUMN_DIR DIRECT /end RECORD_LAYOUT
/begin RECORD_LAYOUT Lookup2D_X_BYTE AXIS_PTS_X 1 SBYTE INDEX_INCR DIRECT /end RECORD_LAYOUT
/begin RECORD_LAYOUT Lookup2D_UWORD FNC_VALUES 1 UWORD COLUMN_DIR DIRECT /end RECORD_LAYOUT
/begin RECORD_LAYOUT Lookup2D_X_UWORD AXIS_PTS_X 1 UWORD INDEX_INCR DIRECT /end RECORD_LAYOUT
/begin RECORD_LAYOUT Lookup2D_WORD FNC_VALUES 1 SWORD COLUMN_DIR DIRECT /end RECORD_LAYOUT
/begin RECORD_LAYOUT Lookup2D_X_WORD AXIS_PTS_X 1 SWORD INDEX_INCR DIRECT /end RECORD_LAYOUT
/begin RECORD_LAYOUT Lookup2D_ULONG FNC_VALUES 1 ULONG COLUMN_DIR DIRECT /end RECORD_LAYOUT
/begin RECORD_LAYOUT Lookup2D_X_ULONG AXIS_PTS_X 1 ULONG INDEX_INCR DIRECT /end RECORD_LAYOUT
/begin RECORD_LAYOUT Lookup2D_LONG FNC_VALUES 1 SLONG COLUMN_DIR DIRECT /end RECORD_LAYOUT
/begin RECORD_LAYOUT Lookup2D_X_LONG AXIS_PTS_X 1 SLONG INDEX_INCR DIRECT /end RECORD_LAYOUT
/begin RECORD_LAYOUT Lookup2D_FLOAT32_IEEE FNC_VALUES 1 FLOAT32_IEEE COLUMN_DIR DIRECT /end RECORD_LAYOUT
/begin RECORD_LAYOUT Lookup2D_X_FLOAT32_IEEE AXIS_PTS_X 1 FLOAT32_IEEE INDEX_INCR DIRECT /end RECORD_LAYOUT
/begin RECORD_LAYOUT Lookup2D_FLOAT64_IEEE FNC_VALUES 1 FLOAT64_IEEE COLUMN_DIR DIRECT /end RECORD_LAYOUT
/begin RECORD_LAYOUT Lookup2D_X_FLOAT64_IEEE AXIS_PTS_X 1 FLOAT64_IEEE INDEX_INCR DIRECT /end RECORD_LAYOUT
/begin CHARACTERISTIC PhyMod_trq2qBas_MAP "Engine basic map for conversion of torque/quantity" /* Characteristic Type */ MAP 0x0000 /* @ECU_Address@PhyMod_trq2qBas_MAP@ */ Lookup2D_WORD /* Maxdiff */ 0 CnvSet_Trq2Q_CM_InjMass_mg_hub -319.0 319.0
 /begin AXIS_DESCR /* Description of X-Axis Points */ /* Axis Type */ COM_AXIS /* Reference to Input */ Epm_nEng CnvSet_Trq2Q_CM_ERPM_rpm 16 -12000.0 12000.0 AXIS_PTS_REF PhyMod_trq2qBas_MAPX /end AXIS_DESCR
 /begin AXIS_DESCR /* Description of Y-Axis Points */ /* Axis Type */ COM_AXIS /* Reference to Input */ PthSet_trqInrSet CnvSet_Trq2Q_CM_Torq_Nm 16 -3276.8 3276.7 AXIS_PTS_REF PhyMod_trq2qBas_MAPY /end AXIS_DESCR
/end CHARACTERISTIC
/begin AXIS_PTS PhyMod_trq2qBas_MAPY "AxisY of the MAP" 0x0000 /* @ECU_Address@PhyMod_trq2qBas_MAPY@ */ /* Input Quantity */ PthSet_trqInrSet Lookup2D_X_WORD /* Maximum Difference */ 0 CnvSet_Trq2Q_CM_Torq_Nm 16 -3276.8 3276.7 /end AXIS_PTS
/begin AXIS_PTS PhyMod_trq2qBas_MAPX "AxisX of the MAP" 0x0000 /* @ECU_Address@PhyMod_trq2qBas_MAPX@ */ /* Input Quantity */ Epm_nEng Lookup2D_X_WORD /* Maximum Difference */ 0 CnvSet_Trq2Q_CM_ERPM_rpm 16 -12000.0 12000.0 /end AXIS_PTS
/begin MEASUREMENT PthSet_trqInrSet "" SWORD CnvSet_Trq2Q_CM_Torq 0 0 -3000.0 3276.7 ECU_ADDRESS 0x0000 /* @ECU_Address@PthSet_trqInrSet@ */ /end MEASUREMENT
/begin MEASUREMENT Epm_nEng "" SWORD CnvSet_Trq2Q_CM_ERPM 0 0 0.0 6000.0 ECU_ADDRESS 0x0000 /* @ECU_Address@Epm_nEng@ */ /end MEASUREMENT
/begin MEASUREMENT CnvSet_qSet "Set point injection quantity" SWORD CnvSet_Trq2Q_CM_InjMass_mg_hub 0 0 -319.0 319.0 ECU_ADDRESS 0x0000 /* @ECU_Address@CnvSet_qSet@ */ /end MEASUREMENT
/begin COMPU_METHOD CnvSet_Trq2Q_CM_InjMass_mg_hub "Q = V*100.000000" RAT_FUNC "%5.2" "mg/hub" COEFFS 0 100.000000 0.000000 0 0 1.000000 /end COMPU_METHOD
/begin COMPU_METHOD CnvSet_Trq2Q_CM_ERPM_rpm "Q = V*2.000000" RAT_FUNC "%6.1" "rpm" COEFFS 0 2.000000 0.000000 0 0 1.000000 /end COMPU_METHOD
/begin COMPU_METHOD CnvSet_Trq2Q_CM_Torq_Nm "Q = V*10.000000" RAT_FUNC "%5.1" "Nm" COEFFS 0 10.000000 0.000000 0 0 1.000000 /end COMPU_METHOD
/begin COMPU_METHOD CnvSet_Trq2Q_CM_Torq "Q = V*10.000000" RAT_FUNC "%5.1" "" COEFFS 0 10.000000 0.000000 0 0 1.000000 /end COMPU_METHOD
/begin COMPU_METHOD CnvSet_Trq2Q_CM_ERPM "Q = V*2.000000" RAT_FUNC "%6.1" "" COEFFS 0 2.000000 0.000000 0 0 1.000000 /end COMPU_METHOD
/begin GROUP CnvSet_Trq2Q "CnvSet_Trq2Q" /* Root */ ROOT /begin SUB_GROUP Root_Overview /end SUB_GROUP /begin REF_MEASUREMENT Epm_nEng PthSet_trqInrSet /end REF_MEASUREMENT /end GROUP
/begin GROUP Root_Overview "CnvSet_Trq2Q/Overview" /begin SUB_GROUP S1_CnvSet_Trq2Q /end SUB_GROUP /end GROUP
/begin GROUP S1_CnvSet_Trq2Q "CnvSet_Trq2Q/Overview/CnvSet_Trq2Q" /begin REF_CHARACTERISTIC PhyMod_trq2qBas_MAP /end REF_CHARACTERISTIC /begin REF_MEASUREMENT CnvSet_qSet /end REF_MEASUREMENT /end GROUP
/end MODULE
/end PROJECT
/* (add any file trailer comments here) */
/* EOF CnvSet_Trq2Q.a2l */
