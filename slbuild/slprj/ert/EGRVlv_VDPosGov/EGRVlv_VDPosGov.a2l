/******************************************************************************
* ASAP2 file: EGRVlv_VDPosGov.a2l
* Code generation for model "EGRVlv_VDPosGov".
* Model version : 1.82
* Simulink Coder version : 9.4 (R2020b) 29-Jul-2020
* C source code generated on : Thu Feb 4 09:39:04 2021
* Target selection: ert.tlc
* Embedded hardware selection: ARM Compatible->ARM Cortex
* Code generation objectives: Unspecified
* Validation result: Not run
* (add additional file header information here)
******************************************************************************/ ASAP2_VERSION 1 31
/* Version 1.31 */
/begin PROJECT ProjectName "Project Comment Goes Here"
/begin HEADER "Header Comments go here" /end HEADER
/begin MODULE ModuleName "Module Comment Goes Here"
/begin MOD_PAR "MOD PAR Comment Goes Here" /end MOD_PAR
/begin MOD_COMMON "Mod Common Comment Here" BYTE_ORDER MSB_LAST /end MOD_COMMON
/begin RECORD_LAYOUT Scalar_BOOLEAN FNC_VALUES 1 UBYTE COLUMN_DIR DIRECT /end RECORD_LAYOUT
/begin RECORD_LAYOUT Scalar_UBYTE FNC_VALUES 1 UBYTE COLUMN_DIR DIRECT /end RECORD_LAYOUT
/begin RECORD_LAYOUT Scalar_BYTE FNC_VALUES 1 SBYTE COLUMN_DIR DIRECT /end RECORD_LAYOUT
/begin RECORD_LAYOUT Scalar_UWORD FNC_VALUES 1 UWORD COLUMN_DIR DIRECT /end RECORD_LAYOUT
/begin RECORD_LAYOUT Scalar_SWORD FNC_VALUES 1 SWORD COLUMN_DIR DIRECT /end RECORD_LAYOUT
/begin RECORD_LAYOUT Scalar_ULONG FNC_VALUES 1 ULONG COLUMN_DIR DIRECT /end RECORD_LAYOUT
/begin RECORD_LAYOUT Scalar_LONG FNC_VALUES 1 SLONG COLUMN_DIR DIRECT /end RECORD_LAYOUT
/begin RECORD_LAYOUT Scalar_FLOAT32_IEEE FNC_VALUES 1 FLOAT32_IEEE COLUMN_DIR DIRECT /end RECORD_LAYOUT
/begin RECORD_LAYOUT Scalar_FLOAT64_IEEE FNC_VALUES 1 FLOAT64_IEEE COLUMN_DIR DIRECT /end RECORD_LAYOUT
/begin RECORD_LAYOUT Lookup1D_BOOLEAN FNC_VALUES 1 UBYTE COLUMN_DIR DIRECT /end RECORD_LAYOUT
/begin RECORD_LAYOUT Lookup1D_X_BOOLEAN AXIS_PTS_X 1 UBYTE INDEX_INCR DIRECT /end RECORD_LAYOUT
/begin RECORD_LAYOUT Lookup1D_BYTE FNC_VALUES 1 SBYTE COLUMN_DIR DIRECT /end RECORD_LAYOUT
/begin RECORD_LAYOUT Lookup1D_X_BYTE AXIS_PTS_X 1 SBYTE INDEX_INCR DIRECT /end RECORD_LAYOUT
/begin RECORD_LAYOUT Lookup1D_UBYTE FNC_VALUES 1 UBYTE COLUMN_DIR DIRECT /end RECORD_LAYOUT
/begin RECORD_LAYOUT Lookup1D_X_UBYTE AXIS_PTS_X 1 UBYTE INDEX_INCR DIRECT /end RECORD_LAYOUT
/begin RECORD_LAYOUT Lookup1D_UWORD FNC_VALUES 1 UWORD COLUMN_DIR DIRECT /end RECORD_LAYOUT
/begin RECORD_LAYOUT Lookup1D_X_UWORD AXIS_PTS_X 1 UWORD INDEX_INCR DIRECT /end RECORD_LAYOUT
/begin RECORD_LAYOUT Lookup1D_WORD FNC_VALUES 1 SWORD COLUMN_DIR DIRECT /end RECORD_LAYOUT
/begin RECORD_LAYOUT Lookup1D_X_WORD AXIS_PTS_X 1 SWORD INDEX_INCR DIRECT /end RECORD_LAYOUT
/begin RECORD_LAYOUT Lookup1D_ULONG FNC_VALUES 1 ULONG COLUMN_DIR DIRECT /end RECORD_LAYOUT
/begin RECORD_LAYOUT Lookup1D_X_ULONG AXIS_PTS_X 1 ULONG INDEX_INCR DIRECT /end RECORD_LAYOUT
/begin RECORD_LAYOUT Lookup1D_SLONG FNC_VALUES 1 SLONG COLUMN_DIR DIRECT /end RECORD_LAYOUT
/begin RECORD_LAYOUT Lookup1D_X_LONG AXIS_PTS_X 1 SLONG INDEX_INCR DIRECT /end RECORD_LAYOUT
/begin RECORD_LAYOUT Lookup1D_FLOAT32_IEEE FNC_VALUES 1 FLOAT32_IEEE COLUMN_DIR DIRECT /end RECORD_LAYOUT
/begin RECORD_LAYOUT Lookup1D_X_FLOAT32_IEEE AXIS_PTS_X 1 FLOAT32_IEEE INDEX_INCR DIRECT /end RECORD_LAYOUT
/begin RECORD_LAYOUT Lookup1D_FLOAT64_IEEE FNC_VALUES 1 FLOAT64_IEEE COLUMN_DIR DIRECT /end RECORD_LAYOUT
/begin RECORD_LAYOUT Lookup1D_X_FLOAT64_IEEE AXIS_PTS_X 1 FLOAT64_IEEE INDEX_INCR DIRECT /end RECORD_LAYOUT
/begin RECORD_LAYOUT Lookup2D_BOOLEAN FNC_VALUES 1 UBYTE COLUMN_DIR DIRECT /end RECORD_LAYOUT
/begin RECORD_LAYOUT Lookup2D_X_BOOLEAN AXIS_PTS_X 1 UBYTE INDEX_INCR DIRECT /end RECORD_LAYOUT
/begin RECORD_LAYOUT Lookup2D_UBYTE FNC_VALUES 1 UBYTE COLUMN_DIR DIRECT /end RECORD_LAYOUT
/begin RECORD_LAYOUT Lookup2D_X_UBYTE AXIS_PTS_X 1 UBYTE INDEX_INCR DIRECT /end RECORD_LAYOUT
/begin RECORD_LAYOUT Lookup2D_BYTE FNC_VALUES 1 SBYTE COLUMN_DIR DIRECT /end RECORD_LAYOUT
/begin RECORD_LAYOUT Lookup2D_X_BYTE AXIS_PTS_X 1 SBYTE INDEX_INCR DIRECT /end RECORD_LAYOUT
/begin RECORD_LAYOUT Lookup2D_UWORD FNC_VALUES 1 UWORD COLUMN_DIR DIRECT /end RECORD_LAYOUT
/begin RECORD_LAYOUT Lookup2D_X_UWORD AXIS_PTS_X 1 UWORD INDEX_INCR DIRECT /end RECORD_LAYOUT
/begin RECORD_LAYOUT Lookup2D_WORD FNC_VALUES 1 SWORD COLUMN_DIR DIRECT /end RECORD_LAYOUT
/begin RECORD_LAYOUT Lookup2D_X_WORD AXIS_PTS_X 1 SWORD INDEX_INCR DIRECT /end RECORD_LAYOUT
/begin RECORD_LAYOUT Lookup2D_ULONG FNC_VALUES 1 ULONG COLUMN_DIR DIRECT /end RECORD_LAYOUT
/begin RECORD_LAYOUT Lookup2D_X_ULONG AXIS_PTS_X 1 ULONG INDEX_INCR DIRECT /end RECORD_LAYOUT
/begin RECORD_LAYOUT Lookup2D_LONG FNC_VALUES 1 SLONG COLUMN_DIR DIRECT /end RECORD_LAYOUT
/begin RECORD_LAYOUT Lookup2D_X_LONG AXIS_PTS_X 1 SLONG INDEX_INCR DIRECT /end RECORD_LAYOUT
/begin RECORD_LAYOUT Lookup2D_FLOAT32_IEEE FNC_VALUES 1 FLOAT32_IEEE COLUMN_DIR DIRECT /end RECORD_LAYOUT
/begin RECORD_LAYOUT Lookup2D_X_FLOAT32_IEEE AXIS_PTS_X 1 FLOAT32_IEEE INDEX_INCR DIRECT /end RECORD_LAYOUT
/begin RECORD_LAYOUT Lookup2D_FLOAT64_IEEE FNC_VALUES 1 FLOAT64_IEEE COLUMN_DIR DIRECT /end RECORD_LAYOUT
/begin RECORD_LAYOUT Lookup2D_X_FLOAT64_IEEE AXIS_PTS_X 1 FLOAT64_IEEE INDEX_INCR DIRECT /end RECORD_LAYOUT
/begin CHARACTERISTIC EGRVlv_rDesEGR_CUR "Curve to calculation the desired value for the governor EGRVlv_rGovDesVal based on EGRVlv_r" CURVE 0x0000 /* @ECU_Address@EGRVlv_rDesEGR_CUR@ */ Lookup1D_WORD 0 EGRVlv_VDPosGov_CM_DutyCycle__ -100.0 100.0
 /begin AXIS_DESCR COM_AXIS EGRVlv_r EGRVlv_VDPosGov_CM_DutyCycle__ 25 -100.0 100.0 AXIS_PTS_REF EGRVlv_rDesEGR_CURX /end AXIS_DESCR
/end CHARACTERISTIC
/begin AXIS_PTS EGRVlv_rDesEGR_CURX "Curve axis to calculation the desired value for the governor EGRVlv_rGovDesVal based on EGRVlv_r" 0x0000 /* @ECU_Address@EGRVlv_rDesEGR_CURX@ */ EGRVlv_r Lookup1D_X_WORD 0 EGRVlv_VDPosGov_CM_DutyCycle__ 25 -100.0 100.0 /end AXIS_PTS
/begin CHARACTERISTIC EGRVlv_iEff_CUR "Transformation curve to convert the positon value to current value" CURVE 0x0000 /* @ECU_Address@EGRVlv_iEff_CUR@ */ Lookup1D_WORD 0 EGRVlv_VDPosGov_CM_Current_mA_mA -12800.0 12799.6
 /begin AXIS_DESCR COM_AXIS EGRVlv_rAbsEGR_mp EGRVlv_VDPosGov_CM_DutyCycle__ 25 -100.0 100.0 AXIS_PTS_REF EGRVlv_iEff_CURX /end AXIS_DESCR
/end CHARACTERISTIC
/begin AXIS_PTS EGRVlv_iEff_CURX "Transformation aixs to  convert the positon value to current value" 0x0000 /* @ECU_Address@EGRVlv_iEff_CURX@ */ EGRVlv_rAbsEGR_mp Lookup1D_X_WORD 0 EGRVlv_VDPosGov_CM_DutyCycle__ 25 -100.0 100.0 /end AXIS_PTS
/begin CHARACTERISTIC EGRVlv_rGovMax_CUR "Transformation curve to convert the current value to position value" CURVE 0x0000 /* @ECU_Address@EGRVlv_rGovMax_CUR@ */ Lookup1D_WORD 0 EGRVlv_VDPosGov_CM_DutyCycle__ -100.0 100.0
 /begin AXIS_DESCR COM_AXIS NO_INPUT_QUANTITY EGRVlv_VDPosGov_CM_Current_mA_mA 25 -12800.0 12799.6 AXIS_PTS_REF EGRVlv_rGovMax_CURX /end AXIS_DESCR
/end CHARACTERISTIC
/begin AXIS_PTS EGRVlv_rGovMax_CURX "Transformation aixs to  convert the current value to position value" 0x0000 /* @ECU_Address@EGRVlv_rGovMax_CURX@ */ NO_INPUT_QUANTITY Lookup1D_X_WORD 0 EGRVlv_VDPosGov_CM_Current_mA_mA 25 -12800.0 12799.6 /end AXIS_PTS
/begin CHARACTERISTIC EGRVlv_rGovMin_CUR "Transformation curve to convert the current value to position value" CURVE 0x0000 /* @ECU_Address@EGRVlv_rGovMin_CUR@ */ Lookup1D_WORD 0 EGRVlv_VDPosGov_CM_DutyCycle__ -100.0 100.0
 /begin AXIS_DESCR COM_AXIS NO_INPUT_QUANTITY EGRVlv_VDPosGov_CM_Current_mA_mA 25 -12800.0 12799.6 AXIS_PTS_REF EGRVlv_rGovMin_CURX /end AXIS_DESCR
/end CHARACTERISTIC
/begin AXIS_PTS EGRVlv_rGovMin_CURX "Transformation aixs to  convert the current value to position value" 0x0000 /* @ECU_Address@EGRVlv_rGovMin_CURX@ */ NO_INPUT_QUANTITY Lookup1D_X_WORD 0 EGRVlv_VDPosGov_CM_Current_mA_mA 25 -12800.0 12799.6 /end AXIS_PTS
/begin CHARACTERISTIC EGRVlv_iEffOvrLd_C "Threshold for overcurrent detection" VALUE 0x0000 /* @ECU_Address@EGRVlv_iEffOvrLd_C@ */ Scalar_SWORD 0 EGRVlv_VDPosGov_CM_Current_mA_mA -12800.0 12799.6 /end CHARACTERISTIC
/begin CHARACTERISTIC EGRVlv_DKdNgv_C "For negative large signals" VALUE 0x0000 /* @ECU_Address@EGRVlv_DKdNgv_C@ */ Scalar_SWORD 0 EGRVlv_VDPosGov_CM_Fac_100____mg_hub__s -100.0 100.0 /end CHARACTERISTIC
/begin CHARACTERISTIC EGRVlv_DKdPsv_C "For positive large signals" VALUE 0x0000 /* @ECU_Address@EGRVlv_DKdPsv_C@ */ Scalar_SWORD 0 EGRVlv_VDPosGov_CM_Fac_100____mg_hub__s -100.0 100.0 /end CHARACTERISTIC
/begin CHARACTERISTIC EGRVlv_SlwClsDKd_C "D-Gain of the PID controller for slow closing" VALUE 0x0000 /* @ECU_Address@EGRVlv_SlwClsDKd_C@ */ Scalar_SWORD 0 EGRVlv_VDPosGov_CM_Fac_100____mg_hub__s -100.0 100.0 /end CHARACTERISTIC
/begin CHARACTERISTIC EGRVlv_SlwClsIKi_C "I-Gain of the PID controller for slow closing" VALUE 0x0000 /* @ECU_Address@EGRVlv_SlwClsIKi_C@ */ Scalar_SWORD 0 EGRVlv_VDPosGov_CM_Fac_100____mg_hub__s -32.0 31.9 /end CHARACTERISTIC
/begin CHARACTERISTIC EGRVlv_SlwClsPKp_C "P-Gain of the PID controller for slow closing" VALUE 0x0000 /* @ECU_Address@EGRVlv_SlwClsPKp_C@ */ Scalar_SWORD 0 EGRVlv_VDPosGov_CM_Fac_100____mg_hub_ -100.0 100.0 /end CHARACTERISTIC
/begin CHARACTERISTIC EGRVlv_SmlSigNgvDKd_C "For negative small signals" VALUE 0x0000 /* @ECU_Address@EGRVlv_SmlSigNgvDKd_C@ */ Scalar_SWORD 0 EGRVlv_VDPosGov_CM_Fac_100____mg_hub__s -100.0 100.0 /end CHARACTERISTIC
/begin CHARACTERISTIC EGRVlv_SmlSigNgvIKi_C "For negative small signals" VALUE 0x0000 /* @ECU_Address@EGRVlv_SmlSigNgvIKi_C@ */ Scalar_SWORD 0 EGRVlv_VDPosGov_CM_Fac_100____mg_hub__s -32.0 31.9 /end CHARACTERISTIC
/begin CHARACTERISTIC EGRVlv_SmlSigNgvPKp_C "For negative small signals" VALUE 0x0000 /* @ECU_Address@EGRVlv_SmlSigNgvPKp_C@ */ Scalar_SWORD 0 EGRVlv_VDPosGov_CM_Fac_100____mg_hub_ -100.0 100.0 /end CHARACTERISTIC
/begin CHARACTERISTIC EGRVlv_SmlSigPsvDKd_C "For positive small signals" VALUE 0x0000 /* @ECU_Address@EGRVlv_SmlSigPsvDKd_C@ */ Scalar_SWORD 0 EGRVlv_VDPosGov_CM_Fac_100____mg_hub__s -100.0 100.0 /end CHARACTERISTIC
/begin CHARACTERISTIC EGRVlv_SmlSigPsvIKi_C "For positive small signals" VALUE 0x0000 /* @ECU_Address@EGRVlv_SmlSigPsvIKi_C@ */ Scalar_SWORD 0 EGRVlv_VDPosGov_CM_Fac_100____mg_hub__s -32.0 31.9 /end CHARACTERISTIC
/begin CHARACTERISTIC EGRVlv_SmlSigPsvPKp_C "For positive small signals" VALUE 0x0000 /* @ECU_Address@EGRVlv_SmlSigPsvPKp_C@ */ Scalar_SWORD 0 EGRVlv_VDPosGov_CM_Fac_100____mg_hub_ -100.0 100.0 /end CHARACTERISTIC
/begin CHARACTERISTIC EGRVlv_facCrntEffFlt_C "Factor of the PT1 filter" VALUE 0x0000 /* @ECU_Address@EGRVlv_facCrntEffFlt_C@ */ Scalar_SWORD 0 EGRVlv_VDPosGov_CM_Fac_100_NaN 0.0 99.9985 /end CHARACTERISTIC
/begin CHARACTERISTIC EGRVlv_rEGRDflVal_C "Default control value for the EGR valve" VALUE 0x0000 /* @ECU_Address@EGRVlv_rEGRDflVal_C@ */ Scalar_SWORD 0 EGRVlv_VDPosGov_CM_DutyCycle__ -100.0 100.0 /end CHARACTERISTIC
/begin CHARACTERISTIC EGRVlv_rEGRSwtOff_C "Desired switch off value" VALUE 0x0000 /* @ECU_Address@EGRVlv_rEGRSwtOff_C@ */ Scalar_SWORD 0 EGRVlv_VDPosGov_CM_DutyCycle__ -100.0 100.0 /end CHARACTERISTIC
/begin CHARACTERISTIC EGRVlv_rGovDvtThres_C "Threshold value for masking the D component of PID controller" VALUE 0x0000 /* @ECU_Address@EGRVlv_rGovDvtThres_C@ */ Scalar_SWORD 0 EGRVlv_VDPosGov_CM_DutyCycle__ -100.0 100.0 /end CHARACTERISTIC
/begin CHARACTERISTIC EGRVlv_rGovMax_C "calibration parameter to set of the upper limiting value of PID controller" VALUE 0x0000 /* @ECU_Address@EGRVlv_rGovMax_C@ */ Scalar_SWORD 0 EGRVlv_VDPosGov_CM_DutyCycle__ -100.0 100.0 /end CHARACTERISTIC
/begin CHARACTERISTIC EGRVlv_rGovMin_C "calibration parameter to set of the lower limiting value of PID controller" VALUE 0x0000 /* @ECU_Address@EGRVlv_rGovMin_C@ */ Scalar_SWORD 0 EGRVlv_VDPosGov_CM_DutyCycle__ -100.0 100.0 /end CHARACTERISTIC
/begin CHARACTERISTIC EGRVlv_rIniStp_C "Lead value for I component in case of step from lower mechanical stop" VALUE 0x0000 /* @ECU_Address@EGRVlv_rIniStp_C@ */ Scalar_SWORD 0 EGRVlv_VDPosGov_CM_DutyCycle__ -100.0 100.0 /end CHARACTERISTIC
/begin CHARACTERISTIC EGRVlv_rOutIMax_C "Upper limiting value of I component of the position governor" VALUE 0x0000 /* @ECU_Address@EGRVlv_rOutIMax_C@ */ Scalar_SWORD 0 EGRVlv_VDPosGov_CM_DutyCycle__ -100.0 100.0 /end CHARACTERISTIC
/begin CHARACTERISTIC EGRVlv_rPIDWinNgv_C "Negative window limit" VALUE 0x0000 /* @ECU_Address@EGRVlv_rPIDWinNgv_C@ */ Scalar_SWORD 0 EGRVlv_VDPosGov_CM_DutyCycle__ -100.0 100.0 /end CHARACTERISTIC
/begin CHARACTERISTIC EGRVlv_rPIDWinPsv_C "Positive window limit" VALUE 0x0000 /* @ECU_Address@EGRVlv_rPIDWinPsv_C@ */ Scalar_SWORD 0 EGRVlv_VDPosGov_CM_DutyCycle__ -100.0 100.0 /end CHARACTERISTIC
/begin CHARACTERISTIC EGRVlv_rSwtOffRmp_C "Slope to ramp to switch off value" VALUE 0x0000 /* @ECU_Address@EGRVlv_rSwtOffRmp_C@ */ Scalar_SWORD 0 EGRVlv_VDPosGov_CM_DutyCycle__ -100.0 100.0 /end CHARACTERISTIC
/begin CHARACTERISTIC EGRVlv_tiLimDlyOvrLd_C "Delay time for governor limitation because of overcurrent" VALUE 0x0000 /* @ECU_Address@EGRVlv_tiLimDlyOvrLd_C@ */ Scalar_SWORD 0 EGRVlv_VDPosGov_CM_Seconds_s 0.0 300.0 /end CHARACTERISTIC
/begin CHARACTERISTIC EGRVlv_tiOutIMax_C "Timer for holding current limitation" VALUE 0x0000 /* @ECU_Address@EGRVlv_tiOutIMax_C@ */ Scalar_SWORD 0 EGRVlv_VDPosGov_CM_Seconds_s 0.0 300.0 /end CHARACTERISTIC
/begin CHARACTERISTIC EGRVlv_swtDesValNrmInv_C "Switch to select the normalized desired value" VALUE 0x0000 /* @ECU_Address@EGRVlv_swtDesValNrmInv_C@ */ Scalar_BOOLEAN 0 EGRVlv_VDPosGov_CM_boolean_NaN 0.0 1.0 /end CHARACTERISTIC
/begin CHARACTERISTIC EGRVlv_swtGovByp_C "Switch for bypassing the position controller" VALUE 0x0000 /* @ECU_Address@EGRVlv_swtGovByp_C@ */ Scalar_BOOLEAN 0 EGRVlv_VDPosGov_CM_boolean_NaN 0.0 1.0 /end CHARACTERISTIC
/begin MEASUREMENT EGRVlv_rAct "" SWORD EGRVlv_VDPosGov_CM_DutyCycle 0 0 -100.0 100.0 ECU_ADDRESS 0x0000 /* @ECU_Address@EGRVlv_rAct@ */ /end MEASUREMENT
/begin MEASUREMENT EGRVlv_rPs "" SWORD EGRVlv_VDPosGov_CM_DutyCycle 0 0 -100.0 100.0 ECU_ADDRESS 0x0000 /* @ECU_Address@EGRVlv_rPs@ */ /end MEASUREMENT
/begin MEASUREMENT BattU_facCor "" SWORD EGRVlv_VDPosGov_CM_Fac_100 0 0 -32.0 31.9 ECU_ADDRESS 0x0000 /* @ECU_Address@BattU_facCor@ */ /end MEASUREMENT
/begin MEASUREMENT EGRVlv_stMon "" UWORD EGRVlv_VDPosGov_CM_State2 0 0 0.0 65535.0 ECU_ADDRESS 0x0000 /* @ECU_Address@EGRVlv_stMon@ */ /end MEASUREMENT
/begin MEASUREMENT DSM_bEGRVlvGovOn "" UBYTE EGRVlv_VDPosGov_CM_boolean 0 0 0.0 1.0 ECU_ADDRESS 0x0000 /* @ECU_Address@DSM_bEGRVlvGovOn@ */ /end MEASUREMENT
/begin MEASUREMENT EGRVlv_rRlsEGR "" SWORD EGRVlv_VDPosGov_CM_DutyCycle 0 0 -100.0 100.0 ECU_ADDRESS 0x0000 /* @ECU_Address@EGRVlv_rRlsEGR@ */ /end MEASUREMENT
/begin MEASUREMENT DSM_bEGRVlvClnUp "" UBYTE EGRVlv_VDPosGov_CM_boolean 0 0 0.0 1.0 ECU_ADDRESS 0x0000 /* @ECU_Address@DSM_bEGRVlvClnUp@ */ /end MEASUREMENT
/begin MEASUREMENT SyC_stSub "" SLONG EGRVlv_VDPosGov_CM_ECUPowerState 0 0 0 3 ECU_ADDRESS 0x0000 /* @ECU_Address@SyC_stSub@ */ /end MEASUREMENT
/begin MEASUREMENT EGRVlv_stTrgClnUp "" UBYTE EGRVlv_VDPosGov_CM_boolean 0 0 0.0 1.0 ECU_ADDRESS 0x0000 /* @ECU_Address@EGRVlv_stTrgClnUp@ */ /end MEASUREMENT
/begin MEASUREMENT EGRVlv_r "" SWORD EGRVlv_VDPosGov_CM_DutyCycle 0 0 -100.0 100.0 ECU_ADDRESS 0x0000 /* @ECU_Address@EGRVlv_r@ */ /end MEASUREMENT
/begin MEASUREMENT EGRVlv_stJamVlv "" UBYTE EGRVlv_VDPosGov_CM_boolean 0 0 0.0 1.0 ECU_ADDRESS 0x0000 /* @ECU_Address@EGRVlv_stJamVlv@ */ /end MEASUREMENT
/begin MEASUREMENT EGRVlv_rAbsEGR_mp "Absolute value of duty cycle for calculating modelled current" SWORD EGRVlv_VDPosGov_CM_DutyCycle__ 0 0 -100.0 100.0 ECU_ADDRESS 0x0000 /* @ECU_Address@EGRVlv_rAbsEGR_mp@ */ /end MEASUREMENT
/begin MEASUREMENT EGRVlv_rGovMax_mp "Maximum governor output limit" SWORD EGRVlv_VDPosGov_CM_DutyCycle__ 0 0 -100.0 100.0 ECU_ADDRESS 0x0000 /* @ECU_Address@EGRVlv_rGovMax_mp@ */ /end MEASUREMENT
/begin MEASUREMENT EGRVlv_rGovDesVal "Internal desired value for governor" SWORD EGRVlv_VDPosGov_CM_DutyCycle__ 0 0 -100.0 100.0 ECU_ADDRESS 0x0000 /* @ECU_Address@EGRVlv_rGovDesVal@ */ /end MEASUREMENT
/begin MEASUREMENT EGRVlv_rGovDvt "Control deviation" SWORD EGRVlv_VDPosGov_CM_DutyCycle__ 0 0 -100.0 100.0 ECU_ADDRESS 0x0000 /* @ECU_Address@EGRVlv_rGovDvt@ */ /end MEASUREMENT
/begin MEASUREMENT EGRVlv_rGovMin_mp "Minimum governor output limit" SWORD EGRVlv_VDPosGov_CM_DutyCycle__ 0 0 -100.0 100.0 ECU_ADDRESS 0x0000 /* @ECU_Address@EGRVlv_rGovMin_mp@ */ /end MEASUREMENT
/begin MEASUREMENT EGRVlv_KpPar "P-Gain of the PID controller" SWORD EGRVlv_VDPosGov_CM_Fac_100____mg_hub_ 0 0 -100.0 100.0 ECU_ADDRESS 0x0000 /* @ECU_Address@EGRVlv_KpPar@ */ /end MEASUREMENT
/begin MEASUREMENT EGRVlv_rOutPID_mp "Output of PID controller" SWORD EGRVlv_VDPosGov_CM_DutyCycle__ 0 0 -100.0 100.0 ECU_ADDRESS 0x0000 /* @ECU_Address@EGRVlv_rOutPID_mp@ */ /end MEASUREMENT
/begin MEASUREMENT EGRVlv_rIniVal "Initial value of correcting variable for position controller for single flow implementation" SWORD EGRVlv_VDPosGov_CM_DutyCycle__ 0 0 -100.0 100.0 ECU_ADDRESS 0x0000 /* @ECU_Address@EGRVlv_rIniVal@ */ /end MEASUREMENT
/begin MEASUREMENT EGRVlv_rGovEGR "Control value from the governor" SWORD EGRVlv_VDPosGov_CM_DutyCycle__ 0 0 -100.0 100.0 ECU_ADDRESS 0x0000 /* @ECU_Address@EGRVlv_rGovEGR@ */ /end MEASUREMENT
/begin MEASUREMENT EGRVlv_rEGR "Control value for the EGR valve" SWORD EGRVlv_VDPosGov_CM_DutyCycle__ 0 0 -100.0 100.0 ECU_ADDRESS 0x0000 /* @ECU_Address@EGRVlv_rEGR@ */ /end MEASUREMENT
/begin MEASUREMENT EGRVlv_KdPar "D-Gain of the PID controller" SWORD EGRVlv_VDPosGov_CM_Fac_100____mg_hub__s 0 0 -100.0 100.0 ECU_ADDRESS 0x0000 /* @ECU_Address@EGRVlv_KdPar@ */ /end MEASUREMENT
/begin MEASUREMENT EGRVlv_KiPar "I-Gain of the PID controller" SWORD EGRVlv_VDPosGov_CM_Fac_100____mg_hub__s 0 0 -32.0 31.9 ECU_ADDRESS 0x0000 /* @ECU_Address@EGRVlv_KiPar@ */ /end MEASUREMENT
/begin MEASUREMENT EGRVlv_rDesValNrm "Normalized desired value" SWORD EGRVlv_VDPosGov_CM_DutyCycle__ 0 0 -100.0 100.0 ECU_ADDRESS 0x0000 /* @ECU_Address@EGRVlv_rDesValNrm@ */ /end MEASUREMENT
/begin MEASUREMENT EGRVlv_iEff_mp "Modelled current" SWORD EGRVlv_VDPosGov_CM_Current_mA_mA 0 0 -12800.0 12799.6 ECU_ADDRESS 0x0000 /* @ECU_Address@EGRVlv_iEff_mp@ */ /end MEASUREMENT
/begin MEASUREMENT GovIni "Status of PID initialization" UBYTE EGRVlv_VDPosGov_CM_boolean_NaN 0 0 0.0 1.0 ECU_ADDRESS 0x0000 /* @ECU_Address@GovIni@ */ /end MEASUREMENT
/begin MEASUREMENT EGRVlv_stIni "Status of limiting the current" UBYTE EGRVlv_VDPosGov_CM_boolean_NaN 0 0 0.0 1.0 ECU_ADDRESS 0x0000 /* @ECU_Address@EGRVlv_stIni@ */ /end MEASUREMENT
/begin MEASUREMENT swt_off "Switch to value EGRVlv_rEGRSwtOff_C over a ramp with slope EGRVlv_rSwtOffRmp_C" UBYTE EGRVlv_VDPosGov_CM_boolean_NaN 0 0 0.0 1.0 ECU_ADDRESS 0x0000 /* @ECU_Address@swt_off@ */ /end MEASUREMENT
/begin COMPU_METHOD EGRVlv_VDPosGov_CM_DutyCycle__ "Q = V*200.000000" RAT_FUNC "%6.3" "%" COEFFS 0 200.000000 0.000000 0 0 1.000000 /end COMPU_METHOD
/begin COMPU_METHOD EGRVlv_VDPosGov_CM_Current_mA_mA "Q = V" RAT_FUNC "%5.0" "mA" COEFFS 0 1 0 0 0 1 /end COMPU_METHOD
/begin COMPU_METHOD EGRVlv_VDPosGov_CM_Fac_100____mg_hub__s "Q = V*200.000000" RAT_FUNC "%6.3" "%/(mg/hub)/s" COEFFS 0 200.000000 0.000000 0 0 1.000000 /end COMPU_METHOD
/begin COMPU_METHOD EGRVlv_VDPosGov_CM_Fac_100____mg_hub_ "Q = V*200.000000" RAT_FUNC "%6.3" "%/(mg/hub)" COEFFS 0 200.000000 0.000000 0 0 1.000000 /end COMPU_METHOD
/begin COMPU_METHOD EGRVlv_VDPosGov_CM_Fac_100_NaN "Q = V*200.000000" RAT_FUNC "%6.3" "NaN" COEFFS 0 200.000000 0.000000 0 0 1.000000 /end COMPU_METHOD
/begin COMPU_METHOD EGRVlv_VDPosGov_CM_Seconds_s "Q = V*10.000000" RAT_FUNC "%5.1" "s" COEFFS 0 10.000000 0.000000 0 0 1.000000 /end COMPU_METHOD
/begin COMPU_METHOD EGRVlv_VDPosGov_CM_boolean_NaN "Q = V" RAT_FUNC "%1.0" "NaN" COEFFS 0 1 0 0 0 1 /end COMPU_METHOD
/begin COMPU_METHOD EGRVlv_VDPosGov_CM_DutyCycle "Q = V*200.000000" RAT_FUNC "%6.3" "" COEFFS 0 200.000000 0.000000 0 0 1.000000 /end COMPU_METHOD
/begin COMPU_METHOD EGRVlv_VDPosGov_CM_Fac_100 "Q = V*200.000000" RAT_FUNC "%6.3" "" COEFFS 0 200.000000 0.000000 0 0 1.000000 /end COMPU_METHOD
/begin COMPU_METHOD EGRVlv_VDPosGov_CM_State2 "Q = V" RAT_FUNC "%5.0" "" COEFFS 0 1 0 0 0 1 /end COMPU_METHOD
/begin COMPU_METHOD EGRVlv_VDPosGov_CM_boolean "Q = V" RAT_FUNC "%1.0" "" COEFFS 0 1 0 0 0 1 /end COMPU_METHOD
/begin COMPU_METHOD EGRVlv_VDPosGov_CM_ECUPowerState "Enumerated data type: ECUPowerState" TAB_VERB "%0.6" "" /* Conversion Table */ COMPU_TAB_REF VTAB_FOR_EGRVlv_VDPosGov_CM_ECUPowerState /end COMPU_METHOD
/begin COMPU_VTAB /* Name of Table */ VTAB_FOR_EGRVlv_VDPosGov_CM_ECUPowerState "Enumerated data type: ECUPowerState" TAB_VERB /* Number of Elements */ 3 0 "ECUPowerState_PowerOFF" 2 "ECUPowerState_PowerON" 3 "ECUPowerState_PowerLatch" /end COMPU_VTAB
/begin GROUP EGRVlv_VDPosGov "EGRVlv_VDPosGov" /* Root */ ROOT /begin SUB_GROUP Root_Overview /end SUB_GROUP
 /begin REF_MEASUREMENT BattU_facCor DSM_bEGRVlvClnUp DSM_bEGRVlvGovOn EGRVlv_r EGRVlv_rAct EGRVlv_rPs EGRVlv_rRlsEGR EGRVlv_stJamVlv EGRVlv_stMon EGRVlv_stTrgClnUp SyC_stSub /end REF_MEASUREMENT
/end GROUP
/begin GROUP Root_Overview "EGRVlv_VDPosGov/Overview" /begin SUB_GROUP S1_EGRVlv_VDPosGov /end SUB_GROUP /end GROUP
/begin GROUP S1_EGRVlv_VDPosGov "EGRVlv_VDPosGov/Overview/EGRVlv_VDPosGov" /begin SUB_GROUP S2_CalcLim S2_CalcParam S2_Switch_Governor_Output /end SUB_GROUP
 /begin REF_CHARACTERISTIC EGRVlv_rDesEGR_CUR EGRVlv_rIniStp_C EGRVlv_swtDesValNrmInv_C /end REF_CHARACTERISTIC
 /begin REF_MEASUREMENT EGRVlv_rDesValNrm EGRVlv_rGovDesVal EGRVlv_rGovDvt /end REF_MEASUREMENT
/end GROUP
/begin GROUP S2_CalcLim "EGRVlv_VDPosGov/Overview/EGRVlv_VDPosGov/CalcLim" /begin SUB_GROUP S3_Limit_IPart /end SUB_GROUP
 /begin REF_CHARACTERISTIC EGRVlv_facCrntEffFlt_C EGRVlv_iEffOvrLd_C EGRVlv_iEff_CUR EGRVlv_rGovMax_C EGRVlv_rGovMax_CUR EGRVlv_rGovMin_C EGRVlv_rGovMin_CUR EGRVlv_tiLimDlyOvrLd_C /end REF_CHARACTERISTIC
 /begin REF_MEASUREMENT EGRVlv_iEff_mp EGRVlv_rAbsEGR_mp EGRVlv_rGovEGR EGRVlv_rGovMax_mp EGRVlv_rGovMin_mp /end REF_MEASUREMENT
/end GROUP
/begin GROUP S2_CalcParam "EGRVlv_VDPosGov/Overview/EGRVlv_VDPosGov/CalcParam"
 /begin REF_CHARACTERISTIC EGRVlv_DKdNgv_C EGRVlv_DKdPsv_C EGRVlv_SlwClsDKd_C EGRVlv_SlwClsIKi_C EGRVlv_SlwClsPKp_C EGRVlv_SmlSigNgvDKd_C EGRVlv_SmlSigNgvIKi_C EGRVlv_SmlSigNgvPKp_C EGRVlv_SmlSigPsvDKd_C EGRVlv_SmlSigPsvIKi_C EGRVlv_SmlSigPsvPKp_C EGRVlv_rGovDvtThres_C EGRVlv_rPIDWinNgv_C EGRVlv_rPIDWinPsv_C /end REF_CHARACTERISTIC
 /begin REF_MEASUREMENT EGRVlv_KdPar EGRVlv_KiPar EGRVlv_KpPar /end REF_MEASUREMENT
/end GROUP
/begin GROUP S2_Switch_Governor_Output "EGRVlv_VDPosGov/Overview/EGRVlv_VDPosGov/Switch Governor Output"
 /begin REF_CHARACTERISTIC EGRVlv_rEGRDflVal_C EGRVlv_rEGRSwtOff_C EGRVlv_rSwtOffRmp_C EGRVlv_swtGovByp_C /end REF_CHARACTERISTIC
 /begin REF_MEASUREMENT EGRVlv_rEGR GovIni swt_off /end REF_MEASUREMENT
/end GROUP
/begin GROUP S3_Limit_IPart "EGRVlv_VDPosGov/Overview/EGRVlv_VDPosGov/CalcLim/Limit_IPart" /begin SUB_GROUP S10_Debounce_DT /end SUB_GROUP /begin REF_CHARACTERISTIC EGRVlv_rOutIMax_C EGRVlv_tiOutIMax_C /end REF_CHARACTERISTIC /begin REF_MEASUREMENT EGRVlv_rIniVal /end REF_MEASUREMENT /end GROUP
/begin GROUP S10_Debounce_DT "EGRVlv_VDPosGov/Overview/EGRVlv_VDPosGov/CalcLim/Limit_IPart/Debounce_DT" /begin REF_MEASUREMENT EGRVlv_stIni /end REF_MEASUREMENT /end GROUP
/begin GROUP S31_Sum_PI "EGRVlv_VDPosGov/Overview/EGRVlv_VDPosGov/Discrete PID Controller/Sum/Sum_PI" /begin REF_MEASUREMENT EGRVlv_rOutPID_mp /end REF_MEASUREMENT /end GROUP
/end MODULE
/end PROJECT
/* (add any file trailer comments here) */
/* EOF EGRVlv_VDPosGov.a2l */
