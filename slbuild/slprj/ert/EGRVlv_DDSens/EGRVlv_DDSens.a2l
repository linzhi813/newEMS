/******************************************************************************
* ASAP2 file: EGRVlv_DDSens.a2l
* Code generation for model "EGRVlv_DDSens".
* Model version : 1.60
* Simulink Coder version : 9.4 (R2020b) 29-Jul-2020
* C source code generated on : Thu Feb 4 09:39:52 2021
* Target selection: ert.tlc
* Embedded hardware selection: ARM Compatible->ARM Cortex
* Code generation objectives: Unspecified
* Validation result: Not run
* (add additional file header information here)
******************************************************************************/ ASAP2_VERSION 1 31
/* Version 1.31 */
/begin PROJECT ProjectName "Project Comment Goes Here"
/begin HEADER "Header Comments go here" /end HEADER
/begin MODULE ModuleName "Module Comment Goes Here"
/begin MOD_PAR "MOD PAR Comment Goes Here" /end MOD_PAR
/begin MOD_COMMON "Mod Common Comment Here" BYTE_ORDER MSB_LAST /end MOD_COMMON
/begin RECORD_LAYOUT Scalar_BOOLEAN FNC_VALUES 1 UBYTE COLUMN_DIR DIRECT /end RECORD_LAYOUT
/begin RECORD_LAYOUT Scalar_UBYTE FNC_VALUES 1 UBYTE COLUMN_DIR DIRECT /end RECORD_LAYOUT
/begin RECORD_LAYOUT Scalar_BYTE FNC_VALUES 1 SBYTE COLUMN_DIR DIRECT /end RECORD_LAYOUT
/begin RECORD_LAYOUT Scalar_UWORD FNC_VALUES 1 UWORD COLUMN_DIR DIRECT /end RECORD_LAYOUT
/begin RECORD_LAYOUT Scalar_SWORD FNC_VALUES 1 SWORD COLUMN_DIR DIRECT /end RECORD_LAYOUT
/begin RECORD_LAYOUT Scalar_ULONG FNC_VALUES 1 ULONG COLUMN_DIR DIRECT /end RECORD_LAYOUT
/begin RECORD_LAYOUT Scalar_LONG FNC_VALUES 1 SLONG COLUMN_DIR DIRECT /end RECORD_LAYOUT
/begin RECORD_LAYOUT Scalar_FLOAT32_IEEE FNC_VALUES 1 FLOAT32_IEEE COLUMN_DIR DIRECT /end RECORD_LAYOUT
/begin RECORD_LAYOUT Scalar_FLOAT64_IEEE FNC_VALUES 1 FLOAT64_IEEE COLUMN_DIR DIRECT /end RECORD_LAYOUT
/begin RECORD_LAYOUT Lookup1D_BOOLEAN FNC_VALUES 1 UBYTE COLUMN_DIR DIRECT /end RECORD_LAYOUT
/begin RECORD_LAYOUT Lookup1D_X_BOOLEAN AXIS_PTS_X 1 UBYTE INDEX_INCR DIRECT /end RECORD_LAYOUT
/begin RECORD_LAYOUT Lookup1D_BYTE FNC_VALUES 1 SBYTE COLUMN_DIR DIRECT /end RECORD_LAYOUT
/begin RECORD_LAYOUT Lookup1D_X_BYTE AXIS_PTS_X 1 SBYTE INDEX_INCR DIRECT /end RECORD_LAYOUT
/begin RECORD_LAYOUT Lookup1D_UBYTE FNC_VALUES 1 UBYTE COLUMN_DIR DIRECT /end RECORD_LAYOUT
/begin RECORD_LAYOUT Lookup1D_X_UBYTE AXIS_PTS_X 1 UBYTE INDEX_INCR DIRECT /end RECORD_LAYOUT
/begin RECORD_LAYOUT Lookup1D_UWORD FNC_VALUES 1 UWORD COLUMN_DIR DIRECT /end RECORD_LAYOUT
/begin RECORD_LAYOUT Lookup1D_X_UWORD AXIS_PTS_X 1 UWORD INDEX_INCR DIRECT /end RECORD_LAYOUT
/begin RECORD_LAYOUT Lookup1D_WORD FNC_VALUES 1 SWORD COLUMN_DIR DIRECT /end RECORD_LAYOUT
/begin RECORD_LAYOUT Lookup1D_X_WORD AXIS_PTS_X 1 SWORD INDEX_INCR DIRECT /end RECORD_LAYOUT
/begin RECORD_LAYOUT Lookup1D_ULONG FNC_VALUES 1 ULONG COLUMN_DIR DIRECT /end RECORD_LAYOUT
/begin RECORD_LAYOUT Lookup1D_X_ULONG AXIS_PTS_X 1 ULONG INDEX_INCR DIRECT /end RECORD_LAYOUT
/begin RECORD_LAYOUT Lookup1D_SLONG FNC_VALUES 1 SLONG COLUMN_DIR DIRECT /end RECORD_LAYOUT
/begin RECORD_LAYOUT Lookup1D_X_LONG AXIS_PTS_X 1 SLONG INDEX_INCR DIRECT /end RECORD_LAYOUT
/begin RECORD_LAYOUT Lookup1D_FLOAT32_IEEE FNC_VALUES 1 FLOAT32_IEEE COLUMN_DIR DIRECT /end RECORD_LAYOUT
/begin RECORD_LAYOUT Lookup1D_X_FLOAT32_IEEE AXIS_PTS_X 1 FLOAT32_IEEE INDEX_INCR DIRECT /end RECORD_LAYOUT
/begin RECORD_LAYOUT Lookup1D_FLOAT64_IEEE FNC_VALUES 1 FLOAT64_IEEE COLUMN_DIR DIRECT /end RECORD_LAYOUT
/begin RECORD_LAYOUT Lookup1D_X_FLOAT64_IEEE AXIS_PTS_X 1 FLOAT64_IEEE INDEX_INCR DIRECT /end RECORD_LAYOUT
/begin RECORD_LAYOUT Lookup2D_BOOLEAN FNC_VALUES 1 UBYTE COLUMN_DIR DIRECT /end RECORD_LAYOUT
/begin RECORD_LAYOUT Lookup2D_X_BOOLEAN AXIS_PTS_X 1 UBYTE INDEX_INCR DIRECT /end RECORD_LAYOUT
/begin RECORD_LAYOUT Lookup2D_UBYTE FNC_VALUES 1 UBYTE COLUMN_DIR DIRECT /end RECORD_LAYOUT
/begin RECORD_LAYOUT Lookup2D_X_UBYTE AXIS_PTS_X 1 UBYTE INDEX_INCR DIRECT /end RECORD_LAYOUT
/begin RECORD_LAYOUT Lookup2D_BYTE FNC_VALUES 1 SBYTE COLUMN_DIR DIRECT /end RECORD_LAYOUT
/begin RECORD_LAYOUT Lookup2D_X_BYTE AXIS_PTS_X 1 SBYTE INDEX_INCR DIRECT /end RECORD_LAYOUT
/begin RECORD_LAYOUT Lookup2D_UWORD FNC_VALUES 1 UWORD COLUMN_DIR DIRECT /end RECORD_LAYOUT
/begin RECORD_LAYOUT Lookup2D_X_UWORD AXIS_PTS_X 1 UWORD INDEX_INCR DIRECT /end RECORD_LAYOUT
/begin RECORD_LAYOUT Lookup2D_WORD FNC_VALUES 1 SWORD COLUMN_DIR DIRECT /end RECORD_LAYOUT
/begin RECORD_LAYOUT Lookup2D_X_WORD AXIS_PTS_X 1 SWORD INDEX_INCR DIRECT /end RECORD_LAYOUT
/begin RECORD_LAYOUT Lookup2D_ULONG FNC_VALUES 1 ULONG COLUMN_DIR DIRECT /end RECORD_LAYOUT
/begin RECORD_LAYOUT Lookup2D_X_ULONG AXIS_PTS_X 1 ULONG INDEX_INCR DIRECT /end RECORD_LAYOUT
/begin RECORD_LAYOUT Lookup2D_LONG FNC_VALUES 1 SLONG COLUMN_DIR DIRECT /end RECORD_LAYOUT
/begin RECORD_LAYOUT Lookup2D_X_LONG AXIS_PTS_X 1 SLONG INDEX_INCR DIRECT /end RECORD_LAYOUT
/begin RECORD_LAYOUT Lookup2D_FLOAT32_IEEE FNC_VALUES 1 FLOAT32_IEEE COLUMN_DIR DIRECT /end RECORD_LAYOUT
/begin RECORD_LAYOUT Lookup2D_X_FLOAT32_IEEE AXIS_PTS_X 1 FLOAT32_IEEE INDEX_INCR DIRECT /end RECORD_LAYOUT
/begin RECORD_LAYOUT Lookup2D_FLOAT64_IEEE FNC_VALUES 1 FLOAT64_IEEE COLUMN_DIR DIRECT /end RECORD_LAYOUT
/begin RECORD_LAYOUT Lookup2D_X_FLOAT64_IEEE AXIS_PTS_X 1 FLOAT64_IEEE INDEX_INCR DIRECT /end RECORD_LAYOUT
/begin CHARACTERISTIC EGRVlv_rTransf_CUR "Transformation curve to convert the voltage value to positon value" /* Characteristic Type */ CURVE 0x0000 /* @ECU_Address@EGRVlv_rTransf_CUR@ */ Lookup1D_WORD /* Maxdiff */ 0 EGRVlv_DDSens_CM_DutyCycle__ -100.0 100.0
 /begin AXIS_DESCR /* Description of X-Axis Points */ /* Axis Type */ COM_AXIS /* Reference to Input */ EGRVlv_uRaw EGRVlv_DDSens_CM_Volt_mV_mv /* Number of Axis Pts */ 25 0.0 5000.0 AXIS_PTS_REF EGRVlv_rTransf_CURX /end AXIS_DESCR
/end CHARACTERISTIC
/begin AXIS_PTS EGRVlv_rTransf_CURX "Transformation aixs to convert the voltage value to positon value" 0x0000 /* @ECU_Address@EGRVlv_rTransf_CURX@ */ /* Input Quantity */ EGRVlv_uRaw Lookup1D_X_WORD 0 EGRVlv_DDSens_CM_Volt_mV_mv /* Number of Axis Pts */ 25 0.0 5000.0 /end AXIS_PTS
/begin CHARACTERISTIC EGRVlv_tiMaxDefDeb_C "Debounce time for checking heal of EGRVlv_bSRCMaxDeb" VALUE 0x0000 /* @ECU_Address@EGRVlv_tiMaxDefDeb_C@ */ Scalar_UWORD 0 EGRVlv_DDSens_CM_Debncd_ms_ms 0.0 6553.5 /end CHARACTERISTIC
/begin CHARACTERISTIC EGRVlv_tiMaxOKDeb_C "Debounce time for checking heal of EGRVlv_bSRCMaxDeb" VALUE 0x0000 /* @ECU_Address@EGRVlv_tiMaxOKDeb_C@ */ Scalar_UWORD 0 EGRVlv_DDSens_CM_Debncd_ms_ms 0.0 6553.5 /end CHARACTERISTIC
/begin CHARACTERISTIC EGRVlv_tiMinDefDeb_C "Debounce time for checking heal of EGRVlv_bSRCMinDeb" VALUE 0x0000 /* @ECU_Address@EGRVlv_tiMinDefDeb_C@ */ Scalar_UWORD 0 EGRVlv_DDSens_CM_Debncd_ms_ms 0.0 6553.5 /end CHARACTERISTIC
/begin CHARACTERISTIC EGRVlv_tiMinOKDeb_C "Debounce time for checking heal of EGRVlv_bSRCMinDeb" VALUE 0x0000 /* @ECU_Address@EGRVlv_tiMinOKDeb_C@ */ Scalar_UWORD 0 EGRVlv_DDSens_CM_Debncd_ms_ms 0.0 6553.5 /end CHARACTERISTIC
/begin CHARACTERISTIC EGRVlv_tiPhysRngHiDefDeb_C "Debounce time for checking heal of EGRVlv_bPhysRngHiDeb" VALUE 0x0000 /* @ECU_Address@EGRVlv_tiPhysRngHiDefDeb_C@ */ Scalar_UWORD 0 EGRVlv_DDSens_CM_Debncd_ms_ms 0.0 6553.5 /end CHARACTERISTIC
/begin CHARACTERISTIC EGRVlv_tiPhysRngHiOKDeb_C "Debounce time for checking heal of EGRVlv_bPhysRngHiDeb" VALUE 0x0000 /* @ECU_Address@EGRVlv_tiPhysRngHiOKDeb_C@ */ Scalar_UWORD 0 EGRVlv_DDSens_CM_Debncd_ms_ms 0.0 6553.5 /end CHARACTERISTIC
/begin CHARACTERISTIC EGRVlv_tiPhysRngLoDefDeb_C "Debounce time for checking heal of EGRVlv_bPhysRngLoDeb" VALUE 0x0000 /* @ECU_Address@EGRVlv_tiPhysRngLoDefDeb_C@ */ Scalar_UWORD 0 EGRVlv_DDSens_CM_Debncd_ms_ms 0.0 6553.5 /end CHARACTERISTIC
/begin CHARACTERISTIC EGRVlv_tiPhysRngLoOKDeb_C "Debounce time for checking heal of EGRVlv_bPhysRngLoDeb" VALUE 0x0000 /* @ECU_Address@EGRVlv_tiPhysRngLoOKDeb_C@ */ Scalar_UWORD 0 EGRVlv_DDSens_CM_Debncd_ms_ms 0.0 6553.5 /end CHARACTERISTIC
/begin CHARACTERISTIC EGRVlv_rAdapDiffPlausLgT_C "Long time drift threshold" VALUE 0x0000 /* @ECU_Address@EGRVlv_rAdapDiffPlausLgT_C@ */ Scalar_SWORD 0 EGRVlv_DDSens_CM_DutyCycle__ -100.0 100.0 /end CHARACTERISTIC
/begin CHARACTERISTIC EGRVlv_uSRCMax_C "Class for default values for signal range check analog input / Threshold for SRC -Max detection" VALUE 0x0000 /* @ECU_Address@EGRVlv_uSRCMax_C@ */ Scalar_SWORD 0 EGRVlv_DDSens_CM_Volt_mV_mv 0.0 5000.0 /end CHARACTERISTIC
/begin CHARACTERISTIC EGRVlv_uSRCMin_C "Class for default values for signal range check analog input / Threshold for SRC -Min detection" VALUE 0x0000 /* @ECU_Address@EGRVlv_uSRCMin_C@ */ Scalar_SWORD 0 EGRVlv_DDSens_CM_Volt_mV_mv 0.0 5000.0 /end CHARACTERISTIC
/begin MEASUREMENT EGRVlv_uRaw "" SWORD EGRVlv_DDSens_CM_Volt_mV 0 0 0.0 5000.0 ECU_ADDRESS 0x0000 /* @ECU_Address@EGRVlv_uRaw@ */ /end MEASUREMENT
/begin MEASUREMENT DSM_bEGRVlvSSpMon "" UBYTE EGRVlv_DDSens_CM_boolean 0 0 0.0 1.0 ECU_ADDRESS 0x0000 /* @ECU_Address@DSM_bEGRVlvSSpMon@ */ /end MEASUREMENT
/begin MEASUREMENT EGRVlv_rOfsLrnFrst_MR "" SWORD EGRVlv_DDSens_CM_DutyCycle 0 0 -100.0 100.0 ECU_ADDRESS 0x0000 /* @ECU_Address@EGRVlv_rOfsLrnFrst_MR@ */ /end MEASUREMENT
/begin MEASUREMENT DSM_bEGRVlvPhysRng "" UBYTE EGRVlv_DDSens_CM_boolean 0 0 0.0 1.0 ECU_ADDRESS 0x0000 /* @ECU_Address@DSM_bEGRVlvPhysRng@ */ /end MEASUREMENT
/begin MEASUREMENT EGRVlv_rSens "Sensed value of actuator position without error handling" SWORD EGRVlv_DDSens_CM_DutyCycle__ 0 0 -100.0 100.0 ECU_ADDRESS 0x0000 /* @ECU_Address@EGRVlv_rSens@ */ /end MEASUREMENT
/begin MEASUREMENT EGRVlv_bSRCMax "EGR Valve voltage signal maximum limit value" UBYTE EGRVlv_DDSens_CM_boolean_NaN 0 0 0.0 1.0 ECU_ADDRESS 0x0000 /* @ECU_Address@EGRVlv_bSRCMax@ */ /end MEASUREMENT
/begin MEASUREMENT EGRVlv_bSRCMaxDeb_DSM "SRC High for EGR position sensor voltage" UBYTE EGRVlv_DDSens_CM_boolean_NaN 0 0 0.0 1.0 ECU_ADDRESS 0x0000 /* @ECU_Address@EGRVlv_bSRCMaxDeb_DSM@ */ /end MEASUREMENT
/begin MEASUREMENT EGRVlv_bSRCMin "EGR Valve voltage signal minimum limit value" UBYTE EGRVlv_DDSens_CM_boolean_NaN 0 0 0.0 1.0 ECU_ADDRESS 0x0000 /* @ECU_Address@EGRVlv_bSRCMin@ */ /end MEASUREMENT
/begin MEASUREMENT EGRVlv_bSRCMinDeb_DSM "SRC Low for EGR position sensor voltage" UBYTE EGRVlv_DDSens_CM_boolean_NaN 0 0 0.0 1.0 ECU_ADDRESS 0x0000 /* @ECU_Address@EGRVlv_bSRCMinDeb_DSM@ */ /end MEASUREMENT
/begin MEASUREMENT EGRVlv_bFinalDef "the final fault flag" UBYTE EGRVlv_DDSens_CM_boolean_NaN 0 0 0.0 1.0 ECU_ADDRESS 0x0000 /* @ECU_Address@EGRVlv_bFinalDef@ */ /end MEASUREMENT
/begin MEASUREMENT EGRVlv_bProvDef "the fault flag for the moment" UBYTE EGRVlv_DDSens_CM_boolean_NaN 0 0 0.0 1.0 ECU_ADDRESS 0x0000 /* @ECU_Address@EGRVlv_bProvDef@ */ /end MEASUREMENT
/begin MEASUREMENT EGRVlv_bPhysRngFinalDef "Status Sensor of the EGR valve physical Signal range check finally defect" UBYTE EGRVlv_DDSens_CM_boolean_NaN 0 0 0.0 1.0 ECU_ADDRESS 0x0000 /* @ECU_Address@EGRVlv_bPhysRngFinalDef@ */ /end MEASUREMENT
/begin MEASUREMENT EGRVlv_bPhysRngProvDef "Status Sensor of the EGR valve physical Signal range check temporary defect" UBYTE EGRVlv_DDSens_CM_boolean_NaN 0 0 0.0 1.0 ECU_ADDRESS 0x0000 /* @ECU_Address@EGRVlv_bPhysRngProvDef@ */ /end MEASUREMENT
/begin MEASUREMENT EGRVlv_bPhysRngHiDeb_DSM "Status of EGRVlv_bPhysRngHiDeb" UBYTE EGRVlv_DDSens_CM_boolean_NaN 0 0 0.0 1.0 ECU_ADDRESS 0x0000 /* @ECU_Address@EGRVlv_bPhysRngHiDeb_DSM@ */ /end MEASUREMENT
/begin MEASUREMENT EGRVlv_bPhysRngLoDeb_DSM "Status of EGRVlv_bPhysRngLoDeb" UBYTE EGRVlv_DDSens_CM_boolean_NaN 0 0 0.0 1.0 ECU_ADDRESS 0x0000 /* @ECU_Address@EGRVlv_bPhysRngLoDeb_DSM@ */ /end MEASUREMENT
/begin MEASUREMENT EGRVlv_bPhysRngHi "Status Sensor of the EGR Valve high voltage Signal range" UBYTE EGRVlv_DDSens_CM_boolean_NaN 0 0 0.0 1.0 ECU_ADDRESS 0x0000 /* @ECU_Address@EGRVlv_bPhysRngHi@ */ /end MEASUREMENT
/begin MEASUREMENT EGRVlv_bPhysRngLo "Status Sensor of the EGR Valve low voltage Signal range" UBYTE EGRVlv_DDSens_CM_boolean_NaN 0 0 0.0 1.0 ECU_ADDRESS 0x0000 /* @ECU_Address@EGRVlv_bPhysRngLo@ */ /end MEASUREMENT
/begin COMPU_METHOD EGRVlv_DDSens_CM_DutyCycle__ "Q = V*200.000000" RAT_FUNC "%6.3" "%" COEFFS 0 200.000000 0.000000 0 0 1.000000 /end COMPU_METHOD
/begin COMPU_METHOD EGRVlv_DDSens_CM_Volt_mV_mv "Q = V" RAT_FUNC "%5.0" "mv" COEFFS 0 1 0 0 0 1 /end COMPU_METHOD
/begin COMPU_METHOD EGRVlv_DDSens_CM_Debncd_ms_ms "Q = V*10.000000" RAT_FUNC "%5.1" "ms" COEFFS 0 10.000000 0.000000 0 0 1.000000 /end COMPU_METHOD
/begin COMPU_METHOD EGRVlv_DDSens_CM_Volt_mV "Q = V" RAT_FUNC "%5.0" "" COEFFS 0 1 0 0 0 1 /end COMPU_METHOD
/begin COMPU_METHOD EGRVlv_DDSens_CM_boolean "Q = V" RAT_FUNC "%1.0" "" COEFFS 0 1 0 0 0 1 /end COMPU_METHOD
/begin COMPU_METHOD EGRVlv_DDSens_CM_DutyCycle "Q = V*200.000000" RAT_FUNC "%6.3" "" COEFFS 0 200.000000 0.000000 0 0 1.000000 /end COMPU_METHOD
/begin COMPU_METHOD EGRVlv_DDSens_CM_boolean_NaN "Q = V" RAT_FUNC "%1.0" "NaN" COEFFS 0 1 0 0 0 1 /end COMPU_METHOD
/begin GROUP EGRVlv_DDSens "EGRVlv_DDSens" /* Root */ ROOT /begin SUB_GROUP Root_Overview /end SUB_GROUP
 /begin REF_MEASUREMENT DSM_bEGRVlvPhysRng DSM_bEGRVlvSSpMon EGRVlv_rOfsLrnFrst_MR EGRVlv_uRaw /end REF_MEASUREMENT
/end GROUP
/begin GROUP Root_Overview "EGRVlv_DDSens/Overview" /begin SUB_GROUP S1_EGRVlv_DDSens /end SUB_GROUP /end GROUP
/begin GROUP S1_EGRVlv_DDSens "EGRVlv_DDSens/Overview/EGRVlv_DDSens" /begin SUB_GROUP S2_PRC_Debounce S2_SRC_Debounce S2_U2R_Cnv /end SUB_GROUP
 /begin REF_MEASUREMENT EGRVlv_bPhysRngFinalDef EGRVlv_bPhysRngHiDeb_DSM EGRVlv_bPhysRngLoDeb_DSM EGRVlv_bPhysRngProvDef /end REF_MEASUREMENT
/end GROUP
/begin GROUP S2_PRC_Debounce "EGRVlv_DDSens/Overview/EGRVlv_DDSens/PRC_Debounce"
 /begin REF_CHARACTERISTIC EGRVlv_rAdapDiffPlausLgT_C EGRVlv_tiPhysRngHiDefDeb_C EGRVlv_tiPhysRngHiOKDeb_C EGRVlv_tiPhysRngLoDefDeb_C EGRVlv_tiPhysRngLoOKDeb_C /end REF_CHARACTERISTIC
 /begin REF_MEASUREMENT EGRVlv_bPhysRngHi EGRVlv_bPhysRngLo /end REF_MEASUREMENT
/end GROUP
/begin GROUP S2_SRC_Debounce "EGRVlv_DDSens/Overview/EGRVlv_DDSens/SRC_Debounce"
 /begin REF_CHARACTERISTIC EGRVlv_tiMaxDefDeb_C EGRVlv_tiMaxOKDeb_C EGRVlv_tiMinDefDeb_C EGRVlv_tiMinOKDeb_C EGRVlv_uSRCMax_C EGRVlv_uSRCMin_C /end REF_CHARACTERISTIC
 /begin REF_MEASUREMENT EGRVlv_bFinalDef EGRVlv_bProvDef EGRVlv_bSRCMax EGRVlv_bSRCMaxDeb_DSM EGRVlv_bSRCMin EGRVlv_bSRCMinDeb_DSM /end REF_MEASUREMENT
/end GROUP
/begin GROUP S2_U2R_Cnv "EGRVlv_DDSens/Overview/EGRVlv_DDSens/U2R_Cnv" /begin REF_CHARACTERISTIC EGRVlv_rTransf_CUR /end REF_CHARACTERISTIC /begin REF_MEASUREMENT EGRVlv_rSens /end REF_MEASUREMENT /end GROUP
/end MODULE
/end PROJECT
/* (add any file trailer comments here) */
/* EOF EGRVlv_DDSens.a2l */
