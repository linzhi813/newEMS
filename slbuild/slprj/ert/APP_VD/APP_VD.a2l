/******************************************************************************
* ASAP2 file: APP_VD.a2l
* Code generation for model "APP_VD".
* Model version : 1.55
* Simulink Coder version : 9.4 (R2020b) 29-Jul-2020
* C source code generated on : Thu Feb 4 09:43:25 2021
* Target selection: ert.tlc
* Embedded hardware selection: ARM Compatible->ARM Cortex
* Code generation objectives: Unspecified
* Validation result: Not run
* (add additional file header information here)
******************************************************************************/ ASAP2_VERSION 1 31
/* Version 1.31 */
/begin PROJECT ProjectName "Project Comment Goes Here"
/begin HEADER "Header Comments go here" /end HEADER
/begin MODULE ModuleName "Module Comment Goes Here"
/begin MOD_PAR "MOD PAR Comment Goes Here" /end MOD_PAR
/begin MOD_COMMON "Mod Common Comment Here" BYTE_ORDER MSB_LAST /end MOD_COMMON
/begin RECORD_LAYOUT Scalar_BOOLEAN FNC_VALUES 1 UBYTE COLUMN_DIR DIRECT /end RECORD_LAYOUT
/begin RECORD_LAYOUT Scalar_UBYTE FNC_VALUES 1 UBYTE COLUMN_DIR DIRECT /end RECORD_LAYOUT
/begin RECORD_LAYOUT Scalar_BYTE FNC_VALUES 1 SBYTE COLUMN_DIR DIRECT /end RECORD_LAYOUT
/begin RECORD_LAYOUT Scalar_UWORD FNC_VALUES 1 UWORD COLUMN_DIR DIRECT /end RECORD_LAYOUT
/begin RECORD_LAYOUT Scalar_SWORD FNC_VALUES 1 SWORD COLUMN_DIR DIRECT /end RECORD_LAYOUT
/begin RECORD_LAYOUT Scalar_ULONG FNC_VALUES 1 ULONG COLUMN_DIR DIRECT /end RECORD_LAYOUT
/begin RECORD_LAYOUT Scalar_LONG FNC_VALUES 1 SLONG COLUMN_DIR DIRECT /end RECORD_LAYOUT
/begin RECORD_LAYOUT Scalar_FLOAT32_IEEE FNC_VALUES 1 FLOAT32_IEEE COLUMN_DIR DIRECT /end RECORD_LAYOUT
/begin RECORD_LAYOUT Scalar_FLOAT64_IEEE FNC_VALUES 1 FLOAT64_IEEE COLUMN_DIR DIRECT /end RECORD_LAYOUT
/begin RECORD_LAYOUT Lookup1D_BOOLEAN FNC_VALUES 1 UBYTE COLUMN_DIR DIRECT /end RECORD_LAYOUT
/begin RECORD_LAYOUT Lookup1D_X_BOOLEAN AXIS_PTS_X 1 UBYTE INDEX_INCR DIRECT /end RECORD_LAYOUT
/begin RECORD_LAYOUT Lookup1D_BYTE FNC_VALUES 1 SBYTE COLUMN_DIR DIRECT /end RECORD_LAYOUT
/begin RECORD_LAYOUT Lookup1D_X_BYTE AXIS_PTS_X 1 SBYTE INDEX_INCR DIRECT /end RECORD_LAYOUT
/begin RECORD_LAYOUT Lookup1D_UBYTE FNC_VALUES 1 UBYTE COLUMN_DIR DIRECT /end RECORD_LAYOUT
/begin RECORD_LAYOUT Lookup1D_X_UBYTE AXIS_PTS_X 1 UBYTE INDEX_INCR DIRECT /end RECORD_LAYOUT
/begin RECORD_LAYOUT Lookup1D_UWORD FNC_VALUES 1 UWORD COLUMN_DIR DIRECT /end RECORD_LAYOUT
/begin RECORD_LAYOUT Lookup1D_X_UWORD AXIS_PTS_X 1 UWORD INDEX_INCR DIRECT /end RECORD_LAYOUT
/begin RECORD_LAYOUT Lookup1D_WORD FNC_VALUES 1 SWORD COLUMN_DIR DIRECT /end RECORD_LAYOUT
/begin RECORD_LAYOUT Lookup1D_X_WORD AXIS_PTS_X 1 SWORD INDEX_INCR DIRECT /end RECORD_LAYOUT
/begin RECORD_LAYOUT Lookup1D_ULONG FNC_VALUES 1 ULONG COLUMN_DIR DIRECT /end RECORD_LAYOUT
/begin RECORD_LAYOUT Lookup1D_X_ULONG AXIS_PTS_X 1 ULONG INDEX_INCR DIRECT /end RECORD_LAYOUT
/begin RECORD_LAYOUT Lookup1D_SLONG FNC_VALUES 1 SLONG COLUMN_DIR DIRECT /end RECORD_LAYOUT
/begin RECORD_LAYOUT Lookup1D_X_LONG AXIS_PTS_X 1 SLONG INDEX_INCR DIRECT /end RECORD_LAYOUT
/begin RECORD_LAYOUT Lookup1D_FLOAT32_IEEE FNC_VALUES 1 FLOAT32_IEEE COLUMN_DIR DIRECT /end RECORD_LAYOUT
/begin RECORD_LAYOUT Lookup1D_X_FLOAT32_IEEE AXIS_PTS_X 1 FLOAT32_IEEE INDEX_INCR DIRECT /end RECORD_LAYOUT
/begin RECORD_LAYOUT Lookup1D_FLOAT64_IEEE FNC_VALUES 1 FLOAT64_IEEE COLUMN_DIR DIRECT /end RECORD_LAYOUT
/begin RECORD_LAYOUT Lookup1D_X_FLOAT64_IEEE AXIS_PTS_X 1 FLOAT64_IEEE INDEX_INCR DIRECT /end RECORD_LAYOUT
/begin RECORD_LAYOUT Lookup2D_BOOLEAN FNC_VALUES 1 UBYTE COLUMN_DIR DIRECT /end RECORD_LAYOUT
/begin RECORD_LAYOUT Lookup2D_X_BOOLEAN AXIS_PTS_X 1 UBYTE INDEX_INCR DIRECT /end RECORD_LAYOUT
/begin RECORD_LAYOUT Lookup2D_UBYTE FNC_VALUES 1 UBYTE COLUMN_DIR DIRECT /end RECORD_LAYOUT
/begin RECORD_LAYOUT Lookup2D_X_UBYTE AXIS_PTS_X 1 UBYTE INDEX_INCR DIRECT /end RECORD_LAYOUT
/begin RECORD_LAYOUT Lookup2D_BYTE FNC_VALUES 1 SBYTE COLUMN_DIR DIRECT /end RECORD_LAYOUT
/begin RECORD_LAYOUT Lookup2D_X_BYTE AXIS_PTS_X 1 SBYTE INDEX_INCR DIRECT /end RECORD_LAYOUT
/begin RECORD_LAYOUT Lookup2D_UWORD FNC_VALUES 1 UWORD COLUMN_DIR DIRECT /end RECORD_LAYOUT
/begin RECORD_LAYOUT Lookup2D_X_UWORD AXIS_PTS_X 1 UWORD INDEX_INCR DIRECT /end RECORD_LAYOUT
/begin RECORD_LAYOUT Lookup2D_WORD FNC_VALUES 1 SWORD COLUMN_DIR DIRECT /end RECORD_LAYOUT
/begin RECORD_LAYOUT Lookup2D_X_WORD AXIS_PTS_X 1 SWORD INDEX_INCR DIRECT /end RECORD_LAYOUT
/begin RECORD_LAYOUT Lookup2D_ULONG FNC_VALUES 1 ULONG COLUMN_DIR DIRECT /end RECORD_LAYOUT
/begin RECORD_LAYOUT Lookup2D_X_ULONG AXIS_PTS_X 1 ULONG INDEX_INCR DIRECT /end RECORD_LAYOUT
/begin RECORD_LAYOUT Lookup2D_LONG FNC_VALUES 1 SLONG COLUMN_DIR DIRECT /end RECORD_LAYOUT
/begin RECORD_LAYOUT Lookup2D_X_LONG AXIS_PTS_X 1 SLONG INDEX_INCR DIRECT /end RECORD_LAYOUT
/begin RECORD_LAYOUT Lookup2D_FLOAT32_IEEE FNC_VALUES 1 FLOAT32_IEEE COLUMN_DIR DIRECT /end RECORD_LAYOUT
/begin RECORD_LAYOUT Lookup2D_X_FLOAT32_IEEE AXIS_PTS_X 1 FLOAT32_IEEE INDEX_INCR DIRECT /end RECORD_LAYOUT
/begin RECORD_LAYOUT Lookup2D_FLOAT64_IEEE FNC_VALUES 1 FLOAT64_IEEE COLUMN_DIR DIRECT /end RECORD_LAYOUT
/begin RECORD_LAYOUT Lookup2D_X_FLOAT64_IEEE AXIS_PTS_X 1 FLOAT64_IEEE INDEX_INCR DIRECT /end RECORD_LAYOUT
/begin CHARACTERISTIC MoFAPP_rLinAPPCURCalMsgA_CUR "the physical value of accpedal" /* Characteristic Type */ CURVE 0x0000 /* @ECU_Address@MoFAPP_rLinAPPCURCalMsgA_CUR@ */ Lookup1D_WORD /* Maxdiff */ 0 APP_VD_CM_Percent__ 0.0 100.0
 /begin AXIS_DESCR /* Description of X-Axis Points */ /* Axis Type */ COM_AXIS /* Reference to Input */ APP_uUnJit_mp APP_VD_CM_Volt_mV_mv /* Number of Axis Pts */ 2 0.0 5000.0 AXIS_PTS_REF MoFAPP_rLinAPPCURCalMsgA_CURX /end AXIS_DESCR
/end CHARACTERISTIC
/begin AXIS_PTS MoFAPP_rLinAPPCURCalMsgA_CURX "accpedal axis" 0x0000 /* @ECU_Address@MoFAPP_rLinAPPCURCalMsgA_CURX@ */ /* Input Quantity */ APP_uUnJit_mp Lookup1D_X_WORD 0 APP_VD_CM_Volt_mV_mv /* Number of Axis Pts */ 2 0.0 5000.0 /end AXIS_PTS
/begin CHARACTERISTIC APP_swtEnaFlt_C "Switch to enable PT1" VALUE 0x0000 /* @ECU_Address@APP_swtEnaFlt_C@ */ Scalar_LONG 0 APP_VD_CM_Switch_NaN 0 1 /end CHARACTERISTIC
/begin CHARACTERISTIC APP_swtEnaUnJit_C "Switch to enable unjittering" VALUE 0x0000 /* @ECU_Address@APP_swtEnaUnJit_C@ */ Scalar_LONG 0 APP_VD_CM_Switch_NaN 0 1 /end CHARACTERISTIC
/begin CHARACTERISTIC SigTst_swtAPP_C "Switch to set accpedal value" VALUE 0x0000 /* @ECU_Address@SigTst_swtAPP_C@ */ Scalar_LONG 0 APP_VD_CM_Switch_NaN 0 1 /end CHARACTERISTIC
/begin CHARACTERISTIC APP_facLowNegPT1_C "Filter parameter falling signal low range" VALUE 0x0000 /* @ECU_Address@APP_facLowNegPT1_C@ */ Scalar_SWORD 0 APP_VD_CM_Fac_100_NaN 0.0 99.9985 /end CHARACTERISTIC
/begin CHARACTERISTIC APP_facLowPosPT1_C "Filter parameter rising signal low range" VALUE 0x0000 /* @ECU_Address@APP_facLowPosPT1_C@ */ Scalar_SWORD 0 APP_VD_CM_Fac_100_NaN 0.0 99.9985 /end CHARACTERISTIC
/begin CHARACTERISTIC APP_facMidNegPT1_C "Filter parameter falling signal mid range" VALUE 0x0000 /* @ECU_Address@APP_facMidNegPT1_C@ */ Scalar_SWORD 0 APP_VD_CM_Fac_100_NaN 0.0 99.9985 /end CHARACTERISTIC
/begin CHARACTERISTIC APP_facMidPosPT1_C "Filter parameter rising signal mid range" VALUE 0x0000 /* @ECU_Address@APP_facMidPosPT1_C@ */ Scalar_SWORD 0 APP_VD_CM_Fac_100_NaN 0.0 99.9985 /end CHARACTERISTIC
/begin CHARACTERISTIC APP_facUppNegPT1_C "Filter parameter falling signal high range" VALUE 0x0000 /* @ECU_Address@APP_facUppNegPT1_C@ */ Scalar_SWORD 0 APP_VD_CM_Fac_100_NaN 0.0 99.9985 /end CHARACTERISTIC
/begin CHARACTERISTIC APP_facUppPosPT1_C "Filter parameter rising signal high range" VALUE 0x0000 /* @ECU_Address@APP_facUppPosPT1_C@ */ Scalar_SWORD 0 APP_VD_CM_Fac_100_NaN 0.0 99.9985 /end CHARACTERISTIC
/begin CHARACTERISTIC APP_rThrFltLowNeg_C "Threshold for low/mid-range Filter parameter falling signal" VALUE 0x0000 /* @ECU_Address@APP_rThrFltLowNeg_C@ */ Scalar_SWORD 0 APP_VD_CM_Percent__ 0.0 100.0 /end CHARACTERISTIC
/begin CHARACTERISTIC APP_rThrFltLowPos_C "Threshold for low/mid-range Filter parameter rising signal" VALUE 0x0000 /* @ECU_Address@APP_rThrFltLowPos_C@ */ Scalar_SWORD 0 APP_VD_CM_Percent__ 0.0 100.0 /end CHARACTERISTIC
/begin CHARACTERISTIC APP_rThrFltMidNeg_C "Threshold for mid/high-range Filter parameter falling signal" VALUE 0x0000 /* @ECU_Address@APP_rThrFltMidNeg_C@ */ Scalar_SWORD 0 APP_VD_CM_Percent__ 0.0 100.0 /end CHARACTERISTIC
/begin CHARACTERISTIC APP_rThrFltMidPos_C "Threshold for mid/high-range Filter parameter rising signal" VALUE 0x0000 /* @ECU_Address@APP_rThrFltMidPos_C@ */ Scalar_SWORD 0 APP_VD_CM_Percent__ 0.0 100.0 /end CHARACTERISTIC
/begin CHARACTERISTIC SigTst_rAPP_C "set the accpedal value" VALUE 0x0000 /* @ECU_Address@SigTst_rAPP_C@ */ Scalar_SWORD 0 APP_VD_CM_Percent__ 0.0 100.0 /end CHARACTERISTIC
/begin CHARACTERISTIC APP_drLinRmp_C "Permissible amount of accpedal value when vehicle quits limp mode" VALUE 0x0000 /* @ECU_Address@APP_drLinRmp_C@ */ Scalar_SWORD 0 APP_VD_CM_Percent_s___s -200.0 200.0 /end CHARACTERISTIC
/begin CHARACTERISTIC APP_uJitter_C "Threshold for unjittering" VALUE 0x0000 /* @ECU_Address@APP_uJitter_C@ */ Scalar_SWORD 0 APP_VD_CM_Volt_mV_mv 0.0 5000.0 /end CHARACTERISTIC
/begin MEASUREMENT APP_uRaw_mp "" SWORD APP_VD_CM_Volt_mV 0 0 0.0 5000.0 ECU_ADDRESS 0x0000 /* @ECU_Address@APP_uRaw_mp@ */ /end MEASUREMENT
/begin MEASUREMENT APP_stSigSrc_APPLIMP_BP "" UBYTE APP_VD_CM_boolean 0 0 0.0 1.0 ECU_ADDRESS 0x0000 /* @ECU_Address@APP_stSigSrc_APPLIMP_BP@ */ /end MEASUREMENT
/begin MEASUREMENT APP_stSigSrc_APPDEF_BP "" UBYTE APP_VD_CM_boolean 0 0 0.0 1.0 ECU_ADDRESS 0x0000 /* @ECU_Address@APP_stSigSrc_APPDEF_BP@ */ /end MEASUREMENT
/begin MEASUREMENT APP_drUnFlt "Acceleration pedal position gradient of unfilterd value" SWORD APP_VD_CM_Percent_s___ms 0 0 -200.0 200.0 ECU_ADDRESS 0x0000 /* @ECU_Address@APP_drUnFlt@ */ /end MEASUREMENT
/begin MEASUREMENT APP_rLinAPP_mp "Linearisation ratio of accelerator pedal" SWORD APP_VD_CM_Percent__ 0 0 0.0 100.0 ECU_ADDRESS 0x0000 /* @ECU_Address@APP_rLinAPP_mp@ */ /end MEASUREMENT
/begin MEASUREMENT APP_rUnFlt_mp "Unfiltered APP value" SWORD APP_VD_CM_Percent__ 0 0 0.0 100.0 ECU_ADDRESS 0x0000 /* @ECU_Address@APP_rUnFlt_mp@ */ /end MEASUREMENT
/begin MEASUREMENT APP_rUnFlt "Unfiltered APP value" SWORD APP_VD_CM_Percent__ 0 0 0.0 100.0 ECU_ADDRESS 0x0000 /* @ECU_Address@APP_rUnFlt@ */ /end MEASUREMENT
/begin MEASUREMENT APP_rFlt_mp "Acceleration pedal position filtered value" SWORD APP_VD_CM_Percent__ 0 0 0.0 100.0 ECU_ADDRESS 0x0000 /* @ECU_Address@APP_rFlt_mp@ */ /end MEASUREMENT
/begin MEASUREMENT APP_facPT1 "Filter time" SWORD APP_VD_CM_Fac_100_NaN 0 0 0.0 99.9985 ECU_ADDRESS 0x0000 /* @ECU_Address@APP_facPT1@ */ /end MEASUREMENT
/begin MEASUREMENT APP_uUnJit_mp "Acceleration pedal position unjittered value" SWORD APP_VD_CM_Volt_mV_mv 0 0 0.0 5000.0 ECU_ADDRESS 0x0000 /* @ECU_Address@APP_uUnJit_mp@ */ /end MEASUREMENT
/begin COMPU_METHOD APP_VD_CM_Percent__ "Q = V*200.000000" RAT_FUNC "%6.3" "%" COEFFS 0 200.000000 0.000000 0 0 1.000000 /end COMPU_METHOD
/begin COMPU_METHOD APP_VD_CM_Volt_mV_mv "Q = V" RAT_FUNC "%5.0" "mv" COEFFS 0 1 0 0 0 1 /end COMPU_METHOD
/begin COMPU_METHOD APP_VD_CM_Switch_NaN "Enumerated data type: Switch" TAB_VERB "%0.6" "NaN" /* Conversion Table */ COMPU_TAB_REF VTAB_FOR_APP_VD_CM_Switch_NaN /end COMPU_METHOD
/begin COMPU_VTAB /* Name of Table */ VTAB_FOR_APP_VD_CM_Switch_NaN "Enumerated data type: Switch" TAB_VERB /* Number of Elements */ 2 /* Table Element */ 0 "Switch_OFF" /* Table Element */ 1 "Switch_ON" /end COMPU_VTAB
/begin COMPU_METHOD APP_VD_CM_Fac_100_NaN "Q = V*200.000000" RAT_FUNC "%6.3" "NaN" COEFFS 0 200.000000 0.000000 0 0 1.000000 /end COMPU_METHOD
/begin COMPU_METHOD APP_VD_CM_Percent_s___s "Q = V*100.000000" RAT_FUNC "%5.2" "%/s" COEFFS 0 100.000000 0.000000 0 0 1.000000 /end COMPU_METHOD
/begin COMPU_METHOD APP_VD_CM_Volt_mV "Q = V" RAT_FUNC "%5.0" "" COEFFS 0 1 0 0 0 1 /end COMPU_METHOD
/begin COMPU_METHOD APP_VD_CM_boolean "Q = V" RAT_FUNC "%1.0" "" COEFFS 0 1 0 0 0 1 /end COMPU_METHOD
/begin COMPU_METHOD APP_VD_CM_Percent_s___ms "Q = V*100.000000" RAT_FUNC "%5.2" "%/ms" COEFFS 0 100.000000 0.000000 0 0 1.000000 /end COMPU_METHOD
/begin GROUP APP_VD "APP_VD" /* Root */ ROOT /begin SUB_GROUP Root_Overview /end SUB_GROUP /begin REF_MEASUREMENT APP_stSigSrc_APPDEF_BP APP_stSigSrc_APPLIMP_BP APP_uRaw_mp /end REF_MEASUREMENT /end GROUP
/begin GROUP Root_Overview "APP_VD/Overview" /begin SUB_GROUP S1_APP_VD /end SUB_GROUP /end GROUP
/begin GROUP S1_APP_VD "APP_VD/Overview/APP_VD" /begin SUB_GROUP S2_APP_UnJit S2_Linearisation S2_Signal_Filter /end SUB_GROUP /end GROUP
/begin GROUP S2_APP_UnJit "APP_VD/Overview/APP_VD/APP_UnJit" /begin REF_CHARACTERISTIC APP_swtEnaUnJit_C APP_uJitter_C /end REF_CHARACTERISTIC /begin REF_MEASUREMENT APP_uUnJit_mp /end REF_MEASUREMENT /end GROUP
/begin GROUP S2_Linearisation "APP_VD/Overview/APP_VD/Linearisation" /begin SUB_GROUP S4_APP_rUnFlt_inl S4_dt2s /end SUB_GROUP /begin REF_CHARACTERISTIC MoFAPP_rLinAPPCURCalMsgA_CUR SigTst_rAPP_C SigTst_swtAPP_C /end REF_CHARACTERISTIC /begin REF_MEASUREMENT APP_rLinAPP_mp APP_rUnFlt /end REF_MEASUREMENT /end GROUP
/begin GROUP S2_Signal_Filter "APP_VD/Overview/APP_VD/Signal_Filter" /begin SUB_GROUP S5_Filter_parameter_selection /end SUB_GROUP /begin REF_CHARACTERISTIC APP_swtEnaFlt_C /end REF_CHARACTERISTIC /begin REF_MEASUREMENT APP_rFlt_mp /end REF_MEASUREMENT /end GROUP
/begin GROUP S4_APP_rUnFlt_inl "APP_VD/Overview/APP_VD/Linearisation/APP_rUnFlt_inl" /begin REF_CHARACTERISTIC APP_drLinRmp_C /end REF_CHARACTERISTIC /begin REF_MEASUREMENT APP_rUnFlt_mp /end REF_MEASUREMENT /end GROUP
/begin GROUP S4_dt2s "APP_VD/Overview/APP_VD/Linearisation/dt2s" /begin REF_MEASUREMENT APP_drUnFlt /end REF_MEASUREMENT /end GROUP
/begin GROUP S5_Filter_parameter_selection "APP_VD/Overview/APP_VD/Signal_Filter/Filter_parameter_selection"
 /begin REF_CHARACTERISTIC APP_facLowNegPT1_C APP_facLowPosPT1_C APP_facMidNegPT1_C APP_facMidPosPT1_C APP_facUppNegPT1_C APP_facUppPosPT1_C APP_rThrFltLowNeg_C APP_rThrFltLowPos_C APP_rThrFltMidNeg_C APP_rThrFltMidPos_C /end REF_CHARACTERISTIC
 /begin REF_MEASUREMENT APP_facPT1 /end REF_MEASUREMENT
/end GROUP
/end MODULE
/end PROJECT
/* (add any file trailer comments here) */
/* EOF APP_VD.a2l */
