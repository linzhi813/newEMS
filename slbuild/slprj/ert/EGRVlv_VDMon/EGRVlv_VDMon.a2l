/******************************************************************************
* ASAP2 file: EGRVlv_VDMon.a2l
* Code generation for model "EGRVlv_VDMon".
* Model version : 1.69
* Simulink Coder version : 9.4 (R2020b) 29-Jul-2020
* C source code generated on : Thu Feb 4 09:39:35 2021
* Target selection: ert.tlc
* Embedded hardware selection: ARM Compatible->ARM Cortex
* Code generation objectives: Unspecified
* Validation result: Not run
* (add additional file header information here)
******************************************************************************/ ASAP2_VERSION 1 31
/* Version 1.31 */
/begin PROJECT ProjectName "Project Comment Goes Here"
/begin HEADER "Header Comments go here" /end HEADER
/begin MODULE ModuleName "Module Comment Goes Here"
/begin MOD_PAR "MOD PAR Comment Goes Here" /end MOD_PAR
/begin MOD_COMMON "Mod Common Comment Here" BYTE_ORDER MSB_LAST /end MOD_COMMON
/begin RECORD_LAYOUT Scalar_BOOLEAN FNC_VALUES 1 UBYTE COLUMN_DIR DIRECT /end RECORD_LAYOUT
/begin RECORD_LAYOUT Scalar_UBYTE FNC_VALUES 1 UBYTE COLUMN_DIR DIRECT /end RECORD_LAYOUT
/begin RECORD_LAYOUT Scalar_BYTE FNC_VALUES 1 SBYTE COLUMN_DIR DIRECT /end RECORD_LAYOUT
/begin RECORD_LAYOUT Scalar_UWORD FNC_VALUES 1 UWORD COLUMN_DIR DIRECT /end RECORD_LAYOUT
/begin RECORD_LAYOUT Scalar_SWORD FNC_VALUES 1 SWORD COLUMN_DIR DIRECT /end RECORD_LAYOUT
/begin RECORD_LAYOUT Scalar_ULONG FNC_VALUES 1 ULONG COLUMN_DIR DIRECT /end RECORD_LAYOUT
/begin RECORD_LAYOUT Scalar_LONG FNC_VALUES 1 SLONG COLUMN_DIR DIRECT /end RECORD_LAYOUT
/begin RECORD_LAYOUT Scalar_FLOAT32_IEEE FNC_VALUES 1 FLOAT32_IEEE COLUMN_DIR DIRECT /end RECORD_LAYOUT
/begin RECORD_LAYOUT Scalar_FLOAT64_IEEE FNC_VALUES 1 FLOAT64_IEEE COLUMN_DIR DIRECT /end RECORD_LAYOUT
/begin RECORD_LAYOUT Lookup1D_BOOLEAN FNC_VALUES 1 UBYTE COLUMN_DIR DIRECT /end RECORD_LAYOUT
/begin RECORD_LAYOUT Lookup1D_X_BOOLEAN AXIS_PTS_X 1 UBYTE INDEX_INCR DIRECT /end RECORD_LAYOUT
/begin RECORD_LAYOUT Lookup1D_BYTE FNC_VALUES 1 SBYTE COLUMN_DIR DIRECT /end RECORD_LAYOUT
/begin RECORD_LAYOUT Lookup1D_X_BYTE AXIS_PTS_X 1 SBYTE INDEX_INCR DIRECT /end RECORD_LAYOUT
/begin RECORD_LAYOUT Lookup1D_UBYTE FNC_VALUES 1 UBYTE COLUMN_DIR DIRECT /end RECORD_LAYOUT
/begin RECORD_LAYOUT Lookup1D_X_UBYTE AXIS_PTS_X 1 UBYTE INDEX_INCR DIRECT /end RECORD_LAYOUT
/begin RECORD_LAYOUT Lookup1D_UWORD FNC_VALUES 1 UWORD COLUMN_DIR DIRECT /end RECORD_LAYOUT
/begin RECORD_LAYOUT Lookup1D_X_UWORD AXIS_PTS_X 1 UWORD INDEX_INCR DIRECT /end RECORD_LAYOUT
/begin RECORD_LAYOUT Lookup1D_WORD FNC_VALUES 1 SWORD COLUMN_DIR DIRECT /end RECORD_LAYOUT
/begin RECORD_LAYOUT Lookup1D_X_WORD AXIS_PTS_X 1 SWORD INDEX_INCR DIRECT /end RECORD_LAYOUT
/begin RECORD_LAYOUT Lookup1D_ULONG FNC_VALUES 1 ULONG COLUMN_DIR DIRECT /end RECORD_LAYOUT
/begin RECORD_LAYOUT Lookup1D_X_ULONG AXIS_PTS_X 1 ULONG INDEX_INCR DIRECT /end RECORD_LAYOUT
/begin RECORD_LAYOUT Lookup1D_SLONG FNC_VALUES 1 SLONG COLUMN_DIR DIRECT /end RECORD_LAYOUT
/begin RECORD_LAYOUT Lookup1D_X_LONG AXIS_PTS_X 1 SLONG INDEX_INCR DIRECT /end RECORD_LAYOUT
/begin RECORD_LAYOUT Lookup1D_FLOAT32_IEEE FNC_VALUES 1 FLOAT32_IEEE COLUMN_DIR DIRECT /end RECORD_LAYOUT
/begin RECORD_LAYOUT Lookup1D_X_FLOAT32_IEEE AXIS_PTS_X 1 FLOAT32_IEEE INDEX_INCR DIRECT /end RECORD_LAYOUT
/begin RECORD_LAYOUT Lookup1D_FLOAT64_IEEE FNC_VALUES 1 FLOAT64_IEEE COLUMN_DIR DIRECT /end RECORD_LAYOUT
/begin RECORD_LAYOUT Lookup1D_X_FLOAT64_IEEE AXIS_PTS_X 1 FLOAT64_IEEE INDEX_INCR DIRECT /end RECORD_LAYOUT
/begin RECORD_LAYOUT Lookup2D_BOOLEAN FNC_VALUES 1 UBYTE COLUMN_DIR DIRECT /end RECORD_LAYOUT
/begin RECORD_LAYOUT Lookup2D_X_BOOLEAN AXIS_PTS_X 1 UBYTE INDEX_INCR DIRECT /end RECORD_LAYOUT
/begin RECORD_LAYOUT Lookup2D_UBYTE FNC_VALUES 1 UBYTE COLUMN_DIR DIRECT /end RECORD_LAYOUT
/begin RECORD_LAYOUT Lookup2D_X_UBYTE AXIS_PTS_X 1 UBYTE INDEX_INCR DIRECT /end RECORD_LAYOUT
/begin RECORD_LAYOUT Lookup2D_BYTE FNC_VALUES 1 SBYTE COLUMN_DIR DIRECT /end RECORD_LAYOUT
/begin RECORD_LAYOUT Lookup2D_X_BYTE AXIS_PTS_X 1 SBYTE INDEX_INCR DIRECT /end RECORD_LAYOUT
/begin RECORD_LAYOUT Lookup2D_UWORD FNC_VALUES 1 UWORD COLUMN_DIR DIRECT /end RECORD_LAYOUT
/begin RECORD_LAYOUT Lookup2D_X_UWORD AXIS_PTS_X 1 UWORD INDEX_INCR DIRECT /end RECORD_LAYOUT
/begin RECORD_LAYOUT Lookup2D_WORD FNC_VALUES 1 SWORD COLUMN_DIR DIRECT /end RECORD_LAYOUT
/begin RECORD_LAYOUT Lookup2D_X_WORD AXIS_PTS_X 1 SWORD INDEX_INCR DIRECT /end RECORD_LAYOUT
/begin RECORD_LAYOUT Lookup2D_ULONG FNC_VALUES 1 ULONG COLUMN_DIR DIRECT /end RECORD_LAYOUT
/begin RECORD_LAYOUT Lookup2D_X_ULONG AXIS_PTS_X 1 ULONG INDEX_INCR DIRECT /end RECORD_LAYOUT
/begin RECORD_LAYOUT Lookup2D_LONG FNC_VALUES 1 SLONG COLUMN_DIR DIRECT /end RECORD_LAYOUT
/begin RECORD_LAYOUT Lookup2D_X_LONG AXIS_PTS_X 1 SLONG INDEX_INCR DIRECT /end RECORD_LAYOUT
/begin RECORD_LAYOUT Lookup2D_FLOAT32_IEEE FNC_VALUES 1 FLOAT32_IEEE COLUMN_DIR DIRECT /end RECORD_LAYOUT
/begin RECORD_LAYOUT Lookup2D_X_FLOAT32_IEEE AXIS_PTS_X 1 FLOAT32_IEEE INDEX_INCR DIRECT /end RECORD_LAYOUT
/begin RECORD_LAYOUT Lookup2D_FLOAT64_IEEE FNC_VALUES 1 FLOAT64_IEEE COLUMN_DIR DIRECT /end RECORD_LAYOUT
/begin RECORD_LAYOUT Lookup2D_X_FLOAT64_IEEE AXIS_PTS_X 1 FLOAT64_IEEE INDEX_INCR DIRECT /end RECORD_LAYOUT
/begin CHARACTERISTIC EGRVlv_tiGovDvtMaxDebDef_C "Debounce time for checking heal of EGRVlv_bGovDvtMaxDeb" VALUE 0x0000 /* @ECU_Address@EGRVlv_tiGovDvtMaxDebDef_C@ */ Scalar_UWORD 0 EGRVlv_VDMon_CM_Debncd_ms_ms 0.0 6553.5 /end CHARACTERISTIC
/begin CHARACTERISTIC EGRVlv_tiGovDvtMaxDebOk_C "Debounce time for checking heal of EGRVlv_bGovDvtMaxDeb" VALUE 0x0000 /* @ECU_Address@EGRVlv_tiGovDvtMaxDebOk_C@ */ Scalar_UWORD 0 EGRVlv_VDMon_CM_Debncd_ms_ms 0.0 6553.5 /end CHARACTERISTIC
/begin CHARACTERISTIC EGRVlv_tiGovDvtMinDebDef_C "Debounce time for checking heal of EGRVlv_bGovDvtMinDeb" VALUE 0x0000 /* @ECU_Address@EGRVlv_tiGovDvtMinDebDef_C@ */ Scalar_UWORD 0 EGRVlv_VDMon_CM_Debncd_ms_ms 0.0 6553.5 /end CHARACTERISTIC
/begin CHARACTERISTIC EGRVlv_tiGovDvtMinDebOk_C "Debounce time for checking heal of EGRVlv_bGovDvtMinDeb" VALUE 0x0000 /* @ECU_Address@EGRVlv_tiGovDvtMinDebOk_C@ */ Scalar_UWORD 0 EGRVlv_VDMon_CM_Debncd_ms_ms 0.0 6553.5 /end CHARACTERISTIC
/begin CHARACTERISTIC EGRVlv_RlsIKi_C "Ki for the release integrator" VALUE 0x0000 /* @ECU_Address@EGRVlv_RlsIKi_C@ */ Scalar_SWORD 0 EGRVlv_VDMon_CM_Fac_100____mg_hub__s -128.0 127.9 /end CHARACTERISTIC
/begin CHARACTERISTIC EGRVlv_drActDvtHi_C "EGR position gradient to undetect deviation fault" VALUE 0x0000 /* @ECU_Address@EGRVlv_drActDvtHi_C@ */ Scalar_SWORD 0 EGRVlv_VDMon_CM_DutyCycle_r_s -100.0 100.0 /end CHARACTERISTIC
/begin CHARACTERISTIC EGRVlv_drActDvt_C "EGR position gradient to detect deviation fault" VALUE 0x0000 /* @ECU_Address@EGRVlv_drActDvt_C@ */ Scalar_SWORD 0 EGRVlv_VDMon_CM_DutyCycle_r_s -100.0 100.0 /end CHARACTERISTIC
/begin CHARACTERISTIC EGRVlv_rDvtMax_C "Threshold for detection of positive governor deviation" VALUE 0x0000 /* @ECU_Address@EGRVlv_rDvtMax_C@ */ Scalar_SWORD 0 EGRVlv_VDMon_CM_DutyCycle__ -100.0 100.0 /end CHARACTERISTIC
/begin CHARACTERISTIC EGRVlv_rDvtMin_C "Threshold for detection of negative governor deviation" VALUE 0x0000 /* @ECU_Address@EGRVlv_rDvtMin_C@ */ Scalar_SWORD 0 EGRVlv_VDMon_CM_DutyCycle__ -100.0 100.0 /end CHARACTERISTIC
/begin CHARACTERISTIC EGRVlv_rLMSActPosThresInit_C "positive threshold" VALUE 0x0000 /* @ECU_Address@EGRVlv_rLMSActPosThresInit_C@ */ Scalar_SWORD 0 EGRVlv_VDMon_CM_DutyCycle__ -100.0 100.0 /end CHARACTERISTIC
/begin CHARACTERISTIC EGRVlv_rLMSActThresDwn_C "Actual position threshold to detect LMS" VALUE 0x0000 /* @ECU_Address@EGRVlv_rLMSActThresDwn_C@ */ Scalar_SWORD 0 EGRVlv_VDMon_CM_DutyCycle__ -100.0 100.0 /end CHARACTERISTIC
/begin CHARACTERISTIC EGRVlv_rLMSThresDwn_C "Set point threshold to detect LMS" VALUE 0x0000 /* @ECU_Address@EGRVlv_rLMSThresDwn_C@ */ Scalar_SWORD 0 EGRVlv_VDMon_CM_DutyCycle__ -100.0 100.0 /end CHARACTERISTIC
/begin CHARACTERISTIC EGRVlv_rLMSThresUp_C "Threshold to reset LMS detection bit" VALUE 0x0000 /* @ECU_Address@EGRVlv_rLMSThresUp_C@ */ Scalar_SWORD 0 EGRVlv_VDMon_CM_DutyCycle__ -100.0 100.0 /end CHARACTERISTIC
/begin CHARACTERISTIC EGRVlv_rLckdDetThres_C "Locked detection threshold ratio" VALUE 0x0000 /* @ECU_Address@EGRVlv_rLckdDetThres_C@ */ Scalar_SWORD 0 EGRVlv_VDMon_CM_DutyCycle__ -100.0 100.0 /end CHARACTERISTIC
/begin CHARACTERISTIC EGRVlv_rRlsMax_C "Maximum output for release function" VALUE 0x0000 /* @ECU_Address@EGRVlv_rRlsMax_C@ */ Scalar_SWORD 0 EGRVlv_VDMon_CM_DutyCycle__ -100.0 100.0 /end CHARACTERISTIC
/begin CHARACTERISTIC EGRVlv_rStpThres_C "Threshold for step detection" VALUE 0x0000 /* @ECU_Address@EGRVlv_rStpThres_C@ */ Scalar_SWORD 0 EGRVlv_VDMon_CM_DutyCycle__ -100.0 100.0 /end CHARACTERISTIC
/begin CHARACTERISTIC EGRVlv_tiLMS_C "Time during which pull down is active" VALUE 0x0000 /* @ECU_Address@EGRVlv_tiLMS_C@ */ Scalar_SWORD 0 EGRVlv_VDMon_CM_Seconds1_s 0.0 3000.0 /end CHARACTERISTIC
/begin CHARACTERISTIC EGRVlv_tiRepRls_C "Time for releasing jammed valve condition" VALUE 0x0000 /* @ECU_Address@EGRVlv_tiRepRls_C@ */ Scalar_SWORD 0 EGRVlv_VDMon_CM_Seconds1_s 0.0 3000.0 /end CHARACTERISTIC
/begin CHARACTERISTIC EGRVlv_tiRls_C "Time during which release function is active" VALUE 0x0000 /* @ECU_Address@EGRVlv_tiRls_C@ */ Scalar_SWORD 0 EGRVlv_VDMon_CM_Seconds1_s 0.0 3000.0 /end CHARACTERISTIC
/begin CHARACTERISTIC EGRVlv_tEngHi_C "Upper temperature threshold for the release of the monitoring of abnormality in the EGR regulation" VALUE 0x0000 /* @ECU_Address@EGRVlv_tEngHi_C@ */ Scalar_SWORD 0 EGRVlv_VDMon_CM_Temp_C_deg -3000.0 3000.0 /end CHARACTERISTIC
/begin CHARACTERISTIC EGRVlv_tEngLo_C "Lower temperature threshold for the release of the monitoring of abnormality in the EGR regulation" VALUE 0x0000 /* @ECU_Address@EGRVlv_tEngLo_C@ */ Scalar_SWORD 0 EGRVlv_VDMon_CM_Temp_C_deg -3000.0 3000.0 /end CHARACTERISTIC
/begin CHARACTERISTIC EGRVlv_numJamVlv_C "The maxmum number of anti-stuck execution times" VALUE 0x0000 /* @ECU_Address@EGRVlv_numJamVlv_C@ */ Scalar_UBYTE 0 EGRVlv_VDMon_CM_State_NaN 0.0 100.0 /end CHARACTERISTIC
/begin CHARACTERISTIC EGRVlv_numLckdDetThres_C "Locked detection threshold" VALUE 0x0000 /* @ECU_Address@EGRVlv_numLckdDetThres_C@ */ Scalar_UBYTE 0 EGRVlv_VDMon_CM_State_NaN 0.0 255.0 /end CHARACTERISTIC
/begin CHARACTERISTIC EGRVlv_numMonEngTemp_C "Index for selecting the engine temperature" VALUE 0x0000 /* @ECU_Address@EGRVlv_numMonEngTemp_C@ */ Scalar_UBYTE 0 EGRVlv_VDMon_CM_State_NaN 0.0 255.0 /end CHARACTERISTIC
/begin MEASUREMENT EGRVlv_rGovDvt "" SWORD EGRVlv_VDMon_CM_DutyCycle 0 0 -100.0 100.0 ECU_ADDRESS 0x0000 /* @ECU_Address@EGRVlv_rGovDvt@ */ /end MEASUREMENT
/begin MEASUREMENT EngDa_tFld "" SWORD EGRVlv_VDMon_CM_Temp_C 0 0 -3000.0 3000.0 /* Array Size */ ARRAY_SIZE 3 ECU_ADDRESS 0x0000 /* @ECU_Address@EngDa_tFld@ */ /end MEASUREMENT
/begin MEASUREMENT DSM_bEGRVlvGovOn "" UBYTE EGRVlv_VDMon_CM_boolean 0 0 0.0 1.0 ECU_ADDRESS 0x0000 /* @ECU_Address@DSM_bEGRVlvGovOn@ */ /end MEASUREMENT
/begin MEASUREMENT EGRVlv_rAct "" SWORD EGRVlv_VDMon_CM_DutyCycle 0 0 -100.0 100.0 ECU_ADDRESS 0x0000 /* @ECU_Address@EGRVlv_rAct@ */ /end MEASUREMENT
/begin MEASUREMENT EGRVlv_rGovDesVal "" SWORD EGRVlv_VDMon_CM_DutyCycle 0 0 -100.0 100.0 ECU_ADDRESS 0x0000 /* @ECU_Address@EGRVlv_rGovDesVal@ */ /end MEASUREMENT
/begin MEASUREMENT CoEng_st "" SLONG EGRVlv_VDMon_CM_EngState 0 0 0 3 ECU_ADDRESS 0x0000 /* @ECU_Address@CoEng_st@ */ /end MEASUREMENT
/begin MEASUREMENT EGRVlv_stMon "State of system monitoring" UWORD EGRVlv_VDMon_CM_State2_NaN 0 0 0.0 65535.0 ECU_ADDRESS 0x0000 /* @ECU_Address@EGRVlv_stMon@ */ /end MEASUREMENT
/begin MEASUREMENT EGRVlv_tEngMon_mp "Engine monitoring temperature" SWORD EGRVlv_VDMon_CM_Temp_C_deg 0 0 -3000.0 3000.0 ECU_ADDRESS 0x0000 /* @ECU_Address@EGRVlv_tEngMon_mp@ */ /end MEASUREMENT
/begin MEASUREMENT EGRVlv_drRaw_mp "EGR rate gradient calculated over current position" SWORD EGRVlv_VDMon_CM_DutyCycle_r_s 0 0 -100.0 100.0 ECU_ADDRESS 0x0000 /* @ECU_Address@EGRVlv_drRaw_mp@ */ /end MEASUREMENT
/begin MEASUREMENT EGRVlv_drRawFlt "EGR rate gradient calculated over current position after PT1-filtering" SWORD EGRVlv_VDMon_CM_DutyCycle_r_s 0 0 -100.0 100.0 ECU_ADDRESS 0x0000 /* @ECU_Address@EGRVlv_drRawFlt@ */ /end MEASUREMENT
/begin MEASUREMENT EGRVlv_rRlsEGR "Additional control value to release a jammed valve" SWORD EGRVlv_VDMon_CM_DutyCycle__ 0 0 -100.0 100.0 ECU_ADDRESS 0x0000 /* @ECU_Address@EGRVlv_rRlsEGR@ */ /end MEASUREMENT
/begin MEASUREMENT EGRVlv_numJamVlv_mp "The number of jammed valve releasing" UBYTE EGRVlv_VDMon_CM_State_NaN 0 0 0.0 255.0 ECU_ADDRESS 0x0000 /* @ECU_Address@EGRVlv_numJamVlv_mp@ */ /end MEASUREMENT
/begin MEASUREMENT EGRVlv_numLckdDet "Number of tasks since constant governor deviation at LMS" UBYTE EGRVlv_VDMon_CM_State_NaN 0 0 0.0 255.0 ECU_ADDRESS 0x0000 /* @ECU_Address@EGRVlv_numLckdDet@ */ /end MEASUREMENT
/begin MEASUREMENT EGRVlv_stEnaMon "Enable condition" UBYTE EGRVlv_VDMon_CM_boolean_NaN 0 0 0.0 1.0 ECU_ADDRESS 0x0000 /* @ECU_Address@EGRVlv_stEnaMon@ */ /end MEASUREMENT
/begin MEASUREMENT EGRVlv_bGovDvtMinDeb_DSM "Status of EGRVlv_bGovDvtMinDeb" UBYTE EGRVlv_VDMon_CM_boolean_NaN 0 0 0.0 1.0 ECU_ADDRESS 0x0000 /* @ECU_Address@EGRVlv_bGovDvtMinDeb_DSM@ */ /end MEASUREMENT
/begin MEASUREMENT EGRVlv_stStepDet "Status of step detection" UBYTE EGRVlv_VDMon_CM_boolean_NaN 0 0 0.0 1.0 ECU_ADDRESS 0x0000 /* @ECU_Address@EGRVlv_stStepDet@ */ /end MEASUREMENT
/begin MEASUREMENT EGRVlv_bGovDvtMaxDeb_DSM "Status of EGRVlv_bGovDvtMaxDeb" UBYTE EGRVlv_VDMon_CM_boolean_NaN 0 0 0.0 1.0 ECU_ADDRESS 0x0000 /* @ECU_Address@EGRVlv_bGovDvtMaxDeb_DSM@ */ /end MEASUREMENT
/begin MEASUREMENT EGRVlv_stJamVlv "Status indicates that the valve is jammed" UBYTE EGRVlv_VDMon_CM_boolean_NaN 0 0 0.0 1.0 ECU_ADDRESS 0x0000 /* @ECU_Address@EGRVlv_stJamVlv@ */ /end MEASUREMENT
/begin MEASUREMENT EGRVlv_bJamVlvRlsCheck_mp "Set bit 10 of EGRVlv_stMon" UBYTE EGRVlv_VDMon_CM_boolean_NaN 0 0 0.0 1.0 ECU_ADDRESS 0x0000 /* @ECU_Address@EGRVlv_bJamVlvRlsCheck_mp@ */ /end MEASUREMENT
/begin MEASUREMENT EGRVlv_bJamVlvClsd_DSM "Status of EGRVlv_bJamVlvClsd" UBYTE EGRVlv_VDMon_CM_boolean_NaN 0 0 0.0 1.0 ECU_ADDRESS 0x0000 /* @ECU_Address@EGRVlv_bJamVlvClsd_DSM@ */ /end MEASUREMENT
/begin MEASUREMENT EGRVlv_bJamVlvOpn_DSM "Status of EGRVlv_bJamVlvOpn" UBYTE EGRVlv_VDMon_CM_boolean_NaN 0 0 0.0 1.0 ECU_ADDRESS 0x0000 /* @ECU_Address@EGRVlv_bJamVlvOpn_DSM@ */ /end MEASUREMENT
/begin COMPU_METHOD EGRVlv_VDMon_CM_Debncd_ms_ms "Q = V*10.000000" RAT_FUNC "%5.1" "ms" COEFFS 0 10.000000 0.000000 0 0 1.000000 /end COMPU_METHOD
/begin COMPU_METHOD EGRVlv_VDMon_CM_Fac_100____mg_hub__s "Q = V*200.000000" RAT_FUNC "%6.3" "%/(mg/hub)/s" COEFFS 0 200.000000 0.000000 0 0 1.000000 /end COMPU_METHOD
/begin COMPU_METHOD EGRVlv_VDMon_CM_DutyCycle_r_s "Q = V*200.000000" RAT_FUNC "%6.3" "r/s" COEFFS 0 200.000000 0.000000 0 0 1.000000 /end COMPU_METHOD
/begin COMPU_METHOD EGRVlv_VDMon_CM_DutyCycle__ "Q = V*200.000000" RAT_FUNC "%6.3" "%" COEFFS 0 200.000000 0.000000 0 0 1.000000 /end COMPU_METHOD
/begin COMPU_METHOD EGRVlv_VDMon_CM_Seconds1_s "Q = V" RAT_FUNC "%5.0" "s" COEFFS 0 1 0 0 0 1 /end COMPU_METHOD
/begin COMPU_METHOD EGRVlv_VDMon_CM_Temp_C_deg "Q = V*10.000000" RAT_FUNC "%5.1" "deg" COEFFS 0 10.000000 0.000000 0 0 1.000000 /end COMPU_METHOD
/begin COMPU_METHOD EGRVlv_VDMon_CM_State_NaN "Q = V" RAT_FUNC "%3.0" "NaN" COEFFS 0 1 0 0 0 1 /end COMPU_METHOD
/begin COMPU_METHOD EGRVlv_VDMon_CM_DutyCycle "Q = V*200.000000" RAT_FUNC "%6.3" "" COEFFS 0 200.000000 0.000000 0 0 1.000000 /end COMPU_METHOD
/begin COMPU_METHOD EGRVlv_VDMon_CM_Temp_C "Q = V*10.000000" RAT_FUNC "%5.1" "" COEFFS 0 10.000000 0.000000 0 0 1.000000 /end COMPU_METHOD
/begin COMPU_METHOD EGRVlv_VDMon_CM_boolean "Q = V" RAT_FUNC "%1.0" "" COEFFS 0 1 0 0 0 1 /end COMPU_METHOD
/begin COMPU_METHOD EGRVlv_VDMon_CM_EngState "Enumerated data type: EngState" TAB_VERB "%0.6" "" /* Conversion Table */ COMPU_TAB_REF VTAB_FOR_EGRVlv_VDMon_CM_EngState /end COMPU_METHOD
/begin COMPU_VTAB /* Name of Table */ VTAB_FOR_EGRVlv_VDMon_CM_EngState "Enumerated data type: EngState" TAB_VERB /* Number of Elements */ 4 0 "EngState_STOPPED" 1 "EngState_CRANKING" 2 "EngState_RUNNING" 3 "EngState_STOPPING" /end COMPU_VTAB
/begin COMPU_METHOD EGRVlv_VDMon_CM_State2_NaN "Q = V" RAT_FUNC "%5.0" "NaN" COEFFS 0 1 0 0 0 1 /end COMPU_METHOD
/begin COMPU_METHOD EGRVlv_VDMon_CM_boolean_NaN "Q = V" RAT_FUNC "%1.0" "NaN" COEFFS 0 1 0 0 0 1 /end COMPU_METHOD
/begin GROUP EGRVlv_VDMon "EGRVlv_VDMon" /* Root */ ROOT /begin SUB_GROUP Root_Overview /end SUB_GROUP
 /begin REF_MEASUREMENT CoEng_st DSM_bEGRVlvGovOn EGRVlv_rAct EGRVlv_rGovDesVal EGRVlv_rGovDvt EngDa_tFld /end REF_MEASUREMENT
/end GROUP
/begin GROUP Root_Overview "EGRVlv_VDMon/Overview" /begin SUB_GROUP S1_EGRVlv_VDMon /end SUB_GROUP /end GROUP
/begin GROUP S1_EGRVlv_VDMon "EGRVlv_VDMon/Overview/EGRVlv_VDMon"
 /begin SUB_GROUP S2_DSM_RepVheck S2_EGRdrRaw S2_Enable_GDMon S2_LMS_Detection S2_Release_Function S2_set_status_bit /end SUB_GROUP
 /begin REF_CHARACTERISTIC EGRVlv_numMonEngTemp_C EGRVlv_tEngHi_C EGRVlv_tEngLo_C /end REF_CHARACTERISTIC
 /begin REF_MEASUREMENT EGRVlv_tEngMon_mp /end REF_MEASUREMENT
/end GROUP
/begin GROUP S2_DSM_RepVheck "EGRVlv_VDMon/Overview/EGRVlv_VDMon/DSM_RepVheck"
 /begin REF_CHARACTERISTIC EGRVlv_drActDvtHi_C EGRVlv_drActDvt_C EGRVlv_rDvtMax_C EGRVlv_rDvtMin_C EGRVlv_tiGovDvtMaxDebDef_C EGRVlv_tiGovDvtMaxDebOk_C EGRVlv_tiGovDvtMinDebDef_C EGRVlv_tiGovDvtMinDebOk_C /end REF_CHARACTERISTIC
 /begin REF_MEASUREMENT EGRVlv_bGovDvtMaxDeb_DSM EGRVlv_bGovDvtMinDeb_DSM /end REF_MEASUREMENT
/end GROUP
/begin GROUP S2_EGRdrRaw "EGRVlv_VDMon/Overview/EGRVlv_VDMon/EGRdrRaw" /begin REF_MEASUREMENT EGRVlv_drRawFlt EGRVlv_drRaw_mp /end REF_MEASUREMENT /end GROUP
/begin GROUP S2_Enable_GDMon "EGRVlv_VDMon/Overview/EGRVlv_VDMon/Enable GDMon" /begin REF_MEASUREMENT EGRVlv_stEnaMon /end REF_MEASUREMENT /end GROUP
/begin GROUP S2_LMS_Detection "EGRVlv_VDMon/Overview/EGRVlv_VDMon/LMS Detection"
 /begin REF_CHARACTERISTIC EGRVlv_numLckdDetThres_C EGRVlv_rDvtMax_C EGRVlv_rDvtMin_C EGRVlv_rLMSActPosThresInit_C EGRVlv_rLMSActThresDwn_C EGRVlv_rLMSThresDwn_C EGRVlv_rLMSThresUp_C EGRVlv_rLckdDetThres_C EGRVlv_rStpThres_C EGRVlv_tiLMS_C /end REF_CHARACTERISTIC
 /begin REF_MEASUREMENT EGRVlv_numLckdDet EGRVlv_stStepDet /end REF_MEASUREMENT
/end GROUP
/begin GROUP S2_Release_Function "EGRVlv_VDMon/Overview/EGRVlv_VDMon/Release Function"
 /begin SUB_GROUP S7_Jammed_valve_detection S7_Repeated_release S7_Valve_jammed_in_the_open_state /end SUB_GROUP
/end GROUP
/begin GROUP S2_set_status_bit "EGRVlv_VDMon/Overview/EGRVlv_VDMon/set status bit" /begin REF_MEASUREMENT EGRVlv_stMon /end REF_MEASUREMENT /end GROUP
/begin GROUP S7_Jammed_valve_detection "EGRVlv_VDMon/Overview/EGRVlv_VDMon/Release Function/Jammed valve detection" /begin REF_CHARACTERISTIC EGRVlv_numJamVlv_C EGRVlv_tiRepRls_C EGRVlv_tiRls_C /end REF_CHARACTERISTIC
 /begin REF_MEASUREMENT EGRVlv_bJamVlvRlsCheck_mp EGRVlv_numJamVlv_mp EGRVlv_stJamVlv /end REF_MEASUREMENT
/end GROUP
/begin GROUP S7_Repeated_release "EGRVlv_VDMon/Overview/EGRVlv_VDMon/Release Function/Repeated release" /begin REF_CHARACTERISTIC EGRVlv_RlsIKi_C EGRVlv_rRlsMax_C /end REF_CHARACTERISTIC /begin REF_MEASUREMENT EGRVlv_rRlsEGR /end REF_MEASUREMENT /end GROUP
/begin GROUP S7_Valve_jammed_in_the_open_state "EGRVlv_VDMon/Overview/EGRVlv_VDMon/Release Function/Valve jammed in the open state" /begin REF_MEASUREMENT EGRVlv_bJamVlvClsd_DSM EGRVlv_bJamVlvOpn_DSM /end REF_MEASUREMENT /end GROUP
/end MODULE
/end PROJECT
/* (add any file trailer comments here) */
/* EOF EGRVlv_VDMon.a2l */
