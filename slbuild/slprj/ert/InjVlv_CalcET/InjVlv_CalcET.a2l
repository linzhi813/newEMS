/******************************************************************************
* ASAP2 file: InjVlv_CalcET.a2l
* Code generation for model "InjVlv_CalcET".
* Model version : 1.59
* Simulink Coder version : 9.4 (R2020b) 29-Jul-2020
* C source code generated on : Thu Feb 4 09:41:40 2021
* Target selection: ert.tlc
* Embedded hardware selection: ARM Compatible->ARM Cortex
* Code generation objectives: Unspecified
* Validation result: Not run
* (add additional file header information here)
******************************************************************************/ ASAP2_VERSION 1 31
/* Version 1.31 */
/begin PROJECT ProjectName "Project Comment Goes Here"
/begin HEADER "Header Comments go here" /end HEADER
/begin MODULE ModuleName "Module Comment Goes Here"
/begin MOD_PAR "MOD PAR Comment Goes Here" /end MOD_PAR
/begin MOD_COMMON "Mod Common Comment Here" BYTE_ORDER MSB_LAST /end MOD_COMMON
/begin RECORD_LAYOUT Scalar_BOOLEAN FNC_VALUES 1 UBYTE COLUMN_DIR DIRECT /end RECORD_LAYOUT
/begin RECORD_LAYOUT Scalar_UBYTE FNC_VALUES 1 UBYTE COLUMN_DIR DIRECT /end RECORD_LAYOUT
/begin RECORD_LAYOUT Scalar_BYTE FNC_VALUES 1 SBYTE COLUMN_DIR DIRECT /end RECORD_LAYOUT
/begin RECORD_LAYOUT Scalar_UWORD FNC_VALUES 1 UWORD COLUMN_DIR DIRECT /end RECORD_LAYOUT
/begin RECORD_LAYOUT Scalar_SWORD FNC_VALUES 1 SWORD COLUMN_DIR DIRECT /end RECORD_LAYOUT
/begin RECORD_LAYOUT Scalar_ULONG FNC_VALUES 1 ULONG COLUMN_DIR DIRECT /end RECORD_LAYOUT
/begin RECORD_LAYOUT Scalar_LONG FNC_VALUES 1 SLONG COLUMN_DIR DIRECT /end RECORD_LAYOUT
/begin RECORD_LAYOUT Scalar_FLOAT32_IEEE FNC_VALUES 1 FLOAT32_IEEE COLUMN_DIR DIRECT /end RECORD_LAYOUT
/begin RECORD_LAYOUT Scalar_FLOAT64_IEEE FNC_VALUES 1 FLOAT64_IEEE COLUMN_DIR DIRECT /end RECORD_LAYOUT
/begin RECORD_LAYOUT Lookup1D_BOOLEAN FNC_VALUES 1 UBYTE COLUMN_DIR DIRECT /end RECORD_LAYOUT
/begin RECORD_LAYOUT Lookup1D_X_BOOLEAN AXIS_PTS_X 1 UBYTE INDEX_INCR DIRECT /end RECORD_LAYOUT
/begin RECORD_LAYOUT Lookup1D_BYTE FNC_VALUES 1 SBYTE COLUMN_DIR DIRECT /end RECORD_LAYOUT
/begin RECORD_LAYOUT Lookup1D_X_BYTE AXIS_PTS_X 1 SBYTE INDEX_INCR DIRECT /end RECORD_LAYOUT
/begin RECORD_LAYOUT Lookup1D_UBYTE FNC_VALUES 1 UBYTE COLUMN_DIR DIRECT /end RECORD_LAYOUT
/begin RECORD_LAYOUT Lookup1D_X_UBYTE AXIS_PTS_X 1 UBYTE INDEX_INCR DIRECT /end RECORD_LAYOUT
/begin RECORD_LAYOUT Lookup1D_UWORD FNC_VALUES 1 UWORD COLUMN_DIR DIRECT /end RECORD_LAYOUT
/begin RECORD_LAYOUT Lookup1D_X_UWORD AXIS_PTS_X 1 UWORD INDEX_INCR DIRECT /end RECORD_LAYOUT
/begin RECORD_LAYOUT Lookup1D_WORD FNC_VALUES 1 SWORD COLUMN_DIR DIRECT /end RECORD_LAYOUT
/begin RECORD_LAYOUT Lookup1D_X_WORD AXIS_PTS_X 1 SWORD INDEX_INCR DIRECT /end RECORD_LAYOUT
/begin RECORD_LAYOUT Lookup1D_ULONG FNC_VALUES 1 ULONG COLUMN_DIR DIRECT /end RECORD_LAYOUT
/begin RECORD_LAYOUT Lookup1D_X_ULONG AXIS_PTS_X 1 ULONG INDEX_INCR DIRECT /end RECORD_LAYOUT
/begin RECORD_LAYOUT Lookup1D_SLONG FNC_VALUES 1 SLONG COLUMN_DIR DIRECT /end RECORD_LAYOUT
/begin RECORD_LAYOUT Lookup1D_X_LONG AXIS_PTS_X 1 SLONG INDEX_INCR DIRECT /end RECORD_LAYOUT
/begin RECORD_LAYOUT Lookup1D_FLOAT32_IEEE FNC_VALUES 1 FLOAT32_IEEE COLUMN_DIR DIRECT /end RECORD_LAYOUT
/begin RECORD_LAYOUT Lookup1D_X_FLOAT32_IEEE AXIS_PTS_X 1 FLOAT32_IEEE INDEX_INCR DIRECT /end RECORD_LAYOUT
/begin RECORD_LAYOUT Lookup1D_FLOAT64_IEEE FNC_VALUES 1 FLOAT64_IEEE COLUMN_DIR DIRECT /end RECORD_LAYOUT
/begin RECORD_LAYOUT Lookup1D_X_FLOAT64_IEEE AXIS_PTS_X 1 FLOAT64_IEEE INDEX_INCR DIRECT /end RECORD_LAYOUT
/begin RECORD_LAYOUT Lookup2D_BOOLEAN FNC_VALUES 1 UBYTE COLUMN_DIR DIRECT /end RECORD_LAYOUT
/begin RECORD_LAYOUT Lookup2D_X_BOOLEAN AXIS_PTS_X 1 UBYTE INDEX_INCR DIRECT /end RECORD_LAYOUT
/begin RECORD_LAYOUT Lookup2D_UBYTE FNC_VALUES 1 UBYTE COLUMN_DIR DIRECT /end RECORD_LAYOUT
/begin RECORD_LAYOUT Lookup2D_X_UBYTE AXIS_PTS_X 1 UBYTE INDEX_INCR DIRECT /end RECORD_LAYOUT
/begin RECORD_LAYOUT Lookup2D_BYTE FNC_VALUES 1 SBYTE COLUMN_DIR DIRECT /end RECORD_LAYOUT
/begin RECORD_LAYOUT Lookup2D_X_BYTE AXIS_PTS_X 1 SBYTE INDEX_INCR DIRECT /end RECORD_LAYOUT
/begin RECORD_LAYOUT Lookup2D_UWORD FNC_VALUES 1 UWORD COLUMN_DIR DIRECT /end RECORD_LAYOUT
/begin RECORD_LAYOUT Lookup2D_X_UWORD AXIS_PTS_X 1 UWORD INDEX_INCR DIRECT /end RECORD_LAYOUT
/begin RECORD_LAYOUT Lookup2D_WORD FNC_VALUES 1 SWORD COLUMN_DIR DIRECT /end RECORD_LAYOUT
/begin RECORD_LAYOUT Lookup2D_X_WORD AXIS_PTS_X 1 SWORD INDEX_INCR DIRECT /end RECORD_LAYOUT
/begin RECORD_LAYOUT Lookup2D_ULONG FNC_VALUES 1 ULONG COLUMN_DIR DIRECT /end RECORD_LAYOUT
/begin RECORD_LAYOUT Lookup2D_X_ULONG AXIS_PTS_X 1 ULONG INDEX_INCR DIRECT /end RECORD_LAYOUT
/begin RECORD_LAYOUT Lookup2D_LONG FNC_VALUES 1 SLONG COLUMN_DIR DIRECT /end RECORD_LAYOUT
/begin RECORD_LAYOUT Lookup2D_X_LONG AXIS_PTS_X 1 SLONG INDEX_INCR DIRECT /end RECORD_LAYOUT
/begin RECORD_LAYOUT Lookup2D_FLOAT32_IEEE FNC_VALUES 1 FLOAT32_IEEE COLUMN_DIR DIRECT /end RECORD_LAYOUT
/begin RECORD_LAYOUT Lookup2D_X_FLOAT32_IEEE AXIS_PTS_X 1 FLOAT32_IEEE INDEX_INCR DIRECT /end RECORD_LAYOUT
/begin RECORD_LAYOUT Lookup2D_FLOAT64_IEEE FNC_VALUES 1 FLOAT64_IEEE COLUMN_DIR DIRECT /end RECORD_LAYOUT
/begin RECORD_LAYOUT Lookup2D_X_FLOAT64_IEEE AXIS_PTS_X 1 FLOAT64_IEEE INDEX_INCR DIRECT /end RECORD_LAYOUT
/begin CHARACTERISTIC InjVlv_tiET_MAP "Map for converting from injection quantity to energizing time,Applies to all injections" /* Characteristic Type */ MAP 0x0000 /* @ECU_Address@InjVlv_tiET_MAP@ */ Lookup2D_WORD /* Maxdiff */ 0 InjVlv_CalcET_CM_uSec1_us -13107.0 13106.0
 /begin AXIS_DESCR /* Description of X-Axis Points */ /* Axis Type */ COM_AXIS /* Reference to Input */ InjCrv_qMI1Des InjVlv_CalcET_CM_InjMass_mg_hub 20 -319.0 319.0 AXIS_PTS_REF InjVlv_tiET_MAPX /end AXIS_DESCR
 /begin AXIS_DESCR /* Description of Y-Axis Points */ /* Axis Type */ COM_AXIS /* Reference to Input */ RailP_pFlt InjVlv_CalcET_CM_Press_bar1_bar 16 0.0 2000.0 AXIS_PTS_REF InjVlv_tiET_MAPY /end AXIS_DESCR
/end CHARACTERISTIC
/begin AXIS_PTS InjVlv_tiET_MAPY "Map for converting from injection quantity to energizing time,Applies to all injections" 0x0000 /* @ECU_Address@InjVlv_tiET_MAPY@ */ /* Input Quantity */ RailP_pFlt Lookup2D_X_WORD 0 InjVlv_CalcET_CM_Press_bar1_bar 16 0.0 2000.0 /end AXIS_PTS
/begin AXIS_PTS InjVlv_tiET_MAPX "Map for converting from injection quantity to energizing time,Applies to all injections" 0x0000 /* @ECU_Address@InjVlv_tiET_MAPX@ */ /* Input Quantity */ InjCrv_qMI1Des Lookup2D_X_WORD 0 InjVlv_CalcET_CM_InjMass_mg_hub 20 -319.0 319.0 /end AXIS_PTS
/begin CHARACTERISTIC SigTst_swtMI1ET_C "Switch for Set Value of energizing time for MI1" /* Type */ VALUE 0x0000 /* @ECU_Address@SigTst_swtMI1ET_C@ */ Scalar_LONG 0 InjVlv_CalcET_CM_Switch_NaN 0 1 /end CHARACTERISTIC
/begin CHARACTERISTIC SigTst_tiMI1ET_C "Set Value of energizing time for MI1" /* Type */ VALUE 0x0000 /* @ECU_Address@SigTst_tiMI1ET_C@ */ Scalar_SWORD 0 InjVlv_CalcET_CM_uSec1_us -13107.0 13106.0 /end CHARACTERISTIC
/begin MEASUREMENT RailP_pFlt "" SWORD InjVlv_CalcET_CM_Press_bar1 0 0 0.0 2500.0 ECU_ADDRESS 0x0000 /* @ECU_Address@RailP_pFlt@ */ /end MEASUREMENT
/begin MEASUREMENT InjCrv_qMI1Des "" SWORD InjVlv_CalcET_CM_InjMass 0 0 -319.0 319.0 ECU_ADDRESS 0x0000 /* @ECU_Address@InjCrv_qMI1Des@ */ /end MEASUREMENT
/begin MEASUREMENT T15_st "" SLONG InjVlv_CalcET_CM_Switch 0 0 0 1 ECU_ADDRESS 0x0000 /* @ECU_Address@T15_st@ */ /end MEASUREMENT
/begin MEASUREMENT InjVlv_tiETMI1NoCor_mp "Start of energizing for MI1 without correction" SWORD InjVlv_CalcET_CM_uSec1_us 0 0 -13107.0 13106.0 ECU_ADDRESS 0x0000 /* @ECU_Address@InjVlv_tiETMI1NoCor_mp@ */ /end MEASUREMENT
/begin MEASUREMENT InjCrv_tiMI1ET "Estimated MI1 energizing time" SWORD InjVlv_CalcET_CM_uSec1_us 0 0 -13107.0 13106.0 ECU_ADDRESS 0x0000 /* @ECU_Address@InjCrv_tiMI1ET@ */ /end MEASUREMENT
/begin COMPU_METHOD InjVlv_CalcET_CM_uSec1_us "Q = V" RAT_FUNC "%5.0" "us" COEFFS 0 1 0 0 0 1 /end COMPU_METHOD
/begin COMPU_METHOD InjVlv_CalcET_CM_InjMass_mg_hub "Q = V*100.000000" RAT_FUNC "%5.2" "mg/hub" COEFFS 0 100.000000 0.000000 0 0 1.000000 /end COMPU_METHOD
/begin COMPU_METHOD InjVlv_CalcET_CM_Press_bar1_bar "Q = V*10.000000" RAT_FUNC "%5.1" "bar" COEFFS 0 10.000000 0.000000 0 0 1.000000 /end COMPU_METHOD
/begin COMPU_METHOD InjVlv_CalcET_CM_Switch_NaN "Enumerated data type: Switch" TAB_VERB "%0.6" "NaN" /* Conversion Table */ COMPU_TAB_REF VTAB_FOR_InjVlv_CalcET_CM_Switch_NaN /end COMPU_METHOD
/begin COMPU_VTAB /* Name of Table */ VTAB_FOR_InjVlv_CalcET_CM_Switch_NaN "Enumerated data type: Switch" TAB_VERB /* Number of Elements */ 2 0 "Switch_OFF" 1 "Switch_ON" /end COMPU_VTAB
/begin COMPU_METHOD InjVlv_CalcET_CM_Press_bar1 "Q = V*10.000000" RAT_FUNC "%5.1" "" COEFFS 0 10.000000 0.000000 0 0 1.000000 /end COMPU_METHOD
/begin COMPU_METHOD InjVlv_CalcET_CM_InjMass "Q = V*100.000000" RAT_FUNC "%5.2" "" COEFFS 0 100.000000 0.000000 0 0 1.000000 /end COMPU_METHOD
/begin COMPU_METHOD InjVlv_CalcET_CM_Switch "Enumerated data type: Switch" TAB_VERB "%0.6" "" /* Conversion Table */ COMPU_TAB_REF VTAB_FOR_InjVlv_CalcET_CM_Switch /end COMPU_METHOD
/begin COMPU_VTAB /* Name of Table */ VTAB_FOR_InjVlv_CalcET_CM_Switch "Enumerated data type: Switch" TAB_VERB /* Number of Elements */ 2 0 "Switch_OFF" 1 "Switch_ON" /end COMPU_VTAB
/begin GROUP InjVlv_CalcET "InjVlv_CalcET" /* Root */ ROOT /begin SUB_GROUP Root_Overview /end SUB_GROUP /begin REF_MEASUREMENT InjCrv_qMI1Des RailP_pFlt T15_st /end REF_MEASUREMENT /end GROUP
/begin GROUP Root_Overview "InjVlv_CalcET/Overview" /begin SUB_GROUP S1_InjVlv_CalcET /end SUB_GROUP /end GROUP
/begin GROUP S1_InjVlv_CalcET "InjVlv_CalcET/Overview/InjVlv_CalcET" /begin REF_CHARACTERISTIC InjVlv_tiET_MAP SigTst_swtMI1ET_C SigTst_tiMI1ET_C /end REF_CHARACTERISTIC /begin REF_MEASUREMENT InjCrv_tiMI1ET InjVlv_tiETMI1NoCor_mp /end REF_MEASUREMENT /end GROUP
/end MODULE
/end PROJECT
/* (add any file trailer comments here) */
/* EOF InjVlv_CalcET.a2l */
