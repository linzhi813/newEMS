/******************************************************************************
* ASAP2 file: APP_SelSig.a2l
* Code generation for model "APP_SelSig".
* Model version : 1.53
* Simulink Coder version : 9.4 (R2020b) 29-Jul-2020
* C source code generated on : Thu Feb 4 09:43:10 2021
* Target selection: ert.tlc
* Embedded hardware selection: ARM Compatible->ARM Cortex
* Code generation objectives: Unspecified
* Validation result: Not run
* (add additional file header information here)
******************************************************************************/ ASAP2_VERSION 1 31
/* Version 1.31 */
/begin PROJECT ProjectName "Project Comment Goes Here"
/begin HEADER "Header Comments go here" /end HEADER
/begin MODULE ModuleName "Module Comment Goes Here"
/begin MOD_PAR "MOD PAR Comment Goes Here" /end MOD_PAR
/begin MOD_COMMON "Mod Common Comment Here" BYTE_ORDER MSB_LAST /end MOD_COMMON
/begin RECORD_LAYOUT Scalar_BOOLEAN FNC_VALUES 1 UBYTE COLUMN_DIR DIRECT /end RECORD_LAYOUT
/begin RECORD_LAYOUT Scalar_UBYTE FNC_VALUES 1 UBYTE COLUMN_DIR DIRECT /end RECORD_LAYOUT
/begin RECORD_LAYOUT Scalar_BYTE FNC_VALUES 1 SBYTE COLUMN_DIR DIRECT /end RECORD_LAYOUT
/begin RECORD_LAYOUT Scalar_UWORD FNC_VALUES 1 UWORD COLUMN_DIR DIRECT /end RECORD_LAYOUT
/begin RECORD_LAYOUT Scalar_SWORD FNC_VALUES 1 SWORD COLUMN_DIR DIRECT /end RECORD_LAYOUT
/begin RECORD_LAYOUT Scalar_ULONG FNC_VALUES 1 ULONG COLUMN_DIR DIRECT /end RECORD_LAYOUT
/begin RECORD_LAYOUT Scalar_LONG FNC_VALUES 1 SLONG COLUMN_DIR DIRECT /end RECORD_LAYOUT
/begin RECORD_LAYOUT Scalar_FLOAT32_IEEE FNC_VALUES 1 FLOAT32_IEEE COLUMN_DIR DIRECT /end RECORD_LAYOUT
/begin RECORD_LAYOUT Scalar_FLOAT64_IEEE FNC_VALUES 1 FLOAT64_IEEE COLUMN_DIR DIRECT /end RECORD_LAYOUT
/begin RECORD_LAYOUT Lookup1D_BOOLEAN FNC_VALUES 1 UBYTE COLUMN_DIR DIRECT /end RECORD_LAYOUT
/begin RECORD_LAYOUT Lookup1D_X_BOOLEAN AXIS_PTS_X 1 UBYTE INDEX_INCR DIRECT /end RECORD_LAYOUT
/begin RECORD_LAYOUT Lookup1D_BYTE FNC_VALUES 1 SBYTE COLUMN_DIR DIRECT /end RECORD_LAYOUT
/begin RECORD_LAYOUT Lookup1D_X_BYTE AXIS_PTS_X 1 SBYTE INDEX_INCR DIRECT /end RECORD_LAYOUT
/begin RECORD_LAYOUT Lookup1D_UBYTE FNC_VALUES 1 UBYTE COLUMN_DIR DIRECT /end RECORD_LAYOUT
/begin RECORD_LAYOUT Lookup1D_X_UBYTE AXIS_PTS_X 1 UBYTE INDEX_INCR DIRECT /end RECORD_LAYOUT
/begin RECORD_LAYOUT Lookup1D_UWORD FNC_VALUES 1 UWORD COLUMN_DIR DIRECT /end RECORD_LAYOUT
/begin RECORD_LAYOUT Lookup1D_X_UWORD AXIS_PTS_X 1 UWORD INDEX_INCR DIRECT /end RECORD_LAYOUT
/begin RECORD_LAYOUT Lookup1D_WORD FNC_VALUES 1 SWORD COLUMN_DIR DIRECT /end RECORD_LAYOUT
/begin RECORD_LAYOUT Lookup1D_X_WORD AXIS_PTS_X 1 SWORD INDEX_INCR DIRECT /end RECORD_LAYOUT
/begin RECORD_LAYOUT Lookup1D_ULONG FNC_VALUES 1 ULONG COLUMN_DIR DIRECT /end RECORD_LAYOUT
/begin RECORD_LAYOUT Lookup1D_X_ULONG AXIS_PTS_X 1 ULONG INDEX_INCR DIRECT /end RECORD_LAYOUT
/begin RECORD_LAYOUT Lookup1D_SLONG FNC_VALUES 1 SLONG COLUMN_DIR DIRECT /end RECORD_LAYOUT
/begin RECORD_LAYOUT Lookup1D_X_LONG AXIS_PTS_X 1 SLONG INDEX_INCR DIRECT /end RECORD_LAYOUT
/begin RECORD_LAYOUT Lookup1D_FLOAT32_IEEE FNC_VALUES 1 FLOAT32_IEEE COLUMN_DIR DIRECT /end RECORD_LAYOUT
/begin RECORD_LAYOUT Lookup1D_X_FLOAT32_IEEE AXIS_PTS_X 1 FLOAT32_IEEE INDEX_INCR DIRECT /end RECORD_LAYOUT
/begin RECORD_LAYOUT Lookup1D_FLOAT64_IEEE FNC_VALUES 1 FLOAT64_IEEE COLUMN_DIR DIRECT /end RECORD_LAYOUT
/begin RECORD_LAYOUT Lookup1D_X_FLOAT64_IEEE AXIS_PTS_X 1 FLOAT64_IEEE INDEX_INCR DIRECT /end RECORD_LAYOUT
/begin RECORD_LAYOUT Lookup2D_BOOLEAN FNC_VALUES 1 UBYTE COLUMN_DIR DIRECT /end RECORD_LAYOUT
/begin RECORD_LAYOUT Lookup2D_X_BOOLEAN AXIS_PTS_X 1 UBYTE INDEX_INCR DIRECT /end RECORD_LAYOUT
/begin RECORD_LAYOUT Lookup2D_UBYTE FNC_VALUES 1 UBYTE COLUMN_DIR DIRECT /end RECORD_LAYOUT
/begin RECORD_LAYOUT Lookup2D_X_UBYTE AXIS_PTS_X 1 UBYTE INDEX_INCR DIRECT /end RECORD_LAYOUT
/begin RECORD_LAYOUT Lookup2D_BYTE FNC_VALUES 1 SBYTE COLUMN_DIR DIRECT /end RECORD_LAYOUT
/begin RECORD_LAYOUT Lookup2D_X_BYTE AXIS_PTS_X 1 SBYTE INDEX_INCR DIRECT /end RECORD_LAYOUT
/begin RECORD_LAYOUT Lookup2D_UWORD FNC_VALUES 1 UWORD COLUMN_DIR DIRECT /end RECORD_LAYOUT
/begin RECORD_LAYOUT Lookup2D_X_UWORD AXIS_PTS_X 1 UWORD INDEX_INCR DIRECT /end RECORD_LAYOUT
/begin RECORD_LAYOUT Lookup2D_WORD FNC_VALUES 1 SWORD COLUMN_DIR DIRECT /end RECORD_LAYOUT
/begin RECORD_LAYOUT Lookup2D_X_WORD AXIS_PTS_X 1 SWORD INDEX_INCR DIRECT /end RECORD_LAYOUT
/begin RECORD_LAYOUT Lookup2D_ULONG FNC_VALUES 1 ULONG COLUMN_DIR DIRECT /end RECORD_LAYOUT
/begin RECORD_LAYOUT Lookup2D_X_ULONG AXIS_PTS_X 1 ULONG INDEX_INCR DIRECT /end RECORD_LAYOUT
/begin RECORD_LAYOUT Lookup2D_LONG FNC_VALUES 1 SLONG COLUMN_DIR DIRECT /end RECORD_LAYOUT
/begin RECORD_LAYOUT Lookup2D_X_LONG AXIS_PTS_X 1 SLONG INDEX_INCR DIRECT /end RECORD_LAYOUT
/begin RECORD_LAYOUT Lookup2D_FLOAT32_IEEE FNC_VALUES 1 FLOAT32_IEEE COLUMN_DIR DIRECT /end RECORD_LAYOUT
/begin RECORD_LAYOUT Lookup2D_X_FLOAT32_IEEE AXIS_PTS_X 1 FLOAT32_IEEE INDEX_INCR DIRECT /end RECORD_LAYOUT
/begin RECORD_LAYOUT Lookup2D_FLOAT64_IEEE FNC_VALUES 1 FLOAT64_IEEE COLUMN_DIR DIRECT /end RECORD_LAYOUT
/begin RECORD_LAYOUT Lookup2D_X_FLOAT64_IEEE AXIS_PTS_X 1 FLOAT64_IEEE INDEX_INCR DIRECT /end RECORD_LAYOUT
/begin CHARACTERISTIC MoFAPP_dRawSigFac_C "Factor between the voltage of APP1 and APP2" VALUE 0x0000 /* @ECU_Address@MoFAPP_dRawSigFac_C@ */ Scalar_UWORD 0 APP_SelSig_CM_Fac10_NaN 0.0 8.0 /end CHARACTERISTIC
/begin CHARACTERISTIC APP_duLimErrPos_C "error ramp within the selction of mastersignal /positive ramp slope" VALUE 0x0000 /* @ECU_Address@APP_duLimErrPos_C@ */ Scalar_SWORD 0 APP_SelSig_CM_Volt_mV_s_mv_s 0.0 5000.0 /end CHARACTERISTIC
/begin CHARACTERISTIC APP_uAPPDef_C "Substitute value if both sensors are defect" VALUE 0x0000 /* @ECU_Address@APP_uAPPDef_C@ */ Scalar_SWORD 0 APP_SelSig_CM_Volt_mV_mv 0.0 5000.0 /end CHARACTERISTIC
/begin CHARACTERISTIC APP_uRaw2Offset_C "Offset for sensor signal 2" VALUE 0x0000 /* @ECU_Address@APP_uRaw2Offset_C@ */ Scalar_SWORD 0 APP_SelSig_CM_Volt_mV_mv 0.0 5000.0 /end CHARACTERISTIC
/begin MEASUREMENT APP_bAPP1FinalDef "" UBYTE APP_SelSig_CM_boolean 0 0 0.0 1.0 ECU_ADDRESS 0x0000 /* @ECU_Address@APP_bAPP1FinalDef@ */ /end MEASUREMENT
/begin MEASUREMENT APP_bAPP2FinalDef "" UBYTE APP_SelSig_CM_boolean 0 0 0.0 1.0 ECU_ADDRESS 0x0000 /* @ECU_Address@APP_bAPP2FinalDef@ */ /end MEASUREMENT
/begin MEASUREMENT APP_bSyncDeb "" UBYTE APP_SelSig_CM_boolean 0 0 0.0 1.0 ECU_ADDRESS 0x0000 /* @ECU_Address@APP_bSyncDeb@ */ /end MEASUREMENT
/begin MEASUREMENT APP_bAPP1ProvDef "" UBYTE APP_SelSig_CM_boolean 0 0 0.0 1.0 ECU_ADDRESS 0x0000 /* @ECU_Address@APP_bAPP1ProvDef@ */ /end MEASUREMENT
/begin MEASUREMENT APP_bAPP2ProvDef "" UBYTE APP_SelSig_CM_boolean 0 0 0.0 1.0 ECU_ADDRESS 0x0000 /* @ECU_Address@APP_bAPP2ProvDef@ */ /end MEASUREMENT
/begin MEASUREMENT APP_bSync "" UBYTE APP_SelSig_CM_boolean 0 0 0.0 1.0 ECU_ADDRESS 0x0000 /* @ECU_Address@APP_bSync@ */ /end MEASUREMENT
/begin MEASUREMENT APP_uRaw2 "" SWORD APP_SelSig_CM_Volt_mV 0 0 0.0 5000.0 ECU_ADDRESS 0x0000 /* @ECU_Address@APP_uRaw2@ */ /end MEASUREMENT
/begin MEASUREMENT APP_uRaw1 "" SWORD APP_SelSig_CM_Volt_mV 0 0 0.0 5000.0 ECU_ADDRESS 0x0000 /* @ECU_Address@APP_uRaw1@ */ /end MEASUREMENT
/begin MEASUREMENT APP_uRaw_mp "Acceleration pedal position raw value" SWORD APP_SelSig_CM_Volt_mV_mv 0 0 0.0 5000.0 ECU_ADDRESS 0x0000 /* @ECU_Address@APP_uRaw_mp@ */ /end MEASUREMENT
/begin MEASUREMENT APP_stSigSrc_APP1_BP "Sensor 1 is the reference variable, Sensor 2 value is defective" UBYTE APP_SelSig_CM_boolean_NaN 0 0 0.0 1.0 ECU_ADDRESS 0x0000 /* @ECU_Address@APP_stSigSrc_APP1_BP@ */ /end MEASUREMENT
/begin MEASUREMENT APP_stSigSrc_APP2_BP "Sensor 2 is the reference variable,Sensor1 value is defective" UBYTE APP_SelSig_CM_boolean_NaN 0 0 0.0 1.0 ECU_ADDRESS 0x0000 /* @ECU_Address@APP_stSigSrc_APP2_BP@ */ /end MEASUREMENT
/begin MEASUREMENT APP_stSigSrc_APPDEF_BP "both the sensors are defective. Use the default value" UBYTE APP_SelSig_CM_boolean_NaN 0 0 0.0 1.0 ECU_ADDRESS 0x0000 /* @ECU_Address@APP_stSigSrc_APPDEF_BP@ */ /end MEASUREMENT
/begin MEASUREMENT APP_stTempErr_mp "Status for temporary errors" UBYTE APP_SelSig_CM_boolean_NaN 0 0 0.0 1.0 ECU_ADDRESS 0x0000 /* @ECU_Address@APP_stTempErr_mp@ */ /end MEASUREMENT
/begin MEASUREMENT APP_stSigSrc_APPLIMP_BP "Substitute operation active, accelerator pedal sensor value and accelerator pedal sensor increase are limited" UBYTE APP_SelSig_CM_boolean_NaN 0 0 0.0 1.0 ECU_ADDRESS 0x0000 /* @ECU_Address@APP_stSigSrc_APPLIMP_BP@ */ /end MEASUREMENT
/begin COMPU_METHOD APP_SelSig_CM_Fac10_NaN "Q = V*1000.000000" RAT_FUNC "%5.3" "NaN" COEFFS 0 1000.000000 0.000000 0 0 1.000000 /end COMPU_METHOD
/begin COMPU_METHOD APP_SelSig_CM_Volt_mV_s_mv_s "Q = V" RAT_FUNC "%5.0" "mv/s" COEFFS 0 1 0 0 0 1 /end COMPU_METHOD
/begin COMPU_METHOD APP_SelSig_CM_Volt_mV_mv "Q = V" RAT_FUNC "%5.0" "mv" COEFFS 0 1 0 0 0 1 /end COMPU_METHOD
/begin COMPU_METHOD APP_SelSig_CM_boolean "Q = V" RAT_FUNC "%1.0" "" COEFFS 0 1 0 0 0 1 /end COMPU_METHOD
/begin COMPU_METHOD APP_SelSig_CM_Volt_mV "Q = V" RAT_FUNC "%5.0" "" COEFFS 0 1 0 0 0 1 /end COMPU_METHOD
/begin COMPU_METHOD APP_SelSig_CM_boolean_NaN "Q = V" RAT_FUNC "%1.0" "NaN" COEFFS 0 1 0 0 0 1 /end COMPU_METHOD
/begin GROUP APP_SelSig "APP_SelSig" /* Root */ ROOT /begin SUB_GROUP Root_Overview /end SUB_GROUP
 /begin REF_MEASUREMENT APP_bAPP1FinalDef APP_bAPP1ProvDef APP_bAPP2FinalDef APP_bAPP2ProvDef APP_bSync APP_bSyncDeb APP_uRaw1 APP_uRaw2 /end REF_MEASUREMENT
/end GROUP
/begin GROUP Root_Overview "APP_SelSig/Overview" /begin SUB_GROUP S1_APP_SelSig /end SUB_GROUP /end GROUP
/begin GROUP S1_APP_SelSig "APP_SelSig/Overview/APP_SelSig" /begin SUB_GROUP S2_Estimate_Reference_Mode S2_Signal_Selection /end SUB_GROUP /end GROUP
/begin GROUP S2_Estimate_Reference_Mode "APP_SelSig/Overview/APP_SelSig/Estimate_Reference_Mode"
 /begin REF_MEASUREMENT APP_stSigSrc_APP1_BP APP_stSigSrc_APP2_BP APP_stSigSrc_APPDEF_BP APP_stSigSrc_APPLIMP_BP /end REF_MEASUREMENT
/end GROUP
/begin GROUP S2_Signal_Selection "APP_SelSig/Overview/APP_SelSig/Signal_Selection"
 /begin REF_CHARACTERISTIC APP_duLimErrPos_C APP_uAPPDef_C APP_uRaw2Offset_C MoFAPP_dRawSigFac_C /end REF_CHARACTERISTIC
 /begin REF_MEASUREMENT APP_stTempErr_mp APP_uRaw_mp /end REF_MEASUREMENT
/end GROUP
/end MODULE
/end PROJECT
/* (add any file trailer comments here) */
/* EOF APP_SelSig.a2l */
