/******************************************************************************
* ASAP2 file: CEngDsT_VD.a2l
* Code generation for model "CEngDsT_VD".
* Model version : 1.111
* Simulink Coder version : 9.4 (R2020b) 29-Jul-2020
* C source code generated on : Thu Feb 4 09:38:50 2021
* Target selection: ert.tlc
* Embedded hardware selection: ARM Compatible->ARM Cortex
* Code generation objectives: Unspecified
* Validation result: Not run
* (add additional file header information here)
******************************************************************************/ ASAP2_VERSION 1 31
/* Version 1.31 */
/begin PROJECT ProjectName "Project Comment Goes Here"
/begin HEADER "Header Comments go here" /end HEADER
/begin MODULE ModuleName "Module Comment Goes Here"
/begin MOD_PAR "MOD PAR Comment Goes Here" /end MOD_PAR
/begin MOD_COMMON "Mod Common Comment Here" BYTE_ORDER MSB_LAST /end MOD_COMMON
/begin RECORD_LAYOUT Scalar_BOOLEAN FNC_VALUES 1 UBYTE COLUMN_DIR DIRECT /end RECORD_LAYOUT
/begin RECORD_LAYOUT Scalar_UBYTE FNC_VALUES 1 UBYTE COLUMN_DIR DIRECT /end RECORD_LAYOUT
/begin RECORD_LAYOUT Scalar_BYTE FNC_VALUES 1 SBYTE COLUMN_DIR DIRECT /end RECORD_LAYOUT
/begin RECORD_LAYOUT Scalar_UWORD FNC_VALUES 1 UWORD COLUMN_DIR DIRECT /end RECORD_LAYOUT
/begin RECORD_LAYOUT Scalar_SWORD FNC_VALUES 1 SWORD COLUMN_DIR DIRECT /end RECORD_LAYOUT
/begin RECORD_LAYOUT Scalar_ULONG FNC_VALUES 1 ULONG COLUMN_DIR DIRECT /end RECORD_LAYOUT
/begin RECORD_LAYOUT Scalar_LONG FNC_VALUES 1 SLONG COLUMN_DIR DIRECT /end RECORD_LAYOUT
/begin RECORD_LAYOUT Scalar_FLOAT32_IEEE FNC_VALUES 1 FLOAT32_IEEE COLUMN_DIR DIRECT /end RECORD_LAYOUT
/begin RECORD_LAYOUT Scalar_FLOAT64_IEEE FNC_VALUES 1 FLOAT64_IEEE COLUMN_DIR DIRECT /end RECORD_LAYOUT
/begin RECORD_LAYOUT Lookup1D_BOOLEAN FNC_VALUES 1 UBYTE COLUMN_DIR DIRECT /end RECORD_LAYOUT
/begin RECORD_LAYOUT Lookup1D_X_BOOLEAN AXIS_PTS_X 1 UBYTE INDEX_INCR DIRECT /end RECORD_LAYOUT
/begin RECORD_LAYOUT Lookup1D_BYTE FNC_VALUES 1 SBYTE COLUMN_DIR DIRECT /end RECORD_LAYOUT
/begin RECORD_LAYOUT Lookup1D_X_BYTE AXIS_PTS_X 1 SBYTE INDEX_INCR DIRECT /end RECORD_LAYOUT
/begin RECORD_LAYOUT Lookup1D_UBYTE FNC_VALUES 1 UBYTE COLUMN_DIR DIRECT /end RECORD_LAYOUT
/begin RECORD_LAYOUT Lookup1D_X_UBYTE AXIS_PTS_X 1 UBYTE INDEX_INCR DIRECT /end RECORD_LAYOUT
/begin RECORD_LAYOUT Lookup1D_UWORD FNC_VALUES 1 UWORD COLUMN_DIR DIRECT /end RECORD_LAYOUT
/begin RECORD_LAYOUT Lookup1D_X_UWORD AXIS_PTS_X 1 UWORD INDEX_INCR DIRECT /end RECORD_LAYOUT
/begin RECORD_LAYOUT Lookup1D_WORD FNC_VALUES 1 SWORD COLUMN_DIR DIRECT /end RECORD_LAYOUT
/begin RECORD_LAYOUT Lookup1D_X_WORD AXIS_PTS_X 1 SWORD INDEX_INCR DIRECT /end RECORD_LAYOUT
/begin RECORD_LAYOUT Lookup1D_ULONG FNC_VALUES 1 ULONG COLUMN_DIR DIRECT /end RECORD_LAYOUT
/begin RECORD_LAYOUT Lookup1D_X_ULONG AXIS_PTS_X 1 ULONG INDEX_INCR DIRECT /end RECORD_LAYOUT
/begin RECORD_LAYOUT Lookup1D_SLONG FNC_VALUES 1 SLONG COLUMN_DIR DIRECT /end RECORD_LAYOUT
/begin RECORD_LAYOUT Lookup1D_X_LONG AXIS_PTS_X 1 SLONG INDEX_INCR DIRECT /end RECORD_LAYOUT
/begin RECORD_LAYOUT Lookup1D_FLOAT32_IEEE FNC_VALUES 1 FLOAT32_IEEE COLUMN_DIR DIRECT /end RECORD_LAYOUT
/begin RECORD_LAYOUT Lookup1D_X_FLOAT32_IEEE AXIS_PTS_X 1 FLOAT32_IEEE INDEX_INCR DIRECT /end RECORD_LAYOUT
/begin RECORD_LAYOUT Lookup1D_FLOAT64_IEEE FNC_VALUES 1 FLOAT64_IEEE COLUMN_DIR DIRECT /end RECORD_LAYOUT
/begin RECORD_LAYOUT Lookup1D_X_FLOAT64_IEEE AXIS_PTS_X 1 FLOAT64_IEEE INDEX_INCR DIRECT /end RECORD_LAYOUT
/begin RECORD_LAYOUT Lookup2D_BOOLEAN FNC_VALUES 1 UBYTE COLUMN_DIR DIRECT /end RECORD_LAYOUT
/begin RECORD_LAYOUT Lookup2D_X_BOOLEAN AXIS_PTS_X 1 UBYTE INDEX_INCR DIRECT /end RECORD_LAYOUT
/begin RECORD_LAYOUT Lookup2D_UBYTE FNC_VALUES 1 UBYTE COLUMN_DIR DIRECT /end RECORD_LAYOUT
/begin RECORD_LAYOUT Lookup2D_X_UBYTE AXIS_PTS_X 1 UBYTE INDEX_INCR DIRECT /end RECORD_LAYOUT
/begin RECORD_LAYOUT Lookup2D_BYTE FNC_VALUES 1 SBYTE COLUMN_DIR DIRECT /end RECORD_LAYOUT
/begin RECORD_LAYOUT Lookup2D_X_BYTE AXIS_PTS_X 1 SBYTE INDEX_INCR DIRECT /end RECORD_LAYOUT
/begin RECORD_LAYOUT Lookup2D_UWORD FNC_VALUES 1 UWORD COLUMN_DIR DIRECT /end RECORD_LAYOUT
/begin RECORD_LAYOUT Lookup2D_X_UWORD AXIS_PTS_X 1 UWORD INDEX_INCR DIRECT /end RECORD_LAYOUT
/begin RECORD_LAYOUT Lookup2D_WORD FNC_VALUES 1 SWORD COLUMN_DIR DIRECT /end RECORD_LAYOUT
/begin RECORD_LAYOUT Lookup2D_X_WORD AXIS_PTS_X 1 SWORD INDEX_INCR DIRECT /end RECORD_LAYOUT
/begin RECORD_LAYOUT Lookup2D_ULONG FNC_VALUES 1 ULONG COLUMN_DIR DIRECT /end RECORD_LAYOUT
/begin RECORD_LAYOUT Lookup2D_X_ULONG AXIS_PTS_X 1 ULONG INDEX_INCR DIRECT /end RECORD_LAYOUT
/begin RECORD_LAYOUT Lookup2D_LONG FNC_VALUES 1 SLONG COLUMN_DIR DIRECT /end RECORD_LAYOUT
/begin RECORD_LAYOUT Lookup2D_X_LONG AXIS_PTS_X 1 SLONG INDEX_INCR DIRECT /end RECORD_LAYOUT
/begin RECORD_LAYOUT Lookup2D_FLOAT32_IEEE FNC_VALUES 1 FLOAT32_IEEE COLUMN_DIR DIRECT /end RECORD_LAYOUT
/begin RECORD_LAYOUT Lookup2D_X_FLOAT32_IEEE AXIS_PTS_X 1 FLOAT32_IEEE INDEX_INCR DIRECT /end RECORD_LAYOUT
/begin RECORD_LAYOUT Lookup2D_FLOAT64_IEEE FNC_VALUES 1 FLOAT64_IEEE COLUMN_DIR DIRECT /end RECORD_LAYOUT
/begin RECORD_LAYOUT Lookup2D_X_FLOAT64_IEEE AXIS_PTS_X 1 FLOAT64_IEEE INDEX_INCR DIRECT /end RECORD_LAYOUT
/begin CHARACTERISTIC SigTst_swtCEngDsT_C "Switch for coolent temperature by hand" VALUE 0x0000 /* @ECU_Address@SigTst_swtCEngDsT_C@ */ Scalar_LONG 0 CEngDsT_VD_CM_Switch_NaN 0 1 /end CHARACTERISTIC
/begin CHARACTERISTIC CEngDsT_facSerPT1_C "Time constant of PT1 filter for coolent Down streem temperature" VALUE 0x0000 /* @ECU_Address@CEngDsT_facSerPT1_C@ */ Scalar_UWORD 0 CEngDsT_VD_CM_Fac100_NaN 0.0 99.9985 /end CHARACTERISTIC
/begin CHARACTERISTIC CEngDsT_tDflCold_C "Default downstream engine coolant temperature value for cold engine conditions" VALUE 0x0000 /* @ECU_Address@CEngDsT_tDflCold_C@ */ Scalar_SWORD 0 CEngDsT_VD_CM_Temp_C_deg -200.0 200.0 /end CHARACTERISTIC
/begin CHARACTERISTIC CEngDsT_tDflWarm_C "Default downstream engine coolant temperature value for warm engine conditions" VALUE 0x0000 /* @ECU_Address@CEngDsT_tDflWarm_C@ */ Scalar_SWORD 0 CEngDsT_VD_CM_Temp_C_deg -200.0 200.0 /end CHARACTERISTIC
/begin CHARACTERISTIC SigTst_tCEngDsT_C "Set coolent temperature by hand" VALUE 0x0000 /* @ECU_Address@SigTst_tCEngDsT_C@ */ Scalar_SWORD 0 CEngDsT_VD_CM_Temp_C_deg -200.0 200.0 /end CHARACTERISTIC
/begin CHARACTERISTIC CEngDsT_RmpSlpNeg_C "Parameter for Ramp 1 / negative ramp slope" VALUE 0x0000 /* @ECU_Address@CEngDsT_RmpSlpNeg_C@ */ Scalar_UWORD 0 CEngDsT_VD_CM_uint16_ms 0.0 200.0 /end CHARACTERISTIC
/begin CHARACTERISTIC CEngDsT_RmpSlpPos_C "Parameter for Ramp 1 / Slope if the ramp has to be increased" VALUE 0x0000 /* @ECU_Address@CEngDsT_RmpSlpPos_C@ */ Scalar_UWORD 0 CEngDsT_VD_CM_uint16_ms 0.0 200.0 /end CHARACTERISTIC
/begin MEASUREMENT CEngDsT_tSens "" SWORD CEngDsT_VD_CM_Temp_C 0 0 -200.0 200.0 ECU_ADDRESS 0x0000 /* @ECU_Address@CEngDsT_tSens@ */ /end MEASUREMENT
/begin MEASUREMENT CEngDsT_bFinalDef "" UBYTE CEngDsT_VD_CM_boolean 0 0 0.0 1.0 ECU_ADDRESS 0x0000 /* @ECU_Address@CEngDsT_bFinalDef@ */ /end MEASUREMENT
/begin MEASUREMENT CEngDsT_bPhysRngFinalDef "" UBYTE CEngDsT_VD_CM_boolean 0 0 0.0 1.0 ECU_ADDRESS 0x0000 /* @ECU_Address@CEngDsT_bPhysRngFinalDef@ */ /end MEASUREMENT
/begin MEASUREMENT CEngDsT_bProvDef "" UBYTE CEngDsT_VD_CM_boolean 0 0 0.0 1.0 ECU_ADDRESS 0x0000 /* @ECU_Address@CEngDsT_bProvDef@ */ /end MEASUREMENT
/begin MEASUREMENT CEngDsT_bPhysRngProvDef "" UBYTE CEngDsT_VD_CM_boolean 0 0 0.0 1.0 ECU_ADDRESS 0x0000 /* @ECU_Address@CEngDsT_bPhysRngProvDef@ */ /end MEASUREMENT
/begin MEASUREMENT CoEng_st "" SLONG CEngDsT_VD_CM_EngState 0 0 0 3 ECU_ADDRESS 0x0000 /* @ECU_Address@CoEng_st@ */ /end MEASUREMENT
/begin MEASUREMENT CEngDsT_tSensFlt "engine coolant sensor temperature without speed up" SWORD CEngDsT_VD_CM_Temp_C_deg 0 0 -200.0 200.0 ECU_ADDRESS 0x0000 /* @ECU_Address@CEngDsT_tSensFlt@ */ /end MEASUREMENT
/begin MEASUREMENT CEngDsT_t "engine coolant temperature after filter" SWORD CEngDsT_VD_CM_Temp_C_deg 0 0 -200.0 200.0 ECU_ADDRESS 0x0000 /* @ECU_Address@CEngDsT_t@ */ /end MEASUREMENT
/begin MEASUREMENT CEngDsT_dt " temperature change rate" SWORD CEngDsT_VD_CM_Temp_C_deg_s 0 0 -200.0 200.0 ECU_ADDRESS 0x0000 /* @ECU_Address@CEngDsT_dt@ */ /end MEASUREMENT
/begin COMPU_METHOD CEngDsT_VD_CM_Switch_NaN "Enumerated data type: Switch" TAB_VERB "%0.6" "NaN" /* Conversion Table */ COMPU_TAB_REF VTAB_FOR_CEngDsT_VD_CM_Switch_NaN /end COMPU_METHOD
/begin COMPU_VTAB /* Name of Table */ VTAB_FOR_CEngDsT_VD_CM_Switch_NaN "Enumerated data type: Switch" TAB_VERB /* Number of Elements */ 2 0 "Switch_OFF" 1 "Switch_ON" /end COMPU_VTAB
/begin COMPU_METHOD CEngDsT_VD_CM_Fac100_NaN "Q = V*500.000000" RAT_FUNC "%6.3" "NaN" COEFFS 0 500.000000 0.000000 0 0 1.000000 /end COMPU_METHOD
/begin COMPU_METHOD CEngDsT_VD_CM_Temp_C_deg "Q = V*10.000000" RAT_FUNC "%5.1" "deg" COEFFS 0 10.000000 0.000000 0 0 1.000000 /end COMPU_METHOD
/begin COMPU_METHOD CEngDsT_VD_CM_uint16_ms "Q = V" RAT_FUNC "%5.0" "ms" COEFFS 0 1 0 0 0 1 /end COMPU_METHOD
/begin COMPU_METHOD CEngDsT_VD_CM_Temp_C "Q = V*10.000000" RAT_FUNC "%5.1" "" COEFFS 0 10.000000 0.000000 0 0 1.000000 /end COMPU_METHOD
/begin COMPU_METHOD CEngDsT_VD_CM_boolean "Q = V" RAT_FUNC "%1.0" "" COEFFS 0 1 0 0 0 1 /end COMPU_METHOD
/begin COMPU_METHOD CEngDsT_VD_CM_EngState "Enumerated data type: EngState" TAB_VERB "%0.6" "" /* Conversion Table */ COMPU_TAB_REF VTAB_FOR_CEngDsT_VD_CM_EngState /end COMPU_METHOD
/begin COMPU_VTAB /* Name of Table */ VTAB_FOR_CEngDsT_VD_CM_EngState "Enumerated data type: EngState" TAB_VERB /* Number of Elements */ 4 0 "EngState_STOPPED" 1 "EngState_CRANKING" 2 "EngState_RUNNING" 3 "EngState_STOPPING" /end COMPU_VTAB
/begin COMPU_METHOD CEngDsT_VD_CM_Temp_C_deg_s "Q = V*10.000000" RAT_FUNC "%5.1" "deg/s" COEFFS 0 10.000000 0.000000 0 0 1.000000 /end COMPU_METHOD
/begin GROUP CEngDsT_VD "CEngDsT_VD" /* Root */ ROOT /begin SUB_GROUP Root_Overview /end SUB_GROUP
 /begin REF_MEASUREMENT CEngDsT_bFinalDef CEngDsT_bPhysRngFinalDef CEngDsT_bPhysRngProvDef CEngDsT_bProvDef CEngDsT_tSens CoEng_st /end REF_MEASUREMENT
/end GROUP
/begin GROUP Root_Overview "CEngDsT_VD/Overview" /begin SUB_GROUP S1_CEngDsT_VD /end SUB_GROUP /end GROUP
/begin GROUP S1_CEngDsT_VD "CEngDsT_VD/Overview/CEngDsT_VD" /begin SUB_GROUP S2_LowPassK_Init /end SUB_GROUP
 /begin REF_CHARACTERISTIC CEngDsT_RmpSlpNeg_C CEngDsT_RmpSlpPos_C CEngDsT_facSerPT1_C CEngDsT_tDflCold_C CEngDsT_tDflWarm_C SigTst_swtCEngDsT_C SigTst_tCEngDsT_C /end REF_CHARACTERISTIC
 /begin REF_MEASUREMENT CEngDsT_dt CEngDsT_t /end REF_MEASUREMENT
/end GROUP
/begin GROUP S2_LowPassK_Init "CEngDsT_VD/Overview/CEngDsT_VD/LowPassK_Init" /begin REF_MEASUREMENT CEngDsT_tSensFlt /end REF_MEASUREMENT /end GROUP
/end MODULE
/end PROJECT
/* (add any file trailer comments here) */
/* EOF CEngDsT_VD.a2l */
