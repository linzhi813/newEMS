/******************************************************************************
* ASAP2 file: APP_ChkSig.a2l
* Code generation for model "APP_ChkSig".
* Model version : 1.53
* Simulink Coder version : 9.4 (R2020b) 29-Jul-2020
* C source code generated on : Thu Feb 4 09:42:33 2021
* Target selection: ert.tlc
* Embedded hardware selection: ARM Compatible->ARM Cortex
* Code generation objectives: Unspecified
* Validation result: Not run
* (add additional file header information here)
******************************************************************************/ ASAP2_VERSION 1 31
/* Version 1.31 */
/begin PROJECT ProjectName "Project Comment Goes Here"
/begin HEADER "Header Comments go here" /end HEADER
/begin MODULE ModuleName "Module Comment Goes Here"
/begin MOD_PAR "MOD PAR Comment Goes Here" /end MOD_PAR
/begin MOD_COMMON "Mod Common Comment Here" BYTE_ORDER MSB_LAST /end MOD_COMMON
/begin RECORD_LAYOUT Scalar_BOOLEAN FNC_VALUES 1 UBYTE COLUMN_DIR DIRECT /end RECORD_LAYOUT
/begin RECORD_LAYOUT Scalar_UBYTE FNC_VALUES 1 UBYTE COLUMN_DIR DIRECT /end RECORD_LAYOUT
/begin RECORD_LAYOUT Scalar_BYTE FNC_VALUES 1 SBYTE COLUMN_DIR DIRECT /end RECORD_LAYOUT
/begin RECORD_LAYOUT Scalar_UWORD FNC_VALUES 1 UWORD COLUMN_DIR DIRECT /end RECORD_LAYOUT
/begin RECORD_LAYOUT Scalar_SWORD FNC_VALUES 1 SWORD COLUMN_DIR DIRECT /end RECORD_LAYOUT
/begin RECORD_LAYOUT Scalar_ULONG FNC_VALUES 1 ULONG COLUMN_DIR DIRECT /end RECORD_LAYOUT
/begin RECORD_LAYOUT Scalar_LONG FNC_VALUES 1 SLONG COLUMN_DIR DIRECT /end RECORD_LAYOUT
/begin RECORD_LAYOUT Scalar_FLOAT32_IEEE FNC_VALUES 1 FLOAT32_IEEE COLUMN_DIR DIRECT /end RECORD_LAYOUT
/begin RECORD_LAYOUT Scalar_FLOAT64_IEEE FNC_VALUES 1 FLOAT64_IEEE COLUMN_DIR DIRECT /end RECORD_LAYOUT
/begin RECORD_LAYOUT Lookup1D_BOOLEAN FNC_VALUES 1 UBYTE COLUMN_DIR DIRECT /end RECORD_LAYOUT
/begin RECORD_LAYOUT Lookup1D_X_BOOLEAN AXIS_PTS_X 1 UBYTE INDEX_INCR DIRECT /end RECORD_LAYOUT
/begin RECORD_LAYOUT Lookup1D_BYTE FNC_VALUES 1 SBYTE COLUMN_DIR DIRECT /end RECORD_LAYOUT
/begin RECORD_LAYOUT Lookup1D_X_BYTE AXIS_PTS_X 1 SBYTE INDEX_INCR DIRECT /end RECORD_LAYOUT
/begin RECORD_LAYOUT Lookup1D_UBYTE FNC_VALUES 1 UBYTE COLUMN_DIR DIRECT /end RECORD_LAYOUT
/begin RECORD_LAYOUT Lookup1D_X_UBYTE AXIS_PTS_X 1 UBYTE INDEX_INCR DIRECT /end RECORD_LAYOUT
/begin RECORD_LAYOUT Lookup1D_UWORD FNC_VALUES 1 UWORD COLUMN_DIR DIRECT /end RECORD_LAYOUT
/begin RECORD_LAYOUT Lookup1D_X_UWORD AXIS_PTS_X 1 UWORD INDEX_INCR DIRECT /end RECORD_LAYOUT
/begin RECORD_LAYOUT Lookup1D_WORD FNC_VALUES 1 SWORD COLUMN_DIR DIRECT /end RECORD_LAYOUT
/begin RECORD_LAYOUT Lookup1D_X_WORD AXIS_PTS_X 1 SWORD INDEX_INCR DIRECT /end RECORD_LAYOUT
/begin RECORD_LAYOUT Lookup1D_ULONG FNC_VALUES 1 ULONG COLUMN_DIR DIRECT /end RECORD_LAYOUT
/begin RECORD_LAYOUT Lookup1D_X_ULONG AXIS_PTS_X 1 ULONG INDEX_INCR DIRECT /end RECORD_LAYOUT
/begin RECORD_LAYOUT Lookup1D_SLONG FNC_VALUES 1 SLONG COLUMN_DIR DIRECT /end RECORD_LAYOUT
/begin RECORD_LAYOUT Lookup1D_X_LONG AXIS_PTS_X 1 SLONG INDEX_INCR DIRECT /end RECORD_LAYOUT
/begin RECORD_LAYOUT Lookup1D_FLOAT32_IEEE FNC_VALUES 1 FLOAT32_IEEE COLUMN_DIR DIRECT /end RECORD_LAYOUT
/begin RECORD_LAYOUT Lookup1D_X_FLOAT32_IEEE AXIS_PTS_X 1 FLOAT32_IEEE INDEX_INCR DIRECT /end RECORD_LAYOUT
/begin RECORD_LAYOUT Lookup1D_FLOAT64_IEEE FNC_VALUES 1 FLOAT64_IEEE COLUMN_DIR DIRECT /end RECORD_LAYOUT
/begin RECORD_LAYOUT Lookup1D_X_FLOAT64_IEEE AXIS_PTS_X 1 FLOAT64_IEEE INDEX_INCR DIRECT /end RECORD_LAYOUT
/begin RECORD_LAYOUT Lookup2D_BOOLEAN FNC_VALUES 1 UBYTE COLUMN_DIR DIRECT /end RECORD_LAYOUT
/begin RECORD_LAYOUT Lookup2D_X_BOOLEAN AXIS_PTS_X 1 UBYTE INDEX_INCR DIRECT /end RECORD_LAYOUT
/begin RECORD_LAYOUT Lookup2D_UBYTE FNC_VALUES 1 UBYTE COLUMN_DIR DIRECT /end RECORD_LAYOUT
/begin RECORD_LAYOUT Lookup2D_X_UBYTE AXIS_PTS_X 1 UBYTE INDEX_INCR DIRECT /end RECORD_LAYOUT
/begin RECORD_LAYOUT Lookup2D_BYTE FNC_VALUES 1 SBYTE COLUMN_DIR DIRECT /end RECORD_LAYOUT
/begin RECORD_LAYOUT Lookup2D_X_BYTE AXIS_PTS_X 1 SBYTE INDEX_INCR DIRECT /end RECORD_LAYOUT
/begin RECORD_LAYOUT Lookup2D_UWORD FNC_VALUES 1 UWORD COLUMN_DIR DIRECT /end RECORD_LAYOUT
/begin RECORD_LAYOUT Lookup2D_X_UWORD AXIS_PTS_X 1 UWORD INDEX_INCR DIRECT /end RECORD_LAYOUT
/begin RECORD_LAYOUT Lookup2D_WORD FNC_VALUES 1 SWORD COLUMN_DIR DIRECT /end RECORD_LAYOUT
/begin RECORD_LAYOUT Lookup2D_X_WORD AXIS_PTS_X 1 SWORD INDEX_INCR DIRECT /end RECORD_LAYOUT
/begin RECORD_LAYOUT Lookup2D_ULONG FNC_VALUES 1 ULONG COLUMN_DIR DIRECT /end RECORD_LAYOUT
/begin RECORD_LAYOUT Lookup2D_X_ULONG AXIS_PTS_X 1 ULONG INDEX_INCR DIRECT /end RECORD_LAYOUT
/begin RECORD_LAYOUT Lookup2D_LONG FNC_VALUES 1 SLONG COLUMN_DIR DIRECT /end RECORD_LAYOUT
/begin RECORD_LAYOUT Lookup2D_X_LONG AXIS_PTS_X 1 SLONG INDEX_INCR DIRECT /end RECORD_LAYOUT
/begin RECORD_LAYOUT Lookup2D_FLOAT32_IEEE FNC_VALUES 1 FLOAT32_IEEE COLUMN_DIR DIRECT /end RECORD_LAYOUT
/begin RECORD_LAYOUT Lookup2D_X_FLOAT32_IEEE AXIS_PTS_X 1 FLOAT32_IEEE INDEX_INCR DIRECT /end RECORD_LAYOUT
/begin RECORD_LAYOUT Lookup2D_FLOAT64_IEEE FNC_VALUES 1 FLOAT64_IEEE COLUMN_DIR DIRECT /end RECORD_LAYOUT
/begin RECORD_LAYOUT Lookup2D_X_FLOAT64_IEEE AXIS_PTS_X 1 FLOAT64_IEEE INDEX_INCR DIRECT /end RECORD_LAYOUT
/begin CHARACTERISTIC APP_swtAliveDetEna_C "Switch to enable alive detection" VALUE 0x0000 /* @ECU_Address@APP_swtAliveDetEna_C@ */ Scalar_LONG 0 APP_ChkSig_CM_Switch_NaN 0 1 /end CHARACTERISTIC
/begin CHARACTERISTIC APP_tiAliveDebHiLo_C "Debounce times for alive detection of APP / Time for a High to Low transition" VALUE 0x0000 /* @ECU_Address@APP_tiAliveDebHiLo_C@ */ Scalar_UWORD 0 APP_ChkSig_CM_Debncd_ms_ms 0.0 1000.0 /end CHARACTERISTIC
/begin CHARACTERISTIC APP_tiAliveDebLoHi_C "Debounce times for alive detection of APP / Time for a Low to High transition" VALUE 0x0000 /* @ECU_Address@APP_tiAliveDebLoHi_C@ */ Scalar_UWORD 0 APP_ChkSig_CM_Debncd_ms_ms 0.0 1000.0 /end CHARACTERISTIC
/begin CHARACTERISTIC APP_rThresAliveDet_C "APP threshold for alive detection" VALUE 0x0000 /* @ECU_Address@APP_rThresAliveDet_C@ */ Scalar_SWORD 0 APP_ChkSig_CM_Percent__ 0.0 100.0 /end CHARACTERISTIC
/begin MEASUREMENT APP_rFlt_mp "" SWORD APP_ChkSig_CM_Percent 0 0 0.0 100.0 ECU_ADDRESS 0x0000 /* @ECU_Address@APP_rFlt_mp@ */ /end MEASUREMENT
/begin MEASUREMENT APP_stSigSrc_APP1_BP "" UBYTE APP_ChkSig_CM_boolean 0 0 0.0 1.0 ECU_ADDRESS 0x0000 /* @ECU_Address@APP_stSigSrc_APP1_BP@ */ /end MEASUREMENT
/begin MEASUREMENT APP_stSigSrc_APP2_BP "" UBYTE APP_ChkSig_CM_boolean 0 0 0.0 1.0 ECU_ADDRESS 0x0000 /* @ECU_Address@APP_stSigSrc_APP2_BP@ */ /end MEASUREMENT
/begin MEASUREMENT APP_r "Acceleration pedal sensor 1 value after fault handling" SWORD APP_ChkSig_CM_Percent__ 0 0 0.0 100.0 ECU_ADDRESS 0x0000 /* @ECU_Address@APP_r@ */ /end MEASUREMENT
/begin COMPU_METHOD APP_ChkSig_CM_Switch_NaN "Enumerated data type: Switch" TAB_VERB "%0.6" "NaN" /* Conversion Table */ COMPU_TAB_REF VTAB_FOR_APP_ChkSig_CM_Switch_NaN /end COMPU_METHOD
/begin COMPU_VTAB /* Name of Table */ VTAB_FOR_APP_ChkSig_CM_Switch_NaN "Enumerated data type: Switch" TAB_VERB /* Number of Elements */ 2 /* Table Element */ 0 "Switch_OFF" /* Table Element */ 1 "Switch_ON" /end COMPU_VTAB
/begin COMPU_METHOD APP_ChkSig_CM_Debncd_ms_ms "Q = V*10.000000" RAT_FUNC "%5.1" "ms" COEFFS 0 10.000000 0.000000 0 0 1.000000 /end COMPU_METHOD
/begin COMPU_METHOD APP_ChkSig_CM_Percent__ "Q = V*200.000000" RAT_FUNC "%6.3" "%" COEFFS 0 200.000000 0.000000 0 0 1.000000 /end COMPU_METHOD
/begin COMPU_METHOD APP_ChkSig_CM_Percent "Q = V*200.000000" RAT_FUNC "%6.3" "" COEFFS 0 200.000000 0.000000 0 0 1.000000 /end COMPU_METHOD
/begin COMPU_METHOD APP_ChkSig_CM_boolean "Q = V" RAT_FUNC "%1.0" "" COEFFS 0 1 0 0 0 1 /end COMPU_METHOD
/begin GROUP APP_ChkSig "APP_ChkSig" /* Root */ ROOT /begin SUB_GROUP Root_Overview /end SUB_GROUP /begin REF_MEASUREMENT APP_rFlt_mp APP_stSigSrc_APP1_BP APP_stSigSrc_APP2_BP /end REF_MEASUREMENT /end GROUP
/begin GROUP Root_Overview "APP_ChkSig/Overview" /begin SUB_GROUP S1_APP_ChkSig /end SUB_GROUP /end GROUP
/begin GROUP S1_APP_ChkSig "APP_ChkSig/Overview/APP_ChkSig" /begin SUB_GROUP S2_Live_Detection /end SUB_GROUP /end GROUP
/begin GROUP S2_Live_Detection "APP_ChkSig/Overview/APP_ChkSig/Live_Detection"
 /begin REF_CHARACTERISTIC APP_rThresAliveDet_C APP_swtAliveDetEna_C APP_tiAliveDebHiLo_C APP_tiAliveDebLoHi_C /end REF_CHARACTERISTIC
 /begin REF_MEASUREMENT APP_r /end REF_MEASUREMENT
/end GROUP
/end MODULE
/end PROJECT
/* (add any file trailer comments here) */
/* EOF APP_ChkSig.a2l */
