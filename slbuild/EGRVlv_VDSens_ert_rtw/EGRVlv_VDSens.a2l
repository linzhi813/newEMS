/******************************************************************************
* ASAP2 file: EGRVlv_VDSens.a2l
* Code generation for model "EGRVlv_VDSens".
* Model version : 1.67
* Simulink Coder version : 9.4 (R2020b) 29-Jul-2020
* C source code generated on : Thu Feb 4 09:40:05 2021
* Target selection: ert.tlc
* Embedded hardware selection: ARM Compatible->ARM Cortex
* Code generation objectives: Unspecified
* Validation result: Not run
* (add additional file header information here)
******************************************************************************/ ASAP2_VERSION 1 31
/* Version 1.31 */
/begin PROJECT ProjectName "Project Comment Goes Here"
/begin HEADER "Header Comments go here" /end HEADER
/begin MODULE ModuleName "Module Comment Goes Here"
/begin MOD_PAR "MOD PAR Comment Goes Here" /end MOD_PAR
/begin MOD_COMMON "Mod Common Comment Here" BYTE_ORDER MSB_LAST /end MOD_COMMON
/begin RECORD_LAYOUT Scalar_BOOLEAN FNC_VALUES 1 UBYTE COLUMN_DIR DIRECT /end RECORD_LAYOUT
/begin RECORD_LAYOUT Scalar_UBYTE FNC_VALUES 1 UBYTE COLUMN_DIR DIRECT /end RECORD_LAYOUT
/begin RECORD_LAYOUT Scalar_BYTE FNC_VALUES 1 SBYTE COLUMN_DIR DIRECT /end RECORD_LAYOUT
/begin RECORD_LAYOUT Scalar_UWORD FNC_VALUES 1 UWORD COLUMN_DIR DIRECT /end RECORD_LAYOUT
/begin RECORD_LAYOUT Scalar_SWORD FNC_VALUES 1 SWORD COLUMN_DIR DIRECT /end RECORD_LAYOUT
/begin RECORD_LAYOUT Scalar_ULONG FNC_VALUES 1 ULONG COLUMN_DIR DIRECT /end RECORD_LAYOUT
/begin RECORD_LAYOUT Scalar_LONG FNC_VALUES 1 SLONG COLUMN_DIR DIRECT /end RECORD_LAYOUT
/begin RECORD_LAYOUT Scalar_FLOAT32_IEEE FNC_VALUES 1 FLOAT32_IEEE COLUMN_DIR DIRECT /end RECORD_LAYOUT
/begin RECORD_LAYOUT Scalar_FLOAT64_IEEE FNC_VALUES 1 FLOAT64_IEEE COLUMN_DIR DIRECT /end RECORD_LAYOUT
/begin RECORD_LAYOUT Lookup1D_BOOLEAN FNC_VALUES 1 UBYTE COLUMN_DIR DIRECT /end RECORD_LAYOUT
/begin RECORD_LAYOUT Lookup1D_X_BOOLEAN AXIS_PTS_X 1 UBYTE INDEX_INCR DIRECT /end RECORD_LAYOUT
/begin RECORD_LAYOUT Lookup1D_BYTE FNC_VALUES 1 SBYTE COLUMN_DIR DIRECT /end RECORD_LAYOUT
/begin RECORD_LAYOUT Lookup1D_X_BYTE AXIS_PTS_X 1 SBYTE INDEX_INCR DIRECT /end RECORD_LAYOUT
/begin RECORD_LAYOUT Lookup1D_UBYTE FNC_VALUES 1 UBYTE COLUMN_DIR DIRECT /end RECORD_LAYOUT
/begin RECORD_LAYOUT Lookup1D_X_UBYTE AXIS_PTS_X 1 UBYTE INDEX_INCR DIRECT /end RECORD_LAYOUT
/begin RECORD_LAYOUT Lookup1D_UWORD FNC_VALUES 1 UWORD COLUMN_DIR DIRECT /end RECORD_LAYOUT
/begin RECORD_LAYOUT Lookup1D_X_UWORD AXIS_PTS_X 1 UWORD INDEX_INCR DIRECT /end RECORD_LAYOUT
/begin RECORD_LAYOUT Lookup1D_WORD FNC_VALUES 1 SWORD COLUMN_DIR DIRECT /end RECORD_LAYOUT
/begin RECORD_LAYOUT Lookup1D_X_WORD AXIS_PTS_X 1 SWORD INDEX_INCR DIRECT /end RECORD_LAYOUT
/begin RECORD_LAYOUT Lookup1D_ULONG FNC_VALUES 1 ULONG COLUMN_DIR DIRECT /end RECORD_LAYOUT
/begin RECORD_LAYOUT Lookup1D_X_ULONG AXIS_PTS_X 1 ULONG INDEX_INCR DIRECT /end RECORD_LAYOUT
/begin RECORD_LAYOUT Lookup1D_SLONG FNC_VALUES 1 SLONG COLUMN_DIR DIRECT /end RECORD_LAYOUT
/begin RECORD_LAYOUT Lookup1D_X_LONG AXIS_PTS_X 1 SLONG INDEX_INCR DIRECT /end RECORD_LAYOUT
/begin RECORD_LAYOUT Lookup1D_FLOAT32_IEEE FNC_VALUES 1 FLOAT32_IEEE COLUMN_DIR DIRECT /end RECORD_LAYOUT
/begin RECORD_LAYOUT Lookup1D_X_FLOAT32_IEEE AXIS_PTS_X 1 FLOAT32_IEEE INDEX_INCR DIRECT /end RECORD_LAYOUT
/begin RECORD_LAYOUT Lookup1D_FLOAT64_IEEE FNC_VALUES 1 FLOAT64_IEEE COLUMN_DIR DIRECT /end RECORD_LAYOUT
/begin RECORD_LAYOUT Lookup1D_X_FLOAT64_IEEE AXIS_PTS_X 1 FLOAT64_IEEE INDEX_INCR DIRECT /end RECORD_LAYOUT
/begin RECORD_LAYOUT Lookup2D_BOOLEAN FNC_VALUES 1 UBYTE COLUMN_DIR DIRECT /end RECORD_LAYOUT
/begin RECORD_LAYOUT Lookup2D_X_BOOLEAN AXIS_PTS_X 1 UBYTE INDEX_INCR DIRECT /end RECORD_LAYOUT
/begin RECORD_LAYOUT Lookup2D_UBYTE FNC_VALUES 1 UBYTE COLUMN_DIR DIRECT /end RECORD_LAYOUT
/begin RECORD_LAYOUT Lookup2D_X_UBYTE AXIS_PTS_X 1 UBYTE INDEX_INCR DIRECT /end RECORD_LAYOUT
/begin RECORD_LAYOUT Lookup2D_BYTE FNC_VALUES 1 SBYTE COLUMN_DIR DIRECT /end RECORD_LAYOUT
/begin RECORD_LAYOUT Lookup2D_X_BYTE AXIS_PTS_X 1 SBYTE INDEX_INCR DIRECT /end RECORD_LAYOUT
/begin RECORD_LAYOUT Lookup2D_UWORD FNC_VALUES 1 UWORD COLUMN_DIR DIRECT /end RECORD_LAYOUT
/begin RECORD_LAYOUT Lookup2D_X_UWORD AXIS_PTS_X 1 UWORD INDEX_INCR DIRECT /end RECORD_LAYOUT
/begin RECORD_LAYOUT Lookup2D_WORD FNC_VALUES 1 SWORD COLUMN_DIR DIRECT /end RECORD_LAYOUT
/begin RECORD_LAYOUT Lookup2D_X_WORD AXIS_PTS_X 1 SWORD INDEX_INCR DIRECT /end RECORD_LAYOUT
/begin RECORD_LAYOUT Lookup2D_ULONG FNC_VALUES 1 ULONG COLUMN_DIR DIRECT /end RECORD_LAYOUT
/begin RECORD_LAYOUT Lookup2D_X_ULONG AXIS_PTS_X 1 ULONG INDEX_INCR DIRECT /end RECORD_LAYOUT
/begin RECORD_LAYOUT Lookup2D_LONG FNC_VALUES 1 SLONG COLUMN_DIR DIRECT /end RECORD_LAYOUT
/begin RECORD_LAYOUT Lookup2D_X_LONG AXIS_PTS_X 1 SLONG INDEX_INCR DIRECT /end RECORD_LAYOUT
/begin RECORD_LAYOUT Lookup2D_FLOAT32_IEEE FNC_VALUES 1 FLOAT32_IEEE COLUMN_DIR DIRECT /end RECORD_LAYOUT
/begin RECORD_LAYOUT Lookup2D_X_FLOAT32_IEEE AXIS_PTS_X 1 FLOAT32_IEEE INDEX_INCR DIRECT /end RECORD_LAYOUT
/begin RECORD_LAYOUT Lookup2D_FLOAT64_IEEE FNC_VALUES 1 FLOAT64_IEEE COLUMN_DIR DIRECT /end RECORD_LAYOUT
/begin RECORD_LAYOUT Lookup2D_X_FLOAT64_IEEE AXIS_PTS_X 1 FLOAT64_IEEE INDEX_INCR DIRECT /end RECORD_LAYOUT
/begin CHARACTERISTIC SigTst_swtEGRVlv_C "Switch for EGR valve position by hand" VALUE 0x0000 /* @ECU_Address@SigTst_swtEGRVlv_C@ */ Scalar_LONG 0 EGRVlv_VDSens_CM_Switch_NaN 0 1 /end CHARACTERISTIC
/begin CHARACTERISTIC EGRVlv_RmpSlpNeg_C "Parameter for Ramp 1 / negative ramp slope" VALUE 0x0000 /* @ECU_Address@EGRVlv_RmpSlpNeg_C@ */ Scalar_SWORD 0 EGRVlv_VDSens_CM_DutyCycle___s -100.0 100.0 /end CHARACTERISTIC
/begin CHARACTERISTIC EGRVlv_RmpSlpPos_C "Parameter for Ramp 1 / Slope if the ramp has to be increased" VALUE 0x0000 /* @ECU_Address@EGRVlv_RmpSlpPos_C@ */ Scalar_SWORD 0 EGRVlv_VDSens_CM_DutyCycle___s -100.0 100.0 /end CHARACTERISTIC
/begin CHARACTERISTIC EGRVlv_facPT1ModVal_C "PT1 filter factor for EGRVlv sensor model value" VALUE 0x0000 /* @ECU_Address@EGRVlv_facPT1ModVal_C@ */ Scalar_SWORD 0 EGRVlv_VDSens_CM_Fac_100_NaN 0.0 99.9985 /end CHARACTERISTIC
/begin CHARACTERISTIC EGRVlv_facPT1_C "PT1 filter factor for EGRVlv sensor" VALUE 0x0000 /* @ECU_Address@EGRVlv_facPT1_C@ */ Scalar_SWORD 0 EGRVlv_VDSens_CM_Fac_100_NaN 0.0 99.9985 /end CHARACTERISTIC
/begin CHARACTERISTIC EGRVlv_rActMax_C "Maximum threshold for actual sensed valve position" VALUE 0x0000 /* @ECU_Address@EGRVlv_rActMax_C@ */ Scalar_SWORD 0 EGRVlv_VDSens_CM_DutyCycle__ -100.0 100.0 /end CHARACTERISTIC
/begin CHARACTERISTIC EGRVlv_rActMin_C "Minimum threshold for actual sensed valve position" VALUE 0x0000 /* @ECU_Address@EGRVlv_rActMin_C@ */ Scalar_SWORD 0 EGRVlv_VDSens_CM_DutyCycle__ -100.0 100.0 /end CHARACTERISTIC
/begin CHARACTERISTIC EGRVlv_rActOfs_C "Offset correction value." VALUE 0x0000 /* @ECU_Address@EGRVlv_rActOfs_C@ */ Scalar_SWORD 0 EGRVlv_VDSens_CM_DutyCycle__ -100.0 100.0 /end CHARACTERISTIC
/begin CHARACTERISTIC EGRVlv_rCmpNewCtlUn_C "Default value for the new ECU" VALUE 0x0000 /* @ECU_Address@EGRVlv_rCmpNewCtlUn_C@ */ Scalar_SWORD 0 EGRVlv_VDSens_CM_DutyCycle__ -100.0 100.0 /end CHARACTERISTIC
/begin CHARACTERISTIC EGRVlv_rPullDwnThres_C "Pull down threshold ratio" VALUE 0x0000 /* @ECU_Address@EGRVlv_rPullDwnThres_C@ */ Scalar_SWORD 0 EGRVlv_VDSens_CM_DutyCycle__ -100.0 100.0 /end CHARACTERISTIC
/begin CHARACTERISTIC EGRVlv_rTmpOfsLrnMax_C "Maximum offset ratio" VALUE 0x0000 /* @ECU_Address@EGRVlv_rTmpOfsLrnMax_C@ */ Scalar_SWORD 0 EGRVlv_VDSens_CM_DutyCycle__ -100.0 100.0 /end CHARACTERISTIC
/begin CHARACTERISTIC EGRVlv_rTmpOfsLrnMin_C "Minimum offset ratio" VALUE 0x0000 /* @ECU_Address@EGRVlv_rTmpOfsLrnMin_C@ */ Scalar_SWORD 0 EGRVlv_VDSens_CM_DutyCycle__ -100.0 100.0 /end CHARACTERISTIC
/begin CHARACTERISTIC EGRVlv_rTransStgDfl_C "Structure for Transtage / Fixed replacement value" VALUE 0x0000 /* @ECU_Address@EGRVlv_rTransStgDfl_C@ */ Scalar_SWORD 0 EGRVlv_VDSens_CM_DutyCycle__ -100.0 100.0 /end CHARACTERISTIC
/begin CHARACTERISTIC SigTst_rEGRVlv_C "Set EGR valve position by hand" VALUE 0x0000 /* @ECU_Address@SigTst_rEGRVlv_C@ */ Scalar_SWORD 0 EGRVlv_VDSens_CM_DutyCycle__ -100.0 100.0 /end CHARACTERISTIC
/begin CHARACTERISTIC EGRVlv_swtActOfs_C "Switch to activate offset correction replacement value" VALUE 0x0000 /* @ECU_Address@EGRVlv_swtActOfs_C@ */ Scalar_BOOLEAN 0 EGRVlv_VDSens_CM_boolean_NaN 0.0 1.0 /end CHARACTERISTIC
/begin CHARACTERISTIC EGRVlv_swtOfsLrnActv_C "Switch to ENABLE/DISABLE offset learning" VALUE 0x0000 /* @ECU_Address@EGRVlv_swtOfsLrnActv_C@ */ Scalar_BOOLEAN 0 EGRVlv_VDSens_CM_boolean_NaN 0.0 1.0 /end CHARACTERISTIC
/begin CHARACTERISTIC EGRVlv_swtSensPrs_C "Switch for position sensor present or not" VALUE 0x0000 /* @ECU_Address@EGRVlv_swtSensPrs_C@ */ Scalar_BOOLEAN 0 EGRVlv_VDSens_CM_boolean_NaN 0.0 1.0 /end CHARACTERISTIC
/begin MEASUREMENT EGRVlv_rSens "" SWORD EGRVlv_VDSens_CM_DutyCycle 0 0 -100.0 100.0 ECU_ADDRESS 0x0000 /* @ECU_Address@EGRVlv_rSens@ */ /end MEASUREMENT
/begin MEASUREMENT EGRVlv_bFinalDef "" UBYTE EGRVlv_VDSens_CM_boolean 0 0 0.0 1.0 ECU_ADDRESS 0x0000 /* @ECU_Address@EGRVlv_bFinalDef@ */ /end MEASUREMENT
/begin MEASUREMENT EGRVlv_bProvDef "" UBYTE EGRVlv_VDSens_CM_boolean 0 0 0.0 1.0 ECU_ADDRESS 0x0000 /* @ECU_Address@EGRVlv_bProvDef@ */ /end MEASUREMENT
/begin MEASUREMENT EGRVlv_bPhysRngFinalDef "" UBYTE EGRVlv_VDSens_CM_boolean 0 0 0.0 1.0 ECU_ADDRESS 0x0000 /* @ECU_Address@EGRVlv_bPhysRngFinalDef@ */ /end MEASUREMENT
/begin MEASUREMENT EGRVlv_bPhysRngProvDef "" UBYTE EGRVlv_VDSens_CM_boolean 0 0 0.0 1.0 ECU_ADDRESS 0x0000 /* @ECU_Address@EGRVlv_bPhysRngProvDef@ */ /end MEASUREMENT
/begin MEASUREMENT EGRVlv_rEGR "" SWORD EGRVlv_VDSens_CM_DutyCycle 0 0 -100.0 100.0 ECU_ADDRESS 0x0000 /* @ECU_Address@EGRVlv_rEGR@ */ /end MEASUREMENT
/begin MEASUREMENT DSM_bEGRVlvModVal "" UBYTE EGRVlv_VDSens_CM_boolean 0 0 0.0 1.0 ECU_ADDRESS 0x0000 /* @ECU_Address@DSM_bEGRVlvModVal@ */ /end MEASUREMENT
/begin MEASUREMENT DSM_bEGRVlvReplVal "" UBYTE EGRVlv_VDSens_CM_boolean 0 0 0.0 1.0 ECU_ADDRESS 0x0000 /* @ECU_Address@DSM_bEGRVlvReplVal@ */ /end MEASUREMENT
/begin MEASUREMENT EGRVlv_rTmpOfs "Temperory offset calculated" SWORD EGRVlv_VDSens_CM_DutyCycle__ 0 0 -100.0 100.0 ECU_ADDRESS 0x0000 /* @ECU_Address@EGRVlv_rTmpOfs@ */ /end MEASUREMENT
/begin MEASUREMENT EGRVlv_rUnFlt "Unfiltered EGR valve position" SWORD EGRVlv_VDSens_CM_DutyCycle__ 0 0 -100.0 100.0 ECU_ADDRESS 0x0000 /* @ECU_Address@EGRVlv_rUnFlt@ */ /end MEASUREMENT
/begin MEASUREMENT EGRVlv_rFlt "Filtered EGR valve position" SWORD EGRVlv_VDSens_CM_DutyCycle__ 0 0 -100.0 100.0 ECU_ADDRESS 0x0000 /* @ECU_Address@EGRVlv_rFlt@ */ /end MEASUREMENT
/begin MEASUREMENT EGRVlv_rActUnCor "Uncorrected position of the valve" SWORD EGRVlv_VDSens_CM_DutyCycle__ 0 0 -100.0 100.0 ECU_ADDRESS 0x0000 /* @ECU_Address@EGRVlv_rActUnCor@ */ /end MEASUREMENT
/begin MEASUREMENT EGRVlv_rOfs_mp "Offset correction" SWORD EGRVlv_VDSens_CM_DutyCycle__ 0 0 -100.0 100.0 ECU_ADDRESS 0x0000 /* @ECU_Address@EGRVlv_rOfs_mp@ */ /end MEASUREMENT
/begin MEASUREMENT EGRVlv_rLinOfs_mp "Valve position before limiting" SWORD EGRVlv_VDSens_CM_DutyCycle__ 0 0 -100.0 100.0 ECU_ADDRESS 0x0000 /* @ECU_Address@EGRVlv_rLinOfs_mp@ */ /end MEASUREMENT
/begin MEASUREMENT EGRVlv_rModVal "The model value used in the evaluation of the EGR valve actuator position EGRVlv_rAct" SWORD EGRVlv_VDSens_CM_DutyCycle__ 0 0 -100.0 100.0 ECU_ADDRESS 0x0000 /* @ECU_Address@EGRVlv_rModVal@ */ /end MEASUREMENT
/begin MEASUREMENT EGRVlv_rAct "Actuatorposition" SWORD EGRVlv_VDSens_CM_DutyCycle__ 0 0 -100.0 100.0 ECU_ADDRESS 0x0000 /* @ECU_Address@EGRVlv_rAct@ */ /end MEASUREMENT
/begin MEASUREMENT EGRVlv_rActInv "Actuatorposition (100% - rAct)" SWORD EGRVlv_VDSens_CM_DutyCycle__ 0 0 -100.0 100.0 ECU_ADDRESS 0x0000 /* @ECU_Address@EGRVlv_rActInv@ */ /end MEASUREMENT
/begin MEASUREMENT EGRVlv_rActNoErrHdl "Valve position (offset corrected without error handling)" SWORD EGRVlv_VDSens_CM_DutyCycle__ 0 0 -100.0 100.0 ECU_ADDRESS 0x0000 /* @ECU_Address@EGRVlv_rActNoErrHdl@ */ /end MEASUREMENT
/begin COMPU_METHOD EGRVlv_VDSens_CM_Switch_NaN "Enumerated data type: Switch" TAB_VERB "%0.6" "NaN" /* Conversion Table */ COMPU_TAB_REF VTAB_FOR_EGRVlv_VDSens_CM_Switch_NaN /end COMPU_METHOD
/begin COMPU_VTAB /* Name of Table */ VTAB_FOR_EGRVlv_VDSens_CM_Switch_NaN "Enumerated data type: Switch" TAB_VERB /* Number of Elements */ 2 /* Table Element */ 0 "Switch_OFF" /* Table Element */ 1 "Switch_ON" /end COMPU_VTAB
/begin COMPU_METHOD EGRVlv_VDSens_CM_DutyCycle___s "Q = V*200.000000" RAT_FUNC "%6.3" "%/s" COEFFS 0 200.000000 0.000000 0 0 1.000000 /end COMPU_METHOD
/begin COMPU_METHOD EGRVlv_VDSens_CM_Fac_100_NaN "Q = V*200.000000" RAT_FUNC "%6.3" "NaN" COEFFS 0 200.000000 0.000000 0 0 1.000000 /end COMPU_METHOD
/begin COMPU_METHOD EGRVlv_VDSens_CM_DutyCycle__ "Q = V*200.000000" RAT_FUNC "%6.3" "%" COEFFS 0 200.000000 0.000000 0 0 1.000000 /end COMPU_METHOD
/begin COMPU_METHOD EGRVlv_VDSens_CM_boolean_NaN "Q = V" RAT_FUNC "%1.0" "NaN" COEFFS 0 1 0 0 0 1 /end COMPU_METHOD
/begin COMPU_METHOD EGRVlv_VDSens_CM_DutyCycle "Q = V*200.000000" RAT_FUNC "%6.3" "" COEFFS 0 200.000000 0.000000 0 0 1.000000 /end COMPU_METHOD
/begin COMPU_METHOD EGRVlv_VDSens_CM_boolean "Q = V" RAT_FUNC "%1.0" "" COEFFS 0 1 0 0 0 1 /end COMPU_METHOD
/begin GROUP EGRVlv_VDSens "EGRVlv_VDSens" /* Root */ ROOT /begin SUB_GROUP Root_Overview /end SUB_GROUP
 /begin REF_MEASUREMENT DSM_bEGRVlvModVal DSM_bEGRVlvReplVal EGRVlv_bFinalDef EGRVlv_bPhysRngFinalDef EGRVlv_bPhysRngProvDef EGRVlv_bProvDef EGRVlv_rEGR EGRVlv_rSens /end REF_MEASUREMENT
/end GROUP
/begin GROUP Root_Overview "EGRVlv_VDSens/Overview" /begin SUB_GROUP S1_EGRVlv_VDSens /end SUB_GROUP /end GROUP
/begin GROUP S1_EGRVlv_VDSens "EGRVlv_VDSens/Overview/EGRVlv_VDSens"
 /begin SUB_GROUP S2_Calculation_of_the_actual_valve_position S2_Transtage_Evaluation /end SUB_GROUP
/end GROUP
/begin GROUP S2_Calculation_of_the_actual_valve_position "EGRVlv_VDSens/Overview/EGRVlv_VDSens/Calculation of the actual valve position" /begin SUB_GROUP S3_Offset_Correction_and_Slope_Calculation /end SUB_GROUP
 /begin REF_CHARACTERISTIC EGRVlv_rActMax_C EGRVlv_rActMin_C EGRVlv_rPullDwnThres_C EGRVlv_rTmpOfsLrnMax_C EGRVlv_rTmpOfsLrnMin_C EGRVlv_swtOfsLrnActv_C EGRVlv_swtSensPrs_C /end REF_CHARACTERISTIC
 /begin REF_MEASUREMENT EGRVlv_rAct EGRVlv_rActInv EGRVlv_rTmpOfs /end REF_MEASUREMENT
/end GROUP
/begin GROUP S2_Transtage_Evaluation "EGRVlv_VDSens/Overview/EGRVlv_VDSens/Transtage Evaluation" /begin SUB_GROUP S4_sensor_fault /end SUB_GROUP
 /begin REF_CHARACTERISTIC EGRVlv_RmpSlpNeg_C EGRVlv_RmpSlpPos_C EGRVlv_facPT1ModVal_C EGRVlv_facPT1_C EGRVlv_rTransStgDfl_C SigTst_rEGRVlv_C SigTst_swtEGRVlv_C /end REF_CHARACTERISTIC
 /begin REF_MEASUREMENT EGRVlv_rActUnCor EGRVlv_rFlt EGRVlv_rModVal /end REF_MEASUREMENT
/end GROUP
/begin GROUP S3_Offset_Correction_and_Slope_Calculation "EGRVlv_VDSens/Overview/EGRVlv_VDSens/Calculation of the actual valve position/Offset Correction and Slope Calculation" /begin REF_CHARACTERISTIC EGRVlv_rActOfs_C EGRVlv_rCmpNewCtlUn_C EGRVlv_swtActOfs_C /end REF_CHARACTERISTIC /begin REF_MEASUREMENT EGRVlv_rActNoErrHdl EGRVlv_rLinOfs_mp EGRVlv_rOfs_mp /end REF_MEASUREMENT /end GROUP
/begin GROUP S4_sensor_fault "EGRVlv_VDSens/Overview/EGRVlv_VDSens/Transtage Evaluation/sensor_fault" /begin REF_MEASUREMENT EGRVlv_rUnFlt /end REF_MEASUREMENT /end GROUP
/end MODULE
/end PROJECT
/* (add any file trailer comments here) */
/* EOF EGRVlv_VDSens.a2l */
