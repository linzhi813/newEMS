/******************************************************************************
* ASAP2 file: EGRVlv_DD.a2l
* Code generation for model "EGRVlv_DD".
* Model version : 1.67
* Simulink Coder version : 9.4 (R2020b) 29-Jul-2020
* C source code generated on : Thu Feb 4 09:39:18 2021
* Target selection: ert.tlc
* Embedded hardware selection: ARM Compatible->ARM Cortex
* Code generation objectives: Unspecified
* Validation result: Not run
* (add additional file header information here)
******************************************************************************/ ASAP2_VERSION 1 31
/* Version 1.31 */
/begin PROJECT ProjectName "Project Comment Goes Here"
/begin HEADER "Header Comments go here" /end HEADER
/begin MODULE ModuleName "Module Comment Goes Here"
/begin MOD_PAR "MOD PAR Comment Goes Here" /end MOD_PAR
/begin MOD_COMMON "Mod Common Comment Here" BYTE_ORDER MSB_LAST /end MOD_COMMON
/begin RECORD_LAYOUT Scalar_BOOLEAN FNC_VALUES 1 UBYTE COLUMN_DIR DIRECT /end RECORD_LAYOUT
/begin RECORD_LAYOUT Scalar_UBYTE FNC_VALUES 1 UBYTE COLUMN_DIR DIRECT /end RECORD_LAYOUT
/begin RECORD_LAYOUT Scalar_BYTE FNC_VALUES 1 SBYTE COLUMN_DIR DIRECT /end RECORD_LAYOUT
/begin RECORD_LAYOUT Scalar_UWORD FNC_VALUES 1 UWORD COLUMN_DIR DIRECT /end RECORD_LAYOUT
/begin RECORD_LAYOUT Scalar_SWORD FNC_VALUES 1 SWORD COLUMN_DIR DIRECT /end RECORD_LAYOUT
/begin RECORD_LAYOUT Scalar_ULONG FNC_VALUES 1 ULONG COLUMN_DIR DIRECT /end RECORD_LAYOUT
/begin RECORD_LAYOUT Scalar_LONG FNC_VALUES 1 SLONG COLUMN_DIR DIRECT /end RECORD_LAYOUT
/begin RECORD_LAYOUT Scalar_FLOAT32_IEEE FNC_VALUES 1 FLOAT32_IEEE COLUMN_DIR DIRECT /end RECORD_LAYOUT
/begin RECORD_LAYOUT Scalar_FLOAT64_IEEE FNC_VALUES 1 FLOAT64_IEEE COLUMN_DIR DIRECT /end RECORD_LAYOUT
/begin RECORD_LAYOUT Lookup1D_BOOLEAN FNC_VALUES 1 UBYTE COLUMN_DIR DIRECT /end RECORD_LAYOUT
/begin RECORD_LAYOUT Lookup1D_X_BOOLEAN AXIS_PTS_X 1 UBYTE INDEX_INCR DIRECT /end RECORD_LAYOUT
/begin RECORD_LAYOUT Lookup1D_BYTE FNC_VALUES 1 SBYTE COLUMN_DIR DIRECT /end RECORD_LAYOUT
/begin RECORD_LAYOUT Lookup1D_X_BYTE AXIS_PTS_X 1 SBYTE INDEX_INCR DIRECT /end RECORD_LAYOUT
/begin RECORD_LAYOUT Lookup1D_UBYTE FNC_VALUES 1 UBYTE COLUMN_DIR DIRECT /end RECORD_LAYOUT
/begin RECORD_LAYOUT Lookup1D_X_UBYTE AXIS_PTS_X 1 UBYTE INDEX_INCR DIRECT /end RECORD_LAYOUT
/begin RECORD_LAYOUT Lookup1D_UWORD FNC_VALUES 1 UWORD COLUMN_DIR DIRECT /end RECORD_LAYOUT
/begin RECORD_LAYOUT Lookup1D_X_UWORD AXIS_PTS_X 1 UWORD INDEX_INCR DIRECT /end RECORD_LAYOUT
/begin RECORD_LAYOUT Lookup1D_WORD FNC_VALUES 1 SWORD COLUMN_DIR DIRECT /end RECORD_LAYOUT
/begin RECORD_LAYOUT Lookup1D_X_WORD AXIS_PTS_X 1 SWORD INDEX_INCR DIRECT /end RECORD_LAYOUT
/begin RECORD_LAYOUT Lookup1D_ULONG FNC_VALUES 1 ULONG COLUMN_DIR DIRECT /end RECORD_LAYOUT
/begin RECORD_LAYOUT Lookup1D_X_ULONG AXIS_PTS_X 1 ULONG INDEX_INCR DIRECT /end RECORD_LAYOUT
/begin RECORD_LAYOUT Lookup1D_SLONG FNC_VALUES 1 SLONG COLUMN_DIR DIRECT /end RECORD_LAYOUT
/begin RECORD_LAYOUT Lookup1D_X_LONG AXIS_PTS_X 1 SLONG INDEX_INCR DIRECT /end RECORD_LAYOUT
/begin RECORD_LAYOUT Lookup1D_FLOAT32_IEEE FNC_VALUES 1 FLOAT32_IEEE COLUMN_DIR DIRECT /end RECORD_LAYOUT
/begin RECORD_LAYOUT Lookup1D_X_FLOAT32_IEEE AXIS_PTS_X 1 FLOAT32_IEEE INDEX_INCR DIRECT /end RECORD_LAYOUT
/begin RECORD_LAYOUT Lookup1D_FLOAT64_IEEE FNC_VALUES 1 FLOAT64_IEEE COLUMN_DIR DIRECT /end RECORD_LAYOUT
/begin RECORD_LAYOUT Lookup1D_X_FLOAT64_IEEE AXIS_PTS_X 1 FLOAT64_IEEE INDEX_INCR DIRECT /end RECORD_LAYOUT
/begin RECORD_LAYOUT Lookup2D_BOOLEAN FNC_VALUES 1 UBYTE COLUMN_DIR DIRECT /end RECORD_LAYOUT
/begin RECORD_LAYOUT Lookup2D_X_BOOLEAN AXIS_PTS_X 1 UBYTE INDEX_INCR DIRECT /end RECORD_LAYOUT
/begin RECORD_LAYOUT Lookup2D_UBYTE FNC_VALUES 1 UBYTE COLUMN_DIR DIRECT /end RECORD_LAYOUT
/begin RECORD_LAYOUT Lookup2D_X_UBYTE AXIS_PTS_X 1 UBYTE INDEX_INCR DIRECT /end RECORD_LAYOUT
/begin RECORD_LAYOUT Lookup2D_BYTE FNC_VALUES 1 SBYTE COLUMN_DIR DIRECT /end RECORD_LAYOUT
/begin RECORD_LAYOUT Lookup2D_X_BYTE AXIS_PTS_X 1 SBYTE INDEX_INCR DIRECT /end RECORD_LAYOUT
/begin RECORD_LAYOUT Lookup2D_UWORD FNC_VALUES 1 UWORD COLUMN_DIR DIRECT /end RECORD_LAYOUT
/begin RECORD_LAYOUT Lookup2D_X_UWORD AXIS_PTS_X 1 UWORD INDEX_INCR DIRECT /end RECORD_LAYOUT
/begin RECORD_LAYOUT Lookup2D_WORD FNC_VALUES 1 SWORD COLUMN_DIR DIRECT /end RECORD_LAYOUT
/begin RECORD_LAYOUT Lookup2D_X_WORD AXIS_PTS_X 1 SWORD INDEX_INCR DIRECT /end RECORD_LAYOUT
/begin RECORD_LAYOUT Lookup2D_ULONG FNC_VALUES 1 ULONG COLUMN_DIR DIRECT /end RECORD_LAYOUT
/begin RECORD_LAYOUT Lookup2D_X_ULONG AXIS_PTS_X 1 ULONG INDEX_INCR DIRECT /end RECORD_LAYOUT
/begin RECORD_LAYOUT Lookup2D_LONG FNC_VALUES 1 SLONG COLUMN_DIR DIRECT /end RECORD_LAYOUT
/begin RECORD_LAYOUT Lookup2D_X_LONG AXIS_PTS_X 1 SLONG INDEX_INCR DIRECT /end RECORD_LAYOUT
/begin RECORD_LAYOUT Lookup2D_FLOAT32_IEEE FNC_VALUES 1 FLOAT32_IEEE COLUMN_DIR DIRECT /end RECORD_LAYOUT
/begin RECORD_LAYOUT Lookup2D_X_FLOAT32_IEEE AXIS_PTS_X 1 FLOAT32_IEEE INDEX_INCR DIRECT /end RECORD_LAYOUT
/begin RECORD_LAYOUT Lookup2D_FLOAT64_IEEE FNC_VALUES 1 FLOAT64_IEEE COLUMN_DIR DIRECT /end RECORD_LAYOUT
/begin RECORD_LAYOUT Lookup2D_X_FLOAT64_IEEE AXIS_PTS_X 1 FLOAT64_IEEE INDEX_INCR DIRECT /end RECORD_LAYOUT
/begin CHARACTERISTIC EGRVlv_rCnvHb_MAP "Pulsation correction map" MAP 0x0000 /* @ECU_Address@EGRVlv_rCnvHb_MAP@ */ Lookup2D_WORD 0 EGRVlv_DD_CM_DutyCycle__ -100.0 100.0
 /begin AXIS_DESCR COM_AXIS Epm_nEng EGRVlv_DD_CM_ERPM_rpm 16 0.0 6000.0 AXIS_PTS_REF EGRVlv_rCnvHb_MAPY /end AXIS_DESCR
 /begin AXIS_DESCR /* Description of Y-Axis Points */ COM_AXIS EGRVlv_rCnvInHb_mp EGRVlv_DD_CM_DutyCycle__ 16 -100.0 100.0 AXIS_PTS_REF EGRVlv_rCnvHb_MAPX /end AXIS_DESCR
/end CHARACTERISTIC
/begin AXIS_PTS EGRVlv_rCnvHb_MAPX "X Axis Points of Map" 0x0000 /* @ECU_Address@EGRVlv_rCnvHb_MAPX@ */ EGRVlv_rCnvInHb_mp Lookup2D_X_WORD 0 EGRVlv_DD_CM_DutyCycle__ 16 -100.0 100.0 /end AXIS_PTS
/begin AXIS_PTS EGRVlv_rCnvHb_MAPY "Y Axis Points of Map" 0x0000 /* @ECU_Address@EGRVlv_rCnvHb_MAPY@ */ Epm_nEng Lookup2D_X_WORD 0 EGRVlv_DD_CM_ERPM_rpm 16 0.0 6000.0 /end AXIS_PTS
/begin CHARACTERISTIC EGRVlv_rCnvPsNrmHb_CUR "Normalized correction curve" CURVE 0x0000 /* @ECU_Address@EGRVlv_rCnvPsNrmHb_CUR@ */ Lookup1D_WORD 0 EGRVlv_DD_CM_DutyCycle__ -100.0 100.0
 /begin AXIS_DESCR COM_AXIS EGRVlv_rPsHb EGRVlv_DD_CM_DutyCycle__ 16 -100.0 100.0 AXIS_PTS_REF EGRVlv_rCnvPsNrmHb_CURX /end AXIS_DESCR
/end CHARACTERISTIC
/begin AXIS_PTS EGRVlv_rCnvPsNrmHb_CURX "X Axis Points of curve" 0x0000 /* @ECU_Address@EGRVlv_rCnvPsNrmHb_CURX@ */ EGRVlv_rPsHb Lookup1D_X_WORD 0 EGRVlv_DD_CM_DutyCycle__ 16 -100.0 100.0 /end AXIS_PTS
/begin CHARACTERISTIC EGRVlv_rCnvPWM_MAP "Pulsation correction map" MAP 0x0000 /* @ECU_Address@EGRVlv_rCnvPWM_MAP@ */ Lookup2D_WORD 0 EGRVlv_DD_CM_DutyCycle__ -100.0 100.0
 /begin AXIS_DESCR COM_AXIS Epm_nEng EGRVlv_DD_CM_ERPM_rpm 16 0.0 6000.0 AXIS_PTS_REF EGRVlv_rCnvPWM_MAPY /end AXIS_DESCR
 /begin AXIS_DESCR /* Description of Y-Axis Points */ COM_AXIS EGRVlv_rCnvInPWM_mp EGRVlv_DD_CM_DutyCycle__ 16 -100.0 100.0 AXIS_PTS_REF EGRVlv_rCnvPWM_MAPX /end AXIS_DESCR
/end CHARACTERISTIC
/begin AXIS_PTS EGRVlv_rCnvPWM_MAPX "X Axis Points of Map" 0x0000 /* @ECU_Address@EGRVlv_rCnvPWM_MAPX@ */ EGRVlv_rCnvInPWM_mp Lookup2D_X_WORD 0 EGRVlv_DD_CM_DutyCycle__ 16 -100.0 100.0 /end AXIS_PTS
/begin AXIS_PTS EGRVlv_rCnvPWM_MAPY "Y Axis Points of Map" 0x0000 /* @ECU_Address@EGRVlv_rCnvPWM_MAPY@ */ Epm_nEng Lookup2D_X_WORD 0 EGRVlv_DD_CM_ERPM_rpm 16 0.0 6000.0 /end AXIS_PTS
/begin CHARACTERISTIC EGRVlv_rCnvPsNrmPWM_CUR "Normalized correction curve" CURVE 0x0000 /* @ECU_Address@EGRVlv_rCnvPsNrmPWM_CUR@ */ Lookup1D_WORD 0 EGRVlv_DD_CM_DutyCycle__ -100.0 100.0
 /begin AXIS_DESCR COM_AXIS EGRVlv_rPsPWM EGRVlv_DD_CM_DutyCycle__ 16 -100.0 100.0 AXIS_PTS_REF EGRVlv_rCnvPsNrmPWM_CURX /end AXIS_DESCR
/end CHARACTERISTIC
/begin AXIS_PTS EGRVlv_rCnvPsNrmPWM_CURX "X Axis Points of curve" 0x0000 /* @ECU_Address@EGRVlv_rCnvPsNrmPWM_CURX@ */ EGRVlv_rPsPWM Lookup1D_X_WORD 0 EGRVlv_DD_CM_DutyCycle__ 16 -100.0 100.0 /end AXIS_PTS
/begin CHARACTERISTIC EGRVlv_facBattCorFacFlt_C "PT1 filter factor for the battery voltage correction filter" VALUE 0x0000 /* @ECU_Address@EGRVlv_facBattCorFacFlt_C@ */ Scalar_SWORD 0 EGRVlv_DD_CM_Fac_100_NaN 0.0 99.9985 /end CHARACTERISTIC
/begin CHARACTERISTIC EGRVlv_facCorStrt_C "Correction factor compensation in Start state" VALUE 0x0000 /* @ECU_Address@EGRVlv_facCorStrt_C@ */ Scalar_SWORD 0 EGRVlv_DD_CM_Fac_100_NaN -32.0 31.9 /end CHARACTERISTIC
/begin CHARACTERISTIC EGRVlv_rPwmOutMax_C "Devlib diagnosis parameter structure / Maximum threshold for the duty cycle" VALUE 0x0000 /* @ECU_Address@EGRVlv_rPwmOutMax_C@ */ Scalar_SWORD 0 EGRVlv_DD_CM_DutyCycle__ -100.0 100.0 /end CHARACTERISTIC
/begin CHARACTERISTIC EGRVlv_rPwmOutMin_C "Devlib diagnosis parameter structure / Minimum threshold for the duty cycle" VALUE 0x0000 /* @ECU_Address@EGRVlv_rPwmOutMin_C@ */ Scalar_SWORD 0 EGRVlv_DD_CM_DutyCycle__ -100.0 100.0 /end CHARACTERISTIC
/begin CHARACTERISTIC EGRVlv_tiPs_C "signal period duration" VALUE 0x0000 /* @ECU_Address@EGRVlv_tiPs_C@ */ Scalar_UWORD 0 EGRVlv_DD_CM_Period_us_us 0.0 6000.0 /end CHARACTERISTIC
/begin CHARACTERISTIC EGRVlv_stPwrStgDiaDis_C "Mask to select power stage diagnosis disable conditions" VALUE 0x0000 /* @ECU_Address@EGRVlv_stPwrStgDiaDis_C@ */ Scalar_UWORD 0 EGRVlv_DD_CM_uint16_NaN 0.0 65535.0 /end CHARACTERISTIC
/begin CHARACTERISTIC EGRVlv_stPwrStgDis_C "Mask to select power stage disable conditions" VALUE 0x0000 /* @ECU_Address@EGRVlv_stPwrStgDis_C@ */ Scalar_UWORD 0 EGRVlv_DD_CM_uint16_NaN 0.0 65535.0 /end CHARACTERISTIC
/begin CHARACTERISTIC EGRVlv_swtHwSel_C "Switch to select between CJ945/TLE6244 and CJ230/TLE7209 power stages" VALUE 0x0000 /* @ECU_Address@EGRVlv_swtHwSel_C@ */ Scalar_BOOLEAN 0 EGRVlv_DD_CM_boolean_NaN 0.0 1.0 /end CHARACTERISTIC
/begin CHARACTERISTIC EGRVlv_swtPwmOutBattCor_C "Devlib diagnosis parameter structure / Switch to enable battery correction" VALUE 0x0000 /* @ECU_Address@EGRVlv_swtPwmOutBattCor_C@ */ Scalar_BOOLEAN 0 EGRVlv_DD_CM_boolean_NaN 0.0 1.0 /end CHARACTERISTIC
/begin MEASUREMENT EGRVlv_rEGR "" SWORD EGRVlv_DD_CM_DutyCycle 0 0 -100.0 100.0 ECU_ADDRESS 0x0000 /* @ECU_Address@EGRVlv_rEGR@ */ /end MEASUREMENT
/begin MEASUREMENT BattU_facCor "" SWORD EGRVlv_DD_CM_Fac_100 0 0 -32.0 31.9 ECU_ADDRESS 0x0000 /* @ECU_Address@BattU_facCor@ */ /end MEASUREMENT
/begin MEASUREMENT CoEng_st "" SLONG EGRVlv_DD_CM_EngState 0 0 0 3 ECU_ADDRESS 0x0000 /* @ECU_Address@CoEng_st@ */ /end MEASUREMENT
/begin MEASUREMENT Epm_nEng "" SWORD EGRVlv_DD_CM_ERPM 0 0 0.0 6000.0 ECU_ADDRESS 0x0000 /* @ECU_Address@Epm_nEng@ */ /end MEASUREMENT
/begin MEASUREMENT DevLib_stPwrStgEnaCond "" UBYTE EGRVlv_DD_CM_State 0 0 0.0 255.0 ECU_ADDRESS 0x0000 /* @ECU_Address@DevLib_stPwrStgEnaCond@ */ /end MEASUREMENT
/begin MEASUREMENT EGRVlv_tiPs "signal period duration" UWORD EGRVlv_DD_CM_Period_us_us 0 0 0.0 6000.0 ECU_ADDRESS 0x0000 /* @ECU_Address@EGRVlv_tiPs@ */ /end MEASUREMENT
/begin MEASUREMENT EGRVlv_rCnvInHb_mp "Measurement point for input of the curve" SWORD EGRVlv_DD_CM_DutyCycle__ 0 0 -100.0 100.0 ECU_ADDRESS 0x0000 /* @ECU_Address@EGRVlv_rCnvInHb_mp@ */ /end MEASUREMENT
/begin MEASUREMENT EGRVlv_rCnvHb_mp "Measurement point for output of the curve for single flow implementation" SWORD EGRVlv_DD_CM_DutyCycle__ 0 0 -100.0 100.0 ECU_ADDRESS 0x0000 /* @ECU_Address@EGRVlv_rCnvHb_mp@ */ /end MEASUREMENT
/begin MEASUREMENT EGRVlv_facCorFltHb_mp "Measurement point for battery correction factor for single flow implementation" SWORD EGRVlv_DD_CM_Fac_100_NaN 0 0 -32.0 31.9 ECU_ADDRESS 0x0000 /* @ECU_Address@EGRVlv_facCorFltHb_mp@ */ /end MEASUREMENT
/begin MEASUREMENT EGRVlv_rPsHb "Duty cycle to power stage" SWORD EGRVlv_DD_CM_DutyCycle__ 0 0 -100.0 100.0 ECU_ADDRESS 0x0000 /* @ECU_Address@EGRVlv_rPsHb@ */ /end MEASUREMENT
/begin MEASUREMENT EGRVlv_rCnvInPWM_mp "Measurement point for input of the curve" SWORD EGRVlv_DD_CM_DutyCycle__ 0 0 -100.0 100.0 ECU_ADDRESS 0x0000 /* @ECU_Address@EGRVlv_rCnvInPWM_mp@ */ /end MEASUREMENT
/begin MEASUREMENT EGRVlv_rCnvPWM_mp "Measurement point for output of the curve for single flow implementation" SWORD EGRVlv_DD_CM_DutyCycle__ 0 0 -100.0 100.0 ECU_ADDRESS 0x0000 /* @ECU_Address@EGRVlv_rCnvPWM_mp@ */ /end MEASUREMENT
/begin MEASUREMENT EGRVlv_facCorFltPWM_mp "Measurement point for battery correction factor for single flow implementation" SWORD EGRVlv_DD_CM_Fac_100_NaN 0 0 -32.0 31.9 ECU_ADDRESS 0x0000 /* @ECU_Address@EGRVlv_facCorFltPWM_mp@ */ /end MEASUREMENT
/begin MEASUREMENT EGRVlv_rPsPWM "Duty cycle to power stage" SWORD EGRVlv_DD_CM_DutyCycle__ 0 0 -100.0 100.0 ECU_ADDRESS 0x0000 /* @ECU_Address@EGRVlv_rPsPWM@ */ /end MEASUREMENT
/begin MEASUREMENT EGRVlv_rPs "Duty cycle to power stage" SWORD EGRVlv_DD_CM_DutyCycle__ 0 0 -100.0 100.0 ECU_ADDRESS 0x0000 /* @ECU_Address@EGRVlv_rPs@ */ /end MEASUREMENT
/begin MEASUREMENT EGRVlv_rPsNrmPWM "Normalized value of EGRVLv_rPSNrm" SWORD EGRVlv_DD_CM_DutyCycle__ 0 0 -100.0 100.0 ECU_ADDRESS 0x0000 /* @ECU_Address@EGRVlv_rPsNrmPWM@ */ /end MEASUREMENT
/begin MEASUREMENT EGRVlv_rPsNrmHb "Normalized value of EGRVLv_rPSNrm" SWORD EGRVlv_DD_CM_DutyCycle__ 0 0 -100.0 100.0 ECU_ADDRESS 0x0000 /* @ECU_Address@EGRVlv_rPsNrmHb@ */ /end MEASUREMENT
/begin MEASUREMENT EGRVlv_rPsNrm "Normalized value of EGRVLv_rPSNrm" SWORD EGRVlv_DD_CM_DutyCycle__ 0 0 -100.0 100.0 ECU_ADDRESS 0x0000 /* @ECU_Address@EGRVlv_rPsNrm@ */ /end MEASUREMENT
/begin COMPU_METHOD EGRVlv_DD_CM_DutyCycle__ "Q = V*200.000000" RAT_FUNC "%6.3" "%" COEFFS 0 200.000000 0.000000 0 0 1.000000 /end COMPU_METHOD
/begin COMPU_METHOD EGRVlv_DD_CM_ERPM_rpm "Q = V*2.000000" RAT_FUNC "%6.1" "rpm" COEFFS 0 2.000000 0.000000 0 0 1.000000 /end COMPU_METHOD
/begin COMPU_METHOD EGRVlv_DD_CM_Fac_100_NaN "Q = V*200.000000" RAT_FUNC "%6.3" "NaN" COEFFS 0 200.000000 0.000000 0 0 1.000000 /end COMPU_METHOD
/begin COMPU_METHOD EGRVlv_DD_CM_Period_us_us "Q = V*10.000000" RAT_FUNC "%5.1" "us" COEFFS 0 10.000000 0.000000 0 0 1.000000 /end COMPU_METHOD
/begin COMPU_METHOD EGRVlv_DD_CM_uint16_NaN "Q = V" RAT_FUNC "%5.0" "NaN" COEFFS 0 1 0 0 0 1 /end COMPU_METHOD
/begin COMPU_METHOD EGRVlv_DD_CM_boolean_NaN "Q = V" RAT_FUNC "%1.0" "NaN" COEFFS 0 1 0 0 0 1 /end COMPU_METHOD
/begin COMPU_METHOD EGRVlv_DD_CM_DutyCycle "Q = V*200.000000" RAT_FUNC "%6.3" "" COEFFS 0 200.000000 0.000000 0 0 1.000000 /end COMPU_METHOD
/begin COMPU_METHOD EGRVlv_DD_CM_Fac_100 "Q = V*200.000000" RAT_FUNC "%6.3" "" COEFFS 0 200.000000 0.000000 0 0 1.000000 /end COMPU_METHOD
/begin COMPU_METHOD EGRVlv_DD_CM_EngState "Enumerated data type: EngState" TAB_VERB "%0.6" "" /* Conversion Table */ COMPU_TAB_REF VTAB_FOR_EGRVlv_DD_CM_EngState /end COMPU_METHOD
/begin COMPU_VTAB /* Name of Table */ VTAB_FOR_EGRVlv_DD_CM_EngState "Enumerated data type: EngState" TAB_VERB /* Number of Elements */ 4 0 "EngState_STOPPED" 1 "EngState_CRANKING" 2 "EngState_RUNNING" 3 "EngState_STOPPING" /end COMPU_VTAB
/begin COMPU_METHOD EGRVlv_DD_CM_ERPM "Q = V*2.000000" RAT_FUNC "%6.1" "" COEFFS 0 2.000000 0.000000 0 0 1.000000 /end COMPU_METHOD
/begin COMPU_METHOD EGRVlv_DD_CM_State "Q = V" RAT_FUNC "%3.0" "" COEFFS 0 1 0 0 0 1 /end COMPU_METHOD
/begin GROUP EGRVlv_DD "EGRVlv_DD" /* Root */ ROOT /begin SUB_GROUP Root_Overview /end SUB_GROUP
 /begin REF_MEASUREMENT BattU_facCor CoEng_st DevLib_stPwrStgEnaCond EGRVlv_rEGR Epm_nEng /end REF_MEASUREMENT
/end GROUP
/begin GROUP Root_Overview "EGRVlv_DD/Overview" /begin SUB_GROUP S1_EGRVlv_DD /end SUB_GROUP /end GROUP
/begin GROUP S1_EGRVlv_DD "EGRVlv_DD/Overview/EGRVlv_DD"
 /begin SUB_GROUP S2_EGR_Valve_with_H_bridge_control S2_EGR_Valve_with_simple_PWM_control /end SUB_GROUP
 /begin REF_CHARACTERISTIC EGRVlv_swtHwSel_C EGRVlv_tiPs_C /end REF_CHARACTERISTIC
 /begin REF_MEASUREMENT EGRVlv_rPs EGRVlv_rPsNrm EGRVlv_tiPs /end REF_MEASUREMENT
/end GROUP
/begin GROUP S2_EGR_Valve_with_H_bridge_control "EGRVlv_DD/Overview/EGRVlv_DD/EGR Valve with H-bridge control" /begin SUB_GROUP S3_Battery_voltage_correction /end SUB_GROUP
 /begin REF_CHARACTERISTIC EGRVlv_rCnvHb_MAP EGRVlv_rCnvPsNrmHb_CUR EGRVlv_rPwmOutMax_C EGRVlv_rPwmOutMin_C EGRVlv_stPwrStgDiaDis_C EGRVlv_stPwrStgDis_C EGRVlv_swtPwmOutBattCor_C /end REF_CHARACTERISTIC
 /begin REF_MEASUREMENT EGRVlv_rCnvHb_mp EGRVlv_rCnvInHb_mp EGRVlv_rPsHb EGRVlv_rPsNrmHb /end REF_MEASUREMENT
/end GROUP
/begin GROUP S2_EGR_Valve_with_simple_PWM_control "EGRVlv_DD/Overview/EGRVlv_DD/EGR Valve with simple PWM control" /begin SUB_GROUP S4_Battery_voltage_correction /end SUB_GROUP
 /begin REF_CHARACTERISTIC EGRVlv_rCnvPWM_MAP EGRVlv_rCnvPsNrmPWM_CUR EGRVlv_rPwmOutMax_C EGRVlv_rPwmOutMin_C EGRVlv_stPwrStgDiaDis_C EGRVlv_stPwrStgDis_C EGRVlv_swtPwmOutBattCor_C /end REF_CHARACTERISTIC
 /begin REF_MEASUREMENT EGRVlv_rCnvInPWM_mp EGRVlv_rCnvPWM_mp EGRVlv_rPsNrmPWM EGRVlv_rPsPWM /end REF_MEASUREMENT
/end GROUP
/begin GROUP S3_Battery_voltage_correction "EGRVlv_DD/Overview/EGRVlv_DD/EGR Valve with H-bridge control/Battery voltage correction" /begin REF_CHARACTERISTIC EGRVlv_facBattCorFacFlt_C EGRVlv_facCorStrt_C /end REF_CHARACTERISTIC /begin REF_MEASUREMENT EGRVlv_facCorFltHb_mp /end REF_MEASUREMENT /end GROUP
/begin GROUP S4_Battery_voltage_correction "EGRVlv_DD/Overview/EGRVlv_DD/EGR Valve with simple PWM control/Battery voltage correction" /begin REF_CHARACTERISTIC EGRVlv_facBattCorFacFlt_C EGRVlv_facCorStrt_C /end REF_CHARACTERISTIC /begin REF_MEASUREMENT EGRVlv_facCorFltPWM_mp /end REF_MEASUREMENT /end GROUP
/end MODULE
/end PROJECT
/* (add any file trailer comments here) */
/* EOF EGRVlv_DD.a2l */
