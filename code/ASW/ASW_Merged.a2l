/******************************************************************************
* ASAP2 file: ASW.a2l
* Code generation for model "ASW".
* Model version : 6.4
* Simulink Coder version : 9.4 (R2020b) 29-Jul-2020
* C source code generated on : Mon Feb 1 14:32:51 2021
* Target selection: ert.tlc
* Embedded hardware selection: ARM Compatible->ARM Cortex
* Code generation objectives: Unspecified
* Validation result: Not run
* (add additional file header information here)
******************************************************************************/ ASAP2_VERSION 1 31
/* Version 1.31 */
/begin PROJECT ProjectName "Project Comment Goes Here"
/begin HEADER "Header Comments go here" /end HEADER
/begin MODULE ModuleName XCP_CAN_ECU
/begin IF_DATA XCPplus 0x0102
 /begin PAG 0x02 /end PAG
 /begin PGM PGM_MODE_ABSOLUTE 0x01 /* MAX_SECTORS */ 0x00 /* MAX_CTO_PGM */
  /begin SECTOR "Sector0" 0x00 /* SECTOR_NUMBER */ 0x00380000 /* address */ 0x00020000 /* length */ 0x00 /* Erase number */ 0x00 /* Program number */ 0x00 /* Programming method */ /end SECTOR
 /end PGM
 /begin XCP_ON_CAN 0x0102 CAN_ID_MASTER 0x0201 CAN_ID_SLAVE 0x0200 BAUDRATE 0x07A120 SAMPLE_POINT 0x4B SAMPLE_RATE SINGLE BTL_CYCLES 0x08 SJW 0x02 SYNC_EDGE SINGLE MAX_BUS_LOAD 100 /* maximum available bus */
  /begin PROTOCOL_LAYER 0x0102 /* XCP protocol layer version */ 5000 /* T1 [ms] */ 5000 /* T2 [ms] */ 0 /* T3 [ms] */ 0 /* T4 [ms] */ 0 /* T5 [ms] */ 0 /* T6 [ms] */ 0 /* T7 [ms] */ 8 /* MAX_CTO */ 8 /* MAX_DTO default for DAQ and STIM */ BYTE_ORDER_MSB_FIRST /* BYTE_ORDER: MOTOROLA */ ADDRESS_GRANULARITY_BYTE /* ADDRESS_GRANULARITY */ OPTIONAL_CMD GET_COMM_MODE_INFO OPTIONAL_CMD SET_MTA OPTIONAL_CMD UPLOAD OPTIONAL_CMD SHORT_UPLOAD OPTIONAL_CMD BUILD_CHECKSUM OPTIONAL_CMD DOWNLOAD OPTIONAL_CMD DOWNLOAD_NEXT OPTIONAL_CMD DOWNLOAD_MAX OPTIONAL_CMD SET_CAL_PAGE OPTIONAL_CMD GET_CAL_PAGE OPTIONAL_CMD COPY_CAL_PAGE OPTIONAL_CMD CLEAR_DAQ_LIST OPTIONAL_CMD SET_DAQ_PTR OPTIONAL_CMD WRITE_DAQ OPTIONAL_CMD SET_DAQ_LIST_MODE OPTIONAL_CMD START_STOP_DAQ_LIST OPTIONAL_CMD START_STOP_SYNCH OPTIONAL_CMD FREE_DAQ OPTIONAL_CMD ALLOC_DAQ OPTIONAL_CMD ALLOC_ODT OPTIONAL_CMD ALLOC_ODT_ENTRY /end PROTOCOL_LAYER
  /begin DAQ /* DAQ supported, at MODULE*/ DYNAMIC /* DAQ_CONFIG_TYPE */ 1024 /* MAX_DAQ */ 3 /* MAX_EVENT_CHANNEL */ 0 /* MIN_DAQ */ OPTIMISATION_TYPE_DEFAULT /* OPTIMISATION_TYPE */ ADDRESS_EXTENSION_FREE IDENTIFICATION_FIELD_TYPE_ABSOLUTE /* IDENTIFICATION_FIELD */ GRANULARITY_ODT_ENTRY_SIZE_DAQ_BYTE /* GRANULARITY_ODT_ENTRY_SIZE_DAQ */ 255 /* MAX_ODT_ENTRY_SIZE_DAQ */ OVERLOAD_INDICATION_EVENT /* OVERLOAD_INDICATION */ PRESCALER_SUPPORTED CPU_LOAD_MAX_TOTAL 0.1
   /begin DAQ_MEMORY_CONSUMPTION 2048 /* DAQ_MEMORY_LIMIT: in Elements[AG] */ 62 /* DAQ_SIZE: number of elements[AG] per DAQ list */ 8 /* ODT_SIZE: number of elements[AG] per ODT */ 7 /* ODT_ENTRY_SIZE: number of elements[AG] per ODT_entry */ 2 /* ODT_DAQ_BUFFER_ELEMENT_SIZE: number of */ /* payload elements[AG]*factor = sizeof(send buffer)[AG] */ 0 /* ODT_STIM_BUFFER_ELEMENT_SIZE: number of */ /* payload elements[AG]*factor = sizeof(receive buffer)[AG] */ /end DAQ_MEMORY_CONSUMPTION
   /begin EVENT "Task_10ms" /* EVENT_CHANNEL_NAME */ "Task_10ms" /* EVENT_CHANNEL_SHORT_NAME */ 0x00 /* EVENT_CHANNEL_NUMBER */ DAQ 0x20 /* MAX_DAQ_LIST */ 0x0a /* EVENT_CHANNEL_TIME_CYCLE */ 0x06 /* EVENT_CHANNEL_TIME_UNIT */ 0x07 /* EVENT_CHANNEL_PRIORITY */ CONSISTENCY EVENT /end EVENT
   /begin EVENT "Task_20ms" "Task_20ms" 0x01 DAQ 0x40 0x14 0x06 0x06 CONSISTENCY EVENT /end EVENT
   /begin EVENT "Task_100ms" "Task_100ms" 0x02 DAQ 0x01 0x64 0x06 0x05 CONSISTENCY EVENT /end EVENT
  /end DAQ
 /end XCP_ON_CAN
/end IF_DATA
/begin MOD_PAR "MOD PAR Comment Goes Here"
 /begin MEMORY_SEGMENT CaliRAM "Calibration data" DATA FLASH INTERN 0x00380000 0x00020000 -1 -1 -1 -1 -1
  /begin IF_DATA XCPplus 0x0102
   /begin SEGMENT 0x00 0x02 0x00 0x00 0x00
    /begin PAGE 0x00 ECU_ACCESS_DONT_CARE XCP_READ_ACCESS_DONT_CARE XCP_WRITE_ACCESS_NOT_ALLOWED /end PAGE
    /begin PAGE 0x01 ECU_ACCESS_DONT_CARE XCP_READ_ACCESS_DONT_CARE XCP_WRITE_ACCESS_DONT_CARE /end PAGE
   /end SEGMENT
  /end IF_DATA
 /end MEMORY_SEGMENT
 /begin MEMORY_SEGMENT CODE_FLASH_major "CODE major" CODE FLASH INTERN 0x00020000 0x000E0000 -1 -1 -1 -1 -1
  /begin IF_DATA XCPplus 0x0102
   /begin SEGMENT 0x00 0x02 0x00 0x00 0x00
    /begin PAGE 0x00 ECU_ACCESS_DONT_CARE XCP_READ_ACCESS_WITH_ECU_ONLY XCP_WRITE_ACCESS_NOT_ALLOWED /end PAGE
    /begin PAGE 0x01 ECU_ACCESS_DONT_CARE XCP_READ_ACCESS_DONT_CARE XCP_WRITE_ACCESS_WITH_ECU_ONLY /end PAGE
   /end SEGMENT
  /end IF_DATA
 /end MEMORY_SEGMENT
 /begin MEMORY_SEGMENT CODE_FLASH_minor "CODE minor " CODE FLASH INTERN 0x0017FF00 0x00000100 -1 -1 -1 -1 -1
  /begin IF_DATA XCPplus 0x0102
   /begin SEGMENT 0x00 0x02 0x00 0x00 0x00
    /begin PAGE 0x00 ECU_ACCESS_DONT_CARE XCP_READ_ACCESS_WITH_ECU_ONLY XCP_WRITE_ACCESS_NOT_ALLOWED /end PAGE
    /begin PAGE 0x01 ECU_ACCESS_DONT_CARE XCP_READ_ACCESS_DONT_CARE XCP_WRITE_ACCESS_WITH_ECU_ONLY /end PAGE
   /end SEGMENT
  /end IF_DATA
 /end MEMORY_SEGMENT
/end MOD_PAR
/begin MOD_COMMON "Mod Common Comment Here" BYTE_ORDER MSB_LAST /end MOD_COMMON
/begin RECORD_LAYOUT Scalar_BOOLEAN FNC_VALUES 1 UBYTE COLUMN_DIR DIRECT /end RECORD_LAYOUT
/begin RECORD_LAYOUT Scalar_UBYTE FNC_VALUES 1 UBYTE COLUMN_DIR DIRECT /end RECORD_LAYOUT
/begin RECORD_LAYOUT Scalar_BYTE FNC_VALUES 1 SBYTE COLUMN_DIR DIRECT /end RECORD_LAYOUT
/begin RECORD_LAYOUT Scalar_UWORD FNC_VALUES 1 UWORD COLUMN_DIR DIRECT /end RECORD_LAYOUT
/begin RECORD_LAYOUT Scalar_SWORD FNC_VALUES 1 SWORD COLUMN_DIR DIRECT /end RECORD_LAYOUT
/begin RECORD_LAYOUT Scalar_ULONG FNC_VALUES 1 ULONG COLUMN_DIR DIRECT /end RECORD_LAYOUT
/begin RECORD_LAYOUT Scalar_LONG FNC_VALUES 1 SLONG COLUMN_DIR DIRECT /end RECORD_LAYOUT
/begin RECORD_LAYOUT Scalar_FLOAT32_IEEE FNC_VALUES 1 FLOAT32_IEEE COLUMN_DIR DIRECT /end RECORD_LAYOUT
/begin RECORD_LAYOUT Scalar_FLOAT64_IEEE FNC_VALUES 1 FLOAT64_IEEE COLUMN_DIR DIRECT /end RECORD_LAYOUT
/begin RECORD_LAYOUT Lookup1D_BOOLEAN FNC_VALUES 1 UBYTE COLUMN_DIR DIRECT /end RECORD_LAYOUT
/begin RECORD_LAYOUT Lookup1D_X_BOOLEAN AXIS_PTS_X 1 UBYTE INDEX_INCR DIRECT /end RECORD_LAYOUT
/begin RECORD_LAYOUT Lookup1D_BYTE FNC_VALUES 1 SBYTE COLUMN_DIR DIRECT /end RECORD_LAYOUT
/begin RECORD_LAYOUT Lookup1D_X_BYTE AXIS_PTS_X 1 SBYTE INDEX_INCR DIRECT /end RECORD_LAYOUT
/begin RECORD_LAYOUT Lookup1D_UBYTE FNC_VALUES 1 UBYTE COLUMN_DIR DIRECT /end RECORD_LAYOUT
/begin RECORD_LAYOUT Lookup1D_X_UBYTE AXIS_PTS_X 1 UBYTE INDEX_INCR DIRECT /end RECORD_LAYOUT
/begin RECORD_LAYOUT Lookup1D_UWORD FNC_VALUES 1 UWORD COLUMN_DIR DIRECT /end RECORD_LAYOUT
/begin RECORD_LAYOUT Lookup1D_X_UWORD AXIS_PTS_X 1 UWORD INDEX_INCR DIRECT /end RECORD_LAYOUT
/begin RECORD_LAYOUT Lookup1D_WORD FNC_VALUES 1 SWORD COLUMN_DIR DIRECT /end RECORD_LAYOUT
/begin RECORD_LAYOUT Lookup1D_X_WORD AXIS_PTS_X 1 SWORD INDEX_INCR DIRECT /end RECORD_LAYOUT
/begin RECORD_LAYOUT Lookup1D_ULONG FNC_VALUES 1 ULONG COLUMN_DIR DIRECT /end RECORD_LAYOUT
/begin RECORD_LAYOUT Lookup1D_X_ULONG AXIS_PTS_X 1 ULONG INDEX_INCR DIRECT /end RECORD_LAYOUT
/begin RECORD_LAYOUT Lookup1D_SLONG FNC_VALUES 1 SLONG COLUMN_DIR DIRECT /end RECORD_LAYOUT
/begin RECORD_LAYOUT Lookup1D_X_LONG AXIS_PTS_X 1 SLONG INDEX_INCR DIRECT /end RECORD_LAYOUT
/begin RECORD_LAYOUT Lookup1D_FLOAT32_IEEE FNC_VALUES 1 FLOAT32_IEEE COLUMN_DIR DIRECT /end RECORD_LAYOUT
/begin RECORD_LAYOUT Lookup1D_X_FLOAT32_IEEE AXIS_PTS_X 1 FLOAT32_IEEE INDEX_INCR DIRECT /end RECORD_LAYOUT
/begin RECORD_LAYOUT Lookup1D_FLOAT64_IEEE FNC_VALUES 1 FLOAT64_IEEE COLUMN_DIR DIRECT /end RECORD_LAYOUT
/begin RECORD_LAYOUT Lookup1D_X_FLOAT64_IEEE AXIS_PTS_X 1 FLOAT64_IEEE INDEX_INCR DIRECT /end RECORD_LAYOUT
/begin RECORD_LAYOUT Lookup2D_BOOLEAN FNC_VALUES 1 UBYTE COLUMN_DIR DIRECT /end RECORD_LAYOUT
/begin RECORD_LAYOUT Lookup2D_X_BOOLEAN AXIS_PTS_X 1 UBYTE INDEX_INCR DIRECT /end RECORD_LAYOUT
/begin RECORD_LAYOUT Lookup2D_UBYTE FNC_VALUES 1 UBYTE COLUMN_DIR DIRECT /end RECORD_LAYOUT
/begin RECORD_LAYOUT Lookup2D_X_UBYTE AXIS_PTS_X 1 UBYTE INDEX_INCR DIRECT /end RECORD_LAYOUT
/begin RECORD_LAYOUT Lookup2D_BYTE FNC_VALUES 1 SBYTE COLUMN_DIR DIRECT /end RECORD_LAYOUT
/begin RECORD_LAYOUT Lookup2D_X_BYTE AXIS_PTS_X 1 SBYTE INDEX_INCR DIRECT /end RECORD_LAYOUT
/begin RECORD_LAYOUT Lookup2D_UWORD FNC_VALUES 1 UWORD COLUMN_DIR DIRECT /end RECORD_LAYOUT
/begin RECORD_LAYOUT Lookup2D_X_UWORD AXIS_PTS_X 1 UWORD INDEX_INCR DIRECT /end RECORD_LAYOUT
/begin RECORD_LAYOUT Lookup2D_WORD FNC_VALUES 1 SWORD COLUMN_DIR DIRECT /end RECORD_LAYOUT
/begin RECORD_LAYOUT Lookup2D_X_WORD AXIS_PTS_X 1 SWORD INDEX_INCR DIRECT /end RECORD_LAYOUT
/begin RECORD_LAYOUT Lookup2D_ULONG FNC_VALUES 1 ULONG COLUMN_DIR DIRECT /end RECORD_LAYOUT
/begin RECORD_LAYOUT Lookup2D_X_ULONG AXIS_PTS_X 1 ULONG INDEX_INCR DIRECT /end RECORD_LAYOUT
/begin RECORD_LAYOUT Lookup2D_LONG FNC_VALUES 1 SLONG COLUMN_DIR DIRECT /end RECORD_LAYOUT
/begin RECORD_LAYOUT Lookup2D_X_LONG AXIS_PTS_X 1 SLONG INDEX_INCR DIRECT /end RECORD_LAYOUT
/begin RECORD_LAYOUT Lookup2D_FLOAT32_IEEE FNC_VALUES 1 FLOAT32_IEEE COLUMN_DIR DIRECT /end RECORD_LAYOUT
/begin RECORD_LAYOUT Lookup2D_X_FLOAT32_IEEE AXIS_PTS_X 1 FLOAT32_IEEE INDEX_INCR DIRECT /end RECORD_LAYOUT
/begin RECORD_LAYOUT Lookup2D_FLOAT64_IEEE FNC_VALUES 1 FLOAT64_IEEE COLUMN_DIR DIRECT /end RECORD_LAYOUT
/begin RECORD_LAYOUT Lookup2D_X_FLOAT64_IEEE AXIS_PTS_X 1 FLOAT64_IEEE INDEX_INCR DIRECT /end RECORD_LAYOUT
/begin CHARACTERISTIC CEngDsT_tTransf_CUR "Transformation curve to convert the voltage value to temperature value" CURVE 0x0000 /* @ECU_Address@CEngDsT_tTransf_CUR@ */ Lookup1D_WORD 0 CEngDsT_DD_CM_Temp_C_deg -50.0 150.0
 /begin AXIS_DESCR COM_AXIS CEngDsT_uRaw CEngDsT_DD_CM_Volt_mV2_mv 26 0.0 5000.0 AXIS_PTS_REF CEngDsT_tTransf_CURX /end AXIS_DESCR
/end CHARACTERISTIC
/begin CHARACTERISTIC CEngDsT_tiMaxDefDeb_C "Debounc time for checking heal of DFC_CEngDsTSRCMax" VALUE 0x0000 /* @ECU_Address@CEngDsT_tiMaxDefDeb_C@ */ Scalar_UWORD 0 CEngDsT_DD_CM_Debncd_ms_ms 0.0 655.0 /end CHARACTERISTIC
/begin CHARACTERISTIC CEngDsT_tiMaxOKDeb_C "Debounc time for checking heal of DFC_CEngDsTSRCMax" VALUE 0x0000 /* @ECU_Address@CEngDsT_tiMaxOKDeb_C@ */ Scalar_UWORD 0 CEngDsT_DD_CM_Debncd_ms_ms 0.0 655.0 /end CHARACTERISTIC
/begin CHARACTERISTIC CEngDsT_tiMinDefDeb_C "Debounc time for checking heal of DFC_CEngDsTSRCMin" VALUE 0x0000 /* @ECU_Address@CEngDsT_tiMinDefDeb_C@ */ Scalar_UWORD 0 CEngDsT_DD_CM_Debncd_ms_ms 0.0 655.0 /end CHARACTERISTIC
/begin CHARACTERISTIC CEngDsT_tiMinOKDeb_C "Debounc time for checking heal of DFC_CEngDsTSRCMin" VALUE 0x0000 /* @ECU_Address@CEngDsT_tiMinOKDeb_C@ */ Scalar_UWORD 0 CEngDsT_DD_CM_Debncd_ms_ms 0.0 655.0 /end CHARACTERISTIC
/begin CHARACTERISTIC CEngDsT_tiPhysRngHiDefDeb_C "Debounc time for checking heal of DFC_CEngDsTPhysRngHi" VALUE 0x0000 /* @ECU_Address@CEngDsT_tiPhysRngHiDefDeb_C@ */ Scalar_UWORD 0 CEngDsT_DD_CM_Debncd_ms_ms 0.0 655.0 /end CHARACTERISTIC
/begin CHARACTERISTIC CEngDsT_tiPhysRngHiOKDeb_C "Debounc time for checking heal of DFC_CEngDsTPhysRngHi" VALUE 0x0000 /* @ECU_Address@CEngDsT_tiPhysRngHiOKDeb_C@ */ Scalar_UWORD 0 CEngDsT_DD_CM_Debncd_ms_ms 0.0 655.0 /end CHARACTERISTIC
/begin CHARACTERISTIC CEngDsT_tiPhysRngLoDefDeb_C "Debounc time for checking heal of DFC_CEngDsTPhysRngLo" VALUE 0x0000 /* @ECU_Address@CEngDsT_tiPhysRngLoDefDeb_C@ */ Scalar_UWORD 0 CEngDsT_DD_CM_Debncd_ms_ms 0.0 655.0 /end CHARACTERISTIC
/begin CHARACTERISTIC CEngDsT_tiPhysRngLoOKDeb_C "Debounc time for checking heal of DFC_CEngDsTPhysRngLo" VALUE 0x0000 /* @ECU_Address@CEngDsT_tiPhysRngLoOKDeb_C@ */ Scalar_UWORD 0 CEngDsT_DD_CM_Debncd_ms_ms 0.0 655.0 /end CHARACTERISTIC
/begin CHARACTERISTIC FM_CEngDsT_SRC_FG_CA "故障组，元素为故障ID" VAL_BLK 0x0000 /* @ECU_Address@FM_CEngDsT_SRC_FG_CA@ */ Scalar_UWORD 0 CEngDsT_DD_CM_Fault_ID_NaN 0.0 65535.0 NUMBER 10 /end CHARACTERISTIC
/begin CHARACTERISTIC CEngDsT_MaxCoolTemp "Maxmium Coolant Temperature" VALUE 0x0000 /* @ECU_Address@CEngDsT_MaxCoolTemp@ */ Scalar_SWORD 0 CEngDsT_DD_CM_Temp_C_deg -2048.0 2047.9375 /end CHARACTERISTIC
/begin CHARACTERISTIC CEngDsT_MinCoolTemp "Minmium Coolant Temperature" VALUE 0x0000 /* @ECU_Address@CEngDsT_MinCoolTemp@ */ Scalar_SWORD 0 CEngDsT_DD_CM_Temp_C_deg -2048.0 2047.9375 /end CHARACTERISTIC
/begin CHARACTERISTIC CEngDsT_uSRCMax_C "Signal Range Check / Threshold for SRC -Max detection" VALUE 0x0000 /* @ECU_Address@CEngDsT_uSRCMax_C@ */ Scalar_SWORD 0 CEngDsT_DD_CM_Volt_mV2_mv 0.0 5000.0 /end CHARACTERISTIC
/begin CHARACTERISTIC CEngDsT_uSRCMin_C "Signal Range Check / Threshold for SRC -Min detection" VALUE 0x0000 /* @ECU_Address@CEngDsT_uSRCMin_C@ */ Scalar_SWORD 0 CEngDsT_DD_CM_Volt_mV2_mv 0.0 5000.0 /end CHARACTERISTIC
/begin AXIS_PTS CEngDsT_tTransf_CURX "Transformation aixs to convert the voltage value to temperature value" 0x0000 /* @ECU_Address@CEngDsT_tTransf_CURX@ */ CEngDsT_uRaw Lookup1D_X_WORD 0 CEngDsT_DD_CM_Volt_mV2_mv 26 0.0 5000.0 /end AXIS_PTS
/begin CHARACTERISTIC SigTst_swtCEngDsT_C "Switch for coolent temperature by hand" VALUE 0x0000 /* @ECU_Address@SigTst_swtCEngDsT_C@ */ Scalar_LONG 0 CEngDsT_VD_CM_Switch_NaN 0 1 /end CHARACTERISTIC
/begin CHARACTERISTIC CEngDsT_facSerPT1_C "Time constant of PT1 filter for coolent Down streem temperature" VALUE 0x0000 /* @ECU_Address@CEngDsT_facSerPT1_C@ */ Scalar_UWORD 0 CEngDsT_VD_CM_Fac100_NaN 0.0 99.9985 /end CHARACTERISTIC
/begin CHARACTERISTIC CEngDsT_tDflWarm_C "Default downstream engine coolant temperature value for warm engine conditions" VALUE 0x0000 /* @ECU_Address@CEngDsT_tDflWarm_C@ */ Scalar_SWORD 0 CEngDsT_VD_CM_Temp_C_deg -200.0 200.0 /end CHARACTERISTIC
/begin CHARACTERISTIC SigTst_tCEngDsT_C "Set coolent temperature by hand" VALUE 0x0000 /* @ECU_Address@SigTst_tCEngDsT_C@ */ Scalar_SWORD 0 CEngDsT_VD_CM_Temp_C_deg -200.0 200.0 /end CHARACTERISTIC
/begin CHARACTERISTIC CEngDsT_RmpSlpNeg_C "Parameter for Ramp 1 / negative ramp slope" VALUE 0x0000 /* @ECU_Address@CEngDsT_RmpSlpNeg_C@ */ Scalar_UWORD 0 CEngDsT_VD_CM_uint16_ms 0.0 200.0 /end CHARACTERISTIC
/begin CHARACTERISTIC CEngDsT_RmpSlpPos_C "Parameter for Ramp 1 / Slope if the ramp has to be increased" VALUE 0x0000 /* @ECU_Address@CEngDsT_RmpSlpPos_C@ */ Scalar_UWORD 0 CEngDsT_VD_CM_uint16_ms 0.0 200.0 /end CHARACTERISTIC
/begin CHARACTERISTIC PhyMod_trq2qBas_MAP "Engine basic map for conversion of torque/quantity" MAP 0x0000 /* @ECU_Address@PhyMod_trq2qBas_MAP@ */ Lookup2D_WORD 0 CnvSet_Trq2Q_CM_InjMass_mg_hub -319.0 319.0
 /begin AXIS_DESCR COM_AXIS Epm_nEng CnvSet_Trq2Q_CM_ERPM_rpm 16 -12000.0 12000.0 AXIS_PTS_REF PhyMod_trq2qBas_MAPX /end AXIS_DESCR
 /begin AXIS_DESCR COM_AXIS PthSet_trqInrSet CnvSet_Trq2Q_CM_Torq_Nm 16 -3276.8 3276.7 AXIS_PTS_REF PhyMod_trq2qBas_MAPY /end AXIS_DESCR
/end CHARACTERISTIC
/begin AXIS_PTS PhyMod_trq2qBas_MAPY "AxisY of the MAP" 0x0000 /* @ECU_Address@PhyMod_trq2qBas_MAPY@ */ PthSet_trqInrSet Lookup2D_X_WORD 0 CnvSet_Trq2Q_CM_Torq_Nm 16 -3276.8 3276.7 /end AXIS_PTS
/begin AXIS_PTS PhyMod_trq2qBas_MAPX "AxisX of the MAP" 0x0000 /* @ECU_Address@PhyMod_trq2qBas_MAPX@ */ Epm_nEng Lookup2D_X_WORD 0 CnvSet_Trq2Q_CM_ERPM_rpm 16 -12000.0 12000.0 /end AXIS_PTS
/begin CHARACTERISTIC RailP_pLin_CUR "Linearisation curve for fuel pressure sensor" CURVE 0x0000 /* @ECU_Address@RailP_pLin_CUR@ */ Lookup1D_WORD 0 RailP_DD_CM_Press_bar1_bar 0.0 2000.0
 /begin AXIS_DESCR COM_AXIS RailP_uRaw RailP_DD_CM_Volt_mV1_mv 4 0.0 5000.0 AXIS_PTS_REF RailP_pLin_CURX /end AXIS_DESCR
/end CHARACTERISTIC
/begin CHARACTERISTIC RailP_tiSRCMaxDefDeb_C "Debounce time for checking defect of RailP_bSRCMaxDeb" VALUE 0x0000 /* @ECU_Address@RailP_tiSRCMaxDefDeb_C@ */ Scalar_UWORD 0 RailP_DD_CM_Debncd_ms_ms 0.0 1000.0 /end CHARACTERISTIC
/begin CHARACTERISTIC RailP_tiSRCMaxOKDeb_C "Debounce time for checking heal of RailP_bSRCMaxDeb" VALUE 0x0000 /* @ECU_Address@RailP_tiSRCMaxOKDeb_C@ */ Scalar_UWORD 0 RailP_DD_CM_Debncd_ms_ms 0.0 1000.0 /end CHARACTERISTIC
/begin CHARACTERISTIC RailP_tiSRCMinDefDeb_C "Debounce time for checking defect of RailP_bSRCMinDeb" VALUE 0x0000 /* @ECU_Address@RailP_tiSRCMinDefDeb_C@ */ Scalar_UWORD 0 RailP_DD_CM_Debncd_ms_ms 0.0 1000.0 /end CHARACTERISTIC
/begin CHARACTERISTIC RailP_tiSRCMinOKDeb_C "Debounce time for checking heal of RailP_bSRCMinDeb" VALUE 0x0000 /* @ECU_Address@RailP_tiSRCMinOKDeb_C@ */ Scalar_UWORD 0 RailP_DD_CM_Debncd_ms_ms 0.0 1000.0 /end CHARACTERISTIC
/begin CHARACTERISTIC RailP_uSRCMax_C "Threshold for SRC -Max detection" VALUE 0x0000 /* @ECU_Address@RailP_uSRCMax_C@ */ Scalar_SWORD 0 RailP_DD_CM_Volt_mV1_mv 0.0 5000.0 /end CHARACTERISTIC
/begin CHARACTERISTIC RailP_uSRCMin_C "Threshold for SRC -Min detection" VALUE 0x0000 /* @ECU_Address@RailP_uSRCMin_C@ */ Scalar_SWORD 0 RailP_DD_CM_Volt_mV1_mv 0.0 5000.0 /end CHARACTERISTIC
/begin AXIS_PTS RailP_pLin_CURX "RailP_uRaw" 0x0000 /* @ECU_Address@RailP_pLin_CURX@ */ RailP_uRaw Lookup1D_X_WORD 0 RailP_DD_CM_Volt_mV1_mv 4 0.0 5000.0 /end AXIS_PTS
/begin CHARACTERISTIC RailP_pFltWinNeg_CUR "Rail pressure decrease from which the system switches to the large signal parameter" CURVE 0x0000 /* @ECU_Address@RailP_pFltWinNeg_CUR@ */ Lookup1D_WORD 0 RailP_VD_CM_Press_bar1_bar 0.0 2000.0
 /begin AXIS_DESCR COM_AXIS InjCtl_qSetUnBal RailP_VD_CM_InjMass_mg_hub 10 -300.0 300.0 AXIS_PTS_REF RailP_pFltWinNeg_CURX /end AXIS_DESCR
/end CHARACTERISTIC
/begin CHARACTERISTIC RailP_facFlt1PT1_C "PT1 filter parameter for increasing rail pressure" VALUE 0x0000 /* @ECU_Address@RailP_facFlt1PT1_C@ */ Scalar_SWORD 0 RailP_VD_CM_Fac_100_NaN 0.0 99.9985 /end CHARACTERISTIC
/begin CHARACTERISTIC RailP_facFlt2PT1_C "PT1 filter parameter for decreasing rail pressure (small signal behaviour)" VALUE 0x0000 /* @ECU_Address@RailP_facFlt2PT1_C@ */ Scalar_SWORD 0 RailP_VD_CM_Fac_100_NaN 0.0 99.9985 /end CHARACTERISTIC
/begin CHARACTERISTIC RailP_facFlt3PT1_C "PT1 filter parameter for severely decreasing rail pressure (large signal behaviour)" VALUE 0x0000 /* @ECU_Address@RailP_facFlt3PT1_C@ */ Scalar_SWORD 0 RailP_VD_CM_Fac_100_NaN 0.0 99.9985 /end CHARACTERISTIC
/begin AXIS_PTS RailP_pFltWinNeg_CURX "InjCtl_qSetUnBal" 0x0000 /* @ECU_Address@RailP_pFltWinNeg_CURX@ */ InjCtl_qSetUnBal Lookup1D_X_WORD 0 RailP_VD_CM_InjMass_mg_hub 10 -300.0 300.0 /end AXIS_PTS
/begin CHARACTERISTIC InjVlv_tiET_MAP "Map for converting from injection quantity to energizing time,Applies to all injections" MAP 0x0000 /* @ECU_Address@InjVlv_tiET_MAP@ */ Lookup2D_LONG 0 InjVlv_CalcET_CM_uSec4_us -13107.0 13106.0
 /begin AXIS_DESCR COM_AXIS InjCrv_qMI1Des InjVlv_CalcET_CM_InjMass_mg_hub 20 -319.0 319.0 AXIS_PTS_REF InjVlv_tiET_MAPX /end AXIS_DESCR
 /begin AXIS_DESCR COM_AXIS RailP_pFlt InjVlv_CalcET_CM_Press_bar1_bar 16 0.0 2000.0 AXIS_PTS_REF InjVlv_tiET_MAPY /end AXIS_DESCR
/end CHARACTERISTIC
/begin CHARACTERISTIC SigTst_swtMI1ET_C "Switch for Set Value of energizing time for MI1" VALUE 0x0000 /* @ECU_Address@SigTst_swtMI1ET_C@ */ Scalar_LONG 0 InjVlv_CalcET_CM_Switch_NaN 0 1 /end CHARACTERISTIC
/begin CHARACTERISTIC SigTst_tiMI1ET_C "Set Value of energizing time for MI1" VALUE 0x0000 /* @ECU_Address@SigTst_tiMI1ET_C@ */ Scalar_LONG 0 InjVlv_CalcET_CM_uSec4_us -13107.0 13106.0 /end CHARACTERISTIC
/begin AXIS_PTS InjVlv_tiET_MAPY "Map for converting from injection quantity to energizing time,Applies to all injections" 0x0000 /* @ECU_Address@InjVlv_tiET_MAPY@ */ RailP_pFlt Lookup2D_X_WORD 0 InjVlv_CalcET_CM_Press_bar1_bar 16 0.0 2000.0 /end AXIS_PTS
/begin AXIS_PTS InjVlv_tiET_MAPX "Map for converting from injection quantity to energizing time,Applies to all injections" 0x0000 /* @ECU_Address@InjVlv_tiET_MAPX@ */ InjCrv_qMI1Des Lookup2D_X_WORD 0 InjVlv_CalcET_CM_InjMass_mg_hub 20 -319.0 319.0 /end AXIS_PTS
/begin CHARACTERISTIC SigTst_swtMI1Q_C "signal test switch" VALUE 0x0000 /* @ECU_Address@SigTst_swtMI1Q_C@ */ Scalar_LONG 0 InjCrv_MI1_CM_Switch_NaN 0 1 /end CHARACTERISTIC
/begin CHARACTERISTIC SigTst_qMI1_C "signal test Replacement value" VALUE 0x0000 /* @ECU_Address@SigTst_qMI1_C@ */ Scalar_SWORD 0 InjCrv_MI1_CM_InjMass_mg_hub -300.0 319.0 /end CHARACTERISTIC
/begin CHARACTERISTIC T15_tiDebHiLo_C "Debounce time terminal15-signal from low to high" VALUE 0x0000 /* @ECU_Address@T15_tiDebHiLo_C@ */ Scalar_UWORD 0 T15_DD_CM_Debncd_ms_ms 0.0 1000.0 /end CHARACTERISTIC
/begin CHARACTERISTIC T15_tiDebLoHi_C "Debounce time terminal15-signal from high to low" VALUE 0x0000 /* @ECU_Address@T15_tiDebLoHi_C@ */ Scalar_UWORD 0 T15_DD_CM_Debncd_ms_ms 0.0 1000.0 /end CHARACTERISTIC
/begin CHARACTERISTIC T15_uThreshold_C "T15 voltage threshold" VALUE 0x0000 /* @ECU_Address@T15_uThreshold_C@ */ Scalar_SWORD 0 T15_DD_CM_Volt_mV1_mv 0.0 5000.0 /end CHARACTERISTIC
/begin CHARACTERISTIC APP_swtAliveDetEna_C "Switch to enable alive detection" VALUE 0x0000 /* @ECU_Address@APP_swtAliveDetEna_C@ */ Scalar_LONG 0 APP_ChkSig_CM_Switch_NaN 0 1 /end CHARACTERISTIC
/begin CHARACTERISTIC APP_tiAliveDebHiLo_C "Debounce times for alive detection of APP / Time for a High to Low transition" VALUE 0x0000 /* @ECU_Address@APP_tiAliveDebHiLo_C@ */ Scalar_UWORD 0 APP_ChkSig_CM_Debncd_ms_ms 0.0 1000.0 /end CHARACTERISTIC
/begin CHARACTERISTIC APP_tiAliveDebLoHi_C "Debounce times for alive detection of APP / Time for a Low to High transition" VALUE 0x0000 /* @ECU_Address@APP_tiAliveDebLoHi_C@ */ Scalar_UWORD 0 APP_ChkSig_CM_Debncd_ms_ms 0.0 1000.0 /end CHARACTERISTIC
/begin CHARACTERISTIC APP_rThresAliveDet_C "APP threshold for alive detection" VALUE 0x0000 /* @ECU_Address@APP_rThresAliveDet_C@ */ Scalar_SWORD 0 APP_ChkSig_CM_Percent__ 0.0 100.0 /end CHARACTERISTIC
/begin CHARACTERISTIC APP_tiSRCHighDefDeb_C "debounce time" VALUE 0x0000 /* @ECU_Address@APP_tiSRCHighDefDeb_C@ */ Scalar_UWORD 0 APP_DD1_CM_Debncd_ms_ms 0.0 1000.0 /end CHARACTERISTIC
/begin CHARACTERISTIC APP_tiSRCHighOKDeb_C "debounce time" VALUE 0x0000 /* @ECU_Address@APP_tiSRCHighOKDeb_C@ */ Scalar_UWORD 0 APP_DD1_CM_Debncd_ms_ms 0.0 1000.0 /end CHARACTERISTIC
/begin CHARACTERISTIC APP_tiSRCLowDefDeb_C "debounce time" VALUE 0x0000 /* @ECU_Address@APP_tiSRCLowDefDeb_C@ */ Scalar_UWORD 0 APP_DD1_CM_Debncd_ms_ms 0.0 1000.0 /end CHARACTERISTIC
/begin CHARACTERISTIC APP_tiSRCLowOKDeb_C "debounce time" VALUE 0x0000 /* @ECU_Address@APP_tiSRCLowOKDeb_C@ */ Scalar_UWORD 0 APP_DD1_CM_Debncd_ms_ms 0.0 1000.0 /end CHARACTERISTIC
/begin CHARACTERISTIC FM_APP1_SRC_FG_CA "Fault Group" VAL_BLK 0x0000 /* @ECU_Address@FM_APP1_SRC_FG_CA@ */ Scalar_UWORD 0 APP_DD1_CM_Fault_ID_NaN 0.0 65535.0 NUMBER 15 /end CHARACTERISTIC
/begin CHARACTERISTIC APP_uRaw1Def_C "Substitute value for sensor 1 defect" VALUE 0x0000 /* @ECU_Address@APP_uRaw1Def_C@ */ Scalar_SWORD 0 APP_DD1_CM_Volt_mV1_mv 0.0 5000.0 /end CHARACTERISTIC
/begin CHARACTERISTIC APP_uRaw1SRCHigh_C "voltage upper threshold of channel 1" VALUE 0x0000 /* @ECU_Address@APP_uRaw1SRCHigh_C@ */ Scalar_SWORD 0 APP_DD1_CM_Volt_mV1_mv 0.0 5000.0 /end CHARACTERISTIC
/begin CHARACTERISTIC APP_uRaw1SRCLow_C "voltage lower threshold of channel 1" VALUE 0x0000 /* @ECU_Address@APP_uRaw1SRCLow_C@ */ Scalar_SWORD 0 APP_DD1_CM_Volt_mV1_mv 0.0 5000.0 /end CHARACTERISTIC
/begin CHARACTERISTIC APP_tiSRCHighDefDeb2_C "debounce time" VALUE 0x0000 /* @ECU_Address@APP_tiSRCHighDefDeb2_C@ */ Scalar_UWORD 0 APP_DD2_CM_Debncd_ms_ms 0.0 1000.0 /end CHARACTERISTIC
/begin CHARACTERISTIC APP_tiSRCHighOKDeb2_C "debounce time" VALUE 0x0000 /* @ECU_Address@APP_tiSRCHighOKDeb2_C@ */ Scalar_UWORD 0 APP_DD2_CM_Debncd_ms_ms 0.0 1000.0 /end CHARACTERISTIC
/begin CHARACTERISTIC APP_tiSRCLowDefDeb2_C "debounce time" VALUE 0x0000 /* @ECU_Address@APP_tiSRCLowDefDeb2_C@ */ Scalar_UWORD 0 APP_DD2_CM_Debncd_ms_ms 0.0 1000.0 /end CHARACTERISTIC
/begin CHARACTERISTIC APP_tiSRCLowOKDeb2_C "debounce time" VALUE 0x0000 /* @ECU_Address@APP_tiSRCLowOKDeb2_C@ */ Scalar_UWORD 0 APP_DD2_CM_Debncd_ms_ms 0.0 1000.0 /end CHARACTERISTIC
/begin CHARACTERISTIC FM_APP2_SRC_FG_CA "Fault Group" VAL_BLK 0x0000 /* @ECU_Address@FM_APP2_SRC_FG_CA@ */ Scalar_UWORD 0 APP_DD2_CM_Fault_ID_NaN 0.0 65535.0 NUMBER 15 /end CHARACTERISTIC
/begin CHARACTERISTIC APP_uRaw2Def_C "Substitute value for sensor 2 defect" VALUE 0x0000 /* @ECU_Address@APP_uRaw2Def_C@ */ Scalar_SWORD 0 APP_DD2_CM_Volt_mV1_mv 0.0 5000.0 /end CHARACTERISTIC
/begin CHARACTERISTIC APP_uRaw2SRCHigh_C "voltage upper threshold of channel 2" VALUE 0x0000 /* @ECU_Address@APP_uRaw2SRCHigh_C@ */ Scalar_SWORD 0 APP_DD2_CM_Volt_mV1_mv 0.0 5000.0 /end CHARACTERISTIC
/begin CHARACTERISTIC APP_uRaw2SRCLow_C "voltage lower threshold of channel 2" VALUE 0x0000 /* @ECU_Address@APP_uRaw2SRCLow_C@ */ Scalar_SWORD 0 APP_DD2_CM_Volt_mV1_mv 0.0 5000.0 /end CHARACTERISTIC
/begin CHARACTERISTIC MoFAPP_dRawSigFac_C "Factor between the voltage of APP1 and APP2" VALUE 0x0000 /* @ECU_Address@MoFAPP_dRawSigFac_C@ */ Scalar_UWORD 0 APP_SelSig_CM_Fac10_NaN 0.0 8.0 /end CHARACTERISTIC
/begin CHARACTERISTIC APP_uAPPDef_C "Substitute value if both sensors are defect" VALUE 0x0000 /* @ECU_Address@APP_uAPPDef_C@ */ Scalar_SWORD 0 APP_SelSig_CM_Volt_mV1_mv 0.0 5000.0 /end CHARACTERISTIC
/begin CHARACTERISTIC APP_uRaw2Offset_C "Offset for sensor signal 2" VALUE 0x0000 /* @ECU_Address@APP_uRaw2Offset_C@ */ Scalar_SWORD 0 APP_SelSig_CM_Volt_mV1_mv 0.0 5000.0 /end CHARACTERISTIC
/begin CHARACTERISTIC APP_duLimErrPos_C "error ramp within the selction of mastersignal /positive ramp slope" VALUE 0x0000 /* @ECU_Address@APP_duLimErrPos_C@ */ Scalar_SWORD 0 APP_SelSig_CM_Volt_mV_s2_mv_s 0.0 5000.0 /end CHARACTERISTIC
/begin CHARACTERISTIC MoFAPP_rLinAPPCURCalMsgA_CUR "the physical value of accpedal" CURVE 0x0000 /* @ECU_Address@MoFAPP_rLinAPPCURCalMsgA_CUR@ */ Lookup1D_WORD 0 APP_VD_CM_Percent__ 0.0 100.0
 /begin AXIS_DESCR COM_AXIS APP_uUnJit_mp APP_VD_CM_Volt_mV1_mv 2 0.0 5000.0 AXIS_PTS_REF MoFAPP_rLinAPPCURCalMsgA_CURX /end AXIS_DESCR
/end CHARACTERISTIC
/begin CHARACTERISTIC APP_swtEnaFlt_C "Switch to enable PT1" VALUE 0x0000 /* @ECU_Address@APP_swtEnaFlt_C@ */ Scalar_LONG 0 APP_VD_CM_Switch_NaN 0 1 /end CHARACTERISTIC
/begin CHARACTERISTIC APP_swtEnaUnJit_C "Switch to enable unjittering" VALUE 0x0000 /* @ECU_Address@APP_swtEnaUnJit_C@ */ Scalar_LONG 0 APP_VD_CM_Switch_NaN 0 1 /end CHARACTERISTIC
/begin CHARACTERISTIC SigTst_swtAPP_C "Switch to set accpedal value" VALUE 0x0000 /* @ECU_Address@SigTst_swtAPP_C@ */ Scalar_LONG 0 APP_VD_CM_Switch_NaN 0 1 /end CHARACTERISTIC
/begin CHARACTERISTIC APP_facLowNegPT1_C "Filter parameter falling signal low range" VALUE 0x0000 /* @ECU_Address@APP_facLowNegPT1_C@ */ Scalar_SWORD 0 APP_VD_CM_Fac_100_NaN 0.0 99.9985 /end CHARACTERISTIC
/begin CHARACTERISTIC APP_facLowPosPT1_C "Filter parameter rising signal low range" VALUE 0x0000 /* @ECU_Address@APP_facLowPosPT1_C@ */ Scalar_SWORD 0 APP_VD_CM_Fac_100_NaN 0.0 99.9985 /end CHARACTERISTIC
/begin CHARACTERISTIC APP_facMidNegPT1_C "Filter parameter falling signal mid range" VALUE 0x0000 /* @ECU_Address@APP_facMidNegPT1_C@ */ Scalar_SWORD 0 APP_VD_CM_Fac_100_NaN 0.0 99.9985 /end CHARACTERISTIC
/begin CHARACTERISTIC APP_facMidPosPT1_C "Filter parameter rising signal mid range" VALUE 0x0000 /* @ECU_Address@APP_facMidPosPT1_C@ */ Scalar_SWORD 0 APP_VD_CM_Fac_100_NaN 0.0 99.9985 /end CHARACTERISTIC
/begin CHARACTERISTIC APP_facUppNegPT1_C "Filter parameter falling signal high range" VALUE 0x0000 /* @ECU_Address@APP_facUppNegPT1_C@ */ Scalar_SWORD 0 APP_VD_CM_Fac_100_NaN 0.0 99.9985 /end CHARACTERISTIC
/begin CHARACTERISTIC APP_facUppPosPT1_C "Filter parameter rising signal high range" VALUE 0x0000 /* @ECU_Address@APP_facUppPosPT1_C@ */ Scalar_SWORD 0 APP_VD_CM_Fac_100_NaN 0.0 99.9985 /end CHARACTERISTIC
/begin CHARACTERISTIC APP_rThrFltLowNeg_C "Threshold for low/mid-range Filter parameter falling signal" VALUE 0x0000 /* @ECU_Address@APP_rThrFltLowNeg_C@ */ Scalar_SWORD 0 APP_VD_CM_Percent__ 0.0 100.0 /end CHARACTERISTIC
/begin CHARACTERISTIC APP_rThrFltLowPos_C "Threshold for low/mid-range Filter parameter rising signal" VALUE 0x0000 /* @ECU_Address@APP_rThrFltLowPos_C@ */ Scalar_SWORD 0 APP_VD_CM_Percent__ 0.0 100.0 /end CHARACTERISTIC
/begin CHARACTERISTIC APP_rThrFltMidNeg_C "Threshold for mid/high-range Filter parameter falling signal" VALUE 0x0000 /* @ECU_Address@APP_rThrFltMidNeg_C@ */ Scalar_SWORD 0 APP_VD_CM_Percent__ 0.0 100.0 /end CHARACTERISTIC
/begin CHARACTERISTIC APP_rThrFltMidPos_C "Threshold for mid/high-range Filter parameter rising signal" VALUE 0x0000 /* @ECU_Address@APP_rThrFltMidPos_C@ */ Scalar_SWORD 0 APP_VD_CM_Percent__ 0.0 100.0 /end CHARACTERISTIC
/begin CHARACTERISTIC SigTst_rAPP_C "set the accpedal value" VALUE 0x0000 /* @ECU_Address@SigTst_rAPP_C@ */ Scalar_SWORD 0 APP_VD_CM_Percent__ 0.0 100.0 /end CHARACTERISTIC
/begin CHARACTERISTIC APP_drLinRmp_C "Permissible amount of accpedal value when vehicle quits limp mode" VALUE 0x0000 /* @ECU_Address@APP_drLinRmp_C@ */ Scalar_SWORD 0 APP_VD_CM_Percent_s___s -200.0 200.0 /end CHARACTERISTIC
/begin CHARACTERISTIC APP_uJitter_C "Threshold for unjittering" VALUE 0x0000 /* @ECU_Address@APP_uJitter_C@ */ Scalar_SWORD 0 APP_VD_CM_Volt_mV1_mv 0.0 5000.0 /end CHARACTERISTIC
/begin AXIS_PTS MoFAPP_rLinAPPCURCalMsgA_CURX "accpedal axis" 0x0000 /* @ECU_Address@MoFAPP_rLinAPPCURCalMsgA_CURX@ */ APP_uUnJit_mp Lookup1D_X_WORD 0 APP_VD_CM_Volt_mV1_mv 2 0.0 5000.0 /end AXIS_PTS
/begin CHARACTERISTIC MoFDrDem_trqEng_MAP "inner torque for disengaged reverse gear calculated from the accelerator pedal angle and the engine speed" MAP 0x0000 /* @ECU_Address@MoFDrDem_trqEng_MAP@ */ Lookup2D_WORD 0 AccPed_DrvDemDes_CM_Torq_Nm -3000.0 3000.0
 /begin AXIS_DESCR COM_AXIS Epm_nEng AccPed_DrvDemDes_CM_ERPM_rpm 16 0.0 6000.0 AXIS_PTS_REF MoFDrDem_trqEng_MAPX /end AXIS_DESCR
 /begin AXIS_DESCR COM_AXIS APP_r AccPed_DrvDemDes_CM_Percent__ 16 0.0 120.0 AXIS_PTS_REF MoFDrDem_trqEng_MAPY /end AXIS_DESCR
/end CHARACTERISTIC
/begin CHARACTERISTIC SigTst_swtAccPed_C "switch of torque under test" VALUE 0x0000 /* @ECU_Address@SigTst_swtAccPed_C@ */ Scalar_LONG 0 AccPed_DrvDemDes_CM_Switch_NaN 0 1 /end CHARACTERISTIC
/begin CHARACTERISTIC SigTst_trqAccPed_C "torque under test" VALUE 0x0000 /* @ECU_Address@SigTst_trqAccPed_C@ */ Scalar_SWORD 0 AccPed_DrvDemDes_CM_Torq_Nm -3000.0 3000.0 /end CHARACTERISTIC
/begin AXIS_PTS MoFDrDem_trqEng_MAPY "Standardized accelerator pedal position" 0x0000 /* @ECU_Address@MoFDrDem_trqEng_MAPY@ */ APP_r Lookup2D_X_WORD 0 AccPed_DrvDemDes_CM_Percent__ 16 0.0 120.0 /end AXIS_PTS
/begin AXIS_PTS MoFDrDem_trqEng_MAPX "Average engine speed of one cylinder segment" 0x0000 /* @ECU_Address@MoFDrDem_trqEng_MAPX@ */ Epm_nEng Lookup2D_X_WORD 0 AccPed_DrvDemDes_CM_ERPM_rpm 16 0.0 6000.0 /end AXIS_PTS
/begin MEASUREMENT CEngDsT_uRaw "Raw ADC value of downstream engine coolant temperature sensor signal" SWORD CEngDsT_DD_CM_Volt_mV2_mv 0 0 0.0 5000.0 ECU_ADDRESS 0x0000 /* @ECU_Address@CEngDsT_uRaw@ */ /end MEASUREMENT
/begin MEASUREMENT CEngDsT_tSens "Sensed engine coolant temperature" SWORD CEngDsT_DD_CM_Temp_C_deg 0 0 -200.0 200.0 ECU_ADDRESS 0x0000 /* @ECU_Address@CEngDsT_tSens@ */ /end MEASUREMENT
/begin MEASUREMENT CEngDsT_bPhysRngHiDeb_DSM "status of CEngDsT_bPhysRngHiDeb" UBYTE CEngDsT_DD_CM_boolean_NaN 0 0 0.0 1.0 ECU_ADDRESS 0x0000 /* @ECU_Address@CEngDsT_bPhysRngHiDeb_DSM@ */ /end MEASUREMENT
/begin MEASUREMENT CEngDsT_bSRCMaxDeb_DSM "status of CEngDsT_bSRCMaxDeb" UBYTE CEngDsT_DD_CM_boolean_NaN 0 0 0.0 1.0 ECU_ADDRESS 0x0000 /* @ECU_Address@CEngDsT_bSRCMaxDeb_DSM@ */ /end MEASUREMENT
/begin MEASUREMENT CEngDsT_bPhysRngLoDeb_DSM "status of CEngDsT_bPhysRngLoDeb" UBYTE CEngDsT_DD_CM_boolean_NaN 0 0 0.0 1.0 ECU_ADDRESS 0x0000 /* @ECU_Address@CEngDsT_bPhysRngLoDeb_DSM@ */ /end MEASUREMENT
/begin MEASUREMENT CEngDsT_bSRCMinDeb_DSM "status of CEngDsT_bSRCMinDeb" UBYTE CEngDsT_DD_CM_boolean_NaN 0 0 0.0 1.0 ECU_ADDRESS 0x0000 /* @ECU_Address@CEngDsT_bSRCMinDeb_DSM@ */ /end MEASUREMENT
/begin MEASUREMENT CEngDsT_bFinalDef "Status Sensor of the coolant temperature finally defect" UBYTE CEngDsT_DD_CM_boolean_NaN 0 0 0.0 1.0 ECU_ADDRESS 0x0000 /* @ECU_Address@CEngDsT_bFinalDef@ */ /end MEASUREMENT
/begin MEASUREMENT CEngDsT_bSRCMax "coolant temperature voltage signal maximum limit value" UBYTE CEngDsT_DD_CM_boolean_NaN 0 0 0.0 1.0 ECU_ADDRESS 0x0000 /* @ECU_Address@CEngDsT_bSRCMax@ */ /end MEASUREMENT
/begin MEASUREMENT CEngDsT_bSRCMin "coolant temperature voltage signal minimum limit value" UBYTE CEngDsT_DD_CM_boolean_NaN 0 0 0.0 1.0 ECU_ADDRESS 0x0000 /* @ECU_Address@CEngDsT_bSRCMin@ */ /end MEASUREMENT
/begin MEASUREMENT CEngDsT_bProvDef "Status Sensor of the coolant temperature temporary defect" UBYTE CEngDsT_DD_CM_boolean_NaN 0 0 0.0 1.0 ECU_ADDRESS 0x0000 /* @ECU_Address@CEngDsT_bProvDef@ */ /end MEASUREMENT
/begin MEASUREMENT CEngDsT_bPhysRngHi "Status Sensor of the coolant temperature high voltage Signal range" UBYTE CEngDsT_DD_CM_boolean_NaN 0 0 0.0 1.0 ECU_ADDRESS 0x0000 /* @ECU_Address@CEngDsT_bPhysRngHi@ */ /end MEASUREMENT
/begin MEASUREMENT CEngDsT_bPhysRngLo "Status Sensor of the coolant temperature low voltage Signal range" UBYTE CEngDsT_DD_CM_boolean_NaN 0 0 0.0 1.0 ECU_ADDRESS 0x0000 /* @ECU_Address@CEngDsT_bPhysRngLo@ */ /end MEASUREMENT
/begin MEASUREMENT CEngDsT_bPhysRngFinalDef "Status Sensor of the CEngDsT physical Signal range check finally defect" UBYTE CEngDsT_DD_CM_boolean_NaN 0 0 0.0 1.0 ECU_ADDRESS 0x0000 /* @ECU_Address@CEngDsT_bPhysRngFinalDef@ */ /end MEASUREMENT
/begin MEASUREMENT CEngDsT_bPhysRngProvDef "Status Sensor of the CEngDsT physical Signal range check temporary defect" UBYTE CEngDsT_DD_CM_boolean_NaN 0 0 0.0 1.0 ECU_ADDRESS 0x0000 /* @ECU_Address@CEngDsT_bPhysRngProvDef@ */ /end MEASUREMENT
/begin MEASUREMENT FM_All_Fault_Status_Array "整个工程所有故障的故障状态数组：数组索引为故障编号，范围为0~65535；数组元素为故障状态，逻辑值，1表示当前故障编号对应故障已确认，0表示无故障或故障已恢复。" UBYTE CEngDsT_DD_CM_boolean 0 0 0.0 1.0 ARRAY_SIZE 100 ECU_ADDRESS 0x0000 /end MEASUREMENT
/begin MEASUREMENT CEngDsT_tSens "Sensed engine coolant temperature" SWORD CEngDsT_VD_CM_Temp_C_deg 0 0 -200.0 200.0 ECU_ADDRESS 0x0000 /* @ECU_Address@CEngDsT_tSens@ */ /end MEASUREMENT
/begin MEASUREMENT CEngDsT_bFinalDef "Status Sensor of the coolant temperature finally defect" UBYTE CEngDsT_VD_CM_boolean_NaN 0 0 0.0 1.0 ECU_ADDRESS 0x0000 /* @ECU_Address@CEngDsT_bFinalDef@ */ /end MEASUREMENT
/begin MEASUREMENT CEngDsT_bPhysRngFinalDef "Status Sensor of the CEngDsT physical Signal range check finally defect" UBYTE CEngDsT_VD_CM_boolean_NaN 0 0 0.0 1.0 ECU_ADDRESS 0x0000 /* @ECU_Address@CEngDsT_bPhysRngFinalDef@ */ /end MEASUREMENT
/begin MEASUREMENT CEngDsT_bProvDef "Status Sensor of the coolant temperature temporary defect" UBYTE CEngDsT_VD_CM_boolean_NaN 0 0 0.0 1.0 ECU_ADDRESS 0x0000 /* @ECU_Address@CEngDsT_bProvDef@ */ /end MEASUREMENT
/begin MEASUREMENT CEngDsT_bPhysRngProvDef "Status Sensor of the CEngDsT physical Signal range check temporary defect" UBYTE CEngDsT_VD_CM_boolean_NaN 0 0 0.0 1.0 ECU_ADDRESS 0x0000 /* @ECU_Address@CEngDsT_bPhysRngProvDef@ */ /end MEASUREMENT
/begin MEASUREMENT CEngDsT_tSensFlt "engine coolant sensor temperature without speed up" SWORD CEngDsT_VD_CM_Temp_C_deg 0 0 -200.0 200.0 ECU_ADDRESS 0x0000 /* @ECU_Address@CEngDsT_tSensFlt@ */ /end MEASUREMENT
/begin MEASUREMENT CEngDsT_t "engine coolant temperature after filter" SWORD CEngDsT_VD_CM_Temp_C_deg 0 0 -200.0 200.0 ECU_ADDRESS 0x0000 /* @ECU_Address@CEngDsT_t@ */ /end MEASUREMENT
/begin MEASUREMENT Epm_nEng "Engine speed" SWORD CEngDsT_VD_CM_ERPM_rpm 0 0 0.0 200.0 ECU_ADDRESS 0x0000 /end MEASUREMENT
/begin MEASUREMENT CoVeh_trqDes "Setpoint torque order to the drive train (gearbox output torque)" SWORD PthSet_TrqCalc_CM_Torq_Nm 0 0 -3000.0 3000.0 ECU_ADDRESS 0x0000 /* @ECU_Address@CoVeh_trqDes@ */ /end MEASUREMENT
/begin MEASUREMENT PthSet_trqInrSet "Inner torque set value after monitoring limitation" SWORD PthSet_TrqCalc_CM_Torq_Nm 0 0 -3000.0 3276.7 ECU_ADDRESS 0x0000 /* @ECU_Address@PthSet_trqInrSet@ */ /end MEASUREMENT
/begin MEASUREMENT PthSet_trqInrSet "Inner torque set value after monitoring limitation" SWORD CnvSet_Trq2Q_CM_Torq_Nm 0 0 -3000.0 3276.7 ECU_ADDRESS 0x0000 /* @ECU_Address@PthSet_trqInrSet@ */ /end MEASUREMENT
/begin MEASUREMENT Epm_nEng "Engine speed" SWORD CnvSet_Trq2Q_CM_ERPM_rpm 0 0 0.0 6000.0 ECU_ADDRESS 0x0000 /end MEASUREMENT
/begin MEASUREMENT CnvSet_qSet "Set point injection quantity" SWORD CnvSet_Trq2Q_CM_InjMass_mg_hub 0 0 -319.0 319.0 ECU_ADDRESS 0x0000 /* @ECU_Address@CnvSet_qSet@ */ /end MEASUREMENT
/begin MEASUREMENT RailP_uRaw "Raw value of rail pressure" SWORD RailP_DD_CM_Volt_mV1_mv 0 0 0.0 5000.0 ECU_ADDRESS 0x0000 /* @ECU_Address@RailP_uRaw@ */ /end MEASUREMENT
/begin MEASUREMENT RailP_pLin "Fuel pressure" SWORD RailP_DD_CM_Press_bar1_bar 0 0 0.0 2000.0 ECU_ADDRESS 0x0000 /* @ECU_Address@RailP_pLin@ */ /end MEASUREMENT
/begin MEASUREMENT RailP_bFinalDef "Status of final default" UBYTE RailP_DD_CM_boolean_NaN 0 0 0.0 1.0 ECU_ADDRESS 0x0000 /* @ECU_Address@RailP_bFinalDef@ */ /end MEASUREMENT
/begin MEASUREMENT RailP_bProvDef "Status of provisional default" UBYTE RailP_DD_CM_boolean_NaN 0 0 0.0 1.0 ECU_ADDRESS 0x0000 /* @ECU_Address@RailP_bProvDef@ */ /end MEASUREMENT
/begin MEASUREMENT FM_All_Fault_Status_Array "整个工程所有故障的故障状态数组：数组索引为故障编号，范围为0~65535；数组元素为故障状态，逻辑值，1表示当前故障编号对应故障已确认，0表示无故障或故障已恢复。" UBYTE RailP_DD_CM_boolean 0 0 0.0 1.0 ARRAY_SIZE 100 ECU_ADDRESS 0x0000 /end MEASUREMENT
/begin MEASUREMENT RailP_pLin "Fuel pressure" SWORD RailP_VD_CM_Press_bar1_bar 0 0 0.0 2000.0 ECU_ADDRESS 0x0000 /* @ECU_Address@RailP_pLin@ */ /end MEASUREMENT
/begin MEASUREMENT InjCtl_qSetUnBal "Current injection quantity" SWORD RailP_VD_CM_InjMass_mg_hub 0 0 -319.0 319.0 ECU_ADDRESS 0x0000 /end MEASUREMENT
/begin MEASUREMENT RailP_facFltPT1_mp "Current filter time for PT1 filter" SWORD RailP_VD_CM_Fac_100_NaN 0 0 0.0 99.9985 ECU_ADDRESS 0x0000 /* @ECU_Address@RailP_facFltPT1_mp@ */ /end MEASUREMENT
/begin MEASUREMENT RailP_pFlt "Maximum rail pressure of the last 10 sampling cycle" SWORD InjVlv_CalcET_CM_Press_bar1_bar 0 0 0.0 2000.0 ECU_ADDRESS 0x0000 /* @ECU_Address@RailP_pFlt@ */ /end MEASUREMENT
/begin MEASUREMENT InjCrv_qMI1Des "desired MI1 injection quantity" SWORD InjVlv_CalcET_CM_InjMass_mg_hub 0 0 -319.0 319.0 ECU_ADDRESS 0x0000 /* @ECU_Address@InjCrv_qMI1Des@ */ /end MEASUREMENT
/begin MEASUREMENT T15_st "Terminal 15 status after debouncing" SLONG InjVlv_CalcET_CM_Switch_NaN 0 0 0 1 ECU_ADDRESS 0x0000 /* @ECU_Address@T15_st@ */ /end MEASUREMENT
/begin MEASUREMENT InjVlv_tiETMI1NoCor_mp "Start of energizing for MI1 without correction" SLONG InjVlv_CalcET_CM_uSec4_us 0 0 -13107.0 13106.0 ECU_ADDRESS 0x0000 /* @ECU_Address@InjVlv_tiETMI1NoCor_mp@ */ /end MEASUREMENT
/begin MEASUREMENT InjCrv_tiMI1ET "Estimated MI1 energizing time" SLONG InjVlv_CalcET_CM_uSec4_us 0 0 -13107.0 13106.0 ECU_ADDRESS 0x0000 /* @ECU_Address@InjCrv_tiMI1ET@ */ /end MEASUREMENT
/begin MEASUREMENT InjCtl_qSetUnBal "Current injection quantity" SWORD InjCrv_MI1_CM_InjMass_mg_hub 0 0 -319.0 319.0 ECU_ADDRESS 0x0000 /end MEASUREMENT
/begin MEASUREMENT InjCrv_qMI1Des "desired MI1 injection quantity" SWORD InjCrv_MI1_CM_InjMass_mg_hub 0 0 -319.0 319.0 ECU_ADDRESS 0x0000 /* @ECU_Address@InjCrv_qMI1Des@ */ /end MEASUREMENT
/begin MEASUREMENT CnvSet_qSet "Injection quantity current path" SWORD InjCtl_qCo_CM_InjMass_mg_hub 0 0 -319.0 319.0 ECU_ADDRESS 0x0000 /* @ECU_Address@CnvSet_qSet@ */ /end MEASUREMENT
/begin MEASUREMENT InjCtl_qSetUnBal "Torque generating engine fuel injection quantity" SWORD InjCtl_qCo_CM_InjMass_mg_hub 0 0 -319.0 319.0 ECU_ADDRESS 0x0000 /end MEASUREMENT
/begin MEASUREMENT T15_uRaw "Raw ADC value of downstream engine coolant temperature sensor signal" SWORD T15_DD_CM_Volt_mV1_mv 0 0 0.0 5000.0 ECU_ADDRESS 0x0000 /* @ECU_Address@T15_uRaw@ */ /end MEASUREMENT
/begin MEASUREMENT T15_st "Terminal 15 status after debouncing" SLONG T15_DD_CM_Switch_NaN 0 0 0 1 ECU_ADDRESS 0x0000 /* @ECU_Address@T15_st@ */ /end MEASUREMENT
/begin MEASUREMENT T15_stRaw "Raw value of Terminal 15 status" UBYTE T15_DD_CM_boolean_NaN 0 0 0 1 ECU_ADDRESS 0x0000 /* @ECU_Address@T15_stRaw@ */ /end MEASUREMENT
/begin MEASUREMENT APP_rFlt_mp "Acceleration pedal position filtered value" SWORD APP_ChkSig_CM_Percent__ 0 0 0.0 100.0 ECU_ADDRESS 0x0000 /* @ECU_Address@APP_rFlt_mp@ */ /end MEASUREMENT
/begin MEASUREMENT APP_stSigSrc_APP1_BP "Sensor 1 is the reference variable, Sensor 2 value is defective" UBYTE APP_ChkSig_CM_boolean_NaN 0 0 0.0 1.0 ECU_ADDRESS 0x0000 /* @ECU_Address@APP_stSigSrc_APP1_BP@ */ /end MEASUREMENT
/begin MEASUREMENT APP_stSigSrc_APP2_BP "Sensor 2 is the reference variable,Sensor1 value is defective" UBYTE APP_ChkSig_CM_boolean_NaN 0 0 0.0 1.0 ECU_ADDRESS 0x0000 /* @ECU_Address@APP_stSigSrc_APP2_BP@ */ /end MEASUREMENT
/begin MEASUREMENT APP_r "Acceleration pedal sensor 1 value after fault handling" SWORD APP_ChkSig_CM_Percent__ 0 0 0.0 100.0 ECU_ADDRESS 0x0000 /* @ECU_Address@APP_r@ */ /end MEASUREMENT
/begin MEASUREMENT APP_uRaw1unLim "Acceleration pedal sensor 1 unlimited raw value" SWORD APP_DD1_CM_Volt_mV1_mv 0 0 0.0 5000.0 ECU_ADDRESS 0x0000 /* @ECU_Address@APP_uRaw1unLim@ */ /end MEASUREMENT
/begin MEASUREMENT APP_uRaw1 "Acceleration Pedal Position D" SWORD APP_DD1_CM_Volt_mV1_mv 0 0 0.0 5000.0 ECU_ADDRESS 0x0000 /* @ECU_Address@APP_uRaw1@ */ /end MEASUREMENT
/begin MEASUREMENT APP_bSRCHigh1Deb_DSM "Status debounced SRC-High error Sensor 1" UBYTE APP_DD1_CM_boolean_NaN 0 0 0.0 1.0 ECU_ADDRESS 0x0000 /* @ECU_Address@APP_bSRCHigh1Deb_DSM@ */ /end MEASUREMENT
/begin MEASUREMENT APP_bSRCLow1Deb_DSM "Status debounced SRC-Low error Sensor 1" UBYTE APP_DD1_CM_boolean_NaN 0 0 0.0 1.0 ECU_ADDRESS 0x0000 /* @ECU_Address@APP_bSRCLow1Deb_DSM@ */ /end MEASUREMENT
/begin MEASUREMENT APP_bAPP1FinalDef "Status Sensor 1 of the acceleration pedal finally defect" UBYTE APP_DD1_CM_boolean_NaN 0 0 0.0 1.0 ECU_ADDRESS 0x0000 /* @ECU_Address@APP_bAPP1FinalDef@ */ /end MEASUREMENT
/begin MEASUREMENT APP_bSRCHigh1 "Status temporary SRC-High error Sensor 1" UBYTE APP_DD1_CM_boolean_NaN 0 0 0.0 1.0 ECU_ADDRESS 0x0000 /* @ECU_Address@APP_bSRCHigh1@ */ /end MEASUREMENT
/begin MEASUREMENT APP_bSRCLow1 "Status temporary SRC-Low error Sensor 1" UBYTE APP_DD1_CM_boolean_NaN 0 0 0.0 1.0 ECU_ADDRESS 0x0000 /* @ECU_Address@APP_bSRCLow1@ */ /end MEASUREMENT
/begin MEASUREMENT APP_bAPP1ProvDef "Status Sensor 1 of the acceleration pedal temporary defect" UBYTE APP_DD1_CM_boolean_NaN 0 0 0.0 1.0 ECU_ADDRESS 0x0000 /* @ECU_Address@APP_bAPP1ProvDef@ */ /end MEASUREMENT
/begin MEASUREMENT FM_All_Fault_Status_Array "整个工程所有故障的故障状态数组：数组索引为故障编号，范围为0~65535；数组元素为故障状态，逻辑值，1表示当前故障编号对应故障已确认，0表示无故障或故障已恢复。" UBYTE APP_DD1_CM_boolean 0 0 0.0 1.0 ARRAY_SIZE 100 ECU_ADDRESS 0x0000 /end MEASUREMENT
/begin MEASUREMENT APP_uRaw2unLim "Acceleration pedal sensor 2 unlimited raw value" SWORD APP_DD2_CM_Volt_mV1_mv 0 0 0.0 5000.0 ECU_ADDRESS 0x0000 /* @ECU_Address@APP_uRaw2unLim@ */ /end MEASUREMENT
/begin MEASUREMENT APP_uRaw2 "Acceleration Pedal Position E" SWORD APP_DD2_CM_Volt_mV1_mv 0 0 0.0 5000.0 ECU_ADDRESS 0x0000 /* @ECU_Address@APP_uRaw2@ */ /end MEASUREMENT
/begin MEASUREMENT APP_bSRCHigh2Deb_DSM "Status debounced SRC-High error Sensor 2" UBYTE APP_DD2_CM_boolean_NaN 0 0 0.0 1.0 ECU_ADDRESS 0x0000 /* @ECU_Address@APP_bSRCHigh2Deb_DSM@ */ /end MEASUREMENT
/begin MEASUREMENT APP_bSRCLow2Deb_DSM "Status debounced SRC-Low error Sensor 2" UBYTE APP_DD2_CM_boolean_NaN 0 0 0.0 1.0 ECU_ADDRESS 0x0000 /* @ECU_Address@APP_bSRCLow2Deb_DSM@ */ /end MEASUREMENT
/begin MEASUREMENT APP_bAPP2FinalDef "Status Sensor 2 of the acceleration pedal finally defect" UBYTE APP_DD2_CM_boolean_NaN 0 0 0.0 1.0 ECU_ADDRESS 0x0000 /* @ECU_Address@APP_bAPP2FinalDef@ */ /end MEASUREMENT
/begin MEASUREMENT APP_bAPP2ProvDef "Status Sensor 2 of the acceleration pedal temporary defect" UBYTE APP_DD2_CM_boolean_NaN 0 0 0.0 1.0 ECU_ADDRESS 0x0000 /* @ECU_Address@APP_bAPP2ProvDef@ */ /end MEASUREMENT
/begin MEASUREMENT FM_All_Fault_Status_Array "整个工程所有故障的故障状态数组：数组索引为故障编号，范围为0~65535；数组元素为故障状态，逻辑值，1表示当前故障编号对应故障已确认，0表示无故障或故障已恢复。" UBYTE APP_DD2_CM_boolean 0 0 0.0 1.0 ARRAY_SIZE 100 ECU_ADDRESS 0x0000 /end MEASUREMENT
/begin MEASUREMENT APP_bAPP1FinalDef "Status Sensor 1 of the acceleration pedal finally defect" UBYTE APP_SelSig_CM_boolean_NaN 0 0 0.0 1.0 ECU_ADDRESS 0x0000 /* @ECU_Address@APP_bAPP1FinalDef@ */ /end MEASUREMENT
/begin MEASUREMENT APP_bAPP2FinalDef "Status Sensor 2 of the acceleration pedal finally defect" UBYTE APP_SelSig_CM_boolean_NaN 0 0 0.0 1.0 ECU_ADDRESS 0x0000 /* @ECU_Address@APP_bAPP2FinalDef@ */ /end MEASUREMENT
/begin MEASUREMENT APP_bAPP1ProvDef "Status Sensor 1 of the acceleration pedal temporary defect" UBYTE APP_SelSig_CM_boolean_NaN 0 0 0.0 1.0 ECU_ADDRESS 0x0000 /* @ECU_Address@APP_bAPP1ProvDef@ */ /end MEASUREMENT
/begin MEASUREMENT APP_bAPP2ProvDef "Status Sensor 2 of the acceleration pedal temporary defect" UBYTE APP_SelSig_CM_boolean_NaN 0 0 0.0 1.0 ECU_ADDRESS 0x0000 /* @ECU_Address@APP_bAPP2ProvDef@ */ /end MEASUREMENT
/begin MEASUREMENT APP_uRaw2 "Acceleration Pedal Position E" SWORD APP_SelSig_CM_Volt_mV1_mv 0 0 0.0 5000.0 ECU_ADDRESS 0x0000 /* @ECU_Address@APP_uRaw2@ */ /end MEASUREMENT
/begin MEASUREMENT APP_uRaw1 "Acceleration Pedal Position D" SWORD APP_SelSig_CM_Volt_mV1_mv 0 0 0.0 5000.0 ECU_ADDRESS 0x0000 /* @ECU_Address@APP_uRaw1@ */ /end MEASUREMENT
/begin MEASUREMENT APP_uRaw_mp "Acceleration pedal position raw value" SWORD APP_SelSig_CM_Volt_mV1_mv 0 0 0.0 5000.0 ECU_ADDRESS 0x0000 /* @ECU_Address@APP_uRaw_mp@ */ /end MEASUREMENT
/begin MEASUREMENT APP_stSigSrc_APP1_BP "Sensor 1 is the reference variable, Sensor 2 value is defective" UBYTE APP_SelSig_CM_boolean_NaN 0 0 0.0 1.0 ECU_ADDRESS 0x0000 /* @ECU_Address@APP_stSigSrc_APP1_BP@ */ /end MEASUREMENT
/begin MEASUREMENT APP_stSigSrc_APP2_BP "Sensor 2 is the reference variable,Sensor1 value is defective" UBYTE APP_SelSig_CM_boolean_NaN 0 0 0.0 1.0 ECU_ADDRESS 0x0000 /* @ECU_Address@APP_stSigSrc_APP2_BP@ */ /end MEASUREMENT
/begin MEASUREMENT APP_stSigSrc_APPDEF_BP "both the sensors are defective. Use the default value" UBYTE APP_SelSig_CM_boolean_NaN 0 0 0.0 1.0 ECU_ADDRESS 0x0000 /* @ECU_Address@APP_stSigSrc_APPDEF_BP@ */ /end MEASUREMENT
/begin MEASUREMENT APP_stTempErr_mp "Status for temporary errors" UBYTE APP_SelSig_CM_boolean_NaN 0 0 0.0 1.0 ECU_ADDRESS 0x0000 /* @ECU_Address@APP_stTempErr_mp@ */ /end MEASUREMENT
/begin MEASUREMENT APP_stSigSrc_APPLIMP_BP "Substitute operation active, accelerator pedal sensor value and accelerator pedal sensor increase are limited" UBYTE APP_SelSig_CM_boolean_NaN 0 0 0.0 1.0 ECU_ADDRESS 0x0000 /* @ECU_Address@APP_stSigSrc_APPLIMP_BP@ */ /end MEASUREMENT
/begin MEASUREMENT APP_uRaw_mp "Acceleration pedal position raw value" SWORD APP_VD_CM_Volt_mV1_mv 0 0 0.0 5000.0 ECU_ADDRESS 0x0000 /* @ECU_Address@APP_uRaw_mp@ */ /end MEASUREMENT
/begin MEASUREMENT APP_stSigSrc_APPLIMP_BP "Substitute operation active, accelerator pedal sensor value and accelerator pedal sensor increase are limited" UBYTE APP_VD_CM_boolean_NaN 0 0 0.0 1.0 ECU_ADDRESS 0x0000 /* @ECU_Address@APP_stSigSrc_APPLIMP_BP@ */ /end MEASUREMENT
/begin MEASUREMENT APP_stSigSrc_APPDEF_BP "both the sensors are defective. Use the default value" UBYTE APP_VD_CM_boolean_NaN 0 0 0.0 1.0 ECU_ADDRESS 0x0000 /* @ECU_Address@APP_stSigSrc_APPDEF_BP@ */ /end MEASUREMENT
/begin MEASUREMENT APP_rLinAPP_mp "Linearisation ratio of accelerator pedal" SWORD APP_VD_CM_Percent__ 0 0 0.0 100.0 ECU_ADDRESS 0x0000 /* @ECU_Address@APP_rLinAPP_mp@ */ /end MEASUREMENT
/begin MEASUREMENT APP_rUnFlt_mp "Unfiltered APP value" SWORD APP_VD_CM_Percent__ 0 0 0.0 100.0 ECU_ADDRESS 0x0000 /* @ECU_Address@APP_rUnFlt_mp@ */ /end MEASUREMENT
/begin MEASUREMENT APP_rUnFlt "Unfiltered APP value" SWORD APP_VD_CM_Percent__ 0 0 0.0 100.0 ECU_ADDRESS 0x0000 /* @ECU_Address@APP_rUnFlt@ */ /end MEASUREMENT
/begin MEASUREMENT APP_facPT1 "Filter time" SWORD APP_VD_CM_Fac_100_NaN 0 0 0.0 99.9985 ECU_ADDRESS 0x0000 /* @ECU_Address@APP_facPT1@ */ /end MEASUREMENT
/begin MEASUREMENT APP_rFlt_mp "Acceleration pedal position filtered value" SWORD APP_VD_CM_Percent__ 0 0 0.0 100.0 ECU_ADDRESS 0x0000 /* @ECU_Address@APP_rFlt_mp@ */ /end MEASUREMENT
/begin MEASUREMENT APP_drUnFlt "Acceleration pedal position gradient of unfilterd value" SWORD APP_VD_CM_Percent_s___ms 0 0 -200.0 200.0 ECU_ADDRESS 0x0000 /* @ECU_Address@APP_drUnFlt@ */ /end MEASUREMENT
/begin MEASUREMENT APP_uUnJit_mp "Acceleration pedal position unjittered value" SWORD APP_VD_CM_Volt_mV1_mv 0 0 0.0 5000.0 ECU_ADDRESS 0x0000 /* @ECU_Address@APP_uUnJit_mp@ */ /end MEASUREMENT
/begin MEASUREMENT APP_r "Acceleration pedal sensor 1 value after fault handling" SWORD AccPed_DrvDemDes_CM_Percent__ 0 0 0.0 100.0 ECU_ADDRESS 0x0000 /* @ECU_Address@APP_r@ */ /end MEASUREMENT
/begin MEASUREMENT Epm_nEng "Engine speed" SWORD AccPed_DrvDemDes_CM_ERPM_rpm 0 0 0.0 6000.0 ECU_ADDRESS 0x0000 /end MEASUREMENT
/begin MEASUREMENT AccPed_trqDesPull "Application parameter for driver demand in pull mode for desired value" SWORD AccPed_DrvDemDes_CM_Torq_Nm 0 0 -3000.0 3000.0 ECU_ADDRESS 0x0000 /* @ECU_Address@AccPed_trqDesPull@ */ /end MEASUREMENT
/begin MEASUREMENT AccPed_trqDesAct "driver torque raw of propulsion" SWORD AccPed_DrvDemDes_CM_Torq_Nm 0 0 -3000.0 3000.0 ECU_ADDRESS 0x0000 /* @ECU_Address@AccPed_trqDesAct@ */ /end MEASUREMENT
/begin MEASUREMENT AccPed_trqDesAct "driver torque raw of propulsion" SWORD VehCo_VehDem_CM_Torq_Nm 0 0 -3000.0 3000.0 ECU_ADDRESS 0x0000 /* @ECU_Address@AccPed_trqDesAct@ */ /end MEASUREMENT
/begin MEASUREMENT CoVeh_trqDes "Setpoint torque order to the drive train (gearbox output torque)" SWORD VehCo_VehDem_CM_Torq_Nm 0 0 -3000.0 3000.0 ECU_ADDRESS 0x0000 /* @ECU_Address@CoVeh_trqDes@ */ /end MEASUREMENT
/begin COMPU_METHOD CEngDsT_DD_CM_Temp_C_deg "Q = V*16.000000" RAT_FUNC "%8.4" "deg" COEFFS 0 16.000000 0.000000 0 0 1.000000 /end COMPU_METHOD
/begin COMPU_METHOD CEngDsT_DD_CM_Volt_mV2_mv "Q = V" RAT_FUNC "%5.0" "mv" COEFFS 0 1 0 0 0 1 /end COMPU_METHOD
/begin COMPU_METHOD CEngDsT_DD_CM_Debncd_ms_ms "Q = V*64.000000" RAT_FUNC "%10.6" "ms" COEFFS 0 64.000000 0.000000 0 0 1.000000 /end COMPU_METHOD
/begin COMPU_METHOD CEngDsT_DD_CM_Fault_ID_NaN "Q = V" RAT_FUNC "%5.0" "NaN" COEFFS 0 1 0 0 0 1 /end COMPU_METHOD
/begin COMPU_METHOD CEngDsT_DD_CM_boolean_NaN "Q = V" RAT_FUNC "%1.0" "NaN" COEFFS 0 1 0 0 0 1 /end COMPU_METHOD
/begin COMPU_METHOD CEngDsT_DD_CM_boolean "Q = V" RAT_FUNC "%1.0" "" COEFFS 0 1 0 0 0 1 /end COMPU_METHOD
/begin COMPU_METHOD CEngDsT_VD_CM_Switch_NaN "Enumerated data type: Switch" TAB_VERB "%0.6" "NaN" COMPU_TAB_REF VTAB_FOR_CEngDsT_VD_CM_Switch_NaN /end COMPU_METHOD
/begin COMPU_METHOD CEngDsT_VD_CM_Fac100_NaN "Q = V*512.000000" RAT_FUNC "%12.9" "NaN" COEFFS 0 512.000000 0.000000 0 0 1.000000 /end COMPU_METHOD
/begin COMPU_METHOD CEngDsT_VD_CM_Temp_C_deg "Q = V*16.000000" RAT_FUNC "%8.4" "deg" COEFFS 0 16.000000 0.000000 0 0 1.000000 /end COMPU_METHOD
/begin COMPU_METHOD CEngDsT_VD_CM_uint16_ms "Q = V" RAT_FUNC "%5.0" "ms" COEFFS 0 1 0 0 0 1 /end COMPU_METHOD
/begin COMPU_METHOD CEngDsT_VD_CM_boolean_NaN "Q = V" RAT_FUNC "%1.0" "NaN" COEFFS 0 1 0 0 0 1 /end COMPU_METHOD
/begin COMPU_METHOD CEngDsT_VD_CM_ERPM_rpm "Q = V*2.000000" RAT_FUNC "%6.1" "rpm" COEFFS 0 2.000000 0.000000 0 0 1.000000 /end COMPU_METHOD
/begin COMPU_METHOD PthSet_TrqCalc_CM_Torq_Nm "Q = V*8.000000" RAT_FUNC "%7.3" "Nm" COEFFS 0 8.000000 0.000000 0 0 1.000000 /end COMPU_METHOD
/begin COMPU_METHOD CnvSet_Trq2Q_CM_InjMass_mg_hub "Q = V*64.000000" RAT_FUNC "%10.6" "mg/hub" COEFFS 0 64.000000 0.000000 0 0 1.000000 /end COMPU_METHOD
/begin COMPU_METHOD CnvSet_Trq2Q_CM_ERPM_rpm "Q = V*2.000000" RAT_FUNC "%6.1" "rpm" COEFFS 0 2.000000 0.000000 0 0 1.000000 /end COMPU_METHOD
/begin COMPU_METHOD CnvSet_Trq2Q_CM_Torq_Nm "Q = V*8.000000" RAT_FUNC "%7.3" "Nm" COEFFS 0 8.000000 0.000000 0 0 1.000000 /end COMPU_METHOD
/begin COMPU_METHOD RailP_DD_CM_Press_bar1_bar "Q = V*16.000000" RAT_FUNC "%8.4" "bar" COEFFS 0 16.000000 0.000000 0 0 1.000000 /end COMPU_METHOD
/begin COMPU_METHOD RailP_DD_CM_Volt_mV1_mv "Q = V*4.000000" RAT_FUNC "%7.2" "mv" COEFFS 0 4.000000 0.000000 0 0 1.000000 /end COMPU_METHOD
/begin COMPU_METHOD RailP_DD_CM_Debncd_ms_ms "Q = V*64.000000" RAT_FUNC "%10.6" "ms" COEFFS 0 64.000000 0.000000 0 0 1.000000 /end COMPU_METHOD
/begin COMPU_METHOD RailP_DD_CM_boolean_NaN "Q = V" RAT_FUNC "%1.0" "NaN" COEFFS 0 1 0 0 0 1 /end COMPU_METHOD
/begin COMPU_METHOD RailP_DD_CM_boolean "Q = V" RAT_FUNC "%1.0" "" COEFFS 0 1 0 0 0 1 /end COMPU_METHOD
/begin COMPU_METHOD RailP_VD_CM_Press_bar1_bar "Q = V*16.000000" RAT_FUNC "%8.4" "bar" COEFFS 0 16.000000 0.000000 0 0 1.000000 /end COMPU_METHOD
/begin COMPU_METHOD RailP_VD_CM_InjMass_mg_hub "Q = V*64.000000" RAT_FUNC "%10.6" "mg/hub" COEFFS 0 64.000000 0.000000 0 0 1.000000 /end COMPU_METHOD
/begin COMPU_METHOD RailP_VD_CM_Fac_100_NaN "Q = V*256.000000" RAT_FUNC "%11.8" "NaN" COEFFS 0 256.000000 0.000000 0 0 1.000000 /end COMPU_METHOD
/begin COMPU_METHOD InjVlv_CalcET_CM_uSec4_us "Q = V*16.000000" RAT_FUNC "%13.4" "us" COEFFS 0 16.000000 0.000000 0 0 1.000000 /end COMPU_METHOD
/begin COMPU_METHOD InjVlv_CalcET_CM_InjMass_mg_hub "Q = V*64.000000" RAT_FUNC "%10.6" "mg/hub" COEFFS 0 64.000000 0.000000 0 0 1.000000 /end COMPU_METHOD
/begin COMPU_METHOD InjVlv_CalcET_CM_Press_bar1_bar "Q = V*16.000000" RAT_FUNC "%8.4" "bar" COEFFS 0 16.000000 0.000000 0 0 1.000000 /end COMPU_METHOD
/begin COMPU_METHOD InjVlv_CalcET_CM_Switch_NaN "Enumerated data type: Switch" TAB_VERB "%0.6" "NaN" COMPU_TAB_REF VTAB_FOR_InjVlv_CalcET_CM_Switch_NaN /end COMPU_METHOD
/begin COMPU_METHOD InjCrv_MI1_CM_Switch_NaN "Enumerated data type: Switch" TAB_VERB "%0.6" "NaN" COMPU_TAB_REF VTAB_FOR_InjCrv_MI1_CM_Switch_NaN /end COMPU_METHOD
/begin COMPU_METHOD InjCrv_MI1_CM_InjMass_mg_hub "Q = V*64.000000" RAT_FUNC "%10.6" "mg/hub" COEFFS 0 64.000000 0.000000 0 0 1.000000 /end COMPU_METHOD
/begin COMPU_METHOD InjCtl_qCo_CM_InjMass_mg_hub "Q = V*64.000000" RAT_FUNC "%10.6" "mg/hub" COEFFS 0 64.000000 0.000000 0 0 1.000000 /end COMPU_METHOD
/begin COMPU_METHOD T15_DD_CM_Debncd_ms_ms "Q = V*64.000000" RAT_FUNC "%10.6" "ms" COEFFS 0 64.000000 0.000000 0 0 1.000000 /end COMPU_METHOD
/begin COMPU_METHOD T15_DD_CM_Volt_mV1_mv "Q = V*4.000000" RAT_FUNC "%7.2" "mv" COEFFS 0 4.000000 0.000000 0 0 1.000000 /end COMPU_METHOD
/begin COMPU_METHOD T15_DD_CM_Switch_NaN "Enumerated data type: Switch" TAB_VERB "%0.6" "NaN" COMPU_TAB_REF VTAB_FOR_T15_DD_CM_Switch_NaN /end COMPU_METHOD
/begin COMPU_METHOD T15_DD_CM_boolean_NaN "Q = V" RAT_FUNC "%1.0" "NaN" COEFFS 0 1 0 0 0 1 /end COMPU_METHOD
/begin COMPU_METHOD APP_ChkSig_CM_Switch_NaN "Enumerated data type: Switch" TAB_VERB "%0.6" "NaN" COMPU_TAB_REF VTAB_FOR_APP_ChkSig_CM_Switch_NaN /end COMPU_METHOD
/begin COMPU_METHOD APP_ChkSig_CM_Debncd_ms_ms "Q = V*64.000000" RAT_FUNC "%10.6" "ms" COEFFS 0 64.000000 0.000000 0 0 1.000000 /end COMPU_METHOD
/begin COMPU_METHOD APP_ChkSig_CM_Percent__ "Q = V*256.000000" RAT_FUNC "%11.8" "%" COEFFS 0 256.000000 0.000000 0 0 1.000000 /end COMPU_METHOD
/begin COMPU_METHOD APP_ChkSig_CM_boolean_NaN "Q = V" RAT_FUNC "%1.0" "NaN" COEFFS 0 1 0 0 0 1 /end COMPU_METHOD
/begin COMPU_METHOD APP_DD1_CM_Debncd_ms_ms "Q = V*64.000000" RAT_FUNC "%10.6" "ms" COEFFS 0 64.000000 0.000000 0 0 1.000000 /end COMPU_METHOD
/begin COMPU_METHOD APP_DD1_CM_Fault_ID_NaN "Q = V" RAT_FUNC "%5.0" "NaN" COEFFS 0 1 0 0 0 1 /end COMPU_METHOD
/begin COMPU_METHOD APP_DD1_CM_Volt_mV1_mv "Q = V*4.000000" RAT_FUNC "%7.2" "mv" COEFFS 0 4.000000 0.000000 0 0 1.000000 /end COMPU_METHOD
/begin COMPU_METHOD APP_DD1_CM_boolean_NaN "Q = V" RAT_FUNC "%1.0" "NaN" COEFFS 0 1 0 0 0 1 /end COMPU_METHOD
/begin COMPU_METHOD APP_DD1_CM_boolean "Q = V" RAT_FUNC "%1.0" "" COEFFS 0 1 0 0 0 1 /end COMPU_METHOD
/begin COMPU_METHOD APP_DD2_CM_Debncd_ms_ms "Q = V*64.000000" RAT_FUNC "%10.6" "ms" COEFFS 0 64.000000 0.000000 0 0 1.000000 /end COMPU_METHOD
/begin COMPU_METHOD APP_DD2_CM_Fault_ID_NaN "Q = V" RAT_FUNC "%5.0" "NaN" COEFFS 0 1 0 0 0 1 /end COMPU_METHOD
/begin COMPU_METHOD APP_DD2_CM_Volt_mV1_mv "Q = V*4.000000" RAT_FUNC "%7.2" "mv" COEFFS 0 4.000000 0.000000 0 0 1.000000 /end COMPU_METHOD
/begin COMPU_METHOD APP_DD2_CM_boolean_NaN "Q = V" RAT_FUNC "%1.0" "NaN" COEFFS 0 1 0 0 0 1 /end COMPU_METHOD
/begin COMPU_METHOD APP_DD2_CM_boolean "Q = V" RAT_FUNC "%1.0" "" COEFFS 0 1 0 0 0 1 /end COMPU_METHOD
/begin COMPU_METHOD APP_SelSig_CM_Fac10_NaN "Q = V*1024.000000" RAT_FUNC "%12.10" "NaN" COEFFS 0 1024.000000 0.000000 0 0 1.000000 /end COMPU_METHOD
/begin COMPU_METHOD APP_SelSig_CM_Volt_mV1_mv "Q = V*4.000000" RAT_FUNC "%7.2" "mv" COEFFS 0 4.000000 0.000000 0 0 1.000000 /end COMPU_METHOD
/begin COMPU_METHOD APP_SelSig_CM_Volt_mV_s2_mv_s "Q = V" RAT_FUNC "%5.0" "mv/s" COEFFS 0 1 0 0 0 1 /end COMPU_METHOD
/begin COMPU_METHOD APP_SelSig_CM_boolean_NaN "Q = V" RAT_FUNC "%1.0" "NaN" COEFFS 0 1 0 0 0 1 /end COMPU_METHOD
/begin COMPU_METHOD APP_VD_CM_Percent__ "Q = V*256.000000" RAT_FUNC "%11.8" "%" COEFFS 0 256.000000 0.000000 0 0 1.000000 /end COMPU_METHOD
/begin COMPU_METHOD APP_VD_CM_Volt_mV1_mv "Q = V*4.000000" RAT_FUNC "%7.2" "mv" COEFFS 0 4.000000 0.000000 0 0 1.000000 /end COMPU_METHOD
/begin COMPU_METHOD APP_VD_CM_Switch_NaN "Enumerated data type: Switch" TAB_VERB "%0.6" "NaN" COMPU_TAB_REF VTAB_FOR_APP_VD_CM_Switch_NaN /end COMPU_METHOD
/begin COMPU_METHOD APP_VD_CM_Fac_100_NaN "Q = V*256.000000" RAT_FUNC "%11.8" "NaN" COEFFS 0 256.000000 0.000000 0 0 1.000000 /end COMPU_METHOD
/begin COMPU_METHOD APP_VD_CM_Percent_s___s "Q = V*64.000000" RAT_FUNC "%10.6" "%/s" COEFFS 0 64.000000 0.000000 0 0 1.000000 /end COMPU_METHOD
/begin COMPU_METHOD APP_VD_CM_boolean_NaN "Q = V" RAT_FUNC "%1.0" "NaN" COEFFS 0 1 0 0 0 1 /end COMPU_METHOD
/begin COMPU_METHOD APP_VD_CM_Percent_s___ms "Q = V*64.000000" RAT_FUNC "%10.6" "%/ms" COEFFS 0 64.000000 0.000000 0 0 1.000000 /end COMPU_METHOD
/begin COMPU_METHOD AccPed_DrvDemDes_CM_Torq_Nm "Q = V*8.000000" RAT_FUNC "%7.3" "Nm" COEFFS 0 8.000000 0.000000 0 0 1.000000 /end COMPU_METHOD
/begin COMPU_METHOD AccPed_DrvDemDes_CM_ERPM_rpm "Q = V*2.000000" RAT_FUNC "%6.1" "rpm" COEFFS 0 2.000000 0.000000 0 0 1.000000 /end COMPU_METHOD
/begin COMPU_METHOD AccPed_DrvDemDes_CM_Percent__ "Q = V*256.000000" RAT_FUNC "%11.8" "%" COEFFS 0 256.000000 0.000000 0 0 1.000000 /end COMPU_METHOD
/begin COMPU_METHOD AccPed_DrvDemDes_CM_Switch_NaN "Enumerated data type: Switch" TAB_VERB "%0.6" "NaN" COMPU_TAB_REF VTAB_FOR_AccPed_DrvDemDes_CM_Switch_NaN /end COMPU_METHOD
/begin COMPU_METHOD VehCo_VehDem_CM_Torq_Nm "Q = V*8.000000" RAT_FUNC "%7.3" "Nm" COEFFS 0 8.000000 0.000000 0 0 1.000000 /end COMPU_METHOD
/begin COMPU_VTAB VTAB_FOR_CEngDsT_VD_CM_Switch_NaN "Enumerated data type: Switch" TAB_VERB 2 0 "Switch_OFF" 1 "Switch_ON" /end COMPU_VTAB
/begin COMPU_VTAB VTAB_FOR_InjVlv_CalcET_CM_Switch_NaN "Enumerated data type: Switch" TAB_VERB 2 0 "Switch_OFF" 1 "Switch_ON" /end COMPU_VTAB
/begin COMPU_VTAB VTAB_FOR_InjCrv_MI1_CM_Switch_NaN "Enumerated data type: Switch" TAB_VERB 2 0 "Switch_OFF" 1 "Switch_ON" /end COMPU_VTAB
/begin COMPU_VTAB VTAB_FOR_T15_DD_CM_Switch_NaN "Enumerated data type: Switch" TAB_VERB 2 0 "Switch_OFF" 1 "Switch_ON" /end COMPU_VTAB
/begin COMPU_VTAB VTAB_FOR_APP_ChkSig_CM_Switch_NaN "Enumerated data type: Switch" TAB_VERB 2 0 "Switch_OFF" 1 "Switch_ON" /end COMPU_VTAB
/begin COMPU_VTAB VTAB_FOR_APP_VD_CM_Switch_NaN "Enumerated data type: Switch" TAB_VERB 2 0 "Switch_OFF" 1 "Switch_ON" /end COMPU_VTAB
/begin COMPU_VTAB VTAB_FOR_AccPed_DrvDemDes_CM_Switch_NaN "Enumerated data type: Switch" TAB_VERB 2 0 "Switch_OFF" 1 "Switch_ON" /end COMPU_VTAB
/begin GROUP ASW "ASW" /* Root */ ROOT /begin SUB_GROUP /*Root_Overview*/ /end SUB_GROUP /end GROUP
/begin GROUP CEngDsT_DD "CEngDsT_DD" /begin SUB_GROUP Root_Overview /end SUB_GROUP /begin REF_MEASUREMENT CEngDsT_uRaw FM_All_Fault_Status_Array /end REF_MEASUREMENT /end GROUP
/begin GROUP Root_Overview "CEngDsT_DD/Overview" /begin SUB_GROUP S1_CEngDsT_DD /end SUB_GROUP /end GROUP
/begin GROUP S1_CEngDsT_DD "CEngDsT_DD/Overview/CEngDsT_DD" /begin SUB_GROUP S2_PRC_Debounce S2_SRC_Debounce S2_U2T_Cnv /end SUB_GROUP /end GROUP
/begin GROUP S2_PRC_Debounce "CEngDsT_DD/Overview/CEngDsT_DD/PRC_Debounce" /begin SUB_GROUP S3_FM_T S3_FM_T1 /end SUB_GROUP
 /begin REF_CHARACTERISTIC CEngDsT_MaxCoolTemp CEngDsT_MinCoolTemp CEngDsT_tiPhysRngHiDefDeb_C CEngDsT_tiPhysRngHiOKDeb_C CEngDsT_tiPhysRngLoDefDeb_C CEngDsT_tiPhysRngLoOKDeb_C /end REF_CHARACTERISTIC
 /begin REF_MEASUREMENT CEngDsT_bPhysRngFinalDef CEngDsT_bPhysRngHi CEngDsT_bPhysRngLo CEngDsT_bPhysRngProvDef /end REF_MEASUREMENT
/end GROUP
/begin GROUP S2_SRC_Debounce "CEngDsT_DD/Overview/CEngDsT_DD/SRC_Debounce" /begin SUB_GROUP S4_FM_frz_T S4_FM_frz_T1 /end SUB_GROUP
 /begin REF_CHARACTERISTIC CEngDsT_tiMaxDefDeb_C CEngDsT_tiMaxOKDeb_C CEngDsT_tiMinDefDeb_C CEngDsT_tiMinOKDeb_C CEngDsT_uSRCMax_C CEngDsT_uSRCMin_C FM_CEngDsT_SRC_FG_CA /end REF_CHARACTERISTIC
 /begin REF_MEASUREMENT CEngDsT_bFinalDef CEngDsT_bProvDef CEngDsT_bSRCMax CEngDsT_bSRCMin /end REF_MEASUREMENT
/end GROUP
/begin GROUP S2_U2T_Cnv "CEngDsT_DD/Overview/CEngDsT_DD/U2T_Cnv" /begin REF_CHARACTERISTIC CEngDsT_tTransf_CUR /end REF_CHARACTERISTIC /begin REF_MEASUREMENT CEngDsT_tSens /end REF_MEASUREMENT /end GROUP
/begin GROUP S3_FM_T "CEngDsT_DD/Overview/CEngDsT_DD/PRC_Debounce/FM_T" /begin REF_MEASUREMENT CEngDsT_bPhysRngHiDeb_DSM /end REF_MEASUREMENT /end GROUP
/begin GROUP S3_FM_T1 "CEngDsT_DD/Overview/CEngDsT_DD/PRC_Debounce/FM_T1" /begin REF_MEASUREMENT CEngDsT_bPhysRngLoDeb_DSM /end REF_MEASUREMENT /end GROUP
/begin GROUP S4_FM_frz_T "CEngDsT_DD/Overview/CEngDsT_DD/SRC_Debounce/FM_frz_T" /begin REF_MEASUREMENT CEngDsT_bSRCMaxDeb_DSM /end REF_MEASUREMENT /end GROUP
/begin GROUP S4_FM_frz_T1 "CEngDsT_DD/Overview/CEngDsT_DD/SRC_Debounce/FM_frz_T1" /begin REF_MEASUREMENT CEngDsT_bSRCMinDeb_DSM /end REF_MEASUREMENT /end GROUP
/begin GROUP CEngDsT_VD "CEngDsT_VD" /begin SUB_GROUP Root_Overview1 /end SUB_GROUP
 /begin REF_MEASUREMENT CEngDsT_bFinalDef CEngDsT_bPhysRngFinalDef CEngDsT_bPhysRngProvDef CEngDsT_bProvDef CEngDsT_tSens /end REF_MEASUREMENT
/end GROUP
/begin GROUP Root_Overview1 "CEngDsT_VD/Overview" /begin SUB_GROUP S1_CEngDsT_VD /end SUB_GROUP /end GROUP
/begin GROUP S1_CEngDsT_VD "CEngDsT_VD/Overview/CEngDsT_VD" /begin SUB_GROUP S2_LowPassK_R /end SUB_GROUP
 /begin REF_CHARACTERISTIC CEngDsT_RmpSlpNeg_C CEngDsT_RmpSlpPos_C CEngDsT_facSerPT1_C CEngDsT_tDflWarm_C SigTst_swtCEngDsT_C SigTst_tCEngDsT_C /end REF_CHARACTERISTIC
 /begin REF_MEASUREMENT CEngDsT_t Epm_nEng /end REF_MEASUREMENT
/end GROUP
/begin GROUP S2_LowPassK_R "CEngDsT_VD/Overview/CEngDsT_VD/LowPassK_R" /begin REF_MEASUREMENT CEngDsT_tSensFlt /end REF_MEASUREMENT /end GROUP
/begin GROUP PthSet_TrqCalc "PthSet_TrqCalc" /begin SUB_GROUP Root_Overview2 /end SUB_GROUP /begin REF_MEASUREMENT CoVeh_trqDes /end REF_MEASUREMENT /end GROUP
/begin GROUP Root_Overview2 "PthSet_TrqCalc/Overview" /begin SUB_GROUP S1_PthSet_TrqCalc /end SUB_GROUP /end GROUP
/begin GROUP S1_PthSet_TrqCalc "PthSet_TrqCalc/Overview/PthSet_TrqCalc" /begin REF_MEASUREMENT PthSet_trqInrSet /end REF_MEASUREMENT /end GROUP
/begin GROUP CnvSet_Trq2Q "CnvSet_Trq2Q" /begin SUB_GROUP Root_Overview3 /end SUB_GROUP /begin REF_MEASUREMENT Epm_nEng PthSet_trqInrSet /end REF_MEASUREMENT /end GROUP
/begin GROUP Root_Overview3 "CnvSet_Trq2Q/Overview" /begin SUB_GROUP S1_CnvSet_Trq2Q /end SUB_GROUP /end GROUP
/begin GROUP S1_CnvSet_Trq2Q "CnvSet_Trq2Q/Overview/CnvSet_Trq2Q" /begin REF_CHARACTERISTIC PhyMod_trq2qBas_MAP /end REF_CHARACTERISTIC /begin REF_MEASUREMENT CnvSet_qSet /end REF_MEASUREMENT /end GROUP
/begin GROUP RailP_DD "RailP_DD" /begin SUB_GROUP Root_Overview4 /end SUB_GROUP /begin REF_MEASUREMENT FM_All_Fault_Status_Array RailP_uRaw /end REF_MEASUREMENT /end GROUP
/begin GROUP Root_Overview4 "RailP_DD/Overview" /begin SUB_GROUP S1_RailP_DD /end SUB_GROUP /end GROUP
/begin GROUP S1_RailP_DD "RailP_DD/Overview/RailP_DD"
 /begin REF_CHARACTERISTIC RailP_pLin_CUR RailP_tiSRCMaxDefDeb_C RailP_tiSRCMaxOKDeb_C RailP_tiSRCMinDefDeb_C RailP_tiSRCMinOKDeb_C RailP_uSRCMax_C RailP_uSRCMin_C /end REF_CHARACTERISTIC
 /begin REF_MEASUREMENT RailP_bFinalDef RailP_bProvDef RailP_pLin /end REF_MEASUREMENT
/end GROUP
/begin GROUP RailP_VD "RailP_VD" /begin SUB_GROUP Root_Overview5 /end SUB_GROUP /begin REF_MEASUREMENT InjCtl_qSetUnBal RailP_pLin /end REF_MEASUREMENT /end GROUP
/begin GROUP Root_Overview5 "RailP_VD/Overview" /begin SUB_GROUP S1_RailP_VD /end SUB_GROUP /end GROUP
/begin GROUP S1_RailP_VD "RailP_VD/Overview/RailP_VD"
 /begin REF_CHARACTERISTIC RailP_facFlt1PT1_C RailP_facFlt2PT1_C RailP_facFlt3PT1_C RailP_pFltWinNeg_CUR /end REF_CHARACTERISTIC
 /begin REF_MEASUREMENT RailP_facFltPT1_mp /end REF_MEASUREMENT
/end GROUP
/begin GROUP InjVlv_CalcET "InjVlv_CalcET" /begin SUB_GROUP Root_Overview6 /end SUB_GROUP /begin REF_MEASUREMENT InjCrv_qMI1Des RailP_pFlt T15_st /end REF_MEASUREMENT /end GROUP
/begin GROUP Root_Overview6 "InjVlv_CalcET/Overview" /begin SUB_GROUP S1_InjVlv_CalcET /end SUB_GROUP /end GROUP
/begin GROUP S1_InjVlv_CalcET "InjVlv_CalcET/Overview/InjVlv_CalcET" /begin REF_CHARACTERISTIC InjVlv_tiET_MAP SigTst_swtMI1ET_C SigTst_tiMI1ET_C /end REF_CHARACTERISTIC /begin REF_MEASUREMENT InjCrv_tiMI1ET InjVlv_tiETMI1NoCor_mp /end REF_MEASUREMENT /end GROUP
/begin GROUP InjCrv_MI1 "InjCrv_MI1" /begin SUB_GROUP Root_Overview7 /end SUB_GROUP /begin REF_MEASUREMENT InjCtl_qSetUnBal /end REF_MEASUREMENT /end GROUP
/begin GROUP Root_Overview7 "InjCrv_MI1/Overview" /begin SUB_GROUP S1_InjCrv_MI1 /end SUB_GROUP /end GROUP
/begin GROUP S1_InjCrv_MI1 "InjCrv_MI1/Overview/InjCrv_MI1" /begin REF_CHARACTERISTIC SigTst_qMI1_C SigTst_swtMI1Q_C /end REF_CHARACTERISTIC /begin REF_MEASUREMENT InjCrv_qMI1Des /end REF_MEASUREMENT /end GROUP
/begin GROUP InjCtl_qCo "InjCtl_qCo" /begin SUB_GROUP Root_Overview8 /end SUB_GROUP /begin REF_MEASUREMENT CnvSet_qSet /end REF_MEASUREMENT /end GROUP
/begin GROUP Root_Overview8 "InjCtl_qCo/Overview" /begin SUB_GROUP S1_InjCtl_qCo /end SUB_GROUP /end GROUP
/begin GROUP S1_InjCtl_qCo "InjCtl_qCo/Overview/InjCtl_qCo" /begin REF_MEASUREMENT InjCtl_qSetUnBal /end REF_MEASUREMENT /end GROUP
/begin GROUP T15_DD "T15_DD" /begin SUB_GROUP Root_Overview9 /end SUB_GROUP /begin REF_MEASUREMENT T15_uRaw /end REF_MEASUREMENT /end GROUP
/begin GROUP Root_Overview9 "T15_DD/Overview" /begin SUB_GROUP S1_T15_DD /end SUB_GROUP /end GROUP
/begin GROUP S1_T15_DD "T15_DD/Overview/T15_DD" /begin REF_CHARACTERISTIC T15_tiDebHiLo_C T15_tiDebLoHi_C T15_uThreshold_C /end REF_CHARACTERISTIC /begin REF_MEASUREMENT T15_st T15_stRaw /end REF_MEASUREMENT /end GROUP
/begin GROUP APP_ChkSig "APP_ChkSig" /begin SUB_GROUP Root_Overview10 /end SUB_GROUP /begin REF_MEASUREMENT APP_rFlt_mp APP_stSigSrc_APP1_BP APP_stSigSrc_APP2_BP /end REF_MEASUREMENT /end GROUP
/begin GROUP Root_Overview10 "APP_ChkSig/Overview" /begin SUB_GROUP S1_APP_ChkSig /end SUB_GROUP /end GROUP
/begin GROUP S1_APP_ChkSig "APP_ChkSig/Overview/APP_ChkSig" /begin SUB_GROUP S2_Live_Detection /end SUB_GROUP /end GROUP
/begin GROUP S2_Live_Detection "APP_ChkSig/Overview/APP_ChkSig/Live_Detection"
 /begin REF_CHARACTERISTIC APP_rThresAliveDet_C APP_swtAliveDetEna_C APP_tiAliveDebHiLo_C APP_tiAliveDebLoHi_C /end REF_CHARACTERISTIC
 /begin REF_MEASUREMENT APP_r /end REF_MEASUREMENT
/end GROUP
/begin GROUP APP_DD1 "APP_DD1" /begin SUB_GROUP Root_Overview11 /end SUB_GROUP /begin REF_MEASUREMENT APP_uRaw1unLim FM_All_Fault_Status_Array /end REF_MEASUREMENT /end GROUP
/begin GROUP Root_Overview11 "APP_DD1/Overview" /begin SUB_GROUP S1_APP_DD1 /end SUB_GROUP /end GROUP
/begin GROUP S1_APP_DD1 "APP_DD1/Overview/APP_DD1" /begin SUB_GROUP S2_DSM_Check S2_Error_Reaction_ /end SUB_GROUP /end GROUP
/begin GROUP S2_DSM_Check "APP_DD1/Overview/APP_DD1/DSM_Check" /begin SUB_GROUP S3_FM_frz_T S3_FM_frz_T1 /end SUB_GROUP
 /begin REF_CHARACTERISTIC APP_tiSRCHighDefDeb_C APP_tiSRCHighOKDeb_C APP_tiSRCLowDefDeb_C APP_tiSRCLowOKDeb_C APP_uRaw1SRCHigh_C APP_uRaw1SRCLow_C FM_APP1_SRC_FG_CA /end REF_CHARACTERISTIC
 /begin REF_MEASUREMENT APP_bAPP1FinalDef APP_bSRCHigh1 APP_bSRCLow1 /end REF_MEASUREMENT
/end GROUP
/begin GROUP S2_Error_Reaction_ "APP_DD1/Overview/APP_DD1/Error_Reaction " /begin REF_CHARACTERISTIC APP_uRaw1Def_C /end REF_CHARACTERISTIC /begin REF_MEASUREMENT APP_bAPP1ProvDef APP_uRaw1 /end REF_MEASUREMENT /end GROUP
/begin GROUP S3_FM_frz_T "APP_DD1/Overview/APP_DD1/DSM_Check/FM_frz_T" /begin REF_MEASUREMENT APP_bSRCHigh1Deb_DSM /end REF_MEASUREMENT /end GROUP
/begin GROUP S3_FM_frz_T1 "APP_DD1/Overview/APP_DD1/DSM_Check/FM_frz_T1" /begin REF_MEASUREMENT APP_bSRCLow1Deb_DSM /end REF_MEASUREMENT /end GROUP
/begin GROUP APP_DD2 "APP_DD2" /begin SUB_GROUP Root_Overview12 /end SUB_GROUP /begin REF_MEASUREMENT APP_uRaw2unLim FM_All_Fault_Status_Array /end REF_MEASUREMENT /end GROUP
/begin GROUP Root_Overview12 "APP_DD2/Overview" /begin SUB_GROUP S1_APP_DD2 /end SUB_GROUP /end GROUP
/begin GROUP S1_APP_DD2 "APP_DD2/Overview/APP_DD2" /begin SUB_GROUP S2_DSM_Check1 S2_Error_Reaction /end SUB_GROUP /end GROUP
/begin GROUP S2_DSM_Check1 "APP_DD2/Overview/APP_DD2/DSM_Check" /begin SUB_GROUP S3_FM_frz_T2 S3_FM_frz_T11 /end SUB_GROUP
 /begin REF_CHARACTERISTIC APP_tiSRCHighDefDeb2_C APP_tiSRCHighOKDeb2_C APP_tiSRCLowDefDeb2_C APP_tiSRCLowOKDeb2_C APP_uRaw2SRCHigh_C APP_uRaw2SRCLow_C FM_APP2_SRC_FG_CA /end REF_CHARACTERISTIC
 /begin REF_MEASUREMENT APP_bAPP2FinalDef /end REF_MEASUREMENT
/end GROUP
/begin GROUP S2_Error_Reaction "APP_DD2/Overview/APP_DD2/Error_Reaction" /begin REF_CHARACTERISTIC APP_uRaw2Def_C /end REF_CHARACTERISTIC /begin REF_MEASUREMENT APP_bAPP2ProvDef APP_uRaw2 /end REF_MEASUREMENT /end GROUP
/begin GROUP S3_FM_frz_T2 "APP_DD2/Overview/APP_DD2/DSM_Check/FM_frz_T" /begin REF_MEASUREMENT APP_bSRCHigh2Deb_DSM /end REF_MEASUREMENT /end GROUP
/begin GROUP S3_FM_frz_T11 "APP_DD2/Overview/APP_DD2/DSM_Check/FM_frz_T1" /begin REF_MEASUREMENT APP_bSRCLow2Deb_DSM /end REF_MEASUREMENT /end GROUP
/begin GROUP APP_SelSig "APP_SelSig" /begin SUB_GROUP Root_Overview13 /end SUB_GROUP
 /begin REF_MEASUREMENT APP_bAPP1FinalDef APP_bAPP1ProvDef APP_bAPP2FinalDef APP_bAPP2ProvDef APP_uRaw1 APP_uRaw2 /end REF_MEASUREMENT
/end GROUP
/begin GROUP Root_Overview13 "APP_SelSig/Overview" /begin SUB_GROUP S1_APP_SelSig /end SUB_GROUP /end GROUP
/begin GROUP S1_APP_SelSig "APP_SelSig/Overview/APP_SelSig" /begin SUB_GROUP S2_Estimate_Reference_Mode S2_Signal_Selection /end SUB_GROUP /end GROUP
/begin GROUP S2_Estimate_Reference_Mode "APP_SelSig/Overview/APP_SelSig/Estimate_Reference_Mode"
 /begin REF_MEASUREMENT APP_stSigSrc_APP1_BP APP_stSigSrc_APP2_BP APP_stSigSrc_APPDEF_BP APP_stSigSrc_APPLIMP_BP /end REF_MEASUREMENT
/end GROUP
/begin GROUP S2_Signal_Selection "APP_SelSig/Overview/APP_SelSig/Signal_Selection"
 /begin REF_CHARACTERISTIC APP_duLimErrPos_C APP_uAPPDef_C APP_uRaw2Offset_C MoFAPP_dRawSigFac_C /end REF_CHARACTERISTIC
 /begin REF_MEASUREMENT APP_stTempErr_mp APP_uRaw_mp /end REF_MEASUREMENT
/end GROUP
/begin GROUP APP_VD "APP_VD" /begin SUB_GROUP Root_Overview14 /end SUB_GROUP /begin REF_MEASUREMENT APP_stSigSrc_APPDEF_BP APP_stSigSrc_APPLIMP_BP APP_uRaw_mp /end REF_MEASUREMENT /end GROUP
/begin GROUP Root_Overview14 "APP_VD/Overview" /begin SUB_GROUP S1_APP_VD /end SUB_GROUP /end GROUP
/begin GROUP S1_APP_VD "APP_VD/Overview/APP_VD" /begin SUB_GROUP S2_APP_UnJit S2_Linearisation S2_Signal_Filter /end SUB_GROUP /end GROUP
/begin GROUP S2_APP_UnJit "APP_VD/Overview/APP_VD/APP_UnJit" /begin REF_CHARACTERISTIC APP_swtEnaUnJit_C APP_uJitter_C /end REF_CHARACTERISTIC /begin REF_MEASUREMENT APP_uUnJit_mp /end REF_MEASUREMENT /end GROUP
/begin GROUP S2_Linearisation "APP_VD/Overview/APP_VD/Linearisation" /begin SUB_GROUP S4_APP_rUnFlt_inl S4_dt2s /end SUB_GROUP /begin REF_CHARACTERISTIC MoFAPP_rLinAPPCURCalMsgA_CUR SigTst_rAPP_C SigTst_swtAPP_C /end REF_CHARACTERISTIC /begin REF_MEASUREMENT APP_rLinAPP_mp APP_rUnFlt /end REF_MEASUREMENT /end GROUP
/begin GROUP S2_Signal_Filter "APP_VD/Overview/APP_VD/Signal_Filter" /begin SUB_GROUP S5_Filter_parameter_selection /end SUB_GROUP /begin REF_CHARACTERISTIC APP_swtEnaFlt_C /end REF_CHARACTERISTIC /begin REF_MEASUREMENT APP_rFlt_mp /end REF_MEASUREMENT /end GROUP
/begin GROUP S4_APP_rUnFlt_inl "APP_VD/Overview/APP_VD/Linearisation/APP_rUnFlt_inl" /begin REF_CHARACTERISTIC APP_drLinRmp_C /end REF_CHARACTERISTIC /begin REF_MEASUREMENT APP_rUnFlt_mp /end REF_MEASUREMENT /end GROUP
/begin GROUP S4_dt2s "APP_VD/Overview/APP_VD/Linearisation/dt2s" /begin REF_MEASUREMENT APP_drUnFlt /end REF_MEASUREMENT /end GROUP
/begin GROUP S5_Filter_parameter_selection "APP_VD/Overview/APP_VD/Signal_Filter/Filter_parameter_selection"
 /begin REF_CHARACTERISTIC APP_facLowNegPT1_C APP_facLowPosPT1_C APP_facMidNegPT1_C APP_facMidPosPT1_C APP_facUppNegPT1_C APP_facUppPosPT1_C APP_rThrFltLowNeg_C APP_rThrFltLowPos_C APP_rThrFltMidNeg_C APP_rThrFltMidPos_C /end REF_CHARACTERISTIC
 /begin REF_MEASUREMENT APP_facPT1 /end REF_MEASUREMENT
/end GROUP
/begin GROUP AccPed_DrvDemDes "AccPed_DrvDemDes" /begin SUB_GROUP Root_Overview15 /end SUB_GROUP /begin REF_MEASUREMENT APP_r Epm_nEng /end REF_MEASUREMENT /end GROUP
/begin GROUP Root_Overview15 "AccPed_DrvDemDes/Overview" /begin SUB_GROUP S1_AccPed_DrvDemDes /end SUB_GROUP /end GROUP
/begin GROUP S1_AccPed_DrvDemDes "AccPed_DrvDemDes/Overview/AccPed_DrvDemDes" /begin REF_CHARACTERISTIC MoFDrDem_trqEng_MAP SigTst_swtAccPed_C SigTst_trqAccPed_C /end REF_CHARACTERISTIC /begin REF_MEASUREMENT AccPed_trqDesAct AccPed_trqDesPull /end REF_MEASUREMENT /end GROUP
/begin GROUP VehCo_VehDem "VehCo_VehDem" /begin SUB_GROUP Root_Overview16 /end SUB_GROUP /begin REF_MEASUREMENT AccPed_trqDesAct /end REF_MEASUREMENT /end GROUP
/begin GROUP Root_Overview16 "VehCo_VehDem/Overview" /begin SUB_GROUP S1_VehCo_VehDem /end SUB_GROUP /end GROUP
/begin GROUP S1_VehCo_VehDem "VehCo_VehDem/Overview/VehCo_VehDem" /begin REF_MEASUREMENT CoVeh_trqDes /end REF_MEASUREMENT /end GROUP
/end MODULE
/end PROJECT
/* (add any file trailer comments here) */
/* EOF ASW.a2l */
